AUTOSAR XML (schema 4-0-3)
package /MICROSAR
  module config CanIf_Rec: definition=CanIf
    CanIfPublicCfg: CanIfSafeBswChecks=1
