AUTOSAR XML (schema 4-0-3)
# COPYRIGHT
# Copyright (c) 2024 by Vector Informatik GmbH. All rights reserved.
# This software is copyright protected and proprietary to Vector Informatik GmbH.
# Vector Informatik GmbH grants to you only those rights as set out in the license conditions.
package /MICROSAR
  module definition CanIf [0..1]: category=VENDOR_SPECIFIC_MODULE_DEFINITION, refined-module-def=CanIf, variants post-build-loadable/pre-compile/post-build-selectable  # CAN Interface | The CAN Interface provides a hardware independent standardized interface to the CAN Drivers and CAN Transceiver Drivers. It abstracts the CAN communication handling for the upper layer modules. #CAN #AUTOSAR
    container CanIfCtrlDrvCfg [1..*]  # Controller Driver Cfg | Configuration parameters for all the underlying CAN driver modules are aggregated under this container. For each CAN driver module a seperate instance of this container has to be provided.
      boolean CanIfCtrlDrvTxCancellation: set at pre-compile, default-value=false  # Controller Driver Tx Cancellation | This parameter switches whether transmit cancellation is supported and if the appropriate callback will be provided to the CAN driver module. true: Transmit cancellation is supported. false: Transmit cancellation is not supported. RESTRICTIONS: This feature works only if parameter 'CanIfPublicTxBuffering' is enabled.
      enumeration CanIfCtrlDrvArVersion: set at pre-compile, origin=Vector Informatik, default-value=CAN_DRV_EQC_MSRC  # CAN Driver AUTOSAR version | AUTOSAR release version the referenced CAN Driver module is based on. The AUTOSAR release versions are clustered in the following equivalence classes (EQCs): CAN_DRV_EQC_MSRC: MICROSAR Classic CAN Driver CAN_DRV_EQC_AR_403: Third party CAN Driver is based on AUTOSAR release version 4.0.3 CAN_DRV_EQC_AR_421: Third party CAN Driver is based on AUTOSAR release version 4.2.1, 4.2.2 or 4.3.0 CAN_DRV_EQC_AR_431: Third party CAN Driver is based on AUTOSAR release version 4.3.1, 4.4.0, R19-11, R20-11, R21-11 or R22-11 NOTE: If a underlying MICROSAR Classic CAN Driver is detected, this parameter is correspondly set and locked by validation.
        CAN_DRV_EQC_MSRC  # CAN_DRIVER_EQUIVALENCE_CLASS_MICROSAR_CLASSIC
        CAN_DRV_EQC_AR_403  # CAN_DRIVER_EQUIVALENCE_CLASS_AUTOSAR_RELEASE_VERSION_403
        CAN_DRV_EQC_AR_421  # CAN_DRIVER_EQUIVALENCE_CLASS_AUTOSAR_RELEASE_VERSION_421
        CAN_DRV_EQC_AR_431  # CAN_DRIVER_EQUIVALENCE_CLASS_AUTOSAR_RELEASE_VERSION_431
      reference CanIfCtrlDrvInitHohConfigRef: set at pre-compile, destination=CanIfInitHohCfg  # NOT used. This parameter references the Init Hoh Configuration of corresponding CAN driver module.
      reference CanIfCtrlDrvNameRef: set at pre-compile, destination=CanGeneral  # This parameter references the CAN driver module. This reference can be used to get any information (Ex. Driver Name, Vendor ID) from the CAN driver module. The CAN driver module name can be derived from the ShortName of the CAN driver module.
      container CanIfCtrlCfg [0..*]  # Controller Cfg | This container contains the configuration (parameters) of an adressed CAN controller by an underlying CAN driver module. This container is configurable per CAN controller.
        integer CanIfCtrlId: 0..255, set at pre-compile, symbolic-name-value=true, default-value=0  # Controller Id | This parameter abstracts from the CAN driver module specific parameter 'CanControllerId'. Each controller of all connected CAN driver modules shall be assigned to one specific 'CanIfCtrlId' of the CAN Interface module. Range: 0..number of configured controllers of all CAN driver modules NOTE: The value of this parameter is calculated and set automatically by the generation tool DaVinci Configurator 5.
        boolean CanIfCtrlWakeupSupport: set at pre-compile in variant post-build-loadable+pre-compile / post-build in variant post-build-selectable, default-value=false  # Controller Wakeup Support | This parameter defines if a respective controller of the referenced CAN driver modules is queriable for wake up events. true: Controller is queriable for wake up events. false: Controller is not queriable for wake up events.
        integer CanIfDoubleHashRandom1 [0..1]: 0..4294967295, set at post-build in variant post-build-loadable+post-build-selectable / pre-compile in variant pre-compile, origin=Vector Informatik, default-value=0  # Random number which is used for search algorithm "DOUBLEHASH". NOTE: This parameter is not editable and is calculated and set automatically by the generation tool DaVinci Configurator 5.
        integer CanIfDoubleHashRandom2 [0..1]: 0..4294967295, set at post-build in variant post-build-loadable+post-build-selectable / pre-compile in variant pre-compile, origin=Vector Informatik, default-value=0  # Random number which is used for search algorithm "DOUBLEHASH". NOTE: This parameter is not editable and is calculated and set automatically by the generation tool DaVinci Configurator 5.
        enumeration CanIfCtrlJ1939DynAddrSupport: set at post-build in variant post-build-loadable+post-build-selectable / pre-compile in variant pre-compile, origin=Vector Informatik, default-value=DISABLED  # Controller J1939 Dynamic Address Support | If enabled, the CAN Interface module translates addresses of corresponding CAN controller according to J1939 using dynamic address lookup tables. These tables are maintained by J1939Nm. DISABLED: Feature is disabled. EXTENDED_CANID: Feature is enabled. Only addresses of CAN messages with 29bit extended CAN identifiers are translated. MIXED_CANID: Feature is enabled. Addresses of CAN messages with 11bit standard and 29bit extended CAN identifiers are translated. Dependent on setting of "CanIfCtrlJ1939DynAddrSupport" the Rx filter settings of corresponding CAN channel within the CanDrv shall be validated: - DISABLED: the Rx filter shall NOT be validated - EXTENDED_CANID: the last two bytes (LSB) of each extended CanId Rx filter shall be set to don't care - MIXED_CANID: the last two bytes (LSB) of each extended CanId Rx filter shall be set to don't care, the last byte (LSB) of each standard CanId Rx filter shall be set to don't care
          DISABLED  # Feature disabled
          EXTENDED_CANID  # Only extended CAN IDs
          MIXED_CANID  # Extended and standard CAN IDs
        symbolic name reference CanIfCtrlCanCtrlRef: set at pre-compile, destination=CanController  # Controller Can Controller Ref | This parameter references to the logical handle of the underlying CAN controller from the CAN driver module to be served by the CAN Interface module. The following parameters of CAN controller config container shall be referenced by this link: CanControllerId, CanWakeupSourceRef Range: 0..max. number of underlying supported CAN controllers
        reference CanIfCtrlTrcvCfgRef [0..1]: set at pre-compile in variant post-build-loadable+pre-compile / post-build in variant post-build-selectable, origin=Vector Informatik, destination=CanIfTrcvCfg  # Controller Transceiver Cfg Ref | This parameter references the CAN transceiver which is connected to current CAN controller.
        reference CanIfEcucPartitionRef [0..1]: set at pre-compile, origin=Vector Informatik, destination=EcucPartition  # This parameter references the partition which handles this CAN controller.
    container CanIfDispatchCfg  # In this container callback functions are defined which are provided by upper layer modules of the CAN Interface module. The callback functions defined in this container are common for all configured CAN driver/CAN transceiver driver modules.
      function name CanIfDispatchUserCheckTrcvWakeFlagIndicationName [0..1]: set at pre-compile, default-value=CanSM_CheckTransceiverWakeFlagIndication  # User Check Trcv Wake Flag Indication Name | This parameter defines the name of <User_CheckTrcvWakeFlagIndication>. If value of parameter 'CanIfDispatchUserCheckTrcvWakeFlagIndicationUL' equals 'CAN_SM' the name of <User_CheckTrcvWakeFlagIndication> is fixed. If it equals 'CDD' the name is selectable. If CanIfPublicPnSupport equals False, this parameter shall not be configurable. NOTE: If feature 'Pn Trcv Handling Support' (see parameter 'CanIfPnTrcvHandlingSupport') is disabled this parameter must not be configured and may be deleted. The specified function must have following signature: void <name> (uint8 TransceiverId).
      enumeration CanIfDispatchUserCheckTrcvWakeFlagIndicationUL [0..1]: {CAN_SM, CDD}, set at pre-compile, default-value=CAN_SM  # User Check Trcv Wake Flag Indication UL | This parameter defines the upper layer module to which the 'CheckTrcvWakeFlagIndication' from the CAN transceiver driver modules have to be routed. If CANIF_PUBLIC_PN_SUPPORT equals False, this parameter shall not be configurable. NOTE: If feature 'Pn Trcv Handling Support' (see parameter 'CanIfPnTrcvHandlingSupport') is disabled this parameter must not be configured and may be deleted.
      function name CanIfDispatchUserClearTrcvWufFlagIndicationName [0..1]: set at pre-compile, default-value=CanSM_ClearTrcvWufFlagIndication  # User Clear Trcv Wuf Flag Indication Name | This parameter defines the name of <User_ClearTrcvWufFlagIndication>. If the value of 'CanIfDispatchUserClearTrcvWufFlagIndicationUL' equals 'CAN_SM' the name of <User_ClearTrcvWufFlagIndication> is fixed. If it equals 'CDD' the name is selectable. If CanIfPublicPnSupport equals False, this parameter shall not be configurable. NOTE: If feature 'Pn Trcv Handling Support' (see parameter 'CanIfPnTrcvHandlingSupport') is disabled this parameter must not be configured and may be deleted. The specified function must have following signature: void <name> (uint8 TransceiverId).
      enumeration CanIfDispatchUserClearTrcvWufFlagIndicationUL [0..1]: {CAN_SM, CDD}, set at pre-compile, default-value=CAN_SM  # User Clear Trcv Wuf Flag Indication UL | This parameter defines the upper layer module to which the ClearTrcvWufFlagIndication from the CAN transceiver driver modules have to be routed. If CANIF_PUBLIC_PN_SUPPORT equals False, this parameter shall not be configurable. NOTE: If feature 'Pn Trcv Handling Support' (see parameter 'CanIfPnTrcvHandlingSupport') is disabled this parameter must not be configured and may be deleted.
      function name CanIfDispatchUserConfirmPnAvailabilityName [0..1]: set at pre-compile, default-value=CanSM_ConfirmPnAvailability  # User Confirm Pn Availability Name | This parameter defines the name of <User_ConfirmPnAvailability>. If value of parameter 'CanIfDispatchUserConfirmPnAvailabilityUL' equals 'CAN_SM' the name of <User_ConfirmPnAvailability> is fixed. If it equals 'CDD' the name is selectable. NOTE: If feature 'Pn Trcv Handling Support' (see parameter 'CanIfPnTrcvHandlingSupport') is disabled this parameter must not be configured and may be deleted. The specified function must have following signature: void <name> (uint8 TransceiverId).
      enumeration CanIfDispatchUserConfirmPnAvailabilityUL [0..1]: {CAN_SM, CDD}, set at pre-compile, default-value=CAN_SM  # User Confirm Pn Availability UL | This parameter defines the upper layer module to which the ConfirmPnAvailability notification from the CAN transceiver driver modules have to be routed. NOTE: If feature 'Pn Trcv Handling Support' (see parameter 'CanIfPnTrcvHandlingSupport') is disabled this parameter must not be configured and may be deleted.
      function name CanIfDispatchUserCtrlBusOffName: set at pre-compile, default-value=CanSM_ControllerBusOff, max-length=32, min-length=1  # User Ctrl Bus Off Name | This parameter defines the name of <User_ControllerBusOff>. This parameter depends on value of the parameter 'CanIfDispatchUserCtrlBusOffUL'. If 'CanIfDispatchUserCtrlBusOffUL' equals 'CAN_SM' the name of <User_ControllerBusOff> is fixed. If 'CanIfDispatchUserCtrlBusOffUL' equals 'CDD' the name of <User_ControllerBusOff> is selectable. NOTE: The specified function must have following signature: void <name> (uint8 ControllerId).
      enumeration CanIfDispatchUserCtrlBusOffUL: {CAN_SM, CDD}, set at pre-compile, default-value=CAN_SM  # User Ctrl Bus Off UL | This parameter defines the upper layer (UL) module to which the notifications of all bus off events from the CAN driver modules have to be routed via <User_ControllerBusOff>. CAUTION: There is no possibility to configure no upper layer (UL) module as the provider of <User_ControllerBusOff>.
      function name CanIfDispatchUserCtrlModeIndicationName: set at pre-compile, default-value=CanSM_ControllerModeIndication, max-length=32, min-length=1  # User Ctrl Mode Indication Name | This parameter defines the name of <User_ControllerModeIndication>. This parameter depends on the value of parameter 'CanIfDispatchUserCtrlModeIndicationUL'. If the value of 'CanIfDispatchUserCtrlModeIndicationUL' equals 'CAN_SM' the name of <User_ControllerModeIndication>; is fixed. If it equals 'CDD' the name of <User_ControllerModeIndication> is selectable. NOTE: The specified function must have following signature: void <name> (uint8 ControllerId, CanIf_ControllerModeType ControllerMode).
      enumeration CanIfDispatchUserCtrlModeIndicationUL: {CAN_SM, CDD}, set at pre-compile, default-value=CAN_SM  # User Ctrl Mode Indication UL | This parameter defines the upper layer (UL) module to which the notifications of all controller transition events from the CAN driver modules have to be routed via <User_ControllerModeIndication>. CAUTION: There is no possibility to configure no upper layer (UL) module as the provider of<User_ControllerModeIndication>.
      function name CanIfDispatchUserTrcvModeIndicationName [0..1]: set at pre-compile, default-value=CanSM_TransceiverModeIndication, max-length=32, min-length=1  # User Trcv Mode Indication Name | This parameter defines the name of <User_TrcvModeIndication>. This parameter depends on the parameter 'CanIfDispatchUserTrcvModeIndicationUL'. If the value of parameter 'CanIfDispatchUserTrcvModeIndicationUL' equals 'CAN_SM' the name of <User_TrcvModeIndication> is fixed. If it equals 'CDD' the name of <User_TrcvModeIndication> is selectable. NOTE: If feature 'Transceiver Handling' (see parameter 'CanIfTransceiverHandling') is disabled this parameter must not be configured and may be deleted. The specified function must have following signature: void <name> (uint8 TransceiverId, CanTrcv_TrcvModeType TransceiverMode).
      enumeration CanIfDispatchUserTrcvModeIndicationUL [0..1]: {CAN_SM, CDD}, set at pre-compile, default-value=CAN_SM  # User Trcv Mode Indication UL | This parameter defines the upper layer (UL) module to which the notifications of all transceiver mode transition events from the CAN transceiver driver modules have to be routed via <User_TrcvModeIndication>. NOTE: If feature 'Transceiver Handling' (see parameter 'CanIfTransceiverHandling') is disabled this parameter must not be configured and may be deleted.
      function name CanIfDispatchUserValidateWakeupEventName [0..1]: set at pre-compile, default-value=EcuM_ValidateWakeupEvent, max-length=32, min-length=1  # User Validate Wakeup Event Name | This parameter defines the name of <User_ValidateWakeupEvent>. This parameter depends on the value of the parameter 'CanIfDispatchUserValidateWakeupEventUL'. If the value of parameter 'CanIfDispatchUserValidateWakeupEventUL' equals 'ECUM' the name of <User_ValidateWakeupEvent> is fixed. If it equals 'CDD' the name of <User_ValidateWakeupEvent> is selectable. If parameter CANIF_WAKEUP_CHECK_VALIDATION_API is disabled, no <User_ValidateWakeupEvent> API can be configured. NOTE: If feature 'Wakeup Check Validation Support' (see parameter 'CanIfPublicWakeupCheckValidSupport') is disabled this parameter must not be configured and may be deleted. The specified function must have following signature: void <name> (EcuM_WakeupSourceType CanWakeupEvents).
      enumeration CanIfDispatchUserValidateWakeupEventUL [0..1]: {CDD, ECUM}, set at pre-compile, default-value=ECUM  # User Validate Wakeup Event UL | This parameter defines the upper layer (UL) module to which the notifications about positive former requested wake-up events have to be routed via <User_ValidateWakeupEvent>. NOTE: If feature 'Wakeup Check Validation Support' (see parameter 'CanIfPublicWakeupCheckValidSupport') is disabled this parameter must not be configured and may be deleted.
      function name CanIfDispatchUserRamCheckCorruptMailboxName [0..1]: set at pre-compile, origin=Vector Informatik, default-value=CanSM_RamCheckCorruptMailbox, max-length=32, min-length=1  # User Ram Check Corrupt Mailbox Name | This parameter defines the name of <User_RamCheckCorruptMailbox>. If value of parameter 'CanIfDispatchUserRamCheckCorruptMailboxUL' equals 'CAN_SM' the name of <User_RamCheckCorruptMailbox> is fixed. If it equals 'CDD' the name is selectable. If CanIfPublicPnSupport equals False, this parameter shall not be configurable. NOTE: If feature "CanIfExtendedRamCheckSupport" is disabled this parameter must not be configured and may be deleted. The specified function must have following signature: void <name> (uint8 ControllerId, CanIf_HwHandleType HwHandle).
      enumeration CanIfDispatchUserRamCheckCorruptMailboxUL [0..1]: {CDD, CAN_SM}, set at pre-compile, origin=Vector Informatik, default-value=CAN_SM  # User Ram Check Corrupt Mailbox UL | This parameter defines the upper layer (UL) module to which the notifications about corrupt mailbox(es) of a CAN controller former requested to be checked have to be routed via <User_RamCheckCorruptMailbox>. NOTE: If feature "CanIfExtendedRamCheckSupport" is disabled this parameter must NOT be configured and may be deleted.
      enumeration CanIfDispatchUserRamCheckCorruptControllerUL [0..1]: {CDD, CAN_SM}, set at pre-compile, origin=Vector Informatik, default-value=CAN_SM  # User Ram Check Corrupt Controller UL | This parameter defines the upper layer (UL) module to which the notifications about corrupt CAN controller(s) former requested to be checked have to be routed via <User_RamCheckCorruptController>. NOTE: If feature "CanIfExtendedRamCheckSupport" is disabled this parameter must NOT be configured and may be deleted.
      function name CanIfDispatchUserRamCheckCorruptControllerName [0..1]: set at pre-compile, origin=Vector Informatik, default-value=CanSM_RamCheckCorruptController, max-length=32, min-length=1  # User Ram Check Corrupt Controller Name | This parameter defines the name of <User_RamCheckCorruptController>. If value of parameter 'CanIfDispatchUserRamCheckCorruptControllerUL' equals 'CAN_SM' the name of <User_RamCheckCorruptController> is fixed. If it equals 'CDD' the name is selectable. If CANIF_PUBLIC_PN_SUPPORT equals False, this parameter shall not be configurable. NOTE: If feature "CanIfExtendedRamCheckSupport" is disabled this parameter must NOT be configured and may be deleted. The specified function must have following signature: void <name> (uint8 ControllerId).
      function name CanIfDispatchDataChecksumRxErrorIndicationName [0..1]: set at pre-compile, origin=Vector Informatik, default-value=NULL_PTR, max-length=32, min-length=1  # This parameter defines the name of function which shall be called in case of the data checksum Rx-verification fails e.g. "My_DataChecksumRxErrFct". The prototype of function must match following signature: - void My_DataChecksumRxErrFct (PduIdType CanIfRxPduId). In case of specifying of a function please configure in addition via the parameter "CanIfPublicCddHeaderFile" the header file in which the prototype of it is defined. NOTE: This parameter is only editable if "CanIfDispatchDataChecksumRxErrorIndicationUL" != NONE. The specified function must have following signature: void <name> (PduIdType CanIfRxPduId).
      enumeration CanIfDispatchDataChecksumRxErrorIndicationUL [0..1]: {CDD, NONE}, set at pre-compile, origin=Vector Informatik, default-value=NONE  # This parameter defines the upper layer (UL) module to which the notifications about Rx-data-checksum failures have to be routed to. If this parameter is set to NONE then "CanIfDispatchDataChecksumRxErrorIndicationName" is not editable and is set to NULL_PTR automatically. If set to CDD then "CanIfDispatchDataChecksumRxErrorIndicationName" is configurable. NOTE: If feature "CanIfDataChecksumRxSupport" is disabled this parameter must NOT be configured and may be deleted.
      function name CanIfDispatchUserSetDynamicRxIdName [0..1]: set at pre-compile, origin=Vector Informatik, default-value=NULL_PTR, max-length=32, min-length=1  # User Set Dynamic Rx Id Name | This parameter defines the name of function which shall be called for a dynamic Rx PDU e.g. "Appl_CanIfSetDynamicRxId". The prototype of function must match following signature: void Appl_CanIfSetDynamicRxId(PduIdType RxPduId, Can_IdType* CanId) In case of specifying of a function please configure in addition via the parameter "CanIfPublicCddHeaderFile" the header file in which the prototype of it is defined. NOTE: This parameter is only editable if "CanIfDispatchUserSetDynamicRxIdUL" != NONE.
      enumeration CanIfDispatchUserSetDynamicRxIdUL [0..1]: {CDD, NONE}, set at pre-compile, origin=Vector Informatik, default-value=NONE  # User Set Dynamic Rx Id UL | This parameter defines the upper layer (UL) module to which the callout to set the CAN identifier of a dynamic Rx PDU have to be routed to. If parameter is set to CDD the parameter "CanIfDispatchUserSetDynamicRxIdName" is configurable. NOTE: The correct configuration of this parameter is controlled by a validation rule depending on configuration of parameter "CanIfPublicSetDynamicRxIdApi".
    container CanIfInitCfg  # This container contains the init parameters of the CAN Interface module. At least one (if only on CAN Interface module with one possible Configuration), but multiple (CAN Interface module with different Configurations) instances of this container are possible.
      string CanIfInitCfgSet [0..1]: set at post-build in variant post-build-loadable+post-build-selectable / pre-compile in variant pre-compile, max-length=32, min-length=1  # NOT used. Selects the CAN Interface module specific configuration setup. This type of the external data structure shall contain the post-build initialization data for the CAN Interface module for all underlying CAN driver modules.
      container CanIfBufferCfg [0..*]: post-build-changeable=true  # This container contains the Tx-buffer configuration. Multiple buffers with different sizes could be configured. If CanIfBufferSize (CANIF834_Conf) equals 0, the CanIf Tx L-PDU only refers via this CanIfBufferCfg the corresponding CanIfHthCfg.
        integer CanIfBufferSize: 0..65535, set at post-build in variant post-build-loadable+post-build-selectable / pre-compile in variant pre-compile, default-value=0  # This parameter defines the number of CanIf Tx L-PDUs which can be buffered in one Tx-buffer. If this value equals 0, the CAN Interface module does not perform Tx buffering for the CanIf Tx L-PDUs which are assigned to this Tx-buffer. If 'CanIfPublicTxBuffering' equals False, this parameter equals 0 for all Tx-buffer. If the 'CanHandleType' of the referred HTH equals 'FULL', this parameter equals 0 for this Tx-buffer. Please NOTE: The value of this parameter is calculated and set automatically by the generation tool DaVinci Configurator 5 if parameter "CanIfTxBufferHandlingType" is set either to PRIO_BY_CANID or to NONE. In case of PRIO_BY_CANID the value is determined from number of Tx-PDUs which are mapped to this Tx-buffer element. In case of NONE the value of this parameter is set to 0.
        enumeration CanIfTxBufferHandlingType: {PRIO_BY_CANID, FIFO, NONE}, set at pre-compile, origin=Vector Informatik, default-value=NONE  # By this parameter the handling type of configured Tx-buffer is selected. 1) PRIO_BY_CANID: The Tx-PDUs stored within the Tx-buffer are handled prioritized. Tx-PDUs with high priority are sent before those ones with lower priority. The priority is given by the CAN identifier of the Tx-PDU. A Tx-PDU with a low CAN identifier has higher priority then a one with greater CAN identifier. The priority of a Tx-PDU is static is determined from values of parameters "CanIfTxPduCanId" and "CanIfTxPduCanIdType". Please consider this aspect in case of configuration of Tx-PDUs with dynamic CAN identifier. 2) FIFO: The Tx-PDUs stored within the Tx-buffer are handled in order First In First Out (FIFO). 3) NONE: Tx-buffer is disabled. This value must be selected if "CanHandleType" of the underlying "CanHardwareObject" is set to FULL. Please NOTE: The options PRIO_BY_CANID and FIFO are only possible if the "CanHandleType" of the underlying "CanHardwareObject" is set to BASIC.
        integer CanIfTxBufferMappedTxPdus: 0..65535, set at post-build in variant post-build-loadable+post-build-selectable / pre-compile in variant pre-compile, origin=Vector Informatik, default-value=0  # The value of this parameter signals how many Tx-PDUs are mapped to the configured Tx-buffer. Please NOTE: The value of this parameter is calculated and set automatically by the generation tool DaVinci Configurator 5. Hence it is NOT editable.
        integer CanIfTxBufferMaxPduLength: 0..64, set at post-build in variant post-build-loadable+post-build-selectable / pre-compile in variant pre-compile, origin=Vector Informatik, default-value=8  # The value of this parameter is only relevant if "CanIfTxBufferHandlingType" is set to FIFO. In such case the value signals the size [bytes] of a single Tx-buffer payload element. The value of this parameter is determined and normalised (see CAUTION) from mapped Tx-PDU to this Tx-buffer configuration with greatest "PduLength". CAUTION: MIN-value is always 8 independent of configuration. Only following normalised values are possible: 8, 12, 16, 20, 24, 32, 48, and 64. This parameter can be used to estimate the RAM-consumption of configured Tx-buffer of handling type FIFO. Assumption for the following formula is that the used compiler applies "StructAlignment = Auto" and "StructInArrayAlignment=Auto": e.g. The required RAM for storing of payload of configured Tx-buffer can be estimated with - <estimated RAM-consumption> [bytes] = "CanIfTxBufferMaxPduLength" x "CanIfBufferSize" Please NOTE: The value of this parameter is calculated and set automatically by the generation tool DaVinci Configurator 5. Hence it is NOT editable.
        reference CanIfBufferHthRef: set at post-build in variant post-build-loadable+post-build-selectable / pre-compile in variant pre-compile, destination=CanIfHthCfg  # Reference to HTH, that defines the hardware object or the pool of hardware objects configured for transmission. All the CanIf Tx L-PDUs refer via the 'CanIfBufferCfg' and this parameter to the HTHs if TxBuffering is enabled, or not. Each HTH shall not be assigned to more than one buffer.
      container CanIfInitHohCfg [1..*]  # This container contains the references to the configuration setup of each underlying CAN driver module.
        reference CanIfInitRefCfgSet [0..1]: set at post-build in variant post-build-loadable+post-build-selectable / pre-compile in variant pre-compile, destination=CanConfigSet  # NOT used. Via this parameter the CAN Interface module specific configuration setup can be selected. This type of external data structure shall contain the post-build initialization data for the CAN Interface module for all underlying CAN driver modules.
        container CanIfHrhCfg [0..*]: post-build-changeable=true  # This container contains configuration parameters for each hardware receive object (HRH).
          boolean CanIfHrhSoftwareFilter: set at pre-compile in variant post-build-loadable+pre-compile / post-build in variant post-build-selectable, default-value=true  # NOT used. Selects the hardware receive objects by using the HRH range/list from the CAN driver module configuration to define for which HRH a software filtering has to be performed during receive processing. true: Software filtering has to be performed. false: Software filtering has not to be performed.
          reference CanIfHrhCanCtrlIdRef: set at pre-compile in variant post-build-loadable+pre-compile / post-build in variant post-build-selectable, destination=CanIfCtrlCfg  # Reference to controller to which the HRH belongs to. A controller can contain one or more HRHs.
          symbolic name reference CanIfHrhCanHandleTypeRef [0..1]: set at pre-compile in variant post-build-loadable+pre-compile / post-build in variant post-build-selectable, destination=CanHardwareObject  # NOT used. The parameter refers to a particular HRH object in the CAN driver module configuration. The type of the HRH can be either Full-CAN or Basic-CAN. The type of HRHs is defined in the CAN driver module and hence it is derived from CAN driver module configuration of a hardware object. If BasicCAN is configured, software filtering is enabled. Please note that this reference is deprecated and is kept only for backward compatibility reasons. 'CanIfHrhIdSymRef' shall be used instead to get the 'CanHandleType' and 'CanObjectId' of CAN driver module. In the next major release this reference will be deleted.
          symbolic name reference CanIfHrhIdSymRef: set at post-build in variant post-build-loadable+post-build-selectable / pre-compile in variant pre-compile, destination=CanHardwareObject  # The parameter refers to a particular HRH object in the CAN driver module configuration. The type of the HRH can be either Full-CAN or Basic-CAN. The type of each HRH is defined in the CAN driver module and hence it is derived from CAN driver module configuration of the referenced hardware object. If BasicCAN is configured, software filtering is enabled. The CAN Interface module receives the following information of the CAN driver module by this reference: - CanHandleType (see CAN323_Conf) - CanObjectId (see CAN326_Conf)
          container CanIfHrhRangeCfg [0..*]  # NOT supported. Defines the parameters required for configurating multiple CANID ranges for a given same HRH.
            integer CanIfHrhRangeRxPduLowerCanId: 0..536870911, set at post-build in variant post-build-loadable+post-build-selectable / pre-compile in variant pre-compile, default-value=0  # Not supported. Lower CAN Identifier of a receive CAN L-PDU for identifier range definition, in which all CAN Ids shall pass the software filtering.
            enumeration CanIfHrhRangeRxPduRangeCanIdType: {EXTENDED, STANDARD}, set at post-build in variant post-build-loadable+post-build-selectable / pre-compile in variant pre-compile, default-value=STANDARD  # Not supported. Specifies whether a configured Range of CAN Ids shall only consider standard CAN Ids or extended CAN Ids.
            integer CanIfHrhRangeRxPduUpperCanId: 0..536870911, set at post-build in variant post-build-loadable+post-build-selectable / pre-compile in variant pre-compile, default-value=0  # Not supported. Upper CAN Identifier of a receive CAN L-PDU for identifier range definition, in which all CAN Ids shall pass the software filtering.
        container CanIfHthCfg [0..*]: post-build-changeable=true  # This container contains parameters related to each HTH (Hardware Transmit Handle).
          reference CanIfHthCanCtrlIdRef: set at pre-compile in variant post-build-loadable+pre-compile / post-build in variant post-build-selectable, destination=CanIfCtrlCfg  # Reference to controller to which the HTH belongs to. A controller can contain one or more HTHs.
          symbolic name reference CanIfHthCanHandleTypeRef [0..1]: set at pre-compile in variant post-build-loadable+pre-compile / post-build in variant post-build-selectable, destination=CanHardwareObject  # NOT used. The parameter refers to a particular HTH object in the CAN driver module configuration. The type of the HTH can either be Full-CAN or Basic-CAN. The type of HTHs is defined in the CAN driver module and hence it is derived from CAN driver module configuration of a Hardware Object. Please note that this reference is deprecated and is kept only for backward compatibility reasons. CanIfHthIdSymRef shall be used instead to get the CanHandleType and CanObjectId of CAN driver module. In the next major release this reference will be deleted.
          symbolic name reference CanIfHthIdSymRef: set at post-build in variant post-build-loadable+post-build-selectable / pre-compile in variant pre-compile, destination=CanHardwareObject  # The parameter refers to a particular HTH object in the CAN driver module configuration. The type of the HTH can be either Full-CAN or Basic-CAN. The type of each HTH is defined in the CAN driver module and hence it is derived from CAN driver module configuration of the referenced hardware object. The CAN Interface module receives the following information of the CAN driver module by this reference: - CanHandleType (see CAN323_Conf) - CanObjectId (see CAN326_Conf
      container CanIfRxPduCfg [0..*]: post-build-changeable=true  # This container contains the configuration (parameters) of each receive CAN L-PDU. The SHORT-NAME of "CanIfRxPduConfig" container itself represents the symolic name of Receive L-PDU.
        integer CanIfRxPduCanId [0..1]: 0..536870911, set at post-build in variant post-build-loadable+post-build-selectable / pre-compile in variant pre-compile  # Via this parameter the CAN identifier of receive CAN L-PDU is set. This parameter is used if exactly one CAN identifier is assigned to the Rx-PDU. If the parameter 'CanIfRxPduCanIdMask' is configured additionally then a range of CAN identifiers is defined. In this case the value of this parameter represents the code and the value of 'CanIfRxPduCanIdMask' the mask of the range. All messages with a CAN identifier which fulfills the following equation hit the range and are routed to the upper layer. & == & Alternatively a range can be configured by an upper and lower CAN identifier. Therefor please use the parameters in the container 'CanIfRxPduCanIdRange'. Range: 11 Bit For Standard CAN Identifier ... 29 Bit For Extended CAN identifier Note: Not configurable if CanIfRxPduXLParams is configured and CanIfXLSduType is not 3.
        enumeration CanIfRxPduCanIdType: {EXTENDED_CAN, STANDARD_CAN, STANDARD_FD_CAN, EXTENDED_FD_CAN, STANDARD_NO_FD_CAN, EXTENDED_NO_FD_CAN}, set at post-build in variant post-build-loadable+post-build-selectable / pre-compile in variant pre-compile  # This parameter switches the type (extended/standard) of the CAN identifier of receive CAN L-PDU. EXTENDED_CAN: CAN 2.0 or CAN FD frame with extended identifier (29 bits) EXTENDED_FD_CAN: CAN FD frame with extended identifier (29 bits) EXTENDED_NO_FD_CAN: CAN 2.0 frame with extended identifier (29 bits) STANDARD_CAN: CAN 2.0 or CAN FD frame with standard identifier (11 bits) STANDARD_FD_CAN: CAN FD frame with standard identifier (11 bits) STANDARD_NO_FD_CAN: CAN 2.0 frame with standard identifier (11 bits) Note: A CAN-message is received sucessfully only if both the selected CAN-identifier ('CanIfRxPduCanId') and the selected CAN-identifier-type ('CanIfRxPduCanIdType') do match. Note: This parameter is always mandatory. However, if CanIfRxPduXLParams is configured and CanIfXLSduType is not 3, it is not evaluated.
        integer CanIfRxPduDlc: 0..2048, set at post-build in variant post-build-loadable+post-build-selectable / pre-compile in variant pre-compile  # This parameter specifies the data length code (DLC) of the received CAN L-PDU. The value of this parameter is used as reference value for the DLC check (s. parameter 'CanIfPrivateDlcCheck'). Additionally it might specify the valid bits in case of the discrete DLC for CAN FD L-PDUs > 8 bytes. The data area size of a CAN L-PDU can have a range from 0 to 2048 bytes. Note: If CanIfRxPduDlc > 8 then CanIfRxPduCanIdType must not be STANDARD_NO_FD_CAN or EXTENDED_NO_FD_CAN. If CanIfRxPduDlc > 64 then CanIfRxPduXLParams must be present.
        integer CanIfRxPduId: 0..65535, set at pre-compile, symbolic-name-value=true, default-value=0  # ECU wide unique, symbolic handle for receive CAN L-PDU. Range: 0..max. number of defined CanRxPduIds NOTE: The value of this parameter is calculated and set automatically by the generation tool DaVinci Configurator 5.
        boolean CanIfRxPduReadData: set at post-build in variant post-build-loadable+post-build-selectable / pre-compile in variant pre-compile, default-value=false  # NOT supported. Enables and disables the Rx buffering for reading of received L-PDU data. true: Rx buffering for reading of received L-PDU data is enabled. false: Rx buffering for reading of received L-PDU data is disabled.
        boolean CanIfRxPduReadNotifyStatus: set at post-build in variant post-build-loadable+post-build-selectable / pre-compile in variant pre-compile, default-value=false  # NOT supported. Enables and disables receive indication for each receive CAN L-PDU for reading its notification status. true: Reading notification status for each receive CAN L-PDU is enabled. false: Reading notification status for each receive CAN L-PDU is disabled.
        function name CanIfRxPduUserRxIndicationName: set at pre-compile, default-value=NULL_PTR, max-length=32, min-length=1  # This parameter defines the name of the <User_RxIndication>. If the value of 'CanIfRxPduUserRxIndicationUL' equals CAN_TP, CAN_NM, PDUR, XCP, J1939TP, J1939NM, CAN_TSYN or CCP the name of the <User_RxIndication> is fixed. If the value of 'CanIfRxPduUserRxIndicationUL' equals CDD or APPL the name of the <User_RxIndication> is selectable.
        enumeration CanIfRxPduUserRxIndicationUL: {CAN_NM, CAN_TP, CDD, J1939NM, J1939TP, PDUR, XCP, NONE, APPL, CAN_TSYN, CCP}, set at pre-compile, default-value=NONE  # This parameter defines the upper layer (UL) module to which the indication of the successfully received Rx-PDU has to be routed via the <User_RxIndication>. This <User_RxIndication> has to be invoked when the indication of the configured Rx-PDU is received by an Rx indication event from the CAN driver module. If no upper layer (UL) module is configured, no <User_RxIndication> has to be called in case of an Rx indication event of the Rx-PDU from the CAN driver module.
        boolean CanIfRxPduDlcCheck: set at post-build in variant post-build-loadable+post-build-selectable / pre-compile in variant pre-compile, origin=Vector Informatik, default-value=true  # This parameter switches the message specific DLC check. true: If parameter 'CanIfPrivateDlcCheck' is enabled DLC check will be executed during the reception of this Rx-PDU. false: No DLC check will be executed during the reception of this Rx-PDU.
        enumeration CanIfRxPduUserRxIndicationType [0..1]: {PDUID_PDUINFOPTR, PDUID_SDUDATAPTR, PDUID_SDUDATAPTR_CANID, PDUID_PDUINFOPTR_CANID}, set at pre-compile, origin=Vector Informatik, default-value=PDUID_PDUINFOPTR  # This parameter switches the type of the <User_RxIndication> concerning the function parameters. PDUID_SDUDATAPTR: Standard: Prototype: 'RxIndication'(PduIdType CanRxPduId, const uint8* CanSduPtr); PDUID_PDUINFOPTR: Advanced: (e.g. used by CanTp, CanNm, PduR) Prototype: 'RxIndication'(PduIdType CanRxPduId, const PduInfoType* PduInfoPtr); PDUID_SDUDATAPTR_CANID: (e.g. used by NmOsek, additionally parameter 'CanIfSupportNmOsek' must be enabled) Prototype: 'RxIndication'(PduIdType CanRxPduId, const uint8* CanSduPtr, Can_IdType CanId); PDUID_PDUINFOPTR_CANID: Prototype: 'RxIndication'(PduIdType CanRxPduId, const PduInfoType* PduInfoPtr, Can_IdType CanId); NOTE: This parameter is optional and can be used to set up the Rx indication type explicitely in case of 'CanIfRxPduUserRxIndicationUL' is set either to APPL or to CDD. Otherwise the Rx indication type is determined from the setting of parameter 'CanIfRxPduUserRxIndicationUL'. If this parameter does not exist the default value 'PDUID_PDUINFOPTR' is assumed.
        boolean CanIfRxPduCanHandleTypeLocked [0..1]: set at post-build in variant post-build-loadable+post-build-selectable / pre-compile in variant pre-compile, origin=Vector Informatik, default-value=false  # This parameter switches whether the filter optimization algorithm is allowed to change the initial configured CAN handle type (BasicCAN/FullCAN) or not. If this parameter is enabled the selected CAN handle type (FullCAN/BasicCAN) of the corresponding Rx-PDU is NOT touched and NOT changed by the filter optimization algorithm. NOTE: This does not mean that the mapping of a Rx-PDU to a CAN hardware object is not changed by the filter optimization algorithm. Only the initial set up CAN handle type is not changed but the filter optimization algorithm is still allowed to change the mapping between a Rx-PDU and a CAN hardware object with the goal of a most effective utilisation of CAN hardware. If this parameter is disabled or not existing the filter optimization algorithm may change the initial configured CAN handle type of the corresponding Rx-PDU.
        integer CanIfRxPduCanIdMask [0..1]: 0..536870911, set at post-build in variant post-build-loadable+post-build-selectable / pre-compile in variant pre-compile, origin=Vector Informatik, default-value=536870911  # By this parameter the CAN identifier mask which denotes relevant bits in the CAN identifier can be configured. By usage of this parameter and the parameter 'CanIfRxPduCanId' a CAN identifier range in an alternative way to 'CanIfRxPduCanIdRange' can be defined. The value of this parameter identifies the bits of the configured CAN identifier that must match the received CAN identifier. Range: 11 bits for standard CAN identifier, 29 bits for extended CAN identifier. Note: Not configurable if CanIfRxPduXLParams is configured and CanIfXLSduType is not 3.
        boolean CanIfRxPduDataChecksumPdu [0..1]: set at post-build in variant post-build-loadable+post-build-selectable / pre-compile in variant pre-compile, origin=Vector Informatik, default-value=false  # Enables / disables data checksum for a Rx-PDU. If enabled data checksum is checked every time the Rx-PDU is received. The verification is application specific and is realised within the API: CanIf_RxIndicationSubDataChecksumRxVerify(). CAUTION: This feature can not be used in conjunction with meta data (please see parameter "MetaDataLength" of corresponding global pdu (referenced by parameter: "CanIfRxPduRef")). NOTE: If verification fails the Rx-PDU is discarded.
        boolean CanIfRxPduSetReceptionModePdu [0..1]: set at post-build in variant post-build-loadable+post-build-selectable / pre-compile in variant pre-compile, origin=Vector Informatik, default-value=false  # Enables / disables the ability to set the reception mode for a Rx-PDU. If enabled the reception mode of a Rx-PDU can be selected at runtime via the API: CanIf_SetPduReceptionMode() otherwise not.
        enumeration CanIfRxPduType: {DYNAMIC, STATIC}, set at post-build in variant post-build-loadable+post-build-selectable / pre-compile in variant pre-compile, origin=Vector Informatik, default-value=STATIC  # This parameter sets the type of the Rx PDU. In case of type DYNAMIC the CAN identifier of the Rx PDU must be set during 'CanIf_Init()' via the callout function 'Appl_CanIfSetDynamicRxId()' (s. parameter CanIfDispatchCfg/CanIfDispatchUserSetDynamicRxIdName). The CAN identifier range in which the CAN identifier to be set should be located must be configured using the 'CanIfRxPduCanIdRange' container.
        reference CanIfRxPduBswSchExclAreaIdRef [0..1]: set at pre-compile, destination=RteBswExclusiveAreaImpl  # Not supported. Reference to an exclusive area Id defined within the BSW Scheduler.
        reference CanIfRxPduHrhIdRef: set at post-build in variant post-build-loadable+post-build-selectable / pre-compile in variant pre-compile, destination=CanIfHrhCfg  # The HRH to which Rx L-PDU belongs to is referred through this parameter. NOTE: Is automatically adapted if it refers to an RxBasicCan hardware object of a Vector CAN driver.
        reference CanIfRxPduRef: set at post-build in variant post-build-loadable+post-build-selectable / pre-compile in variant pre-compile, destination=Pdu  # Reference to the "global" PDU structure to allow harmonization of handle IDs in the COM-Stack.
        container CanIfRxPduCanIdRange [0..1]: post-build-changeable=true  # Optional container that allows to map a range of CAN identifiers to one PduId. All messages with a CAN identifier which fulfills the following equation hit the range and are routed to the upper layer. <received CAN-ID> >= <CanIfRxPduCanIdRangeLowerCanId> and <received CAN-ID> <= <CanIfRxPduCanIdRangeUpperCanId> >= : greater or equal <= : less than or equal Note: Not configurable if CanIfRxPduXLParams is configured and CanIfXLSduType is not 3.
          integer CanIfRxPduCanIdRangeLowerCanId: 0..536870911, set at post-build in variant post-build-loadable+post-build-selectable / pre-compile in variant pre-compile  # Lower CAN Identifier of a receive CAN L-PDU for identifier range definition, in which all CAN identifiers are mapped to one PduId.
          integer CanIfRxPduCanIdRangeUpperCanId: 0..536870911, set at post-build in variant post-build-loadable+post-build-selectable / pre-compile in variant pre-compile  # Upper CAN Identifier of a receive CAN L-PDU for identifier range definition, in which all CAN identifiers are mapped to one PduId.
        container CanIfTTRxFrameTriggering [0..1]  # Not supported. Frame trigger for TTCAN reception. This container is only included and valid if the controller supports TTCAN, TTCAN Interface SWS is used, TTCAN is enabled and a joblist is used for reception.
          integer CanTTRxJoblistTimeMark [0..1]: 0..65535, set at post-build in variant post-build-loadable+post-build-selectable / pre-compile in variant pre-compile, default-value=0  # Not supported. Defines the point in time, when the joblist execution funciton (JLEF) shall be called for the referenced rx trigger. Value is given in cycle time. This parameter is only configurable if a joblist is enabled by parameter CanIfTTJobList.
          reference CanIfTTRxHwObjectTriggerIdRef: set at post-build in variant post-build-loadable+post-build-selectable / pre-compile in variant pre-compile, destination=CanTTHardwareObjectTrigger  # Not supported. This parameter refers to a particular TTCAN hardware receive object Trigger of a hardware object in the TTCAN driver module, which is referred via plain CAN parameter CANIF_HRH_HANDLETYPE_REF. This parameter is only configurable if a joblist is enabled by parameter CanIfTTJobList.
        container CanIfRxPduXLParams [0..1]: post-build-changeable=true  # CAN XL parameters. Identifies the CanIfRxPduCfg as CAN XL PDU.
          integer CanIfXLAcceptanceField [0..1]: 0..4294967295, set at post-build in variant post-build-loadable+post-build-selectable / pre-compile in variant pre-compile, origin=Vector Informatik  # Acceptance Field | Acceptance field of the CAN XL PDU. Note: Not configurable if CanIfXLSduType equals 3.
          integer CanIfXLPriorityId [0..1]: 0..2047, set at post-build in variant post-build-loadable+post-build-selectable / pre-compile in variant pre-compile, origin=Vector Informatik  # Priority ID | Priority ID of the CAN XL PDU.
          integer CanIfXLSduType [0..1]: 0..255, set at post-build in variant post-build-loadable+post-build-selectable / pre-compile in variant pre-compile, origin=Vector Informatik  # SDU type | SDU type of the CAN XL PDU.
          integer CanIfXLVcid [0..1]: 0..255, set at post-build in variant post-build-loadable+post-build-selectable / pre-compile in variant pre-compile, origin=Vector Informatik  # VCID | Virtual CAN network ID of the CAN XL PDU.
      container CanIfTxPduCfg [0..*]: post-build-changeable=true  # This container contains the configuration (parameters) of a transmit CAN L-PDU. It has to be configured as often as a transmit CAN L-PDU is needed. The SHORT-NAME of "CanIfTxPduConfig" container represents the symolic name of Transmit L-PDU.
        integer CanIfTxPduCanId: 0..536870911, set at post-build in variant post-build-loadable+post-build-selectable / pre-compile in variant pre-compile  # By this parameter the CAN identifier of the transmit CAN L-PDU is set. Range: 11 bits for standard CAN identifier, 29 bits for extended CAN identifier In case of a dynamic Tx-PDU (s. parameter 'CanIfTxPduType') the default CAN identifier of such Tx-PDU is specified by this parameter and by the way the priority of the Tx-PDU. Note: This parameter is always mandatory. However, if CanIfTxPduXLParams is configured and CanIfXLSduType is not 3, it is not evaluated.
        enumeration CanIfTxPduCanIdType: {EXTENDED_CAN, STANDARD_CAN, EXTENDED_FD_CAN, STANDARD_FD_CAN}, set at post-build in variant post-build-loadable+post-build-selectable / pre-compile in variant pre-compile  # By this parameter the type of the CAN identifier of the transmit CAN L-PDU is set. EXTENDED_CAN: CAN 2.0 frame with extended identifier (29 bits) EXTENDED_FD_CAN: CAN FD frame with extended identifier (29 bits) STANDARD_CAN: CAN 2.0 frame with standard identifier (11 bits) STANDARD_FD_CAN: CAN FD frame with standard identifier (11 bits) Note: This parameter is always mandatory. However, if CanIfTxPduXLParams is configured and CanIfXLSduType is not 3, it is not evaluated.
        integer CanIfTxPduDlc: 0..2048, set at post-build in variant post-build-loadable+post-build-selectable / pre-compile in variant pre-compile, default-value=8  # Not used. NOTE: The length of a PDU is set via the parameter 'PduLength' within the referenced 'Pdu'. The 'Pdu' is referenced by parameter 'CanIfTxPduRef'. The data area size of a CAN L-Pdu can have a range from 0 to 2048 bytes.
        integer CanIfTxPduId: 0..65535, set at pre-compile, symbolic-name-value=true, default-value=0  # ECU wide unique, symbolic handle for transmit CAN L-PDU. Range: 0..max. number of CantTxPduIds NOTE: The value of this parameter is calculated and set automatically by the generation tool DaVinci Configurator 5.
        boolean CanIfTxPduPnFilterPdu [0..1]: set at post-build in variant post-build-loadable+post-build-selectable / pre-compile in variant pre-compile, default-value=false  # If the Tx-PDU filter is enabled (see parameter 'CanIfPnWakeupTxPduFilterSupport') the Tx-PDU can be configured which shall pass the Tx-PDU filter. If there is no CanIfTxPduPnFilterPdu configured per controller, the corresponding controller applies no CanIfPnFilter. true: The Tx-PDU will pass the filter. false: The Tx-PDU won't pass the filter.
        boolean CanIfTxPduReadNotifyStatus: set at post-build in variant post-build-loadable+post-build-selectable / pre-compile in variant pre-compile, default-value=false  # NOT supported. Enables and disables transmit confirmation for each transmit CAN L-PDU for reading its notification status. true: Reading notification status for each transmit CAN L-PDU is enabled false: Reading notification status for each transmit CAN L-PDU is disabled
        enumeration CanIfTxPduType: {DYNAMIC, STATIC}, set at post-build in variant post-build-loadable+post-build-selectable / pre-compile in variant pre-compile, default-value=STATIC  # This parameter sets the type of the Tx PDU. In case of type DYNAMIC the CAN identifier of the Tx PDU can be set / changed by using the API 'CanIf_SetDynamicTxId'.
        function name CanIfTxPduUserTxConfirmationName [0..1]: set at pre-compile in variant post-build-loadable+pre-compile / post-build in variant post-build-selectable, default-value=NULL_PTR, max-length=32, min-length=1  # This parameter defines the name of the <User_TxConfirmation>. The value of this parameter depends on the value of parameter 'CanIfTxPduUserTxConfirmationUL'. If the value of 'CanIfTxPduUserTxConfirmationUL' equals CAN_TP, CAN_NM, PDUR, XCP, J1939TP, J1939NM, CAN_TSYN or CCP the name of the <User_TxConfirmation> is fixed. If the value of 'CanIfTxPduUserTxConfirmationUL' equals CDD or APPL the name of the <User_TxConfirmation> is selectable. NOTE: The specified function must have following signature: void <name> (PduIdType CanTxPduId).
        enumeration CanIfTxPduUserTxConfirmationUL: {CAN_NM, CAN_TP, CDD, J1939NM, J1939TP, PDUR, XCP, NONE, APPL, CAN_TSYN, CCP}, set at pre-compile in variant post-build-loadable+pre-compile / post-build in variant post-build-selectable, default-value=NONE  # This parameter defines the upper layer (UL) module to which the confirmation of the successfully transmitted CANTXPDUID has to be routed via the <User_TxConfirmation>. This <User_TxConfirmation> has to be invoked when the confirmation of the configured CANTXPDUID will be received by a Tx confirmation event from the CAN driver module. If no upper layer (UL) module is configured, no <User_TxConfirmation> has to be called in case of a Tx confirmation event of the CANTXPDUID from the CAN driver module.
        integer CanIfTxPduCanIdMask [0..1]: 0..4294967295, set at post-build in variant post-build-loadable+post-build-selectable / pre-compile in variant pre-compile, origin=Vector Informatik, default-value=4294967295  # By this parameter the identifier mask which denotes relevant bits in the CAN identifier is set. This parameter may be used to keep parts of the CAN identifier of a dynamic transmit L-PDU static. The static part of a CAN identfier must be given as logic '1' the dynamic one as logic '0'. Range: IDE bit + FD bit + 11 bits for standard CAN identifier or 29 bits for extended CAN identifier. HINT: The resulting CAN identifier is calculated in the following way at runtime: (CanIfTxPduCanId & CanIfTxPduCanIdMask) | (<dynamic parts of CAN identifier> & ~CanIfTxPduCanIdMask). ~: Logic one's complement &: Logic AND-instruction. |: Logic OR-instruction Note: Not configurable if CanIfTxPduXLParams is configured and CanIfXLSduType is not 3.
        boolean CanIfTxPduDataChecksumPdu [0..1]: set at post-build in variant post-build-loadable+post-build-selectable / pre-compile in variant pre-compile, origin=Vector Informatik, default-value=false  # Enables / disables data checksum for a Tx-PDU. If enabled a checksum is calculated and appended to data of Tx-PDU before transmission of it. The appending of checksum is application specific and is realised within the API: CanIf_TransmitSubDataChecksumTxAppend().
        boolean CanIfTxPduTruncation: set at post-build in variant post-build-loadable+post-build-selectable / pre-compile in variant pre-compile, origin=Vector Informatik, default-value=true  # Enables/ disables truncation of a PDU that exceeds the configured length. true: Truncation of PDU is enabled. false: Truncation of PDU is disabled. NOTE: The Tx request will be rejected if the PDU length exceeds the configured length and CanIfTxPduTruncation is disabled.
        reference CanIfTxPduBswSchExclAreaIdRef [0..1]: set at pre-compile, destination=RteBswExclusiveAreaImpl  # Not supported. Reference to an exclusive area Id defined within the BSW Scheduler.
        reference CanIfTxPduBufferRef: set at post-build in variant post-build-loadable+post-build-selectable / pre-compile in variant pre-compile, destination=CanIfBufferCfg  # Reference to 'CanIfBufferCfg' configuration.
        reference CanIfTxPduRef: set at post-build in variant post-build-loadable+post-build-selectable / pre-compile in variant pre-compile, destination=Pdu  # Reference to the "global" PDU structure to allow harmonization of handle IDs in the COM-Stack.
        container CanIfTTTxFrameTriggering [0..1]  # NOT supported. Frame trigger for TTCAN transmission. This container is only included and valid if the controller supports TTCAN, TTCAN Interface SWS is used, TTCAN is enabled and a joblist is used.
          integer CanIfTTTxJoblistTimeMark [0..1]: 0..65535, set at post-build in variant post-build-loadable+post-build-selectable / pre-compile in variant pre-compile, default-value=0  # NOT supported. Defines the point in time, when the joblist execution funciton (JLEF) shall be called for the referenced tx frame trigger. Value is given in cycle time. This parameter is only configurable if a joblist is enabled by parameter CanIfTTJobList.
          reference CanIfTTTxHwObjectTriggerIdRef: set at post-build in variant post-build-loadable+post-build-selectable / pre-compile in variant pre-compile, destination=CanTTHardwareObjectTrigger  # NOT supported. This parameter refers to a particular TTCAN hardware transmit object Trigger of a hardware object in the TTCAN driver module, which is referred via plain CAN parameter CANIF_HTH_HANDLETYPE_REF. This parameter is only configurable if a joblist is enabled by parameter CanIfTTJobList.
        container CanIfTxPduXLParams [0..1]: post-build-changeable=true  # CAN XL parameters. Identifies the CanIfTxPduCfg as CAN XL PDU.
          integer CanIfXLAcceptanceField [0..1]: 0..4294967295, set at post-build in variant post-build-loadable+post-build-selectable / pre-compile in variant pre-compile, origin=Vector Informatik  # Acceptance Field | Acceptance field of the CAN XL PDU. Note: Not configurable if CanIfXLSduType equals 3.
          integer CanIfXLPriorityId [0..1]: 0..2047, set at post-build in variant post-build-loadable+post-build-selectable / pre-compile in variant pre-compile, origin=Vector Informatik  # Priority ID | Priority ID of the CAN XL PDU.
          integer CanIfXLSduType [0..1]: 0..255, set at post-build in variant post-build-loadable+post-build-selectable / pre-compile in variant pre-compile, origin=Vector Informatik  # SDU type | SDU type of the CAN XL PDU.
          integer CanIfXLVcid [0..1]: 0..255, set at post-build in variant post-build-loadable+post-build-selectable / pre-compile in variant pre-compile, origin=Vector Informatik  # VCID | Virtual CAN network ID of the CAN XL PDU.
    container CanIfPrivateCfg  # This container contains the private configuration (parameters) of the CAN Interface module.
      boolean CanIfPrivateDlcCheck: set at pre-compile, default-value=true  # Dlc Check | This parameter switches the support for DLC check which is performed at reception of Rx-PDUs. Additionally the DLC check can be configured for each Rx-PDU individually (s. parameter 'CanIfRxPduDlcCheck'). The reference value required for the DLC check is configured individually for every Rx-PDU by the parameter 'CanIfRxPduDlc'. If the DLC of received message is smaller than the reference value the check fails and the received message is discarded and is not reported to the upper layer. Otherwise the check passes and the received message is reported to the upper layer. true: DLC check is enabled. false: DLC check is disabled.
      enumeration CanIfPrivateSoftwareFilterType: {LINEAR, DOUBLEHASH}, set at pre-compile, default-value=DOUBLEHASH  # Software Filter Type | Via this parameter the software filter mechanism for reception of Basic-CAN CAN2.0/FD Rx PDUs with single CAN ID can be selected. The type 'LINEAR' is not effective if many Basic-CAN CAN2.0/FD Rx PDUs with single CAN ID are configured. In such case please select 'DOUBLEHASH'. The type 'DOUBLEHASH' is recommended if a big amount of Basic-CAN CAN2.0/FD Rx PDUs with single CAN ID is configured and if the same search time is required for each of those Rx PDUs independent of it's priority. The disadvantages of type 'DOUBLEHASH' are: It needs more ROM in comparison to 'LINEAR' and it uses the operation modulo. The additional ROM consumption (in bytes) is shown by the value of parameter 'CanIfDoubleHashAdditionalMemory' (NOTE: The value is refreshed only during the generation of code). Note: The software filter mechanism for Basic-CAN CAN2.0/FD Rx PDUs with CAN ID range and of CAN XL Rx PDUs is always linear.
      boolean CanIfSupportTTCAN: set at pre-compile, default-value=false  # NOT supported. Defines whether TTCAN is supported. true: TTCAN is supported. false: TTCAN is not supported, only normal CAN communication is possible.
      boolean CanIfTransceiverMapping: set at pre-compile, origin=Vector Informatik, default-value=false  # This parameter must be enabled if at least two different CAN transceiver driver modules are used. NOTE: This parameter is only configurable and the value of it is considered only if the feature 'Transceiver Handling' is enabled (s. parameter 'CanIfTransceiverHandling').
      boolean CanIfTransceiverHandling: set at pre-compile, origin=Vector Informatik, default-value=false  # This parameter switches the support of an AUTOSAR CAN transceiver driver module. Therefor the following APIs are enabled/disabled via this parameter: - CanIf_SetTrcvMode - CanIf_GetTrcvMode - CanIf_GetTrcvWakeupReason - CanIf_SetTrcvWakeupMode - CanIf_TrcvModeIndication true: The mentioned APIs are enabled. false: The mentioned APIs are disabled.
      boolean CanIfSupportExtendedIds: set at pre-compile, origin=Vector Informatik, default-value=false  # This parameter switches the support for handling of Rx-/Tx-PDUs with an extended CAN identifier. This parameter must be enabled if at least one Rx-/Tx-PDU with an extended CAN identifier is configured. true: The CAN Interface module supports the handling of Rx-/Tx-PDUs with an extended CAN identifier. false: The handling of Rx-/Tx-PDUs with an extended CAN identifier is not supported by CAN Interface module.
      string CanIfUserConfigFile [0..1]: set at pre-compile, origin=Vector Informatik  # Reference to an external user configuration file that will be included during generation.The content of the user configuration file will be added at the end of file 'CanIf_Cfg.h' and allows altering or extending of generated code. CAUTION: User configuration files can cause the software module to malfunction and must only be used with great care!
      boolean CanIfSupportNmOsek: set at pre-compile, origin=Vector Informatik, default-value=false  # This parameter enables/disables one further Rx-indication function type which additionally pass the CAN identifier of received message. true: The Rx-indication function type 'PDUID_SDUDATAPTR_CANID' is supported and can be used (see parameter ''CanIfRxPduUserRxIndicationType'). false: The mentioned Rx-indication function type is not supported and can not be used.
      boolean CanIfWakeupValidateAllRxMsgs [0..1]: set at pre-compile, origin=Vector Informatik, default-value=false  # This parameter switches the support for wake-up validation by any received message. If this feature is disabled, the wake-up event is validated only by messages in the Rx-list of the CAN controller or by messages which pass the range else by any received message. true: The described feature is enabled. false: The described feature is disabled. NOTE: This parameter is only configurable and the value of it is considered only if the feature 'Wakeup Check Validation Support' is enabled (s. parameter 'CanIfPublicWakeupCheckValidSupport').
      boolean CanIfWakeupSupport: set at pre-compile, origin=Vector Informatik, default-value=false  # This parameter switches the support for wake-up events and enables/disables the API 'CanIf_CheckWakeup'. true: Wake-up events are supported by the CAN Interface module and the API 'CanIf_CheckWakeup' is enabled. false: Wake-up events are NOT supported by the CAN Interface module and the API 'CanIf_CheckWakeup' is disabled. NOTE: This parameter is enabled automatically if at least one of the parameters 'CanIfCtrlWakeupSupport' or 'CanIfTrcvWakeupSupport' is enabled. This parameter can be enabled manually too, e.g. in case of a library delivery if it is not known whether the referenced CAN controllers and CAN transceivers do support wakeup or not.
      integer CanIfDoubleHashAdditionalMemory [0..1]: 0..65535, set at post-build in variant post-build-loadable+post-build-selectable / pre-compile in variant pre-compile, origin=Vector Informatik, default-value=0  # This parameter shows the additional memory consumption [BYTE] in case of search algorithm 'DOUBLEHASH' (s. parameter 'CanIfPrivateSoftwareFilterType') is selected instead of 'LINEAR'. CAUTION: The value is refreshed only during the generation of code! NOTE: This parameter is not editable and is calculated and set automatically by the generation tool DaVinci Configurator 5.
      integer CanIfDoubleHashAdjustCount [0..1]: 0..65535, set at post-build in variant post-build-loadable+post-build-selectable / pre-compile in variant pre-compile, origin=Vector Informatik, default-value=0  # Number of elements required for the 'DOUBLEHASH' adjust table. NOTE: This parameter is not editable and is calculated and set automatically by the generation tool DaVinci Configurator 5.
      boolean CanIfStaticFdTxBufferSupport: set at pre-compile, origin=Vector Informatik, default-value=false  # Enables the support to buffer FD Tx PDUs (the size of such PDUs may be up to 64 bytes) in a Tx buffer of type "PRIO_BY_CANID". true: Tx buffers of handling type "PRIO_BY_CANID" support the buffering of FD Tx PDUs. false: Tx buffers of handling type "PRIO_BY_CANID" DON'T support the buffering of FD Tx PDUs. NOTE: In case a Tx buffer of type "PRIO_BY_CANID" is configured that has at least one FD Tx PDU with data length > 8 bytes mapped to it, this parameter is enabled and locked automatically. NOTE: This parameter must be set to "true" at Pre-Compile time to be able to use Tx buffers of handling type "PRIO_BY_CANID" that support the buffering of FD Tx PDUs (with data length > 8 bytes) in the Post-Build Loadable configuration phase.
      boolean CanIfRxSearchConsiderMsgType: set at pre-compile, origin=Vector Informatik, default-value=false  # This parameter switches whether additionally to the CAN identifier the type of the received message shall be checked for matching with the configured one or not (see parameter 'CanIfRxPduCanIdType'). If the described check is enabled and fails the received message is abandoned even if the CAN identifier matches. true: The check of CAN-message type as described above is enabled. false: The check of CAN-message type as described above is disabled. NOTE: This feature must be enabled if at least one Rx-PDU is configured as follows 'CanIfRxPduCanIdType' = EXTENDED_FD_CAN or EXTENDED_NO_FD_CAN or STANDARD_FD_CAN or STANDARD_NO_FD_CAN.
      boolean CanIfTxBufferFifoSupport: set at pre-compile, origin=Vector Informatik, default-value=false  # Enables the support of Tx buffers of handling type "FIFO". NOTE: The handling type of a Tx buffer can be configured individually for each "CanIfBufferCfg" via the parameter "CanIfTxBufferHandlingType". In case a Tx buffer of handling type "FIFO" is configured, this parameter is enabled and locked automatically. true: Tx buffers of handling type "FIFO" are supported. false: Tx buffers of handling type "FIFO" are NOT supported at all. NOTE: This parameter must be set to "true" at Pre-Compile time to be able to add Tx buffers of type "FIFO" in the Post-Build Loadable configuration phase. NOTE: This parameter is editable only if parameter "CanIfPublicTxBuffering" is enabled. The correct configuration of this parameter is controlled by a validation rule depending on configuration of parameter(s): "CanIfTxBufferHandlingType".
      boolean CanIfDataChecksumTxSupport [0..1]: set at pre-compile, origin=Vector Informatik, default-value=false  # This parameter switches the support of Tx-data-checksum at all. NOTE: The correct configuration of this parameter is controlled by a validation rule depending on configuration of parameter(s): "CanIfTxPduDataChecksumPdu".
      boolean CanIfDataChecksumRxSupport [0..1]: set at pre-compile, origin=Vector Informatik, default-value=false  # This parameter switches the support of Rx-data-checksum at all. NOTE: The correct configuration of this parameter is controlled by a validation rule depending on configuration of parameter(s): "CanIfRxPduDataChecksumPdu".
      boolean CanIfSetPduReceptionModeSupport: set at pre-compile, origin=Vector Informatik, default-value=false  # This parameter switches the feature to be able to set the reception mode of a Rx-PDU. The reception mode can be set per Rx-PDU and only for Rx-PDU whose parameter "CanIfRxPduSetReceptionModePdu" is enabled. true: The feature to control the reception mode of a Rx-PDU is enabled at all in the CAN Interface module. false: The feature to control the reception mode of a Rx-PDU is disabled at all in the CAN Interface module.
      boolean CanIfTxBufferPrioByCanIdSupport: set at pre-compile, origin=Vector Informatik, default-value=false  # Enables the support of Tx buffers of handling type "PRIO_BY_CANID". NOTE: The handling type of a Tx buffer can be configured individually for each "CanIfBufferCfg" via the parameter "CanIfTxBufferHandlingType". In case a Tx buffer of handling type "PRIO_BY_CANID" is configured, this parameter is enabled and locked automatically. true: Tx buffers of handling type PRIO_BY_CANID are supported. false: Tx buffers of handling type PRIO_BY_CANID are NOT supported at all. NOTE: This parameter must be set to "true" at Pre-Compile time to be able to add Tx buffers of type "PRIO_BY_CANID" in the Post-Build Loadable configuration phase. NOTE: This parameter is editable only if parameter "CanIfPublicTxBuffering" is enabled. The correct configuration of this parameter is controlled by a validation rule depending on configuration of parameter(s): "CanIfTxBufferHandlingType".
      boolean CanIfSupportCanXL: set at pre-compile, origin=Vector Informatik, default-value=false  # Support CAN XL | Enables the support of CAN XL. true: CAN XL is supported. false: CAN XL is NOT supported at all. NOTE: In case at least one CAN XL PDU is configured, this parameter is enabled and locked automatically. NOTE: This parameter must be set to "true" at Pre-Compile time to be able to configure CAN XL PDUs in the Post-Build Loadable configuration phase.
      container CanIfTTGeneral [0..1]  # This container contains the parameters, which define if and in which way TTCAN is supported. This container is only included and valid if the controller supports TTCAN, TTCAN Interface SWS is used and TTCAN is enabled.
        boolean CanIfTTJoblist: set at pre-compile, default-value=false  # NOT supported. Defines whether TTCAN is processed via a joblist. true: Joblist is used. false: No joblist is used. This parameter is only configurable if TTCAN is enabled by parameter CanIfSupportTTCAN.
        integer CanIfTTMaxIsrDelay: 0..65535, set at post-build in variant post-build-loadable+post-build-selectable / pre-compile in variant pre-compile, default-value=0  # NOT supported. Defines the maximum delay for the execution of the joblist execution function JLEF. This parameter is only configurable if a joblist is enabled by parameter CanIfTTJobList.
    container CanIfPublicCfg  # This container contains the public configuration (parameters) of the CAN Interface module.
      boolean CanIfPublicCancelTransmitSupport: set at pre-compile, default-value=false  # Cancel Transmit Support | This parameter enables/disables the API 'CanIf_CancelTransmit'. This API can be used to request the cancellation of a Tx-PDU. true: API 'CanIf_CancelTransmit' is enabled. false: API 'CanIf_CancelTransmit' is disabled.
      string CanIfPublicCddHeaderFile [0..*]: set at pre-compile, max-length=32, min-length=1  # Cdd Header Files | By this parameter additional header files can be specified which shall be included by the CAN Interface module. The specified header files are generated into the file CanIf_Lcfg.c. The configuration of this parameter is mandatory if the module CDD is used otherwise the code won't compile. In case of module CDD is used all the header files where the prototypes of - Rx-indication, - Tx-confirmation - and other callback functions are specified and which have to be serviced by the CAN Interface module shall be configured by this parameter. Range of characters is 1.. 32.
      boolean CanIfPublicChangeBaudrateSupport [0..1]: set at pre-compile, default-value=false  # Change Baudrate Support | This parameter enables/disables the APIs 'CanIf_ChangeBaudrate' and 'CanIf_CheckBaudrate' This APIs can be used to change/check the baudrate of a CAN controller. true: APIs 'CanIf_ChangeBaudrate' and 'CanIf_CheckBaudrate' are enabled. false: APIs 'CanIf_ChangeBaudrate' and 'CanIf_CheckBaudrate' are disabled.
      boolean CanIfPublicDevErrorDetect: set at pre-compile, default-value=true  # Dev Error Detect | This parameter switches the Development Error Detection (DET) and Notification ON or OFF. true: Development error detection is enabled. false: Development error detection is disabled. NOTE: In general, the development error detection is recommended during pre-test phase. It is not recommended to enable the development error detection in production code due to increased runtime and ROM needs.
      enumeration CanIfPublicHandleTypeEnum: {UINT16, UINT8}, set at pre-compile, default-value=UINT8  # Handle Type Enum | NOT used. This parameter is used to configure the Can_HwHandleType. The Can_HwHandleType represents the hardware object handles of a CAN hardware unit. For CAN hardware units with more than 255 HW objects the extended range shall be used (UINT16).
      boolean CanIfPublicMultipleDrvSupport: set at pre-compile, default-value=false  # Multiple Drv Support | Selects support for multiple CAN driver modules. true: Support for multiple CAN driver modules is enabled false: Support for multiple CAN driver modules is disabled
      integer CanIfPublicNumberOfCanHwUnits: 1..255, set at pre-compile, default-value=1  # Number Of Can Hw Units | NOT used. Number of served CAN hardware units. NOTE: Only one CAN driver module is supported.
      boolean CanIfPublicPnSupport: set at pre-compile, default-value=false  # Pn Support | This parameter switches the support of Partial Network (PN) features in the CAN Interface module. true: The PN-features represented by parameters 'CanIfPnTrcvHandlingSupport' and 'CanIfPnWakeupTxPduFilterSupport' can be configured. false: None of PN-features mentioned above can be configured. NOTE: The partial network features have to be configured explicitely by the parameters: 'CanIfPnTrcvHandlingSupport' and 'CanIfPnWakeupTxPduFilterSupport'. The parameter 'CanIfPnTrcvHandlingSupport' is configurable only in case of parameter ''CanIfTransceiverHandling' is enabled.
      boolean CanIfPublicReadRxPduDataApi: set at pre-compile, default-value=false  # Read Rx Pdu Data Api | NOT supported. This parameter enables/disables the API 'CanIf_ReadRxPduData()' for reading received Rx-PDU data. true: API 'CanIf_ReadRxPduData' is enabled false: API 'CanIf_ReadRxPduData' is disabled
      boolean CanIfPublicReadRxPduNotifyStatusApi: set at pre-compile, default-value=false  # Read Rx Pdu Notify Status Api | NOT supported. This parameter enables/disables the API 'CanIf_ReadRxNotifStatus' for reading of the receive indication status of any Rx-PDU. true: API 'CanIf_ReadRxNotifStatus' is enabled. false: API 'CanIf_ReadRxNotifStatus' is disabled.
      boolean CanIfPublicReadTxPduNotifyStatusApi: set at pre-compile, default-value=false  # Read Tx Pdu Notify Status Api | NOT supported. This parameter enables/disables the API 'CanIf_ReadTxNotifStatus' for reading the notification status of Tx-PDUs. true: API 'CanIf_ReadTxNotifStatus' is enabled. false: API 'CanIf_ReadTxNotifStatus' is disabled.
      boolean CanIfPublicSetDynamicTxIdApi: set at pre-compile, default-value=false  # Set Dynamic Tx Id Api | This parameter enables/disables the API 'CanIf_SetDynamicTxId'. This API allows the reconfiguration of the CAN Identifier of a dynamic Tx-PDU. A dynamic Tx-PDU is configured by setting of parameter 'CanIfTxPduType' (s. container 'CanIfTxPduConfig') to value 'DYNAMIC'. true: API 'CanIf_SetDynamicTxId' is enabled, false: API 'CanIf_SetDynamicTxId' is disabled.
      boolean CanIfPublicTxBuffering: set at pre-compile, default-value=false  # Tx Buffering | This parameter switches the buffering of Tx-PDUs mapped to a Tx-buffer (rejected by the CAN driver module) within the CAN Interface module. NOTE: The handling type of a Tx-buffer can be configured individually for each "CanIfBufferCfg" via the parameter "CanIfTxBufferHandlingType". true: The Tx-PDU buffer is enabled at all. false: The Tx-PDU buffer is disabled at all. NOTE: The correct configuration of this parameter is controlled by a validation rule depending on configuration of parameter(s): "CanIfTxBufferHandlingType".
      boolean CanIfPublicTxConfirmPollingSupport: set at pre-compile, default-value=false  # Tx Confirmation Polling Support | This parameter enables/disables the API 'CanIf_GetTxConfirmationState'. This API allows to poll for Tx confirmation state per each CAN controller. true: The API 'CanIf_GetTxConfirmationState' is enabled. false: The API 'CanIf_GetTxConfirmationState' is disabled.
      boolean CanIfPublicVersionInfoApi: set at pre-compile, default-value=false  # Version Info Api | This parameter enables/disables the API 'CanIf_GetVersionInfo()' to get major, minor and patch version information of the CAN Interface module. true: The API 'CanIf_GetVersionInfo()' is enabled. false: The API 'CanIf_GetVersionInfo()' is disabled.
      boolean CanIfPublicWakeupCheckValidByNM [0..1]: set at pre-compile, default-value=false  # Wakeup Check Validation By NM | This parameter switches whether only the reception of Network Management (NM) messages shall validate a detected wake-up event or all messages of corresponding CAN controller. true: Only the reception of a NM message validates the detected wake-up event. false: The reception of any message of corresponding CAN controller validates the detected wake-up event. NOTE: This parameter is only configurable and the value of it is considered only if the feature 'Wakeup Check Validation Support' is enabled (s. parameter 'CanIfPublicWakeupCheckValidSupport').
      boolean CanIfPublicWakeupCheckValidSupport: set at pre-compile, default-value=false  # Wakeup Check Validation Support | This parameter switches the support for wake-up validation. true: Wake-up validation is enabled. false: Wake-up validation is disabled. NOTE: This parameter is only editable and the value of it is considered only if feature 'Wakeup Support' is enabled (s. parameter 'CanIfWakeupSupport').
      boolean CanIfPnWakeupTxPduFilterSupport: set at pre-compile, origin=Vector Informatik, default-value=false  # Pn Wakeup Tx Pdu Filter Support | This parameter switches the support of a filter for Tx-PDUs which may be required in case of use case Partial Network (PN). true: Tx-PDU filter is enabled. false: Tx-PDU filter is disabled. If the Tx-PDU filter is enabled the filter is activated in case of the PDU mode of the CAN Interface module is changed either to mode 'CANIF_SET_TX_ONLINE_WAKF' or to mode 'CANIF_SET_ONLINE_WAKF'. The filter is deactivated if a Tx-confirmation or a Rx-indication arrives on corresponding CAN controller or the mentioned PDU modes are left explicitly. If the filter is activated the CAN Interface module blocks every Tx-PDU to be transmitted with exception of special configured one(s). Tx-PDUs which shall pass the filter have to be configured by enabling of parameter 'CanIfTxPduPnFilterPdu'. NOTE: This parameter is only editable and the value of it is considered only if feature 'Pn Support' is enabled (s. parameter 'CanIfPublicPnSupport').
      boolean CanIfPnTrcvHandlingSupport: set at pre-compile, origin=Vector Informatik, default-value=false  # Pn Transceiver Handling Support | This parameter switches the support of an AUTOSAR partial network CAN transceiver driver module. Therefor the following APIs are enabled/disabled via this parameter: - CanIf_ConfirmPnAvailability - CanIf_ClearTrcvWufFlag - CanIf_ClearTrcvWufFlagIndication - CanIf_CheckTrcvWakeFlag - CanIf_CheckTrcvWakeFlagIndication true: The mentioned APIs are enabled. false: The mentioned APIs are disabled. NOTE: This parameter is only editable and the value of it is considered only if both features 'Transceiver Handling' (s. parameter 'CanIfTransceiverHandling') and 'Pn Support' (s. parameter 'CanIfPublicPnSupport') are enabled.
      boolean CanIfMetaDataSupport [0..1]: set at pre-compile, origin=Vector Informatik, default-value=false  # This parameter switches the support for dynamic CAN identifier handling by using of SDU meta data. The value of this parameter is only considered in case of configuration variant Post-build loadable. In case of configuration variant Pre-compile the setting of this feature is determined from the configuration of Rx- and Tx-PDUs (s. parameter 'MetaDataLength'). If there is at least one Rx-PDU with configured 'MetaDataLength' then this feature is enabled for Rx-path, The same applies for the Tx-path. true: The support for dynamic CAN identifier handling by using of SDU meta data both for Rx and Tx is enabled (independent of there are any Rx-/Tx-PDUs with a configured 'MetaDataLength'). false: The support for dynamic CAN identifier handling by using of SDU meta data is disabled at all. (Only if there are no Rx-/Tx-PDUs with configured 'MetaDataLength').
      boolean CanIfSetBaudrateApi [0..1]: set at pre-compile, origin=Vector Informatik, default-value=false  # This parameter enables/disables the API 'CanIf_SetBaudrate'. By usage of this API the baud rate of a CAN Controller can be changed. true: The API 'CanIf_SetBaudrate' is enabled. false: The API 'CanIf_SetBaudrate' is disabled.
      enumeration CanIfJ1939DynAddrSupport: set at pre-compile, origin=Vector Informatik, default-value=DISABLED  # J1939 Dynamic Address Support | If enabled, the CAN Interface module is able to translate addresses according to J1939 by using dynamic address lookup tables. These tables are maintained by J1939Nm. The CAN controller specific configuration is performed via the parameter 'CanIfCtrlJ1939DynAddrSupport'. DISABLED: Feature is disabled at all. EXTENDED_CANID: Feature is enabled at all. Only addresses of CAN messages with 29bit extended CAN identifiers are able to be translated. MIXED_CANID: Feature is enabled at all. Addresses of CAN messages with 11bit standard and 29bit extended CAN identifiers are able to be translated. NOTE: The correct setting of this parameter (according to values of "CanIfCtrlJ1939DynAddrSupport") is performed automatically by DaVinci Configurator 5.
        DISABLED  # Feature disabled
        EXTENDED_CANID  # Only extended CAN IDs
        MIXED_CANID  # Extended and standard CAN IDs
      boolean CanIfExtendedRamCheckSupport [0..1]: set at pre-compile, origin=Vector Informatik, default-value=false  # This parameter switches the feature Extended RAM-check in the CAN Interface module. If enabled then the CAN Interface module provides the API "CanIf_RamCheckExecute()" in order to request an underlying CAN controller to execute a check of CAN-controller-HW-registers. In addition if this feature is enabled the APIs "CanIf_RamCheckCorruptMailbox()" and "CanIf_RamCheckCorruptController()" are provided to report about corrupt mailbox(es) (EcuC-object: "CanHardwareObject") and/or CAN controller(s) (EcuC-object: "CanController"). Such failures are forwarded by the CAN Interface module to APIs which are configured by parameters: "CanIfDispatchUserRamCheckCorruptMailboxName" and "CanIfDispatchUserRamCheckCorruptControllerName". These additional parameters MUST be configured if this feature is enabled. Furthermore if this feature is enabled the APIs "CanIf_RamCheckEnableMailbox()" and "CanIf_RamCheckEnableController ()" are provided in order to be able to enable a mailbox (EcuC-object: "CanHardwareObject") and/or a CAN controller (EcuC-object: "CanController") which former were reported as corrupt ones. NOTE: A mailbox and/or a CAN controller which is reported to be a corrupt-one is deactivated automatically by the CAN driver module. true: The feature Extended RAM-check is enabled at all in the CAN Interface module. false: The feature Extended RAM-check is disabled at all in the CAN Interface module.
      boolean CanIfSafeBswChecks: set at pre-compile, origin=Vector Informatik, default-value=false  # Selects if safety checks are used. These checks improve robustness as e.g. invalid parameters are checked before function is executed. This attribute has to be enabled for safety projects where this component is mapped to an ASIL partition.
      boolean CanIfBusMirroringSupport: set at pre-compile, origin=Vector Informatik, default-value=false  # Enable support for Bus Mirroring. It can only be used with Vector CAN driver modules. true: Bus Mirroring is enabled. false: Bus Mirroring is disabled.
      boolean CanIfEnableSecurityEventReporting: set at pre-compile, origin=Vector Informatik, default-value=false  # Enable security event reporting. true: Security event reporting is enabled. false: Security event reporting is disabled.
      boolean CanIfSupportMultipartition: set at pre-compile, origin=Vector Informatik, default-value=false  # Enable support for multi-partition true: Multi-partition is enabled. CAN controllers are mapped to at least two different partitions via the parameter CanIfCtrlCfg/CanIfEcucPartitionRef. false: Multi-partition is disabled (CAN controllers are mapped to the same or to no partition; CAN drivers do not support it). NOTE: The correct configuration of this parameter is controlled by a validation rule depending on configuration of parameter(s): "CanIfCtrlCfg/CanIfEcucPartitionRef" and "CanGeneral/CanSupportMultipartition".
      boolean CanIfPublicSetDynamicRxIdApi: set at pre-compile, origin=Vector Informatik, default-value=false  # Set Dynamic Rx Id Api | Enables the support of dynamic Rx PDUs. A dynamic Rx PDU is configured by setting parameter 'CanIfRxPduType' (s. container 'CanIfRxPduConfig') to value 'DYNAMIC'. For dynamic Rx PDUs the CAN identifier must be set during 'CanIf_Init()' via the callout 'Appl_CanIfSetDynamicRxId()' (s. parameter CanIfDispatchCfg/CanIfDispatchUserSetDynamicRxIdName). true: Support of dynamic Rx PDUs is enabled, false: Support of dynamic Rx PDUs is disabled. NOTE: In case of configuration variant Pre-compile the setting of this feature is determined from the configuration of Rx PDUs (s. parameter 'CanIfRxPduCfg/CanIfRxPduType'). If there is at least one Rx PDU with configured CanIfRxPduType set to DYNAMIC then this feature is enabled.
      container CanIfSecurityEventRefs [0..1]  # This container contains the security event reference configuration.
        symbolic name reference CANIF_SEV_TX_ERROR_DETECTED [0..1]: set at pre-compile, origin=Vector Informatik, destination=IdsMEvent  # Security Event Tx Error Detected | This parameter is a reference to the corresponding configured security event in the IdsM.
        symbolic name reference CANIF_SEV_RX_ERROR_DETECTED [0..1]: set at pre-compile, origin=Vector Informatik, destination=IdsMEvent  # Security Event Rx Error Detected | This parameter is a reference to the corresponding configured security event in the IdsM.
        symbolic name reference CANIF_SEV_ERRORSTATE_PASSIVE [0..1]: set at pre-compile, origin=Vector Informatik, destination=IdsMEvent  # Security Event Error State Passive | This parameter is a reference to the corresponding configured security event in the IdsM.
        symbolic name reference CANIF_SEV_ERRORSTATE_BUSOFF [0..1]: set at pre-compile, origin=Vector Informatik, destination=IdsMEvent  # Security Event Error State BusOff | This parameter is a reference to the corresponding configured security event in the IdsM.
    container CanIfTrcvDrvCfg [0..*]  # Transceiver Driver Cfg | This container contains the configuration (parameters) of all addressed CAN transceivers by each underlying CAN transceiver driver module. For each CAN transceiver driver module a seperate instance of this container shall be provided.
      container CanIfTrcvCfg [1..*]  # Transceiver Cfg | This container contains the configuration (parameters) of one addressed CAN transceiver by the underlying CAN transceiver driver module. For each CAN transceiver a seperate instance of this container has to be provided.
        integer CanIfTrcvId: 0..255, set at pre-compile, symbolic-name-value=true, default-value=0  # Transceiver Id | This parameter abstracts from the CAN transceiver driver module specific parameter 'CanTrcvChannelId'. Each transceiver of all connected CAN transceiver driver modules shall be assigned to one specific 'CanIfTrcvId' of the CAN Interface module. Range: 0..number of configured transceiver of all CAN transceiver driver modules NOTE: The value of this parameter is calculated and set automatically by the generation tool DaVinci Configurator 5.
        boolean CanIfTrcvWakeupSupport: set at pre-compile in variant post-build-loadable+pre-compile / post-build in variant post-build-selectable, default-value=false  # Transceiver Wakeup Support | This parameter defines if a respective CAN transceiver of the referenced CAN transceiver driver modules is queriable for wake-up events. true: The referenced CAN transceiver has a wake-up event and shall be queried by the CAN Interface module. false: The referenced CAN transceiver has NO wake-up event and shall not be queried by the CAN Interface module.
        symbolic name reference CanIfTrcvCanTrcvRef: set at pre-compile, destination=CanTrcvChannel  # Transceiver CanTransceiver Ref | This parameter references to the logical handle of the underlying CAN transceiver from the CAN transceiver driver module to be served by the CAN Interface module. Range: 0..max. number of underlying supported CAN transceivers
  bsw implementation CanIf_Impl: programming-language=C, sw-version=11.02.00, used-code-generator=cMSR, vendor-id=30, ar-release-version=4.00.03, behavior=CanIf_Behavior, preconfigured-configuration=CanIf_Pre, recommended-configuration=CanIf_Rec, vendor-specific-module-def=CanIf
  module config CanIf_Pre: definition=CanIf
  module config CanIf_Rec: definition=CanIf
