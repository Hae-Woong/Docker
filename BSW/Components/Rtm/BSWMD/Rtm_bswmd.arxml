AUTOSAR XML (schema 4-0-3)
package /MICROSAR
  module definition Rtm: category=VENDOR_SPECIFIC_MODULE_DEFINITION, variants pre-compile/link-time  # Runtime Measurement. Rtm allows the user to determine runtimes and CPU load of BSW modules and user code sections. Measurement is controlled- and evaluated in CANoe by RTM's frontend or a self-written RTM application. Data exchange between CANoe and the ECU is done by the XCP protocol. #AMD #Xcp #CANoe #CANape #Monitoring #RuntimeMeasurement #Vector
    container RtmGeneral  # General configuration parameters of the RTM.
      boolean RtmDevErrorDetect: set at pre-compile, origin=Vector Informatik, default-value=true  # This parameter switches the Development Error Detection and Notification ON or OFF. true: Development error detection is enabled. false: Development error detection is disabled. Note: In general, the development error detection is recommended during pre-test phase. It is not recommended to enable the development error detection in production code due to increased runtime and ROM needs.
      string RtmGetMeasurementTimestampFct: set at pre-compile, origin=Vector Informatik, default-value=Rtm_GetTimeMeasurement  # Name of the function or macro that shall be used by RTM to acquire the current value of a hardware counter. The prototype will be defined in Rtm_Cbk.h. This function has to be provided by the application. Prototype: Rtm_TimestampType Rtm_GetTimeMeasurement(void); The return type Rtm_TimestampType depends on the parameter Rtm32BitTimer.
      integer RtmMeasurementCtrFrequency: 1000..4294967295, set at pre-compile, origin=Vector Informatik, default-value=10000  # Number of ticks per [ms] provided by the hardware timer. The frequency of the hardware timer used to acquire measurement timestamps has to be adjusted to provide a compromise between accuracy and maximal measurement duration. If the timer has a frequency of 10MHz, then this parameter shall be set to 10000[Ticks/ms]. A higher frequency results in higher measurement accuracy but will also shorten the period which can be measured.
      enumeration RtmCtrDirection: set at pre-compile, origin=Vector Informatik, default-value=RTM_UP  # Defines the counting direction of the hardware counter: -RTM_UP: 0 to MAXVAL -RTM_DOWN: MAXVAL to 0
        RTM_UP  # Upwards
        RTM_DOWN  # Downwards
      float RtmMainfunctionCycleTime: 0.001..1, set at pre-compile, origin=Vector Informatik, default-value=0.01  # Cycle time of RTM main function. A value of 0.01 [s] is recommended. Lower values result in higher update-rates during live measurement but also require more bandwidth to transmit the measurement results. Higher values may lead to erroneous results if the main function's cycle time has a jitter larger than a half of the hardware counters cycle time.
      string RtmUserConfigFile [0..1]: set at pre-compile, origin=Vector Informatik  # A configuration file is generated by Cfg5. If you want to overwrite settings in the generated configuration file, you can specify a path to a user defined configuration file. Note: The user defined configuration file will be included at the end of the generated file. Therefore definitions in the user defined configuration file can overwrite definitions in the generated configuration file. The contents of the user defined configuration file is copied to the end of <Bsw>_Cfg.h.
      boolean RtmTimerOverrunSupport: set at pre-compile, origin=Vector Informatik, default-value=false  # This parameter switches the Support for Timer Overruns ON or OFF. true: Timer Overrun Handling is enabled. false: Timer Overrun Handling is disabled.
      boolean Rtm32BitTimer: set at pre-compile, origin=Vector Informatik, default-value=false  # Specifies if 32bit timer is used. If set to true: a 32bit timer is used If set to false: a 16bit timer is used
      boolean RtmUseNestingCounter: set at pre-compile, origin=Vector Informatik, default-value=true  # The nesting counter is used to detect successive activation of a measurement point before stopping.
      integer RtmUsedCoreMask: 1..65535, set at pre-compile, origin=Vector Informatik, default-value=1  # Specifies selection of cores to be measured. This parameter must not be changed! It is calculated automatically.
      boolean RtmControl: set at pre-compile, origin=Vector Informatik, default-value=false  # If enabled the global variable Rtm_ControlState is provided which allows disabling and enabling the RTM functionality during runtime. The feature may be used to prevent unintended RTM activity by disabling the functionality on a special trigger. If this option is disabled RTM will always be activated in the ECU.
      boolean RtmSafeBswChecks: set at pre-compile, origin=Vector Informatik, default-value=false  # Selects if safety checks are used. These checks improve robustness as e.g. invalid parameters are checked before function is executed. This attribute has to be enabled for safety projects where this component is mapped to an ASIL partition.
      string RtmEcuName: set at pre-compile, origin=Vector Informatik, default-value=Rtm, max-length=50, min-length=1  # This parameter specifies the ECU name within the XCP settings of CANoe.
      reference RtmNvMTaskStackUsage [0..1]: set at pre-compile, origin=Vector Informatik, destination=NvMBlockDescriptor  # NvM Task Stack Usage | This optional reference can be used to persist the task stack usage in the NvM.
      reference RtmNvMResults [0..1]: set at pre-compile, origin=Vector Informatik, destination=NvMBlockDescriptor  # NvM Results | This optional reference can be used to persist all measurement results (Rtm_Results[]: uint32 time, uint32 count, uint32 min, uint32 max) as raw values (in ticks) in the NvM.
    container RtmMeasurementPoint [0..*]  # Each measurement point describes one code area whose runtime shall be measured using the RTM module.
      boolean RtmAutostartEnabled: set at pre-compile, origin=Vector Informatik, default-value=false  # Defines if this measurement shall be activated during ECU startup automatically. Autostart may be used for init-functions which are called only during the startup-phase the communication stack, XCP and RTM module are activated. Note: Each autostart measurement causes CPU-load. It is therefore advised to activate autostart only when it is required.
      boolean RtmMeasurementEnabled: set at pre-compile, origin=Vector Informatik, default-value=true  # This parameter defines the availability of a measurement section during pre-compile time. If disabled, the measurement points of this section will be generated as empty macros. Hence this measurement section requires no memory- or runtime resources. Since the measurement settings are still part of the ECU configuration, the measurement enabled settings can be changed later.
      string RtmMeasurementGroup [0..1]: configuration-class-affection=affection-kind=NO-AFFECT, set at pre-compile, origin=Vector Informatik, default-value=Default  # The name can be used to organize measurement sections into groups by defining a unique group name. The groups will be visible in CANoe and the generated measurement report.
      boolean RtmDisableInterrupts: configuration-class-affection=affection-kind=NO-AFFECT, set at pre-compile, origin=Vector Informatik, default-value=false  # Defines if interrupts are locked during measurement. If enabled, RTM locks interrupts during measurement using the critical section RTM_EXCLUSIVE_AREA_0. This results in more accurate measurement results but will increase the time spent with locked interrupt.
      integer RtmMeasurementId: 0..65535, set at pre-compile, origin=Vector Informatik, symbolic-name-value=true, default-value=0  # This ID defines the measurement object
      enumeration RtmMeasurementType: {GrossExecutionTime, FlatExecutionTime, NetExecutionTime}, set at pre-compile, origin=Vector Informatik, default-value=GrossExecutionTime  # The measurement type defines the measurement behavior of this measurement point. If set to GrossExecutionTime: - Measures the absolute time between measurement start and stop. If set to NetExecutionTime: - Measures like GrossExecutionTime minus interruptions by task or ISR. If set to FlatExecutionTime: - Measures like NetExecutionTime minus the execution time of nested measurement points.
      enumeration RtmMeasurementPointType: {Runtime, Task, CPU_Load}, set at pre-compile, origin=Vector Informatik, default-value=Runtime  # This parameter defines whether the measurement point measures: Runtime: Regular runtime measurement point. Task: Task response time measurement point. CPU_Load: Core specific CPU load measurement point.
      integer RtmTargetRuntime: 0..1000000, set at pre-compile, origin=Vector Informatik, default-value=0  # This parameter determines the target (respectively the expected) runtime of the Measurement Point (MP). In the following use cases this value must be defined (greater than 0): 1. For /RtmThresholdCallback it defines when the callback is called. 2. For the calculation of relative maximum measurement results. 3. For LET MPs (configured by RTE) it is used to calculate the relative remaining time. 4. For task response time MPs (/RtmMeasurementPointType set to 'Task'), this value defines the runtime required for the 100% percentile.
      boolean RtmThresholdCallback: set at pre-compile, origin=Vector Informatik, default-value=false  # Enables the call of an application callback if the configured threshold (/RtmTargetRuntime) is elapsed between the last calls of Rtm_Start() and Rtm_Stop). The name scheme of the callback is "Rtm_<NameOfTheMP>_ThresholdCbk(Rtm_MeasurementTimestampType executionTime)".
      reference RtmAssignedToCore: set at pre-compile, origin=Vector Informatik, destination=RtmCoreDefinition  # Defines on which core the Measurement Point is running.
    container RtmCoreDefinition [1..*]: multiple-configuration-container=true  # Each Measurement Point needs to have a core description assigned. The core description defines on which core the Measurement Point is running on. There is a special case when no /MICROSAR/Rtm/RtmCoreDefinition/RtmCore is configured. This is for cross core applications where a measurement is started on one core and stopped on another core.
      integer RtmCoreDefinitionId: 0..65535, set at pre-compile, origin=Vector Informatik, symbolic-name-value=true, default-value=0  # Symbolic Name Value of this container.
      integer RtmNumberOfTaskResponseTimePercentiles [0..1]: 2..255, set at pre-compile, origin=Vector Informatik, default-value=10  # When this feature is enabled (value > 0) a percentile histogram is calculated and managed by the RTM. The histogram is divided in as many divisions as here configured exclusively the additional 200% percentile. Example: If this parameter is set to 2, there is the 0-99%, the 100-199%, and the 200% percentiles. Please note: This feature requires additional runtime and memory. The histogram can be persisted in NvM. If this parameter does not exist, this feature is disabled.
      integer RtmCore [0..1]: 0..65535, set at pre-compile, origin=Vector Informatik, default-value=0  # Defines the core the application is running on. For cross core measurement, leave this field empty.
      boolean RtmBSWCore: set at pre-compile, origin=Vector Informatik, default-value=false  # This parameter defines whether this Core is running the BSW software. Only one Core Definition can have this flag set.
      string RtmBackgroundTaskName [0..1]: set at pre-compile, origin=Vector Informatik, default-value=BackgroundTaskName, max-length=511, min-length=1  # Name of the background/idle task of this core. This parameter is only required for CPU load measurement. Per default, the IdleTask_OsCore<CoreId> is the correct background/idle task, but it is possible to cover this task by a custom background/idle task implementing an endless loop. As this task has a higher priority, the IdleTask_OsCore<CoreId> will never be called. Therefore, the custom background/idle task shall be set here.
      reference RtmNvMTaskResponseTimePersistencyBlock [0..1]: set at pre-compile, origin=Vector Informatik, destination=NvMBlockDescriptor  # NvM Task Response Time Persistency Block | This optional reference can be used to persist histogram information in the NvM. The histogram information is available for each core seperately and therefore requires a NvM block for each core.
    container RtmCpuLoadMeasurement [0..1]  # If this container exists, the CPU load measurement is enabled.
      float RtmHyperperiod: 0.001..60, set at pre-compile, origin=Vector Informatik, default-value=0.1  # Defines the time frame of the histogram information. Needs to be a multiple of the Rtm Mainfunction Cycle Time.
      enumeration RtmCpuLoadControlMode: {C_API, Xcp}, set at pre-compile, origin=Vector Informatik, default-value=C_API  # Define how the Cpu load is measured and the measurement is controlled. If set to "C_API", the Cpu load measurement is started and stopped and the results are requested with C APIs. If set to "Xcp", the Cpu load is measured by a measurement point. This measurement point can be activated like all other measurement points. Hint: For this feature a measurement point called "Rtm_CpuLoadMeasurement" (resp. in multi core "Rtm_CpuLoadMeasurement_<CoreId>") has to exist and must be enabled in order to measure the overall CPU load. Please note that this measurement point(s) should not be called by an application.
      integer RtmNumberOfCpuLoadPercentiles [0..1]: 2..99, set at pre-compile, origin=Vector Informatik, default-value=10  # When this feature is enabled (this parameter exists) a percentile histogram is calculated and managed by the RTM. The histogram is divided in as many divisions as here configured exclusively the additional 100% percentile. Example: If this parameter is set to 2, there is the 0-49%, the 50-99%, and the 100% percentiles. Please note: This feature requires additional runtime and memory. The histogram can be persisted in NvM. If this parameter does not exist, this feature is disabled.
      reference RtmNvMCpuLoadPersistencyBlock [0..1]: set at pre-compile, origin=Vector Informatik, destination=NvMBlockDescriptor  # NvM Cpu Load Persistency Block | This optional reference can be used to persist the CPU load histogram information in the NvM.
  bsw implementation Rtm_Impl: programming-language=C, sw-version=11.00.00, used-code-generator=DaVinci Configurator, vendor-id=30, ar-release-version=4.02.02, behavior=RtmBehavior, preconfigured-configuration=Rtm_Pre, recommended-configuration=Rtm_Rec, vendor-specific-module-def=Rtm
  module config Rtm_Pre: definition=Rtm
  module config Rtm_Rec: definition=Rtm
