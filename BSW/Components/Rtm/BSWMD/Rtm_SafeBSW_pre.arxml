AUTOSAR XML (schema 4-0-3)
package /MICROSAR
  module config Rtm_Rec: definition=Rtm
    RtmGeneral: RtmSafeBswChecks=1
