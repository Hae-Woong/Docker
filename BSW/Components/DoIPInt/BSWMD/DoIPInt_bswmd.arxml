AUTOSAR XML (schema 4-2-2)
package /MICROSAR
  bsw implementation DoIPInt_Impl: programming-language=C, sw-version=7.00.00, used-code-generator=DaVinci Configurator, vendor-id=30, ar-release-version=4.02.02, behavior=DoIPIntBehavior, preconfigured-configuration=DoIPInt_Pre, recommended-configuration=DoIPInt_Rec, vendor-specific-module-def=DoIPInt
  module definition DoIPInt [0..1]: category=VENDOR_SPECIFIC_MODULE_DEFINITION, variants pre-compile  # The Diagnostic over IP for vehicle internal communication (DoIPInt) module implements a transport protocol for diagnostic data over the Internet Protocol. It is derived from the DoIP module according to ISO Standard 13400 and adapted to fit the vehicle internal communication needs. #Ethernet #Diag #Vector
    container DoIPIntConfigSet: multiplicity set at pre-compile  # This container contains the configuration parameters and sub containers of the DoIPInt module.
      container DoIPIntChannel [1..65535]: multiplicity set at pre-compile  # This container includes the configuration to describe the link to the upper layer PDUR module,
        integer DoIPIntChannelId: 0..65534, multiplicity set at pre-compile, origin=Vector Informatik, set at pre-compile, symbolic-name-value=true, default-value=0  # This parameter defines the Channel ID required for API calls using channels (e.g. DoIPInt_OverwriteLogicalAddresses()).
        boolean DoIPIntChannelReadyNotification: multiplicity set at pre-compile, origin=Vector Informatik, set at pre-compile, default-value=false  # This parameter defines whether this channel is related to the channel ready notification. true: BswM is notified when a TCP connection establishment succeeded. false: BswM is not notified.
        choice reference DoIPIntClientOrServerConnectionRef: multiplicity set at pre-compile, origin=Vector Informatik, set at pre-compile, destination=[DoIPIntClientConnection, DoIPIntServerConnection]  # Reference to the DoIPIntClientConnection or DoIPIntServerConnection which is used to send or receive data for this channel.
        reference DoIPIntLocalAddressRef: multiplicity set at pre-compile, origin=Vector Informatik, set at pre-compile, destination=DoIPIntLocalAddress  # Reference to a DoIPIntLocalAddress which is used as logical address in diagnostic messages (e.g. as source address in case of transmission).
        reference DoIPIntRemoteAddressRef: multiplicity set at pre-compile, origin=Vector Informatik, set at pre-compile, destination=DoIPIntRemoteAddress  # Reference to a DoIPIntRemoteAddress which is used as logical address in diagnostic messages (e.g. as target address in case of transmission).
        container DoIPIntPduRRxPdu [0..1]: multiplicity set at pre-compile  # PduR Rx Pdu | This container contains the Rx Pdu for the channel.
          integer DoIPIntPduRRxPduId: 0..65535, multiplicity set at , origin=Vector Informatik, set at , symbolic-name-value=true, default-value=0  # PduR Rx Pdu Id | This parameter defines the Pdu ID required for the TP API calls. (e.g. DoIPInt_TpCancelReceive()) to handle reception to PDUR.
          reference DoIPIntPduRRxPduRef: multiplicity set at pre-compile, origin=Vector Informatik, set at pre-compile, destination=Pdu  # PduR Rx Pdu Ref | Reference to the "global" Pdu structure to allow harmonization of handle IDs in the COM-Stack.
        container DoIPIntPduRTxPdu [0..1]: multiplicity set at pre-compile  # PduR Tx Pdu | This container contains the Tx Pdu for the channel
          integer DoIPIntPduRTxPduId: 0..65535, multiplicity set at , origin=Vector Informatik, set at , symbolic-name-value=true, default-value=0  # PduR Tx Pdu Id | This parameter defines the Pdu ID required for the TP and IF API calls. (e.g. DoIPInt_TpTransmit()) to send data from PDUR.
          enumeration DoIPIntPduType: {DOIPINT_IFPDU, DOIPINT_TPPDU}, multiplicity set at pre-compile, origin=Vector Informatik, set at pre-compile, default-value=DOIPINT_TPPDU  # This parameter defines the API Type to use for communication with PduR. DOIPINT_IFPDU for UUDT messages, DOIPINT_TPPDU for all other diagnostic messages.
          reference DoIPIntPduRTxPduRef: multiplicity set at pre-compile, origin=Vector Informatik, set at pre-compile, destination=Pdu  # PduR Tx Pdu Ref | Reference to the "global" Pdu structure to allow harmonization of handle IDs in the COM-Stack.
      container DoIPIntConnections: multiplicity set at pre-compile  # This container contains the connections to the lower layer SOAD module.
        container DoIPIntClientConnection [0..32767]: multiplicity set at pre-compile  # This container includes the connection configuration to the lower layer SOAD module for TCP client connections.
          integer DoIPIntClientConnectionId: 0..65535, multiplicity set at pre-compile, origin=Vector Informatik, set at pre-compile, symbolic-name-value=true  # This parameter gives a unique identifier for client and server connections required for API calls using connections (e.g. DoIPInt_CloseConnection(), DoIPInt_TransmitOemSpecificPayloadType()).
          container DoIPIntClientSoAdRxPdu: multiplicity set at pre-compile  # Client SoAd Rx Pdu | This container contains the Rx Pdu for the TCP connection.
            integer DoIPIntClientSoAdRxPduId: 0..65535, multiplicity set at , origin=Vector Informatik, set at , symbolic-name-value=true, default-value=0  # Client SoAd Rx Pdu Id | This parameter defines the Pdu ID required for the TP API calls. (e.g. DoIPInt_SoAdTpRxIndication()) to receive TCP data from SOAD.
            reference DoIPIntClientSoAdRxPduRef: multiplicity set at pre-compile, origin=Vector Informatik, set at pre-compile, destination=Pdu  # Client SoAd Rx Pdu Ref | Reference to the "global" Pdu structure to allow harmonization of handle IDs in the COM-Stack.
          container DoIPIntClientSoAdTxPdu: multiplicity set at pre-compile  # Client SoAd Tx Pdu | This container contains the Tx Pdu for the TCP connection.
            integer DoIPIntClientSoAdTxPduId: 0..65535, multiplicity set at , origin=Vector Informatik, set at , symbolic-name-value=true, default-value=0  # Client SoAd Tx Pdu Id | This parameter defines the Pdu ID required for the TP API calls. (e.g. DoIPInt_SoAdTpTxConfirmation()) to confirm TCP data from SOAD.
            reference DoIPIntClientSoAdTxPduRef: multiplicity set at pre-compile, origin=Vector Informatik, set at pre-compile, destination=Pdu  # Client SoAd Tx Pdu Ref | Reference to the "global" Pdu structure to allow harmonization of handle IDs in the COM-Stack.
        container DoIPIntServerConnection [0..32767]: multiplicity set at pre-compile  # This container includes the connection configuration to the lower layer SOAD module for TCP server connections.
          integer DoIPIntServerConnectionId: 0..65535, multiplicity set at pre-compile, origin=Vector Informatik, set at pre-compile, symbolic-name-value=true  # This parameter gives a unique identifier for client and server connections required for API calls using connections (e.g. DoIPInt_CloseConnection(), DoIPInt_TransmitOemSpecificPayloadType()).
          container DoIPIntServerSoAdRxPdu: multiplicity set at pre-compile  # Server SoAd Rx Pdu | This container contains the Rx Pdu for the TCP connection.
            integer DoIPIntServerSoAdRxPduId: 0..65535, multiplicity set at , origin=Vector Informatik, set at , symbolic-name-value=true, default-value=0  # Server SoAd Rx Pdu Id | This parameter defines the Pdu ID required for the TP API calls. (e.g. DoIPInt_SoAdTpRxIndication()) to receive TCP data from SOAD.
            reference DoIPIntServerSoAdRxPduRef: multiplicity set at pre-compile, origin=Vector Informatik, set at pre-compile, destination=Pdu  # Server SoAd Rx Pdu Ref | Reference to the "global" Pdu structure to allow harmonization of handle IDs in the COM-Stack.
          container DoIPIntServerSoAdTxPdu: multiplicity set at pre-compile  # Server SoAd Tx Pdu | This container contains the Tx Pdu for the TCP connection.
            integer DoIPIntServerSoAdTxPduId: 0..65535, multiplicity set at , origin=Vector Informatik, set at , symbolic-name-value=true, default-value=0  # Server SoAd Tx Pdu Id | This parameter defines the Pdu ID required for the TP API calls. (e.g. DoIPInt_SoAdTpTxConfirmation()) to confirm TCP data from SOAD.
            reference DoIPIntServerSoAdTxPduRef: multiplicity set at pre-compile, origin=Vector Informatik, set at pre-compile, destination=Pdu  # Server SoAd Tx Pdu Ref | Reference to the "global" Pdu structure to allow harmonization of handle IDs in the COM-Stack.
      container DoIPIntRemoteAddress [1..65535]: multiplicity set at pre-compile  # This container defines the logical remote address which is used in the diagnostic messages (e.g. as target address in case of transmission).
        integer DoIPIntRemoteAddressValue: 0..65535, multiplicity set at pre-compile, origin=Vector Informatik, set at pre-compile  # This parameter defines the logical remote address which is sent within diagnostic messages.
      container DoIPIntLocalAddress [1..65535]: multiplicity set at pre-compile  # This container defines the logical local address which is used in the diagnostic messages (e.g. as source address in case of transmission).
        integer DoIPIntLocalAddressValue: 0..65535, multiplicity set at pre-compile, origin=Vector Informatik, set at pre-compile  # This parameter defines the logical local address which is sent within diagnostic messages.
      container DoIPIntOemPayload [0..1]: multiplicity set at pre-compile  # This container defines parameter (Tx/Rx buffer and callback configuration) for OEM payload type messages.
        function name DoIPIntOemPayloadRxCallback [0..1]: multiplicity set at pre-compile, origin=Vector Informatik, set at pre-compile, default-value=Appl_DoIPInt_ReceiveOemSpecificPayloadType, max-length=255, min-length=1  # This parameter defines a callback function to forward received manufacturer-specific payload types to a user via <User>_DoIPIntReceiveOemSpecificPayloadType. Note: In case no DoIPIntOemPayloadRxBuffer is configured which can be used for a connection no reception of OEM specific messages is supported on this connection and the reception of the message is skipped.
        container DoIPIntOemPayloadTxBuffer [0..65535]: multiplicity set at pre-compile  # This container provides parameter to configure a Tx buffer which is used for messages with OEM payload type.
          integer DoIPIntOemPayloadTxBufferSize: 1..65535, multiplicity set at pre-compile, origin=Vector Informatik, set at pre-compile, default-value=1500  # This parameter defines the size of the Tx buffer for OEM payload type.
          choice reference DoIPIntOemPayloadTxBufferClientOrServerConnectionRef [0..65535]: multiplicity set at pre-compile, origin=Vector Informatik, set at pre-compile, destination=[DoIPIntClientConnection, DoIPIntServerConnection]  # Reference to the dedicated client or server connections the Tx buffer is used for. In case a reference exists this buffer is reserved for the dedicated connections. In case no reference exists the buffer can be used for transmission on any connection.
        container DoIPIntOemPayloadRxBuffer [0..65535]: multiplicity set at pre-compile  # This container provides parameter to configure an Rx buffer which is used for messages with OEM payload type.
          integer DoIPIntOemPayloadRxBufferSize: 1..65535, multiplicity set at pre-compile, origin=Vector Informatik, set at pre-compile, default-value=1500  # This parameter defines the size of the Rx buffer for OEM payload type.
          choice reference DoIPIntOemPayloadRxBufferClientOrServerConnectionRef [0..65535]: multiplicity set at pre-compile, origin=Vector Informatik, set at pre-compile, destination=[DoIPIntClientConnection, DoIPIntServerConnection]  # Reference to the dedicated client or server connections the Rx buffer is used for. In case a reference exists this buffer is reserved for the dedicated connections. In case no reference exists the buffer can be used for reception on any connection.
    container DoIPIntGeneral: multiplicity set at pre-compile  # This container contains general configuration parameters of the DoIPInt module.
      boolean DoIPIntDevErrorDetect: multiplicity set at pre-compile, origin=Vector Informatik, set at pre-compile, default-value=true  # This parameter switches the Development Error Detection and Notification ON or OFF. true: Development error detection is enabled. false: Development error detection is disabled. Note: In general, the development error detection is recommended during pre-test phase. It is not recommended to enable the development error detection in production code due to increased runtime and ROM needs.
      boolean DoIPIntSafeBswChecks: multiplicity set at pre-compile, origin=Vector Informatik, set at pre-compile, default-value=false  # Selects if safety checks are used. These checks improve robustness as e.g. invalid parameters are checked before function is executed. This attribute has to be enabled for safety projects where this component is mapped to an ASIL partition.
      float DoIPIntMainFunctionPeriod: 0..0.1, multiplicity set at pre-compile, origin=Vector Informatik, set at pre-compile, default-value=0.005  # This parameter defines the main function call period.
      boolean DoIPIntVersionInfoApi: multiplicity set at pre-compile, origin=Vector Informatik, set at pre-compile, default-value=false  # Version Info API | This parameter activates/deactivates the DoIP_GetVersionInfo() API.
      string DoIPIntUserConfigFile [0..1]: multiplicity set at pre-compile, origin=Vector Informatik, set at pre-compile, max-length=255, min-length=0  # Reference to an external user configuration file that will be included during generation. The content of the user configuration file will be added at the end of the generated module configuration file and allows altering or extending the generated code. Caution: User configuration files can cause the software module to malfunction and must only be used with great care!
      integer DoIPIntTxProcessLimit: 1..255, multiplicity set at pre-compile, origin=Vector Informatik, set at pre-compile, default-value=1  # This parameter specifies how many transmission requests are processed in one main function cycle. A value greater than 1 is only applicable if multiple transmission requests can be processed by SoAd (SoAdTxTpOptimized enabled).
      float DoIPIntRxRetryTimeout: 0.05..5, multiplicity set at pre-compile, origin=Vector Informatik, set at pre-compile, default-value=0.2  # This parameter specifies the retry timeout which is used in two different reception contexts. 1. In case reception to user fails (PduR_DoIPIntTpStartOfReception() API). The module retries the reception until the timeout elapses. The message is dropped as soon as the timeout has elapsed. 2. In case all applicable OEM specific reception buffers are currently in use. The module retries getting a buffer until the timeout elapses. The message is dropped as soon as the timeout has elapsed.
      integer DoIPIntTxQueueSize: 1..65535, multiplicity set at pre-compile, origin=Vector Informatik, set at pre-compile, default-value=16  # This parameter specifies the maximum size of the transmission queue per connection. The transmission queue stores the number of parallel transmission requests on a connection. This parameter does not apply to a connection with a smaller number of DoIPIntChannels than the value specified by this parameter. In this case the number of DoIPIntChannels equals the size of the transmission queue.
      enumeration DoIPIntHeaderStructure: {ISO, LIGHT}, multiplicity set at pre-compile, origin=Vector Informatik, set at pre-compile, default-value=ISO  # This parameter specifies the header structure which is expected on reception and used on transmission. ISO: Version | Inv. Version | Payload Type | Payload Length | Src. Address | Tgt. Address | User Data LIGHT: Src. Address | Tgt. Address | Payload Length | User Data
      integer DoIPIntIfPayloadType [0..1]: 0..65535, multiplicity set at pre-compile, origin=Vector Informatik, set at pre-compile, default-value=32769  # This parameter specifies which payload type shall be used for IF-PDUs. This parameter is only applicable if an IF-PDU is configured and if ISO is used as DoIPIntHeaderStructure.
      string DoIPIntApplicationHeaderFileInclusion [0..255]: multiplicity set at pre-compile, origin=Vector Informatik, set at pre-compile, max-length=255, min-length=3  # This parameter defines a list of header files to be included containing application specific functionality (e.g. for DoIPIntOemPayloadRxCallback configuration). These header files are included in the SoAd_Lcfg.c file.
      integer DoIPIntProtocolVersion: 2..255, multiplicity set at pre-compile, origin=Vector Informatik, set at pre-compile, default-value=3  # This value specifies the DoIP protocol version used in the generic DoIP header. The valid range of this parameter is defined by the always latest release of ISO 13400-2 and can be extended with every new release of the ISO document. As example a value of 0x03 defines the ISO 13400-2:2019 release. Note: The version 0xFF should not be used as it is the default protocol version of the ISO.
      container DoIPIntGeneration: multiplicity set at pre-compile  # This container contains parameters to change general generation behavior.
        enumeration DoIPIntOutOfBoundsWriteProtectionStrategy: multiplicity set at pre-compile, origin=Vector Informatik, set at pre-compile, default-value=NONE  # This parameter is used to configure a strategy to protect the code to write out of bounds. NONE: no protection strategy is generated in the data access. INDEX_SATURATION: arrays are blown up and the data access index is saturated by an appropriate mask. The advantage is the speed of the data access, but own data elements at other indexes of the same variable can be overridden. INDEX_CHECKING: the data access index is validated by a runtime check. The advantage is that values are never written to incorrect indexes of the data access.
          NONE  # none
          INDEX_SATURATION  # index saturation
          INDEX_CHECKING  # index checking
        boolean DoIPIntOutOfBoundsWriteSanitizer: multiplicity set at pre-compile, origin=Vector Informatik, set at pre-compile, default-value=false  # This parameter activates/deactivates the generation of runtime checks which call a DET error notification function to find easily out of bounds write problems. FALSE: no checks are generated in the data access. TRUE: the data access is enriched with DET checks to validate indexes.
        boolean DoIPIntOutOfBoundsReadSanitizer: multiplicity set at pre-compile, origin=Vector Informatik, set at pre-compile, default-value=false  # This parameter activates/deactivates the generation of runtime checks which call a DET error notification function to find easily out of bounds read problems. FALSE: no checks are generated in the data access. TRUE: the data access is enriched with DET checks to validate indexes.
        boolean DoIPIntReduceConstantData2Define: multiplicity set at pre-compile, origin=Vector Informatik, set at pre-compile, default-value=false  # Reduce Constant Data To a Define | This parameter activates/deactivates the capability to generate CONFIG-CLASS PRE-COMPILE ROM arrays as constant define. FALSE: ROM arrays are generated as data even if all values are identical. TRUE: ROM arrays are generated as constant define if all values are identical.
        enumeration DoIPIntBoolDataInArrayOfStructStrategy: multiplicity set at pre-compile, origin=Vector Informatik, set at pre-compile, default-value=BITMASKING  # This parameter is used to tailor the usage of boolean data in structures in all CONFIG-CLASSES ROM data. The difference between BITFIELD and BITMASKING depends on your compiler options and memory mapping. BOOLEAN: the datatype of boolean data is native boolean. BITFIELD: the bitfield type is used and the compiler extracts the boolean data from structures. BITMASKING: generated masks are used to extract the boolean data from structures.
          BOOLEAN  # boolean
          BITFIELD  # bitfield
          BITMASKING  # bitmasking
        boolean DoIPIntDeduplicateIndirectedData: multiplicity set at pre-compile, origin=Vector Informatik, set at pre-compile, default-value=true  # This parameter activates/deactivates the capability to compress 0:N relational ROM data in all CONFIG-CLASSES without increasing the runtime. FALSE: 0:N relational ROM data is not compressed. TRUE: 0:N relational ROM data is compressed without increasing the runtime.
        enumeration DoIPIntDataDeduplicationStrategy: multiplicity set at pre-compile, origin=Vector Informatik, set at pre-compile, default-value=DEDUPLICATE_CONST_DATA_WITH_CAST  # This parameter is used to taylor the the deduplication of CONFIG-CLASS PRE-COMPILE ROM data. NONE: The generated data is not deduplicated. DEDUPLICATE_CONST_DATA_WITHOUT_CAST: The data is deduplicated without using casts. DEDUPLICATE_CONST_DATA_WITH_CAST: The data is deduplicated using casts.
          NONE  # none
          DEDUPLICATE_CONST_DATA_WITHOUT_CAST  # deduplicate const data without cast
          DEDUPLICATE_CONST_DATA_WITH_CAST  # deduplicate const data with cast
        integer DoIPIntReduceBoolDataByNegationThreshold: 0..9223372036854775807, multiplicity set at pre-compile, origin=Vector Informatik, set at pre-compile, default-value=2  # This parameter activates/deactivates the capability to compress boolean CONFIG-CLASS PRE-COMPILE ROM data by using the negation operator. 0: The optimization is deactivated. >0: If the number of deduplicateable elements is greater than this threshold the data optimization can be performed.
        integer DoIPIntReduceBoolDataByNumericalComparisonThreshold: 0..9223372036854775807, multiplicity set at pre-compile, origin=Vector Informatik, set at pre-compile, default-value=2  # This parameter activates/deactivates the capability to compress boolean CONFIG-CLASS PRE-COMPILE ROM data by using numerical comparison with other ROM data. 0: The optimization is deactivated. >0: If the number of deduplicateable elements is greater than this threshold the data optimization can be performed.
        integer DoIPIntReduceBoolDataByNumericalRelationThreshold: 0..9223372036854775807, multiplicity set at pre-compile, origin=Vector Informatik, set at pre-compile, default-value=2  # This parameter activates/deactivates the capability to compress boolean CONFIG-CLASS PRE-COMPILE ROM data by using relational comparison with other ROM data. 0: The optimization is deactivated. >0: If the number of deduplicateable elements is greater than this threshold the data optimization can be performed.
        enumeration DoIPIntReduceBoolDataByNumericalOperandStrategy: multiplicity set at pre-compile, origin=Vector Informatik, set at pre-compile, default-value=DEDUPLICATE_DATA_WITH_ANY_VALUE  # This parameter is used to taylor the CONFIG-CLASS PRE-COMPILE ROM bool data with number deduplication mechanisms. A comparison with 0 is very efficient, but a numerical comparison with a value not 0 can be used to increase the ROM data compression rate. NONE: ROM data deduplications are switched off. DEDUPLICATE_DATA_WITH_ZERO: ROM data deduplications can be applied with the value 0. DEDUPLICATE_DATA_WITH_ANY_VALUE: ROM data deduplications can be applied with any numerical value.
          NONE  # none
          DEDUPLICATE_DATA_WITH_ZERO  # deduplicate data with zero
          DEDUPLICATE_DATA_WITH_ANY_VALUE  # deduplicate data with any value
        integer DoIPIntReduceNumericalDataByOffsetThreshold: 0..9223372036854775807, multiplicity set at pre-compile, origin=Vector Informatik, set at pre-compile, default-value=2  # This parameter activates/deactivates the capability to compress numerical CONFIG-CLASS PRE-COMPILE ROM data by using a constant offset. 0: The optimization is deactivated. >0: If the number of deduplicateable elements is greater than this threshold the data optimization can be performed.
        integer DoIPIntReduceNumericalDataByArraySubtractionThreshold: 0..9223372036854775807, multiplicity set at pre-compile, origin=Vector Informatik, set at pre-compile, default-value=2  # This parameter activates/deactivates the capability to compress numerical CONFIG-CLASS PRE-COMPILE ROM data by using a subtraction with other ROM data. 0: The optimization is deactivated. >0: If the number of deduplicateable elements is greater than this threshold the data optimization can be performed.
        boolean DoIPIntShortSymbols: multiplicity set at pre-compile, origin=Vector Informatik, set at pre-compile, default-value=false  # This parameter activates/deactivates the capability to generate shortened symbol names. FALSE: symbol names are generated in a human readable style based on the MIP, tags and variant names. TRUE: symbol names are generated based on the MIP and a CRC32.
        boolean DoIPIntInterfacesForDeactivatedData: multiplicity set at pre-compile, origin=Vector Informatik, set at pre-compile, default-value=false  # This parameter activates/deactivates the capability to generate bsw data interfaces for deactivated data elements. This is an advantage for the BSW developer to reduce the time to market with a development environment using auto completition and to investigate potential interfaces. FALSE: data interfaces are not generated if the data elementis deactivated. TRUE: data interfaces are generated as e.g. emty macros.
        boolean DoIPIntReferringKeysInComments: multiplicity set at pre-compile, origin=Vector Informatik, set at pre-compile, default-value=false  # This parameter activates/deactivates the capability to generate referring keys in comments. This is an advantage for the developer to investigate indirections, but this feature reduces the overall readability of the generated data. FALSE: referring keys are not generated in comments. TRUE: referring keys are generated in comments.
      container DoIPIntEventCallback [0..1]: multiplicity set at pre-compile  # This container provides parameter to configure an event callback and all its related parameter.
        function name DoIPIntEventCallback: multiplicity set at pre-compile, origin=Vector Informatik, set at pre-compile, default-value=Appl_DoIPInt_Event, max-length=255, min-length=1  # This parameter defines a callback function to report events via <User>_DoIPIntEvent.
        integer DoIPIntEventMaxUserDataLength: 0..65535, multiplicity set at pre-compile, origin=Vector Informatik, set at pre-compile, default-value=0  # This parameter defines the maximum user data length that shall be forwarded inisde the configured event callback function.
