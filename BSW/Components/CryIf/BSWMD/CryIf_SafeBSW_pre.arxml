AUTOSAR XML (schema 4-3-0)
# COPYRIGHT
# Copyright (c) 2023 by Vector Informatik GmbH. All rights reserved.
# This software is copyright protected and proprietary to Vector Informatik GmbH.
# Vector Informatik GmbH grants to you only those rights as set out in the license conditions.
package /MICROSAR
  module config CryIf_Rec: definition=CryIf  # CryIf recommended configuration
    CryIfGeneral: CryIfSafeBswChecks=1
