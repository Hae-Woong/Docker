AUTOSAR XML (schema 00048)
# COPYRIGHT
# Copyright (c) 2023 by Vector Informatik GmbH. All rights reserved.
# This software is copyright protected and proprietary to Vector Informatik GmbH.
# Vector Informatik GmbH grants to you only those rights as set out in the license conditions.
package /MICROSAR
  bsw implementation CryIf_Impl
    required-artifacts:
      dependency on artifact CryIf_MemMap: category=MEMMAP, artifact-descriptor={short-label=CryIf_MemMap.h, category=SWHDR}
    resource consumption ResourceConsumption
      memory section CRYIF_CODE: sw-addrmethod=CODE, symbol=CODE
      memory section CRYIF_CONST_UNSPECIFIED: alignment=UNSPECIFIED, sw-addrmethod=CONST, symbol=CONST_UNSPECIFIED
      memory section CRYIF_VAR_CLEARED_8: alignment=8, sw-addrmethod=VAR_CLEARED, symbol=VAR_ZERO_INIT_8BIT
