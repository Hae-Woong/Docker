AUTOSAR XML (schema 4-3-0)
# COPYRIGHT
# Copyright (c) 2023 by Vector Informatik GmbH. All rights reserved.
# This software is copyright protected and proprietary to Vector Informatik GmbH.
# Vector Informatik GmbH grants to you only those rights as set out in the license conditions.
package /MICROSAR
  module definition CryIf [0..1]: category=VENDOR_SPECIFIC_MODULE_DEFINITION, refined-module-def=CryIf, variants pre-compile  # The Crypto Interface (CRYIF) is called by the Cryptographic Service Manager (CSM) to forward its service requests to the underlying Crypto Drivers (CRYPTO). #Crypto #Cryptographic #Cryptography #Security #AUTOSAR #ServiceComponent
    container CryIfChannel [1..*]: multiplicity set at pre-compile  # Container for incorporation of CryIfChannel.
      integer CryIfChannelId: 0..4294967295, multiplicity set at pre-compile, set at pre-compile, symbolic-name-value=true, default-value=0  # Identifier of the crypto channel. | Specifies to which crypto channel the CSM queue is connected to.
      symbolic name reference CryIfDriverObjectRef: multiplicity set at pre-compile, set at pre-compile, requires-symbolic-name-value=true, destination=CryptoDriverObject  # This parameter refers to a Crypto Driver Object. | Specifies to which Crypto Driver Object the crypto channel is connected to
    container CryIfGeneral: multiplicity set at pre-compile  # Container for incorporation of CryIfGeneral.
      boolean CryIfDevErrorDetect: multiplicity set at pre-compile, set at pre-compile, default-value=true  # Switches the development error detection and notification on or off. | true: detection and notification is enabled. false: detection and notification is disabled.
      boolean CryIfVersionInfoApi: multiplicity set at pre-compile, set at pre-compile, default-value=false  # Pre-processor switch to enable and disable availability of the API CryIf_GetVersionInfo(). | True: API CryIf_GetVersionInfo() is available False: API CryIf_GetVersionInfo() is not available.
      integer CryIfMaxNumberOfKeyElements: 1..4294967295, multiplicity set at pre-compile, origin=Vector Informatik, set at pre-compile, default-value=10  # Maximum number of key elements in one key which needs to be copied from one driver to another.
      integer CryIfMaxSizeOfKeyElement: 1..4294967295, multiplicity set at pre-compile, origin=Vector Informatik, set at pre-compile, default-value=32  # Size of the largest key element which needs to be copied from one driver to another.
      boolean CryIfRedirection: multiplicity set at pre-compile, origin=Vector Informatik, set at pre-compile, default-value=false  # If enabled, the CryIf supports the redirection feature of ASR 4.4. It is mandatory that the used Csm is also capable of this feature. If disabled, the CryIf ignores any kind of redirection.
      boolean CryIfSafeBswChecks: multiplicity set at pre-compile, origin=Vector Informatik, set at pre-compile, default-value=false  # Enables safety checks. These checks improve robustness. E.g. invalid parameters are checked before function is executed. This attribute has to be enabled for safety projects where this component is mapped to an ASIL partition.
    container CryIfKey [1..*]: multiplicity set at pre-compile  # Container for incorporation of CryIfKey.
      integer CryIfKeyId: 0..4294967295, multiplicity set at pre-compile, set at pre-compile, symbolic-name-value=true, default-value=0  # Identifier of the CryIf key. | Specifies to which CryIf key the CSM key is mapped to.
      symbolic name reference CryIfKeyRef: multiplicity set at pre-compile, set at pre-compile, requires-symbolic-name-value=true, destination=CryptoKey  # This parameter refers to the crypto driver key. | Specifies to which crypto driver key the CryIf key is mapped to.
    container CryIfCryptoModule [1..*]: multiplicity set at pre-compile  # Container for incorporation of Crypto Modules
      boolean CryIfSupportsKeyElementCopyPartial: multiplicity set at pre-compile, origin=Vector Informatik, set at pre-compile, default-value=false  # If enabled, the referenced driver provides the service Crypto_KeyElementCopyPartial. This service is available since ASR 4.4.x. If disabled, CryIf emulates the service by getting and setting the key. If driver prevents reading or writing one of the involved keys, the service fails with an error.
      string CryIfCryptoIncludeFile [0..1]: multiplicity set at pre-compile, origin=Vector Informatik, set at pre-compile, default-value=Crypto.h, min-length=3  # Include file of the Crypto module. If CryIfCryptoIncludeFile is not existent, the following pattern is applied for inclusion: Crypto_{Vendor Id}_{Vendor Api Infix}.h
      string CryIfCryptoMip [0..1]: multiplicity set at pre-compile, origin=Vector Informatik, set at pre-compile, default-value=Crypto, min-length=1  # Module implementation prefix for the referenced Crypto Module. If not set, then the Mip is determined from BSW-Configuration in the following way: Crypto_{Vendor Id}_{Vendor Api Infix}
      string CryIfCryptoKeySetValidAPI [0..1]: multiplicity set at pre-compile, origin=Vector Informatik, set at pre-compile, default-value=KeySetValid, min-length=1  # The Crypto Api Crypto_KeyValidSet was renamed in ASR 4.3.1 to Crypto_KeySetValid. In order to ensure compatibility, this parameter enables renaming the API call to the corresponding Crypto driver. If this parameter is not present, CryIf will default to KeyValidSet.
      boolean CryIfCancelJobApiUsesJobType: multiplicity set at pre-compile, origin=Vector Informatik, set at pre-compile, default-value=false  # Specifies whether the referenced driver's Job Cancellation interface uses the Crypto_JobType instead of the Crypto_JobInfoType data type. Set to TRUE for compatibility with ASR R19-11 and the MICROSAR crypto driver. Set to FALSE for compatibility with third-party crypto drivers implementing ASR 4.4 and older. Attention: There is an inconsistency in the ASR specs 4.4 and older which, by default, makes it impossible to implement this interface in standard-compliant way. If you set this switch to FALSE, you also need to set the parameter /MICROSAR/Csm/CsmGeneral/CsmJobTypeLayout/CsmJobTypeLayoutVarMembers to TRUE. This circumvents the limitations of the ASR spec and makes it possible to provide a compliant interface. Note that this Csm switch only exists in MICROSAR Csm 4.2.0 and above. In MICROSAR Csm versions earlier than 5.1.0, the switch resides directly under Csm/CsmGeneral.
      boolean CryIfSupportsCertificateAPI: multiplicity set at pre-compile, origin=Vector Informatik, set at pre-compile, default-value=true  # If enabled, the referenced driver provides the services CertificateParse and CertificateVerify. This service was removed in ASR R19-11. If disabled, CryIf always returns E_NOT_OK when service is called for this driver. If CryIfDevErrorDetect is enabled, also a development error is reported.
      boolean CryIfSupportsKeyStatusAPI: multiplicity set at pre-compile, origin=Vector Informatik, set at pre-compile, default-value=false  # If enabled, the referenced driver provides the services KeyGetStatus and KeySetInvalid. These services are available since ASR R20-11. If disabled, CryIf always returns E_NOT_OK when service is called for this driver. If CryIfDevErrorDetect is enabled, also a development error is reported.
      foreign reference CryIfCryptoModuleRef: multiplicity set at pre-compile, origin=Vector Informatik, set at pre-compile, destination-type=ECUC-MODULE-CONFIGURATION-VALUES  # Reference to the Crypto Driver
  bsw implementation CryIf_Impl: programming-language=C, sw-version=7.01.00, used-code-generator=DaVinci Configurator, vendor-id=30, ar-release-version=4.04.00, behavior=Behavior, preconfigured-configuration=CryIf_Pre, recommended-configuration=CryIf_Rec, vendor-specific-module-def=CryIf
  module config CryIf_Pre: definition=CryIf
  module config CryIf_Rec: definition=CryIf, implementation-config-variant=VARIANT-PRE-COMPILE
