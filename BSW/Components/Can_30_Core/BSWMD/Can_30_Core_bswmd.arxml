AUTOSAR XML (schema 4-0-3)
# COPYRIGHT
# Copyright (c) 2024 by Vector Informatik GmbH. All rights reserved.
# This software is copyright protected and proprietary to Vector Informatik GmbH.
# Vector Informatik GmbH grants to you only those rights as set out in the license conditions.
package /MICROSAR/Can_30_Core
  bsw implementation Can_Impl: programming-language=C, sw-version=4.01.00, used-code-generator=DaVinci Configurator, vendor-id=30, ar-release-version=4.00.03, behavior=Can_CoreBehavior, preconfigured-configuration=Can_Pre, recommended-configuration=Can_Rec, vendor-api-infix=Core, vendor-specific-module-def=Can
  module definition Can [0..*]: category=VENDOR_SPECIFIC_MODULE_DEFINITION, refined-module-def=Can, variants pre-compile/post-build-loadable/post-build-selectable  # The CAN Driver (Can) abstracts the hardware related implementation details of specific CAN communication controller. Upper layer is CanIf. #CAN #ISO11898 #Driver #AUTOSAR
    container CanConfigSet  # This is the multiple configuration set container for CAN Driver.
      container CanController [0..*]  # This container contains the configuration parameters of the CAN controller(s).
        enumeration CanBusoffProcessing: {INTERRUPT, POLLING}, set at post-build in variant post-build-loadable+post-build-selectable / pre-compile in variant pre-compile, default-value=INTERRUPT  # Define the context in which the Busoff will be processed. INTERRUPT: Busoff handling is done in interrupt context by Busoff event. POLLING: Busoff is handled in function Can_MainFunction_BusOff(). This function has to be called cyclic.
        boolean CanControllerActivation: set at pre-compile in variant post-build-loadable+pre-compile / post-build in variant post-build-selectable, default-value=true  # Defines if a CAN controller is used in the configuration.
        integer CanControllerBaseAddress: 0..4294967295, set at pre-compile in variant post-build-loadable+pre-compile / post-build in variant post-build-selectable, default-value=0  # Specifies the CAN controller base address.
        integer CanControllerId: 0..255, set at pre-compile, symbolic-name-value=true, default-value=0  # This parameter provides the controller ID which is unique in a given CAN Driver. The value for this parameter starts with 0 and continue without any gaps.
        enumeration CanRxProcessing: {INTERRUPT, POLLING}, set at post-build in variant post-build-loadable+post-build-selectable / pre-compile in variant pre-compile, default-value=INTERRUPT  # Define the context in which the PDU reception will be processed. INTERRUPT: Reception handling is done in interrupt context by event. POLLING: Reception is handled in function Can_MainFunction_Read(). This function has to be called cyclic.
        enumeration CanTxProcessing: {INTERRUPT, POLLING}, set at post-build in variant post-build-loadable+post-build-selectable / pre-compile in variant pre-compile, default-value=INTERRUPT  # Define the context in which the PDU transmission confirmation will be processed. INTERRUPT: Transmission confirmation handling is done in interrupt context by event. POLLING: Transmission confirmation is handled in function Can_MainFunction_Write(). This function has to be called cyclic.
        enumeration CanWakeupProcessing: {INTERRUPT, POLLING}, set at post-build in variant post-build-loadable+post-build-selectable / pre-compile in variant pre-compile, default-value=INTERRUPT  # Define the context in which the wakeup event will be processed. INTERRUPT: Wakeup handling is done in interrupt context by event. POLLING: Wakeup is handled in function Can_MainFunction_Wakeup(). This function has to be called cyclic. RESTRICTIONS: 'CanWakeupProcessing' is only available, if hardware supports this by mean wakeup detection by bus event.
        boolean CanWakeupSupport: set at post-build in variant post-build-loadable+post-build-selectable / pre-compile in variant pre-compile, default-value=false  # CAN driver support wakeup over CAN Bus. RESTRICTIONS: 'CanWakeupSupport' is only available when Hardware supports Wakeup over Bus.
        integer CanWakeupSourceId: 0..2147483648, set at post-build in variant post-build-loadable+post-build-selectable / pre-compile in variant pre-compile, origin=Vector Informatik, default-value=0  # Wakeup Source ID given by EcuM. RESTRICTIONS: 'CanWakeupSourceId' is only used when no ECU State Manager Reference is available in the ECUC file. Otherwise the value is given by reference to EcuM in CanWakeupSourceRef.
        boolean CanIndividualProcessing: set at post-build in variant post-build-loadable+post-build-selectable / pre-compile in variant pre-compile, origin=Vector Informatik, default-value=false  # Activate this when you like to configure each Rx and Tx CanHardwareObject separate (deactivate to reduce runtime and memory consumption). RESTRICTIONS: 'CanIndividualProcessing' influences the settings of 'CanRxProcessing' and 'CanTxProcessing'. It is only available, if hardware supports/needs this and Highend licence is given.
        enumeration CanFdSupport: {NONE, BRS, FULL}, set at post-build in variant post-build-loadable+post-build-selectable / pre-compile in variant pre-compile, origin=Vector Informatik, default-value=NONE  # Specifies the kind of CAN FD support. NONE: CAN FD is deactivated. BRS: Bitrate switching is activated but DLC is 8 at maximum. FULL: Bitrate switching is activated and DLC can be 64 at maximum.
        integer CanMaxRxDataLen: 0..64, set at post-build in variant post-build-loadable+post-build-selectable / pre-compile in variant pre-compile, origin=Vector Informatik, default-value=8  # Specifies the maximum amount of used bytes for receive buffers in case of CAN FD is activated.
        integer CanMaxTxDataLen: 0..64, set at post-build in variant post-build-loadable+post-build-selectable / pre-compile in variant pre-compile, origin=Vector Informatik, default-value=8  # Specifies the maximum amount of used bytes for transmit buffers in case of CAN FD is activated.
        enumeration CanRamCheck: {None, Active, MailboxNotification}, set at pre-compile in variant post-build-loadable+pre-compile / post-build in variant post-build-selectable, origin=Vector Informatik, default-value=None  # This parameter defines whether the RAM check for Rx and Tx mailboxes is active on this controller or not. This setting will be derived and synchronized with parameter: Can\CanGeneral\CanRamCheck (for more description details please refer to that paramter).
        reference CanControllerDefaultBaudrate: set at post-build in variant post-build-loadable+post-build-selectable / pre-compile in variant pre-compile, destination=CanControllerBaudrateConfig  # Reference to baudrate configuration container configured for the Can Controller as default.
        reference CanCpuClockRef: set at pre-compile in variant post-build-loadable+pre-compile / post-build in variant post-build-selectable, destination=McuClockReferencePoint  # Reference to the CPU clock configuration, which is set in the MCU driver configuration.
        symbolic name reference CanWakeupSourceRef [0..1]: set at pre-compile in variant post-build-loadable+pre-compile / post-build in variant post-build-selectable, destination=EcuMWakeupSource  # Reference to the Wakeup Source for this controller as defined in the ECU State Manager. Implementation Type: reference to EcuM_WakeupSourceType RESTRICTIONS: 'CanWakeupSourceRef' is only used when an ECU State Manager Reference is available in the ECUC. Else use the parameter CanWakeupSourceId. | Implementation Type: reference to EcuM_WakeupSourceType
        foreign reference CanControllerSystemRef [0..1]: set at pre-compile in variant post-build-loadable+pre-compile / post-build in variant post-build-selectable, origin=Vector Informatik, destination-type=CAN-COMMUNICATION-CONTROLLER  # Reference to the CAN communication controller in the system extract. Used to get recommended baudrate settings.
        reference CanvCanExtensionRef: set at pre-compile, origin=Vector Informatik, destination=vCanController  # Reference to the CAN controller in the CAN driver extension module.
        reference CanOsCounterRef: set at pre-compile, origin=Vector Informatik, destination=OsCounter  # This parameter contains a reference to a OS-counter, which is used by the CAN driver to handle timeouts while mode transition and hardware loop timeouts. This counter is partition dependent. RESTRICTIONS: This parameter will not be used when 'CanSupportMultipartition' is deactivated. Instead 'Can/CanGeneral/CanOsCounterRef' will be used.
        container CanControllerBaudrateConfig [0..255]: post-build-changeable=true  # This container contains bit timing related configuration parameters of the CAN controller(s). When connecting CANoe to your hardware, you have to use the same settings (CanControllerBaudRate, CanControllerSyncJumpWidth and the Sample point) in your hardware and CANoe.
          float CanControllerBaudRate: 5..1000, set at post-build in variant post-build-loadable+post-build-selectable / pre-compile in variant pre-compile, default-value=500  # Specifies the baudrate of the controller in kbps.
          integer CanControllerBaudRateConfigID: 0..65535, set at post-build in variant post-build-loadable+post-build-selectable / pre-compile in variant pre-compile, origin=Vector Informatik, default-value=0  # Uniquely identifies a specific baud rate configuration. This ID is used by SetBaudrate API.
          integer CanControllerPropSeg: 1..1024, set at post-build in variant post-build-loadable+post-build-selectable / pre-compile in variant pre-compile, default-value=7  # Specifies propagation delay in time quantas. TSeg1=Seg1+PropSeg
          integer CanControllerSeg1: 1..1024, set at post-build in variant post-build-loadable+post-build-selectable / pre-compile in variant pre-compile, default-value=4  # Specifies phase segment 1 in time quantas. TSeg1=Seg1+PropSeg
          integer CanControllerSeg2: 1..1024, set at post-build in variant post-build-loadable+post-build-selectable / pre-compile in variant pre-compile, default-value=4  # Specifies phase segment 2 in time quantas. TSeg2=Seg2
          integer CanControllerSyncJumpWidth: 1..1024, set at post-build in variant post-build-loadable+post-build-selectable / pre-compile in variant pre-compile, default-value=1  # Specifies the synchronization jump width for the controller in time quantas.
          integer CanBaudrateClock: 1..1000000, set at post-build in variant post-build-loadable+post-build-selectable / pre-compile in variant pre-compile, origin=Vector Informatik, default-value=8000  # Quartz frequency in kHertz used for baudrate calculation RESTRICTIONS: The value is derived from CanCpuClockRef and may be modified by CAN cell prescalers.
          integer CanBaudratePrescaler: 1..4096, set at post-build in variant post-build-loadable+post-build-selectable / pre-compile in variant pre-compile, origin=Vector Informatik, default-value=2  # Specifies the baudrate prescaler to calculate time quantum out of CanBaudrateClock.
          container CanControllerFdBaudrateConfig [0..1]: post-build-changeable=true  # This optional container contains bit timing related configuration parameters of the CAN controller(s) for payload and CRC of a CAN FD frame. If this container exists the controller supports CAN FD frames.
            float CanControllerFdBaudRate: 5..8000, set at post-build in variant post-build-loadable+post-build-selectable / pre-compile in variant pre-compile, origin=Vector Informatik, default-value=500  # Specifies the data segment baud rate of the controller in kbps.
            integer CanControllerPropSeg: 1..1024, set at post-build in variant post-build-loadable+post-build-selectable / pre-compile in variant pre-compile, origin=Vector Informatik, default-value=7  # Specifies propagation delay in time quantas.
            integer CanControllerSeg1: 1..1024, set at post-build in variant post-build-loadable+post-build-selectable / pre-compile in variant pre-compile, origin=Vector Informatik, default-value=4  # Specifies phase segment 1 in time quantas.
            integer CanControllerSeg2: 1..1024, set at post-build in variant post-build-loadable+post-build-selectable / pre-compile in variant pre-compile, origin=Vector Informatik, default-value=4  # Specifies phase segment 2 in time quantas.
            integer CanControllerSyncJumpWidth: 1..1024, set at post-build in variant post-build-loadable+post-build-selectable / pre-compile in variant pre-compile, origin=Vector Informatik, default-value=1  # Specifies the synchronization jump width for the controller in time quantas.
            boolean CanControllerTxBitRateSwitch: set at post-build in variant post-build-loadable+post-build-selectable / pre-compile in variant pre-compile, origin=Vector Informatik, default-value=true  # Specifies if the bit rate switching shall be used for transmissions. | If FALSE: CAN FD frames shall be sent without bit rate switching.
            integer CanBaudratePrescaler: 1..4096, set at post-build in variant post-build-loadable+post-build-selectable / pre-compile in variant pre-compile, origin=Vector Informatik, default-value=2  # Specifies the baudrate prescaler to calculate time quantum out of CanBaudrateClock.
            integer CanControllerSspOffset [0..1]: 0..1024, set at post-build in variant post-build-loadable+post-build-selectable / pre-compile in variant pre-compile, origin=Vector Informatik, default-value=0  # Controller Secondary Sample Point | Specifies the Transmitter Delay Compensation Offset in minimum time quanta. Transmitter Delay Compensation Offset is used to adjust the position of the Secondary Sample Point (SSP), relative to the beginning of the received bit. If this parameter is configured, the Transmitter Delay Compensation is done by measurement of the CAN controller. If not specified, Transmitter Delay Compensation is disabled.
        container CanFilterMask [0..*]: post-build-changeable=true  # This container contains the configuration (parameters) of the CAN Filter Mask(s).
          integer CanFilterMaskValue: 0..4294967295, set at post-build in variant post-build-loadable+post-build-selectable / pre-compile in variant pre-compile, default-value=0  # Describes a mask for hardware-based filtering of CAN identifiers. The CAN identifiers of incoming messages are masked with the appropriate CanFilterMaskValue. Bits holding a 0 mean don't care, i.e. do not compare the message's identifier in the respective bit position. The Filter is defined by Code and Mask part: pass Filter when: receiveID & Mask == Code & Mask Mask Bit 31 used to mask Extended and Mixed ID. For mixed CAN ID filters the value of extended and standard CAN id is aligned left (extended ID: bit 28-0, standard ID: 28-18). | The mask shall be build by filling with leading 0. In case of CanIdType EXTENDED or MIXED a 29 bit mask shall be build. In case of CanIdType STANDARD a 11 bit mask shall be build
          integer CanFilterCodeValue: 0..4294967295, set at post-build in variant post-build-loadable+post-build-selectable / pre-compile in variant pre-compile, origin=Vector Informatik, default-value=0  # The Filter is defined by Code and Mask part: pass Filter when: received ID & Mask == Code & Mask Code Bit 31 used to mask Mixed ID This value is equal to CanHardwareObject/CanIdValue if there is only one Filter for the RxBasicCAN CanHardwareObject used. But for multiple Filters more than one Id Value is needed. For mixed CAN ID filters the value of extended and standard CAN id is aligned left (extended ID: bit 28-0, standard ID: 28-18)
          boolean IsLocked: set at post-build in variant post-build-loadable+post-build-selectable / pre-compile in variant pre-compile, origin=Vector Informatik, default-value=false  # This parameter defines whether the settings in this container CanFilterMask shall stay unchanged during GenTool optimization.
          integer CanFilterMaskId: 0..255, set at post-build in variant post-build-loadable+post-build-selectable / pre-compile in variant pre-compile, origin=Vector Informatik, default-value=0  # Set by CAN driver. Define the order of filtering. The Fitler with the lowest ID will be used first. (Set by hardware validator)
          integer CanFilterRangeLowerBound: 0..4294967295, set at post-build in variant post-build-loadable+post-build-selectable / pre-compile in variant pre-compile, origin=Vector Informatik, default-value=0  # Defines the lower bound of a range filter. Note that boundary values are accepted by a range filter. Bit 31 is used to mask Extended identifiers. Note that mixed range filters are not configurable. Both boundaries of a range filter have to be of the same type (either both Standard or both Extended).
          integer CanFilterRangeUpperBound: 0..4294967295, set at post-build in variant post-build-loadable+post-build-selectable / pre-compile in variant pre-compile, origin=Vector Informatik, default-value=0  # Defines the upper bound of a range filter. Note that boundary values are accepted by a range filter. Bit 31 is used to mask Extended identifiers. Note that mixed range filters are not configurable. Both boundaries of a range filter have to be of the same type (either both Standard or both Extended).
          integer CanFilterDualId1: 0..4294967295, set at post-build in variant post-build-loadable+post-build-selectable / pre-compile in variant pre-compile, origin=Vector Informatik, default-value=0  # Defines one of the two ids accepted by the dual id filter. Bit 31 is used to mask Extended identifiers. Both ids of a dual id filter have to of the same type (either both Standard or both Extended).
          integer CanFilterDualId2: 0..4294967295, set at post-build in variant post-build-loadable+post-build-selectable / pre-compile in variant pre-compile, origin=Vector Informatik, default-value=0  # Defines one of the two ids accepted by the dual id filter. Bit 31 is used to mask Extended identifiers. Both ids of a dual id filter have to of the same type (either both Standard or both Extended).
          enumeration CanFilterMode: {CodeMask, Range, DualId}, set at post-build in variant post-build-loadable+post-build-selectable / pre-compile in variant pre-compile, origin=Vector Informatik, default-value=CodeMask  # This parameter defines the mode of the filter defined in this container CanFilterMask. CodeMask: Code-mask filter mode. Range: A range filter is a filter defined by a lower bound and an upper bound. It matches all ids between its lower bound and its upper bound including the boundary values. DualId: A dual id filter is a filter matching exactly two ids.
          boolean CanIsRejectionFilter: set at post-build in variant post-build-loadable+post-build-selectable / pre-compile in variant pre-compile, origin=Vector Informatik, default-value=false  # This parameter defines the filter defined in this container CanFilterMask is considered a rejection filter. A rejection filter is a filter that rejects ids that are matching with the filter (instead of accepting them, they will not be recevied). To reasonably use them, rejection filters should be processed by the hardware before acception filters are processed. Make sure that the Filter Mask Ids are set accordingly.
        container CanTTController [0..0]  # Not Used. Not Supported. This container is only included and valid if TTCAN SWS is used and TTCAN is enabled. | This container contains the configuration parameters of the TTCAN controller(s) (which are needed in addition to the configuration parameters of the CAN controller(s)). CanTTController is only included, if the controller supports TTCAN.
          integer CanTTControllerApplWatchdogLimit: 0..255, set at post-build in variant post-build-loadable+post-build-selectable / pre-compile in variant pre-compile, default-value=0  # Defines the maximum time period (unit is 256 times NTU) after which the application has to serve the watchdog.
          integer CanTTControllerCycleCountMax: 0..63, set at post-build in variant post-build-loadable+post-build-selectable / pre-compile in variant pre-compile, default-value=0  # Defines the value for cycle_count_max. | Allowed values: 0x00: 1 basic cycle 0x01: 2 basic cycles 0x03: 4 basic cycles 0x07: 8 basic cycles 0x0F: 16 basic cycles 0x1F: 32 basic cycles 0x3F: 64 basic cycles
          integer CanTTControllerExpectedTxTrigger: 0..255, set at post-build in variant post-build-loadable+post-build-selectable / pre-compile in variant pre-compile, default-value=0  # Number of expected_tx_trigger.
          boolean CanTTControllerExternalClockSynchronisation: set at post-build in variant post-build-loadable+post-build-selectable / pre-compile in variant pre-compile, default-value=false  # Enables/disables the external clock synchronization. | TRUE: External clock synchronization enabled. FALSE: External clock synchronization disabled. This parameter shall only be configurable if parameter CanTTControllerLevel2 equals TRUE.
          boolean CanTTControllerGlobalTimeFiltering: set at post-build in variant post-build-loadable+post-build-selectable / pre-compile in variant pre-compile, default-value=false  # Enables/disables the global time filtering. | TRUE: Global time filtering enabled. FALSE: Global time filtering disabled. This parameter shall only be configurable if parameter CanTTControllerLevel2 equals TRUE.
          integer CanTTControllerInitialRefOffset: 0..127, set at post-build in variant post-build-loadable+post-build-selectable / pre-compile in variant pre-compile, default-value=0  # Defines the initial value for ref trigger offset.
          integer CanTTControllerInterruptEnable: 0..1023, set at post-build in variant post-build-loadable+post-build-selectable / pre-compile in variant pre-compile, default-value=0  # Enables/disables the respective interrupts. | Bit Position set to 1: Enable respective interrupt. Bit Position set to 0: Disable respective interrupt. Bit Position / Interrupt Source: 10: Application Watchdog. 9: Watch Trigger reached. 8: Initialization Watch Trigger reached. 7: Change of Error Level. 6: Tx Overflow. 5: Tx Underflow. 4: Global Time Error. 3: Gap. 2: Start of Cycle. 1: Time Discontinuity. 0: Master State Change. Bit position "1: Time Discontinuity" and "4: Global Time Error" shall only be configurable if parameter CanTTControllerLevel2 equals TRUE.
          boolean CanTTControllerLevel2: set at post-build in variant post-build-loadable+post-build-selectable / pre-compile in variant pre-compile, default-value=false  # Defines whether Level 2 or Level 1 is used. | TRUE: Level 2. FALSE: Level 1. If this parameter is set to FALSE then all parameters with dependency to CanTTControllerLevel2 need not be configured.
          float CanTTControllerNTUConfig: 0..100, set at post-build in variant post-build-loadable+post-build-selectable / pre-compile in variant pre-compile, default-value=0  # Defines the config value for NTU (network time unit). | Value given in microseconds. The value configured shall be greater than 0. Together with the local oscillator period, the TUR (time unit ratio) can be derived from the NTU. This parameter shall only be configurable if parameter CanTTControllerLevel2 equals TRUE.
          enumeration CanTTControllerOperationMode: {CAN_TT_EVENT_SYNC_TIME_TRIGGERED, CAN_TT_EVENT_TRIGGERED, CAN_TT_TIME_TRIGGERED}, set at post-build in variant post-build-loadable+post-build-selectable / pre-compile in variant pre-compile, default-value=CAN_TT_EVENT_TRIGGERED  # Defines the operation mode.
          float CanTTControllerSyncDeviation: 0..100, set at post-build in variant post-build-loadable+post-build-selectable / pre-compile in variant pre-compile, default-value=0  # Defines the maximum synchronization deviation: | Given as a percentage value of the NTU (network time unit). The value configured shall be greater than 0. This parameter shall only be configurable if parameter CanTTControllerLevel2 equals TRUE.
          boolean CanTTControllerTURRestore: set at post-build in variant post-build-loadable+post-build-selectable / pre-compile in variant pre-compile, default-value=false  # Enables/disables the TUR restore. | Note that the value configured for TUR can be derived from the value configured for NTU and the local oscillator preriod. TRUE: TUR restore enabled. FALSE: TUR restore disabled. This parameter shall only be configurable if parameter CanTTControllerLevel2 equals TRUE.
          boolean CanTTControllerTimeMaster: set at post-build in variant post-build-loadable+post-build-selectable / pre-compile in variant pre-compile, default-value=false  # Defines whether the controller acts as a potential time master. | TRUE: Potential time master. FALSE: Time slave.
          integer CanTTControllerTimeMasterPriority: 0..7, set at post-build in variant post-build-loadable+post-build-selectable / pre-compile in variant pre-compile, default-value=0  # Defines the time master priority.
          integer CanTTControllerTxEnableWindowLength: 1..16, set at post-build in variant post-build-loadable+post-build-selectable / pre-compile in variant pre-compile, default-value=1  # Length of the tx enable window given in CAN bit times. | Definition parameter "CanTTControllerTxEnableWindowlength" is used such that: Length of enable window = CanTTControllerTxEnableWindowLength + 1
          integer CanTTControllerWatchTriggerGapTimeMark: 0..65535, set at post-build in variant post-build-loadable+post-build-selectable / pre-compile in variant pre-compile, default-value=0  # Watch trigger time mark after a gap.
          integer CanTTControllerWatchTriggerTimeMark: 0..65535, set at post-build in variant post-build-loadable+post-build-selectable / pre-compile in variant pre-compile, default-value=0  # Watch trigger time mark.
          enumeration CanTTIRQProcessing: {INTERRUPT, POLLING}, set at post-build in variant post-build-loadable+post-build-selectable / pre-compile in variant pre-compile, default-value=INTERRUPT  # Enables / disables API Can_MainFunction_BusOff() for handling busoff events in polling mode.
        container CanFilterOptimizationSettings  # This container contains the settings for the filter optimization algorithm of the DaVinci Configurator. The filter optimization algorithm is triggered from the "Acceptance Filter" comfort view. The parameters of this container can be changed there as well.
          integer CanFilterResourcesToBeUsed: 1..100, set at post-build in variant post-build-loadable+post-build-selectable / pre-compile in variant pre-compile, origin=Vector Informatik, default-value=50  # Specifies the percentages of filter resources to be used by the filter algorithm if the "CanModifyNumberOfFilters" parameter is set to true. Filter resources are defined as: - maximum number of available Standard filters - maximum number of available Extended filters - maximum number of available Mixed filters - maximum number of available total filters The algorithm will always use at least the minimal needed filter resources to create a valid filter configuration for the channel. Be carefull when using a lot of filter resources: They might be shared over multiple controllers.
          integer CanFullCansToBeUsed: 0..100, set at post-build in variant post-build-loadable+post-build-selectable / pre-compile in variant pre-compile, origin=Vector Informatik, default-value=50  # Specifies the percentage of the available Rx Full-CAN hardware objects that can be configured by the algorithm. Be carefull when using a lot of Full-CANs: They might be shared over multiple controllers.
          boolean CanRangeFilterUsage: set at post-build in variant post-build-loadable+post-build-selectable / pre-compile in variant pre-compile, origin=Vector Informatik, default-value=false  # True, if the filter algorithm shall consider range filters, else false. A range filter is a filter defined by a lower bound and an upper bound. It matches all ids between its lower bound and its upper bound including the boundary values.
          boolean CanDualIdFilterUsage: set at post-build in variant post-build-loadable+post-build-selectable / pre-compile in variant pre-compile, origin=Vector Informatik, default-value=false  # True, if the filter algorithm shall consider dual id filters, else false. A dual id filter is a filter matching exactly two ids.
          boolean CanRejectionFilterUsage: set at post-build in variant post-build-loadable+post-build-selectable / pre-compile in variant pre-compile, origin=Vector Informatik, default-value=false  # True, if the filter algorithm shall consider rejection filters, else false. A rejection filter is a filter that rejects ids that are matching with the filter (instead of accepting them).
          boolean CanModifyNumberOfFilters: set at post-build in variant post-build-loadable+post-build-selectable / pre-compile in variant pre-compile, origin=Vector Informatik, default-value=false  # True, if the algorithm is allowed to create or delete filters using the maximal resources specified in the "CanFilterRssourcesToBeUsed" parameter.
          enumeration CanFilterSearchIntensity: {LOW, MEDIUM, HIGH}, set at post-build in variant post-build-loadable+post-build-selectable / pre-compile in variant pre-compile, origin=Vector Informatik, default-value=MEDIUM  # Specifies the intensity with which the filter optimization algorithm searches for a solution. A higher search intensity leads in general to better results, but increases the computation time (up to several minutes).
      container CanHardwareObject [0..*]: post-build-changeable=true  # This container contains the configuration (parameters) of CanHardwareObjects.
        enumeration CanHandleType: {BASIC, FULL}, set at post-build in variant post-build-loadable+post-build-selectable / pre-compile in variant pre-compile, default-value=BASIC  # Specifies the type (FullCAN or BasicCAN) of a CanHardwareObject.
        enumeration CanIdType: {EXTENDED, MIXED, STANDARD}, set at post-build in variant post-build-loadable+post-build-selectable / pre-compile in variant pre-compile, default-value=STANDARD  # This parameter defines whether the IdValue is of type: EXTENDED: All the CANIDs are of type extended only (29 bit). MIXED: The type of CANIDs can be both Standard or Extended. STANDARD: All the CANIDs are of type standard only (11bit). ImplementationType: Can_IdType | - standard identifier - extended identifier - mixed mode ImplementationType: Can_IdType
        integer CanIdValue: 0..4294967295, set at post-build in variant post-build-loadable+post-build-selectable / pre-compile in variant pre-compile, default-value=0  # This value specifies the CAN identifier of the CAN message. RxFullCAN messages: Contain the ID value of the message. RxBasicCAN message: Specifies (together with the filter mask) the identifiers range that passes the hardware filter.
        integer CanObjectId: 0..65535, set at post-build in variant post-build-loadable+post-build-selectable / pre-compile in variant pre-compile, default-value=0  # Holds the handle ID of HRH or HTH. The value of this parameter is unique in a given CAN Driver, and it should start with 0 and continue without any gaps. Hint: This value is auto-calculated by the generator. Restriction: All Tx-, RxBasicCAN- and RxFullCAN-CanHardwareObjects for the same controller has to be grouped without gaps. | The HRH and HTH Ids are defined under two different name-spaces. Example: HRH0-0, HRH1-1, HTH0-2, HTH1-3
        enumeration CanObjectType: {RECEIVE, TRANSMIT}, set at post-build in variant post-build-loadable+post-build-selectable / pre-compile in variant pre-compile, default-value=RECEIVE  # Specifies if the CanHardwareObject is used as Transmit or as Receive object.
        boolean CanHwProcessing: set at post-build in variant post-build-loadable+post-build-selectable / pre-compile in variant pre-compile, origin=Vector Informatik, default-value=false  # Enable Polling Processing | Define if this hardware object is polled or not. The usage depends on the parameter CanConfigSet/CanController/CanIndividualProcessing which has to be enabled.
        integer CanObjectHwSize: 1..65535, set at post-build in variant post-build-loadable+post-build-selectable / pre-compile in variant pre-compile, origin=Vector Informatik, default-value=1  # This value specifies the numbers of used hardware buffers for this CanHardwareObject. For RxBasicCAN CanHardwareObjects with configurable size the user can adapt this. Otherwise it will be filled and used by generator only.
        integer CanObjectHwHandle: 0..65535, set at post-build in variant post-build-loadable+post-build-selectable / pre-compile in variant pre-compile, origin=Vector Informatik, default-value=0  # Index for first hardware buffer used by this CanHardwareObject. Hint: Will be filled and used by generator only.
        integer CanFdPaddingValue: 0..255, set at post-build in variant post-build-loadable+post-build-selectable / pre-compile in variant pre-compile, origin=Vector Informatik, default-value=0  # Specifies the value which is used to pad unspecified data in CAN FD frames > 8 bytes for transmission. This is necessary due to the discrete possible values of the DLC if > 8 bytes. If the length of a PDU which was requested to be sent does not match the allowed DLC values, the remaining bytes up to the next possible value shall be padded with this value.
        boolean CanObjectMultiplexedTransmission: set at post-build in variant post-build-loadable+post-build-selectable / pre-compile in variant pre-compile, origin=Vector Informatik, default-value=false  # Multiplexed Transmission | Define if this CanHardwareObject use Multiplexed Transmission. RESTRICTIONS: 'CanObjectMultiplexedTransmission' is only used if hardware supports this and 'CanObjectType' is of type 'TRANSMIT' and 'CanHandleType' is of type 'BASIC'. This feature cannot be combined with "CanObjectHwFifo".
        boolean CanObjectHwFifo: set at post-build in variant post-build-loadable+post-build-selectable / pre-compile in variant pre-compile, origin=Vector Informatik, default-value=false  # Hardware FIFO | Define if this CanHardwareObject use a FIFO queue. RESTRICTIONS: 'CanObjectHwFifo' is only used if hardware supports this and 'CanObjectType' is of type 'TRANSMIT' and 'CanHandleType' is of type 'BASIC'. This feature cannot be combined with "CanObjectMultiplexedTransmission".
        integer CanMaxDataLen: 0..64, set at post-build in variant post-build-loadable+post-build-selectable / pre-compile in variant pre-compile, origin=Vector Informatik, default-value=8  # Specifies the maximum amount of used bytes in case of CAN FD is activated.
        reference CanControllerRef: set at post-build in variant post-build-loadable+post-build-selectable / pre-compile in variant pre-compile, destination=CanController  # Reference to CAN Controller to which the HOH is associated to.
        reference CanFilterMaskRef [0..*]: set at post-build in variant post-build-loadable+post-build-selectable / pre-compile in variant pre-compile, destination=CanFilterMask  # Reference to the filter mask that is used for hardware filtering together with the CanIdValue Multiple References for more than one BasicCAN Filter. This is only available for some hardware platforms. | The CanFilterMaskRef is omitted for 1) CanHardwareObjects with CanObjectType set to TRANSMIT 2) CanHardwareObjects with CanObjectType set to RECEIVE if only a single Can ID shall be received via this CanHardwareObjects (i.e., exact match with CanIdValue)
        reference CanMainFunctionRWPeriodRef [0..1]: set at post-build in variant post-build-loadable+post-build-selectable / pre-compile in variant pre-compile, destination=CanMainFunctionRWPeriods  # Reference to CanMainFunctionRWPeriod to which the HOH is associated to. RESTRICTIONS: not used. Only one set of CanMainfunctionRWPeriods is supported.
        container CanTTHardwareObjectTrigger [0..0]  # Not Used. Not Supported. This container is only included and valid if TTCAN SWS is used and TTCAN is enabled. | This container contains the configuration (parameters) of TTCAN triggers for CanHardwareObjects, which are additional to the configuration (parameters) of CAN CanHardwareObjects. CanTTHardwareObjectTrigger is only included, if the controller supports TTCAN.
          integer CanTTHardwareObjectBaseCycle: 0..63, set at post-build in variant post-build-loadable+post-build-selectable / pre-compile in variant pre-compile, default-value=0  # Defines the cycle_offset. | CanTTHardwareObjectBaseCycle must be not greater than cycle_count_max.
          integer CanTTHardwareObjectCycleRepetition: 1..64, set at post-build in variant post-build-loadable+post-build-selectable / pre-compile in variant pre-compile, default-value=1  # Defines the repeat_factor. | CanTTHardwareObjectCycleRepetition shall be a power of two (2), greater than cycle_offset but not greater than cycle_count_max + 1.
          integer CanTTHardwareObjectTimeMark: 0..65535, set at post-build in variant post-build-loadable+post-build-selectable / pre-compile in variant pre-compile, default-value=0  # Defines the point in time, when the trigger will be activated. | Value is given in cycle time.
          integer CanTTHardwareObjectTriggerId: 0..63, set at post-build in variant post-build-loadable+post-build-selectable / pre-compile in variant pre-compile, symbolic-name-value=true, default-value=0  # Sequential number which allows separation of different TTCAN triggers configured for one and the same CanHardwareObject.
          enumeration CanTTHardwareObjectTriggerType: {CAN_TT_RX_TRIGGER, CAN_TT_TX_REF_TRIGGER, CAN_TT_TX_REF_TRIGGER_GAP, CAN_TT_TX_TRIGGER_EXCLUSIVE, CAN_TT_TX_TRIGGER_MERGED, CAN_TT_TX_TRIGGER_SINGLE}, set at post-build in variant post-build-loadable+post-build-selectable / pre-compile in variant pre-compile, default-value=CAN_TT_RX_TRIGGER  # Defines the type of the trigger associated with the CanHardwareObject. This parameter depends on plain CAN parameter CAN_OBJECT_TYPE. | If CAN_OBJECT_TYPE equals RECEIVE than this parameter is fixed to CAN_TT_RX_TRIGGER. If CAN_OBJECT_TYPE equals TRANSMIT than one of the following literals is configurable: CAN_TT_TX_REF_TRIGGER, CAN_TT_TX_REF_TRIGGER_GAP, CAN_TT_TX_TRIGGER_MERGED, CAN_TT_TX_TRIGGER_SINGLE, CAN_TT_TX_TRIGGER_EXCLUSIVE.
    container CanGeneral  # General configuration parameters of the CAN Driver.
      boolean CanChangeBaudrateApi: set at pre-compile, default-value=true  # The support of the Can_ChangeBaudrate and Can_CheckBaudrate API. RESTRICTIONS: Independent of this setting the API is always available, no preprocessor optimization supported here. Using this API is not recommended for FD baudrates where same CanControllerBaudRate is used multiple times (use Can_SetBaudrateApi instead). This API is deprecated since AUTOSAR 4.2 | If this parameter is set to true the Can_ChangeBaudrate API shall be supported. Otherwise the API is not supported.
      boolean CanDevErrorDetection: set at pre-compile, default-value=true  # This parameter switches the Development Error Detection and Notification ON or OFF. true: Development error detection is enabled. false: Development error detection is disabled. Note: In general, the development error detection is recommended during pre-test phase. It is not recommended to enable the development error detection in production code due to increased runtime and ROM needs.
      boolean CanHardwareCancellation: set at pre-compile, default-value=false  # Hardware Transmit Cancellation | Enable/disable the usage of transmit cancelation out of Tx CanHardwareObject, so that the canceled message will not be send (this avoids internal priority inversion). RESTRICTIONS: 'CanHardwareCancellation' is only available, if hardware supports this by mean of cancel Tx CanHardwareObject and CanIf-Tx-buffer activated.
      boolean CanIdenticalIdCancellation: set at pre-compile, default-value=false  # Enables/disables cancellation of pending PDUs with identical ID. 'CanHardwareCancellation' (GUI name 'Hardware Transmit Cancellation') also cancels messages with same PDU identifier (newer data will be send) out of Tx CanHardwareObjects. Otherwise only lower prior CAN identifiers will be cancelled (older data will be send).
      integer CanIndex: 0..255, set at pre-compile, default-value=0  # Specifies the InstanceId of this module instance. If only one instance is present it shall have the Id 0.
      function name CanLPduReceiveCalloutFunction [0..1]: set at pre-compile, default-value=Appl_GenericPrecopy  # Not Used. (Use instead 'CanGenericPrecopy') This parameter defines the existence and the name of a callout function that is called after a successful reception. | reception of a received CAN Rx L-PDU. If this parameter is omitted no callout shall take place.
      float CanMainFunctionBusoffPeriod: 0..65.535, set at pre-compile, default-value=0.01  # This value specifies the period for cyclic call to Can_MainFunction_Busoff. EcuC unit is seconds.
      float CanMainFunctionModePeriod: 0..65.535, set at pre-compile, default-value=0.01  # This value specifies the period for cyclic call to Can_MainFunction_Mode. EcuC unit is seconds.
      float CanMainFunctionWakeupPeriod: 0..65.535, set at pre-compile, default-value=0.01  # This value specifies describes the period for cyclic call to Can_MainFunction_Wakeup. EcuC unit is seconds.
      boolean CanMultiplexedTransmission: set at pre-compile, default-value=false  # Specifies if multiplexed transmission shall be supported ON or OFF. This parameter will be set automatically for precompile configurations depending on CanHardwareObjects CanObjectMultiplexedTransmission settings. RESTRICTIONS: 'CanMultiplexedTransmission' is only available, if hardware supports this by mean of multiple priorized mailboxes.
      float CanTimeoutDuration: 1E-06..65.535, set at pre-compile, default-value=0.01  # Specifies the maximum time for blocking function until a timeout is detected. EcuC unit is seconds.
      boolean CanVersionInfoApi: set at pre-compile, default-value=false  # The support of the Can_GetVersionInfo API. API to read out major, minor and patch version of the CAN driver. RESTRICTIONS: Always true, no preprocessor optimization supported here.
      boolean CanGenericPrecopy: set at pre-compile, origin=Vector Informatik, default-value=false  # This parameter defines whether the Generic Precopy function is called or not. This function is called for any Rx event.
      string CanUserConfigFile [0..1]: set at pre-compile, origin=Vector Informatik, default-value=UserCfg  # Reference to an external text file that will be included during generation to Can_Cfg.h. The content of the user configuration file will be added at the end of the generated module configuration file and allows altering or extending the generated code. Caution: User configuration files can cause the software module to malfunction and must only be used with great care!
      boolean CanHardwareCancelByAppl: set at pre-compile, origin=Vector Informatik, default-value=false  # This parameter defines whether the application can cancel a hardware loop check. 'CanTimeoutDuration' will then be ignored. The following callbacks have to be implemented in application: Appl_30_Core_CanTimerStart() Appl_30_Core_CanTimerLoop() Appl_30_Core_CanTimerEnd() RESTRICTIONS: 'CanHardwareCancelByAppl' is only available, if 'CanHardwareLoopCheck' is enabled.
      boolean CanGenericConfirmationAPI2: set at pre-compile, origin=Vector Informatik, default-value=false  # This parameter indicates that CanGenericConfirmation set to API2 (need for compatibility to CanIf).
      boolean CanRxQueue: set at pre-compile, origin=Vector Informatik, default-value=false  # This parameter defines whether the Rx Queue shall be active or not. The idea of the Rx Queue is to quickly free CanHardwareObjects by queueing Rx PDUs (CAN-Id, DLC and data) to the Rx Queue in 'INTERRUPT' context. The queued PDUs are processed when Can_MainFunction_Read() is called. Note: If the Rx Queue is used with 'POLLING' as configured Rx processing context, Rx PDUs are queued to and processed from the Rx Queue within the same call of Can_MainFunction_Read(). This will increase runtime without the benefit of directly freeing the CanHardwareObjects and is therefore NOT recommended. RESTRICTIONS: 'CanRxQueue' is only available, if hardware supports/needs this and Highend licence is given.
      boolean CanSupportMixedID: set at pre-compile, origin=Vector Informatik, default-value=false  # This parameter defines to force the code to contain mixed ID handling to be free afterwards using standard, extended or mixed IDs. No more ID type optimization! RESTRICTIONS: 'CanSupportMixedID' is only available, if hardware supports mixed ID handling. And it is not modify-able when mixed ID used in database.
      boolean CanSupportExtendedID: set at pre-compile, origin=Vector Informatik, default-value=false  # Using extended ID type. This parameter will be set automatically depending on CanSupportMixedID setting and given CanIdTypes.
      integer CanRxQueueSize: 2..65535, set at pre-compile, origin=Vector Informatik, default-value=10  # This value specifies the number of Rx PDUs that can be stored in the Rx Queue. If more Rx PDUs are received before Can_MainFunction_Read() is called where the Rx queue is processed and emptied, an overrun will occur and the Rx PDUs are lost. To prevent this, the queue size should be at least equal to the maximum number of Rx PDUs that can be received between two calls of Can_MainFunction_Read(). Note that the call of Can_MainFunction_Read() could be delayed by interrupts. RESTRICTIONS: 'CanRxQueueSize' is only available, if 'CanRxQueue' is enabled.
      enumeration CanHardwareHandleType: {UINT8, UINT16}, set at pre-compile, origin=Vector Informatik, default-value=UINT16  # Depending on the platform, there is the need to use more than 8bit CanHardwareObject (defined by AUTOSAR 3.x). So it is possible to use 8bit or 16bit types (defined by AUTOSAR 4.x). RESTRICTIONS: 'CanHardwareHandleType' need to be set to 8bit when CAN Interface without this support is used (Vector Interface >= 4.12 support 16bit).
      enumeration CanInterruptCategory: {CATEGORY2, VOIDFUNCVOID}, set at pre-compile, origin=Vector Informatik, default-value=CATEGORY2  # Specifies the type of the interrupt function. CATEGORY2: Interrupt function is defined with ISR() define. VOIDFUNCVOID: Interrupt function is defined as void Func(void) function. RESTRICTIONS: 'Category 2' is only relevant when AUTOSAR or OSEK OS is used otherwise the Interrupt will be Void.
      boolean CanGetStatus: set at pre-compile, origin=Vector Informatik, default-value=true  # The support of the Can_GetStatus() API. The API returns the hardware states: CAN_STATUS_STOP, CAN_STATUS_INIT, CAN_STATUS_INCONSISTENT, CAN_STATUS_WARNING, CAN_STATUS_PASSIVE, CAN_STATUS_BUSOFF, CAN_STATUS_SLEEP RESTRICTIONS: Always true, no preprocessor optimization supported here.
      enumeration CanInterruptLock: {DRIVER, APPL, BOTH}, set at pre-compile, origin=Vector Informatik, default-value=DRIVER  # This parameter defines who handles the interrupt locking. Disable and Restore CAN interrupts by CAN Driver or Application or CAN Driver and Application. Reason may be, that the CAN driver should not access the interrupt controller for CAN interrupts or there are other restrictions (special security level) or Application has to care about additional interrupts like Wakeup.
      enumeration CanOverrunNotification: {None, DET, Application}, set at pre-compile, origin=Vector Informatik, default-value=DET  # This parameter defines whether a detected overrun or overwrite at a Rx CanHardwareObject of type Basic- or Full-CAN is not notified, notified to the DET module or notified to the application. Whether a CanHardwareObject has overrun or overwrite behavior and whether a overrun or overwrite can be detected depends on the underlying CAN Hardware Unit(s) (check the corresponding vCan Extension TechRef for details) None: Nothing is done. DET: DET is called. Application: Appl_30_Core_CanOverrun is called when a overun or overwrite is detected for a Basic-CAN. Appl_30_Core_CanFullCanOverrun is called when an overrun or overwrite is detected for a Full-CAN.
      boolean CanReinitStart: set at pre-compile, origin=Vector Informatik, default-value=false  # ReInitialization While Start Transition | This parameter defines whether to process a full controller reinitialization at start transition (include hardware Rx and Tx CanHardwareObject and control registers) or not. This cause significant runtime.
      boolean CanGenericPreTransmit: set at pre-compile, origin=Vector Informatik, default-value=false  # This parameter defines whether the API 'Appl_GenericPreTransmit()', common for all Tx messages will be called when this checkbox is enabled. Use this to change data right before the message will be send.
      boolean CanRuntimeMeasurementSupport: set at pre-compile, origin=Vector Informatik, default-value=false  # If enabled runtime measurement points are added to the CAN driver module code and are added to the module configuration of MICROSAR RTM. The available measurement points can be seen and configured in the RTM module configuration. Availability of the MICROSAR RTM module is a prerequisite to make use of the runtime measurement functionality. Runtime measurement should be disabled in production code as measurement points may inflict additional runtime.
      boolean CanUsePeripheralAccessApi: set at pre-compile, origin=Vector Informatik, default-value=false  # Use Peripheral Access API for access to those peripheral registers which need supervisor permissions. This allows the CAN driver to run in an untrusted OS Application.
      boolean CanUseOsInterruptControl: set at pre-compile, origin=Vector Informatik, default-value=false  # This parameter specifies whether the interrupt registers are acessed directly or over the OS. TRUE: Interrupt sources are controlled by the OS. CAN driver uses API osDisableInterruptSource, osEnableInterruptSource and osClearPendingInterrupt to access the interrupt control registers. FALSE: Interrupt sources are controlled directly by the CAN driver.
      boolean CanSafeBswChecks: set at pre-compile, origin=Vector Informatik, default-value=true  # Selects if safety checks are used. These checks improve robustness as e.g. invalid parameters are checked before function is executed. This attribute has to be enabled for safety projects where this component is mapped to an ASIL partition.
      boolean CanCheckWakeupCanRetType: set at pre-compile, origin=Vector Informatik, default-value=true  # This parameter defines whether the CAN driver supports the Can_ReturnType (true) or the Std_ReturnType (false) as return type for the Can_CheckWakeup() API. The value can be used to force the usage of Std_ReturnType to be compatibel to older CAN Interfaces.
      boolean CanFdHardwareBufferOptimization: set at pre-compile, origin=Vector Informatik, default-value=false  # Enable optimizations for hardware buffer lengths | If selected the hardware buffers for RX objects are limited to the framelength of the actual message to be received. In general this saves hardware resources but if CAN-FD messages with larger framelengths are received, they might be discarded by the driver. If this feature is disabled, the hardware buffers are configured to have maximum size to be able to receive longer messages. See the hardware specific Technical Reference for details and limitations on the hardware buffer configuration.
      enumeration CanGenericConfirmation: {None, API1, API2}, set at pre-compile, origin=Vector Informatik, default-value=None  # This parameter defines whether the Generic Confirmation function shall be called or not. And what kind of Callout should be used (for detailed API information please refer to TechnicalReference API description). API2 is used to support bus mirroring (See also 'CanMirrorModeSupport'.) The generic confirmation function is called for all Tx events.
      boolean CanMirrorModeSupport: set at pre-compile, origin=Vector Informatik, default-value=false  # Use CDD Mirror component to route messages to other controllers. See specification of CDD Mirror component. (Require GenericPrecopy and GenericConfirmationAPI2)
      boolean CanSilentModeSupport: set at pre-compile, origin=Vector Informatik, default-value=false  # This parameter defines whether the CAN driver silent mode is used.
      boolean CanHardwareLoopCheck: set at pre-compile, origin=Vector Informatik, default-value=true  # This parameter enables hardware loop check(s) to avoid endless loops. Under some conditions, the CAN driver has to wait for hardware dependent events. This will be done in a so-called 'Hardware Loop'. Refer to the technical reference documentation for usage of this kind of loops. To secure that this loop will not run infinitely, a timeout (CanTimeoutDuration) can be configured. A DET notification appears in this case. RESTRICTIONS: CanHardwareLoopCheck is only available, if hardware supports/needs this.
      boolean CanEnableSecurityEventReporting: set at pre-compile, origin=Vector Informatik, default-value=false  # Enables security event reporting. true: Security event reporting is enabled. false: Security event reporting is disabled.
      boolean CanSetBaudrateApi: set at pre-compile, origin=Vector Informatik, default-value=true  # The support of the Can_SetBaudrate API. This is the standard API since AUTOSAR 4.2 (see also CanChangeBaudrate parameter). RESTRICTIONS: Independent of this setting the API is always available, no preprocessor optimization supported here. | If this parameter is set to true the Can_SetBaudrate API shall be supported. Otherwise the API is not supported.
      boolean CanSoftwareCancellation: set at pre-compile, origin=Vector Informatik, default-value=false  # Software Transmit Cancellation | This parameter defines whether software cancellation shall be supported (SW cancel request over CAN Interface API 'CanIf_CancelTransmit'). If enabled the canceled message will not be confirmed to the upper layer (sent out of the canceled message is possible). Can be combined with hardware transmit cancelation (CanHardwareCancellation), if the hardware supports it.
      enumeration CanRamCheck: {None, Active, MailboxNotification}, set at pre-compile, origin=Vector Informatik, default-value=None  # This parameter defines whether the RAM check for Rx and Tx CanHardwareObject is active or not. The application notification functions "Appl_30_Core_CanCorruptMailbox" and "Appl_30_Core_CanMemCheckFailed" are called in case of RAM is corrupted. Controller will be deactivated and no communication will be processed. - None: Feature deactive. - Active: "Appl_30_Core_CanMemCheckFailed" will be called in case of issue in any CanHardwareObject ID,DLC or data register. - Mailbox Notification:"Appl_30_Core_CanMemCheckFailed" and "Appl_30_Core_CanCorruptMailbox" will be called for dedicated CanHardwareObject ID, DLC or data register.
      boolean CanSupportMultipartition: set at pre-compile, origin=Vector Informatik, default-value=false  # This parameter defines whether multi-partitioning shall be used.
      boolean CanConstantDataToDefine: set at pre-compile, origin=Vector Informatik, default-value=true  # This parameter specifies whether the generated data should be optimized to improve runtime and reduce ROM usage. When this optimization is active, constant data will be generated as defines, TRUE: Optimization active (default) FALSE: Optimization not active (only for debug)
      reference CanCounterRef: set at pre-compile, destination=OsCounter  # This parameter contains a reference to a OS-counter, which is used by the CAN driver, to handle timeouts while mode transition and Hardware Loop timeouts. RESTRICTIONS: This parameter will not be used when 'CanSupportMultipartition' is active. Instead 'Can/CanConfigSet/CanController/CanOsCounterRef' will be used.
      reference CanSupportTTCANRef [0..0]: set at pre-compile, destination=CanIfPrivateCfg  # Not Used. Not Supported. The parameter refers to CanIfSupportTTCAN parameter in the CAN Interface Module configuration. | The CanIfSupportTTCAN parameter defines whether TTCAN is supported.
      container CanMainFunctionRWPeriods  # This container contains the read and write periods (referred by CanHardwareObject).
        float CanMainFunctionReadPeriod [0..*]: 0..65.535, set at pre-compile, default-value=0.01  # This value specifies the period for cyclic call to Can_MainFunction_Read. EcuC unit is seconds. Different poll-cycles will be configurable if more than one CanMainFunctionReadPeriod is configured. In this case multiple Can_MainFunction_Read() will be provided by the CAN Driver module.
        float CanMainFunctionWritePeriod [0..*]: 0..65.535, set at pre-compile, default-value=0.01  # This value specifies the period for cyclic call to Can_MainFunction_Write. EcuC unit is seconds. Different poll-cycles will be configurable if more than one CanMainFunctionWritePeriod is configured. In this case multiple Can_MainFunction_Write() will be provided by the CAN Driver module.
  module config Can_Pre: definition=Can
    CanGeneral: CanVersionInfoApi=1, CanGetStatus=1
  module config Can_Rec: definition=Can
