AUTOSAR XML (schema 4-0-3)
package /MICROSAR/EcucDefs
  module definition vCan [0..*]: category=VENDOR_SPECIFIC_MODULE_DEFINITION, variants pre-compile/post-build-loadable/post-build-selectable  # EcucDef as interface description to vCan modules
    container vCanController [0..*]  # This container contains the configuration parameters of the HW specific aspects of the CAN controller
      integer vCanBaudrateClock: 0..10000000, set at post-build in variant post-build-loadable+post-build-selectable / pre-compile in variant pre-compile, origin=Vector Informatik, default-value=0  # Baudrate Clock | Clock used for baudrate generation, derived form MCU clock on the controller.
      container vCanBaudrateSetting  # This container contains the range of bit timing related configuration parameters possible on the CAN controller.
        integer vCanBtlCyclesMin: 8..255, set at pre-compile, origin=Vector Informatik, default-value=8  # The minimum Btl cycles supported by the CAN controller
        integer vCanBtlCyclesMax: 8..255, set at pre-compile, origin=Vector Informatik, default-value=25  # The maximum Btl cycles supported by the CAN controller
        integer vCanPropSegMin: 1..255, set at pre-compile, origin=Vector Informatik, default-value=1  # The minimum Propagation segment supported by the CAN controller in time quantas
        integer vCanPropSegMax: 1..255, set at pre-compile, origin=Vector Informatik, default-value=8  # The maximum Propagation segment supported by the CAN controller in time quantas
        integer vCanSeg1Min: 1..255, set at pre-compile, origin=Vector Informatik, default-value=1  # The minimum phase segment 1 supported by the CAN controller in time quantas
        integer vCanSeg1Max: 1..255, set at pre-compile, origin=Vector Informatik, default-value=8  # The maximum phase segment 1 supported by the CAN controller in time quantas
        integer vCanSeg2Min: 1..255, set at pre-compile, origin=Vector Informatik, default-value=2  # The minimum phase segment 2 supported by the CAN controller in time quantas
        integer vCanSeg2Max: 1..255, set at pre-compile, origin=Vector Informatik, default-value=8  # The maximum phase segment 2 supported by the CAN controller in time quantas
        integer vCanSjwMin: 1..255, set at pre-compile, origin=Vector Informatik, default-value=1  # The minimum possible value of the synchronization jump width for the controller in time quantas
        integer vCanSjwMax: 1..255, set at pre-compile, origin=Vector Informatik, default-value=4  # The maximum possible value of the synchronization jump width for the controller in time quantas
        integer vCanBaudrateMin: 1000..1000000, set at pre-compile, origin=Vector Informatik, default-value=10000  # The minimum possible value of Baudrate for the controller in kHz
        integer vCanBaudrateMax: 1000..1000000, set at pre-compile, origin=Vector Informatik, default-value=1000000  # The maximum possible value of Baudrate for the controller in kHz
        integer vCanPrescalerMin: 1..255, set at pre-compile, origin=Vector Informatik, default-value=1  # The minimum possible value of Prescaler for the controller
        integer vCanPrescalerMax: 1..255, set at pre-compile, origin=Vector Informatik, default-value=25  # The maximum possible value of Prescaler for the controller
        integer vCanTSeg1Min: 2..255, set at pre-compile, origin=Vector Informatik, default-value=2  # The minimum possible value of Tseg1 for the controller Tseg1 = Prop seg + Phase segment 1
        integer vCanTSeg1Max: 2..255, set at pre-compile, origin=Vector Informatik, default-value=16  # The maximum possible value of TSeg1 for the controller in time quantas. Tseg1 = Prop seg + Phase segment 1
      container vCanFdBaudrateSetting  # This container contains the range of CAN-FD bit timing related configuration parameters possible on the CAN controller.
        integer vCanBtlCyclesMin: 8..255, set at pre-compile, origin=Vector Informatik, default-value=8  # The minimum Btl cycles supported by the CAN controller
        integer vCanBtlCyclesMax: 8..255, set at pre-compile, origin=Vector Informatik, default-value=25  # The maximum Btl cycles supported by the CAN controller
        integer vCanPropSegMin: 1..255, set at pre-compile, origin=Vector Informatik, default-value=1  # The minimum Propagation segment supported by the CAN controller in time quantas
        integer vCanPropSegMax: 1..255, set at pre-compile, origin=Vector Informatik, default-value=8  # The maximum Propagation segment supported by the CAN controller in time quantas
        integer vCanSeg1Min: 1..255, set at pre-compile, origin=Vector Informatik, default-value=1  # The minimum phase segment 1 supported by the CAN controller in time quantas
        integer vCanSeg1Max: 1..255, set at pre-compile, origin=Vector Informatik, default-value=8  # The maximum phase segment 1 supported by the CAN controller in time quantas
        integer vCanSeg2Min: 1..255, set at pre-compile, origin=Vector Informatik, default-value=2  # The minimum phase segment 2 supported by the CAN controller in time quantas
        integer vCanSeg2Max: 1..255, set at pre-compile, origin=Vector Informatik, default-value=8  # The maximum phase segment 2 supported by the CAN controller in time quantas
        integer vCanSjwMin: 1..255, set at pre-compile, origin=Vector Informatik, default-value=1  # The minimum possible value of the synchronization jump width for the controller in time quantas
        integer vCanSjwMax: 1..255, set at pre-compile, origin=Vector Informatik, default-value=4  # The maximum possible value of the synchronization jump width for the controller in time quantas
        integer vCanBaudrateMin: 1000..1000000, set at pre-compile, origin=Vector Informatik, default-value=10000  # The minimum possible value of Baudrate for the controller in kHz
        integer vCanBaudrateMax: 1000..16000000, set at pre-compile, origin=Vector Informatik, default-value=8000000  # The maximum possible value of Baudrate for the controller in kHz
        integer vCanPrescalerMin: 1..255, set at pre-compile, origin=Vector Informatik, default-value=1  # The minimum possible value of Prescaler for the controller
        integer vCanPrescalerMax: 1..255, set at pre-compile, origin=Vector Informatik, default-value=25  # The maximum possible value of Prescaler for the controller
        integer vCanTSeg1Min: 2..255, set at pre-compile, origin=Vector Informatik, default-value=2  # The minimum possible value of Tseg1 for the controller Tseg1 = Prop seg + Phase segment 1
        integer vCanTSeg1Max: 2..255, set at pre-compile, origin=Vector Informatik, default-value=16  # The maximum possible value of TSeg1 for the controller in time quantas. Tseg1 = Prop seg + Phase segment 1
      container vCanFilterSettings  # This container contains the acceptance filter related configuration parameters possible on the CAN controller.
        boolean vCanRangeFilterSupport: set at post-build in variant post-build-loadable+post-build-selectable / pre-compile in variant pre-compile, origin=Vector Informatik, default-value=false  # True, if all Standard and Extended filter elements can be configured as range filters, else false. A range filter is a filter defined by a lower bound and an upper bound. It matches all ids between its lower bound and its upper bound including the boundary values.
        boolean vCanDualIdFilterSupport: set at post-build in variant post-build-loadable+post-build-selectable / pre-compile in variant pre-compile, origin=Vector Informatik, default-value=false  # True, if all Standard and Extended filter elements can be configured as dual id filters, else false. A dual id filter is a filter matching exactly two ids.
        boolean vCanRejectionFilterSupport: set at post-build in variant post-build-loadable+post-build-selectable / pre-compile in variant pre-compile, origin=Vector Informatik, default-value=false  # True, if all Standard and Extended filter elements (including range filters if activated) can be configured as rejection filters, else false. A rejection filter is a filter that rejects ids that are matching with the filter (instead of accepting them).
        integer vCanAvailableStdFilters: 0..9223372036854775807, set at post-build in variant post-build-loadable+post-build-selectable / pre-compile in variant pre-compile, origin=Vector Informatik, default-value=0  # Specifies the number of available Standard filters. This number has to be guaranteed for all enabled filter modes (range, dual, rejection).
        integer vCanAvailableExtFilters: 0..9223372036854775807, set at post-build in variant post-build-loadable+post-build-selectable / pre-compile in variant pre-compile, origin=Vector Informatik, default-value=0  # Specifies the number of available Extended filters. This number has to be guaranteed for all enabled filter modes (range, dual, rejection).
        integer vCanAvailableMixedFilters: 0..9223372036854775807, set at post-build in variant post-build-loadable+post-build-selectable / pre-compile in variant pre-compile, origin=Vector Informatik, default-value=0  # Specifies the number of available Mixed filters. This number has to be guaranteed for code/mask-filters. Mixed filters are never configured as range, dual id or rejection filters. Mixed filters are left flush, meaning that a Standard ids are compared to bit 18 to 28 of code and mask.
        integer vCanStdFilterWeight: 0..9223372036854775807, set at post-build in variant post-build-loadable+post-build-selectable / pre-compile in variant pre-compile, origin=Vector Informatik, default-value=0  # Specifies the weight of a Standard filter. The filter optimization algorithm has to respect the following formula: Number of Standard filters * vCanStdFilterWeight + Number of Extended filters * vCanExtFilterWeight + Number of Mixed filters * vCanMixedFilterWeight + Number of Standard Full-CANs * vCanStdFullCanWeight + Number of Extended Full-CANs * vCanExtFullCanWeight <= vCanAvailableFilterSpace
        integer vCanAvailableRxFullCans: 0..9223372036854775807, set at post-build in variant post-build-loadable+post-build-selectable / pre-compile in variant pre-compile, origin=Vector Informatik, default-value=0  # Specifies the number of availbale Rx Full-CAN hardware objects.
        integer vCanExtFilterWeight: 0..9223372036854775807, set at post-build in variant post-build-loadable+post-build-selectable / pre-compile in variant pre-compile, origin=Vector Informatik, default-value=0  # Specifies the weight of a Extended filter. This parameter is used if the different filter types share the same hardware ressources. The filter optimization algorithm has to respect the following formula: Number of Standard filters * vCanStdFilterWeight + Number of Extended filters * vCanExtFilterWeight + Number of Mixed filters * vCanMixedFilterWeight + Number of Standard Full-CANs * vCanStdFullCanWeight + Number of Extended Full-CANs * vCanExtFullCanWeight <= vCanAvailableFilterSpace
        integer vCanMixedFilterWeight: 0..9223372036854775807, set at post-build in variant post-build-loadable+post-build-selectable / pre-compile in variant pre-compile, origin=Vector Informatik, default-value=0  # Specifies the weight of a Mixed filter. This parameter is used if the different filter types share the same hardware ressources. The filter optimization algorithm has to respect the following formula: Number of Standard filters * vCanStdFilterWeight + Number of Extended filters * vCanExtFilterWeight + Number of Mixed filters * vCanMixedFilterWeight + Number of Standard Full-CANs * vCanStdFullCanWeight + Number of Extended Full-CANs * vCanExtFullCanWeight <= vCanAvailableFilterSpace
        integer vCanStdFullCanWeight: 0..9223372036854775807, set at post-build in variant post-build-loadable+post-build-selectable / pre-compile in variant pre-compile, origin=Vector Informatik, default-value=0  # Specifies the weight of a Standard Rx Full-CAN hardware object. This parameter is used if Rx Full-CAN hardware object share hardware ressources with filters and 0 otherwise. The filter optimization algorithm has to respect the following formula: Number of Standard filters * vCanStdFilterWeight + Number of Extended filters * vCanExtFilterWeight + Number of Mixed filters * vCanMixedFilterWeight + Number of Standard Full-CANs * vCanStdFullCanWeight + Number of Extended Full-CANs * vCanExtFullCanWeight <= vCanAvailableFilterSpace
        integer vCanExtFullCanWeight: 0..9223372036854775807, set at post-build in variant post-build-loadable+post-build-selectable / pre-compile in variant pre-compile, origin=Vector Informatik, default-value=0  # Specifies the weight of a Extended Rx Full-CAN hardware object. This parameter is used if Rx Full-CAN hardware object share hardware ressources with filters and 0 otherwise. The filter optimization algorithm has to respect the following formula: Number of Standard filters * vCanStdFilterWeight + Number of Extended filters * vCanExtFilterWeight + Number of Mixed filters * vCanMixedFilterWeight + Number of Standard Full-CANs * vCanStdFullCanWeight + Number of Extended Full-CANs * vCanExtFullCanWeight <= vCanAvailableFilterSpace
        integer vCanAvailableFilterSpace: 0..9223372036854775807, set at post-build in variant post-build-loadable+post-build-selectable / pre-compile in variant pre-compile, origin=Vector Informatik, default-value=0  # Specifies the overall available space for filters (can include Rx Full-CAN hardware objects). The filter optimization algorithm has to respect the following formula: Number of Standard filters * vCanStdFilterWeight + Number of Extended filters * vCanExtFilterWeight + Number of Mixed filters * vCanMixedFilterWeight + Number of Standard Full-CANs * vCanStdFullCanWeight + Number of Extended Full-CANs * vCanExtFullCanWeight <= vCanAvailableFilterSpace
        integer vCanAvailableRxBasicCans: 0..9223372036854775807, set at post-build in variant post-build-loadable+post-build-selectable / pre-compile in variant pre-compile, origin=Vector Informatik, default-value=0  # Specifies the number of available Rx Basic-CAN hardware objects.
        boolean vCanFullCansCountAsFilters: set at post-build in variant post-build-loadable+post-build-selectable / pre-compile in variant pre-compile, origin=Vector Informatik, default-value=false  # True, if Full-CANs are counted into the amount of (Std/Ext) filters. In this case the filter optimization algorithm has to respect the following formulas: Number of Standard filters + Number of Standard Full-CANs <= vCanAvailableStdFilters Number of Extended filters + Number of Extended Full-CANs <= vCanAvailableExtFilters Number of Standard Full-CANs + Number of Extended Full-CANs <= vCanAvailableRxFullCans False, if Full-CANs are NOT counted into the amount of (Std/Ext) filters. In this case the filter optimization algorithm has to respect the following formulas: Number of Standard filters <= vCanAvailableStdFilters Number of Extended filters <= vCanAvailableExtFilters Number of Standard Full-CANs + Number of Extended Full-CANs <= vCanAvailableRxFullCans
    container vCanGeneral  # This container contains the global configuration parameters
      string vCanUserConfigFile [0..1]: set at pre-compile, origin=Vector Informatik, default-value=UserCfg  # Reference to an external text file that will be included into vCan_30_MyPlatform_Cfg.h during code generation. The content of the user configuration file will be added at the end of the generated module configuration file and allows altering or extending the generated code. Caution: User configuration files can cause the software module to malfunction and must only be used with great care!
      boolean vCanUseNestedCANInterrupts: set at pre-compile, origin=Vector Informatik, default-value=false  # This parameter defines whether CAN ISRs from different controllers can interrupt each other (only with higher priority). Deactivate this parameter to reduce runtime consumption.
      boolean vCanFdNiso: set at pre-compile, origin=Vector Informatik, default-value=false  # FD Non ISO Operation | Non ISO Operation (NISO). Activate this option if you want to make your ECU runable in a non ISO CAN FD network. TRUE: no ISO 11898-1 CRC is used. FALSE: ISO 11898-1 CRC is used.
      boolean vCanFdPed: set at pre-compile, origin=Vector Informatik, default-value=false  # FD Protocol Exception Disable | Protocol Exception Disable (PED). Disabling the Protocol Exception leads to a form error, when the res bit of the CTRL field is detected to be recessive. TRUE: disable the protocol exection. FALSE: enable protocol exception.
      boolean vCanUseVirtualAddressing: set at pre-compile, origin=Vector Informatik, default-value=false  # This parameter specifies whether a virtual address space should be accessed instead of the CAN controller in hardware. TRUE: Virtual address space used FALSE: Virtual address space not used (default)
      boolean vCanConstantDataToDefine: set at pre-compile, origin=Vector Informatik, default-value=true  # This parameter specifies whether the generated data should be optimized to improve runtime and reduce ROM usage. When this optimization is active, constant data will be generated as defines, TRUE: Optimization active (default) FALSE: Optimization not active (only for debug)
      container vCanHardwareLoopCheck [0..*]  # Under some conditions, the CAN driver has to wait for hardware dependent events. This will be done in a so-called 'Hardware Loop'. Refer to the technical reference documentation for usage of this kind of loops. To secure that this loop will not run infinitely, a timeout (CanTimeoutDuration) can be configured. A DET notification appears in this case.
        integer vCanHardwareLoopCheckId: 0..255, set at pre-compile, origin=Vector Informatik, default-value=0  # ID for HW loop check
      container vCanGeneralSetting  # General settings of supported features
        boolean vCanWakeupSupport: set at pre-compile, origin=Vector Informatik, default-value=false  # This parameter defines whether the hardware supports wakeup over CAN Bus.
        boolean vCanMultipleRxBasicCANSupport: set at pre-compile, origin=Vector Informatik, default-value=false  # This parameter defines whether the hardware supports multiple RxBasicCAN hardware objects per controller.
        boolean vCanMultipleTxBasicCANSupport: set at pre-compile, origin=Vector Informatik, default-value=false  # This parameter defines whether the hardware supports multiple TxBasicCAN hardware objects per controller.
        enumeration vCanFdSupport: {NONE, BRS, FULL}, set at pre-compile, origin=Vector Informatik, default-value=NONE  # Specifies the kind of CAN FD support. NONE: CAN FD is deactivated BRS: Bitrate switching is activated but DLC is 8 at maximum FULL: Bitrate switching is activated and DLC can be 64 at maximum
        boolean vCanSilentModeSupport: set at pre-compile, origin=Vector Informatik, default-value=false  # Support 'Silent Mode' by hardware.
        boolean vCanHwTxFifoSupport: set at pre-compile, origin=Vector Informatik, default-value=false  # Hardware transmit FIFO support | Support a TX FIFO in hardware
        boolean vCanIndividualProcessingSupport: set at pre-compile, origin=Vector Informatik, default-value=false  # Support 'Individual processing' by hardware
        integer vCanCompatibilityVersion: 0..65535, set at pre-compile, origin=Vector Informatik, default-value=0  # core - extension interface version
        boolean vCanHardwareCancellationSupport: set at pre-compile, origin=Vector Informatik, default-value=false  # This parameter defines whether the hardware supports the cancellation of a TX requested.
        boolean vCanMultiplexedTransmissionSupport: set at pre-compile, origin=Vector Informatik, default-value=true  # This parameter defines whether the hardware supports multiplexed TX CanHardwareObjects.
        boolean vCanMixedFiltersSupport: set at pre-compile, origin=Vector Informatik, default-value=false  # This parameter defines whether the hardware supports mixed CAN ID filters (standard and extended CAN ID in one CanFilterMask object). The CanFilterMask/Code are left aligned related to extended CAN ID.
        boolean vCanMixedRxBasicCANSupport: set at pre-compile, origin=Vector Informatik, default-value=false  # This parameter defines whether the hardware supports mixed CAN ID in one BasicCAN CanHardwareObject.
        boolean vCanHardwareCancellationTaskSupport: set at pre-compile, origin=Vector Informatik, default-value=false  # This parameter defines whether the hardware need to handle the TX hardware cancellation in a polling task.
        enumeration vCanRamCheckSupport: {None, Active, MailboxNotification}, set at pre-compile, origin=Vector Informatik, default-value=MailboxNotification  # Level of RAM Check supported by the driver
        boolean vCanUseOsInterruptControlSupport: set at pre-compile, origin=Vector Informatik, default-value=true  # This parameter defines whether the driver support OS calls to handle the CAN interrupt locks.
        boolean vCanMultipleFiltersPerBasicCANSupport: set at pre-compile, origin=Vector Informatik, default-value=false  # This parameter defines whether the hardware supports mulitple CanFilterMasks for one BasicCAN CanHardwareObject.
        boolean vCanMultipartitionSupport: set at pre-compile, origin=Vector Informatik, default-value=false  # This parameter defines whether the hardware supports multiple partitions.
        boolean vCanInterruptLockByDriverSupport: set at pre-compile, origin=Vector Informatik, default-value=true  # This parameter defines whether the driver supports CAN interrupt locks by him self. (vCanUseOsInterruptControlSupport may be supported in parallel)
        boolean vCanInitPowerOnCallSupport: set at pre-compile, origin=Vector Informatik, default-value=false  # Activating this parameter will lead to a call to the service function "void vCan_InitPowerOn(void)" from the Can_30_Core during Can_30_Core_Init() execution.
      container vCanCriticalArea [0..*]  # Critical area settings for CAN
        integer vCanCriticalAreaId: 0..255, set at pre-compile, origin=Vector Informatik, default-value=0  # Critical area ID
