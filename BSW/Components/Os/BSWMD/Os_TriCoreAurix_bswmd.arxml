AUTOSAR XML (schema 4-2-1)
package /MICROSAR
  module definition Os [0..1]: category=VENDOR_SPECIFIC_MODULE_DEFINITION, refined-module-def=Os, variants pre-compile  # Operating System (OS). The OS is responsible for Task and Interrupt handling. It provides common services to the Application as well as error detection mechanisms such as Timing- and Memory-Protection. #RuntimeEnvironment #Startup #Shutdown #Scheduling #TaskMapping #Safety #ISO26262 #Monitoring #Multicore #Debugging #AUTOSAR
    container OsAlarm [0..16383]: multiplicity set at pre-compile  # An OsAlarm may be used to asynchronously inform or activate a specific task. It is possible to start alarms automatically at system start-up depending on the application mode.
      reference OsAlarmAccessingApplication [0..*]: multiplicity set at pre-compile, set at pre-compile, destination=OsApplication  # Reference to applications which have an access to this object.
      reference OsAlarmCounterRef: scope=ECU, multiplicity set at pre-compile, set at pre-compile, destination=OsCounter  # Reference to the assigned counter for that alarm.
      choice container OsAlarmAction: multiplicity set at pre-compile  # This container defines which type of notification is used when the alarm expires.
        container OsAlarmActivateTask [0..1]: multiplicity set at pre-compile  # This container specifies the parameters to activate a task.
          reference OsAlarmActivateTaskRef: scope=ECU, multiplicity set at pre-compile, set at pre-compile, destination=OsTask  # Reference to the task that will be activated by that alarm action.
        container OsAlarmCallback [0..1]: multiplicity set at pre-compile  # This container specifies the parameters to call a callback OS alarm action.
          function name OsAlarmCallbackName: multiplicity set at pre-compile, set at pre-compile  # Name of the function that is called when this alarm callback is triggered.
        container OsAlarmIncrementCounter [0..1]: multiplicity set at pre-compile  # This container specifies the parameters to increment a counter.
          reference OsAlarmIncrementCounterRef: scope=ECU, multiplicity set at pre-compile, set at pre-compile, destination=OsCounter  # Reference to the counter that will be incremented by that alarm action.
        container OsAlarmSetEvent [0..1]: multiplicity set at pre-compile  # This container specifies the parameters to set an event.
          reference OsAlarmSetEventRef: scope=ECU, multiplicity set at pre-compile, set at pre-compile, destination=OsEvent  # Reference to the event that will be set by that alarm action.
          reference OsAlarmSetEventTaskRef: scope=ECU, multiplicity set at pre-compile, set at pre-compile, destination=OsTask  # Reference to the task that will be activated by that event.
        container OsAlarmScheduleEventRoundRobin [0..1]: multiplicity set at pre-compile  # This container specifies, that the alarm is used for round robin scheduling. Exactly one alarm with this container is needed per core which has one or more tasks that have round robin scheduling configured by means of the container: OsTaskRoundRobinScheduling. Typically, this is enforced by a validator with a preferred solving action. So no need to add such an alarm manually.
      container OsAlarmAutostart [0..1]: multiplicity set at pre-compile  # If present this container defines if an alarm is started automatically at system start-up depending on the application mode.
        integer OsAlarmAlarmTime: 0..4294967295, multiplicity set at pre-compile, set at pre-compile  # The relative or absolute tick value when the alarm expires for the first time. Note that for an alarm which is RELATIVE the value must be at bigger than 0.
        enumeration OsAlarmAutostartType: {ABSOLUTE, RELATIVE}, multiplicity set at pre-compile, set at pre-compile, default-value=RELATIVE  # This specifies the type of autostart for the alarm..
        integer OsAlarmCycleTime: 0..4294967295, multiplicity set at pre-compile, set at pre-compile, default-value=0  # Cycle time of a cyclic alarm in ticks. If the value is 0 than the alarm is not cyclic.
        reference OsAlarmAppModeRef [1..*]: multiplicity set at pre-compile, set at pre-compile, destination=OsAppMode  # Reference to the application modes for which the AUTOSTART shall be performed.
    container OsAppMode [1..9]: multiplicity set at pre-compile  # OsAppMode is the object used to define an OS application mode. | No standard attributes are defined for AppMode. In a CPU, at least one AppMode object has to be defined. [source: OSEK OIL Spec. 2.5] An OsAppMode called OSDEFAULTAPPMODE must always be there for OSEK compatibility.
    container OsApplication [0..65535]: multiplicity set at pre-compile  # An AUTOSAR OS must be capable of supporting a collection of OS objects (tasks, interrupts, alarms, hooks etc.) that form a cohesive functional unit. This collection of objects is termed an OS-Application. | All objects which belong to the same OS-Application have access to each other. Access means to allow to use these objects within API services. Access by other applications can be granted separately.
      boolean OsTrusted: scope=ECU, multiplicity set at pre-compile, set at pre-compile, default-value=true  # Parameter to specify if an OS-Application is trusted or not. | true: OS-Application is trusted false: OS-Application is not trusted (default)
      boolean OsTrustedApplicationDelayTimingViolationCall: scope=ECU, multiplicity set at pre-compile, set at pre-compile, default-value=false  # Parameter to specify if a timing violation which occurs within an trusted OS-Application is raised immediately or if it is delayed until the current task returns to the calling OS-Application (return of CallTrustedFunction). | true: violation / call to ProtectionHook() is delayed false: timing violation cause an immediate call to the ProtectionHook().
      boolean OsTrustedApplicationWithProtection: scope=ECU, multiplicity set at pre-compile, set at pre-compile, default-value=false  # Parameter to specify if a trusted OS-Application is executed with memory protection or not. | true: OS-Application runs within a protected environment. This means that write access is limited. false: OS-Application has full write access (default)
      boolean OsApplicationIsPrivileged: multiplicity set at pre-compile, origin=Vector Informatik, set at pre-compile, default-value=false  # This parameter shows whether the OS-Application runs in supervisor (privileged) or user mode. Caution: This parameter is for information only and must not be changed manually.
      integer OsAppMemoryProtectionIdentifier [0..1]: 0..4294967295, multiplicity set at pre-compile, origin=Vector Informatik, set at pre-compile, default-value=0  # This optional parameter can be used to specify a memory protection identifier for the OS-Application.
      boolean OsAppUseTrustedFunctionStubs: scope=ECU, multiplicity set at pre-compile, origin=Vector Informatik, set at pre-compile, default-value=false  # This parameter enables the MICROSAR OS extension to the standard trusted function feature. Trusted function stubs package all user configured parameters and provide an API to call the trusted function with the specified parameters. Syntax: Os_Call_<TrustedFunctionName>(arg1, arg2, ...) true: Trusted function stubs will be generated false: No stubs will be generated
      string OsAppCalloutStubsIncludeHeader [0..*]: scope=ECU, multiplicity set at pre-compile, origin=Vector Informatik, set at pre-compile  # This parameter could be used to specify user specific data types for trusted function stubs. Insert header files to be included in Os_Lcfg.h and Os_Service_Lcfg.c. Insert complete filenames including extension (e.g. MyHeader.h).
      reference OsAppAlarmRef [0..*]: scope=ECU, multiplicity set at pre-compile, set at pre-compile, destination=OsAlarm  # Specifies the OsAlarms that belong to the OsApplication.
      reference OsAppCounterRef [0..*]: scope=ECU, multiplicity set at pre-compile, set at pre-compile, destination=OsCounter  # References the OsCounters that belong to the OsApplication.
      reference OsAppEcucPartitionRef [0..1]: scope=ECU, multiplicity set at pre-compile, set at pre-compile, destination=EcucPartition  # Denotes which "EcucPartition" is implemented by this "OSApplication".
      reference OsAppIsrRef [0..*]: scope=ECU, multiplicity set at pre-compile, set at pre-compile, destination=OsIsr  # References which OsIsrs belong to the OsApplication.
      reference OsAppScheduleTableRef [0..*]: scope=ECU, multiplicity set at pre-compile, set at pre-compile, destination=OsScheduleTable  # References the OsScheduleTables that belong to the OsApplication.
      reference OsAppTaskRef [0..*]: scope=ECU, multiplicity set at pre-compile, set at pre-compile, destination=OsTask  # References which OsTasks belong to the OsApplication.
      reference OsRestartTask [0..1]: scope=ECU, multiplicity set at pre-compile, set at pre-compile, destination=OsTask  # Optionally one task of an OS-Application may be defined as Restart Task. | Multiplicity = 1: Restart Task is activated by the Operating System if the protection hook requests it. Multiplicity = 0: No task is automatically started after a protection error happened.
      symbolic name reference OsApplicationCoreRef [0..1]: scope=ECU, multiplicity set at pre-compile, set at pre-compile, destination=EcucCoreDefinition  # Reference to the Core Definition in the Ecuc Module where the CoreId is defined. This reference is used to describe to which Core the OS-Application is bound.
      container OsApplicationHooks: multiplicity set at pre-compile  # Container to structure the OS-Application-specific hooks.
        boolean OsAppErrorHook: scope=ECU, multiplicity set at pre-compile, set at pre-compile, default-value=false  # Select the OS-Application specific error hook. | true: Hook is called false: Hook is not called
        boolean OsAppShutdownHook: scope=ECU, multiplicity set at pre-compile, set at pre-compile, default-value=false  # Select the OS-Application specific shutdown hook. | true: Hook is called false: Hook is not called
        boolean OsAppStartupHook: scope=ECU, multiplicity set at pre-compile, set at pre-compile, default-value=false  # Select the OS-Application specific startup hook. | true: Hook is called false: Hook is not called
      container OsApplicationTrustedFunction [0..65534]: multiplicity set at pre-compile  # Container to structure the configuration parameters of trusted functions.
        function name OsTrustedFunctionName: scope=ECU, multiplicity set at pre-compile, set at pre-compile  # Trusted function (as part of a trusted OS-Application) available to other OS-Applications. This also supersedes the OSEK OIL attribute TRUSTED in APPLICATION because the optionality of this parameter is describing that already.
        string OsTrustedFunctionReturnType: scope=ECU, multiplicity set at pre-compile, origin=Vector Informatik, set at pre-compile, default-value=void  # This parameter specifies the return value of the trusted function.
        container OsTrustedFunctionParam [0..127]: multiplicity set at pre-compile  # This container includes all configuration sub-attributes of one trusted function parameter. These will be used for trusted function stubs generation. This feature can be enabled with /MICROSAR/Os/OsApplication/OsAppUseTrustedFunctionStubs. If no parameter is specified, 'void' is generated. Note: Passed pointers have to be checked for validity by the trusted function implementation.
          integer OsTrustedFunctionParamId: 1..127, scope=ECU, multiplicity set at pre-compile, origin=Vector Informatik, set at pre-compile, default-value=1  # This parameter is used to order the trusted function parameters.
          string OsTrustedFunctionParamDataType: scope=ECU, multiplicity set at pre-compile, origin=Vector Informatik, set at pre-compile, default-value=uint8  # This parameter defines the C data type of the trusted function parameter. Note: If IN parameter is a complex datatype, it shall be passed by reference ('const <DataType>*').
          enumeration OsTrustedFunctionParamDirection: {IN, OUT, IN_OUT}, scope=ECU, multiplicity set at pre-compile, origin=Vector Informatik, set at pre-compile, default-value=IN  # This parameter defines the usage direction of a trusted function parameter. IN: Parameter is only used as input value (passed by value or reference: '<DataType> arg'). OUT: Parameter is only used as output value (always passed by reference: '<DataType> *arg'). IN_OUT: Parameter is used as input and output value (always passed by reference: '<DataType> *arg'). Where <DataType> is the configured data type string.
      container OsApplicationFastTrustedFunction [0..65534]: multiplicity set at pre-compile  # Container to structure the configuration parameters of MICROSAR OS fast trusted functions.
        function name OsFastTrustedFunctionName: multiplicity set at pre-compile, origin=Vector Informatik, set at pre-compile  # Fast trusted function (as part of a trusted OS-Application) available to other OS-Applications.
      container OsApplicationNonTrustedFunction [0..65534]: multiplicity set at pre-compile  # Container to structure the configuration parameters of MICROSAR OS non-trusted functions.
        function name OsNonTrustedFunctionName: multiplicity set at pre-compile, origin=Vector Informatik, set at pre-compile  # Non-trusted function (as part of a non-trusted OS-Application) available to other OS-Applications.
        integer OsNonTrustedFunctionStacks: 1..4294967295, multiplicity set at pre-compile, origin=Vector Informatik, set at pre-compile, default-value=1  # Specifies the maximum number of stacks for the non-trusted function. Each parallel call of a non-trusted function needs its own stack. So this value must be equal to the maximum number of parallel calls of this function.
        integer OsNonTrustedFunctionStackSize: 0..4294967295, multiplicity set at pre-compile, origin=Vector Informatik, set at pre-compile, default-value=1024  # This attribute specifies the stack size of the non-trusted function in bytes. In case of parallel calls each stack is set up with the same size.
        container OsNonTrustedFunctionCaller [0..32]: multiplicity set at pre-compile  # This container structures all parameters to specify the maximum number of stacks for a non-trusted function used by a specific OS-Application.
          integer OsNonTrustedFunctionAppStacks: 0..4294967295, multiplicity set at pre-compile, origin=Vector Informatik, set at pre-compile, default-value=1  # Specifies the maximum number of stacks for the non-trusted function used by the referenced OS-Application. Each parallel call of a non-trusted function needs its own stack. So this value must be equal to the maximum number of parallel calls from the referenced OS-Application.
          reference OsNonTrustedFunctionAppRef: multiplicity set at pre-compile, origin=Vector Informatik, set at pre-compile, destination=OsApplication  # Reference to the caller OS-Application.
    container OsBarrier [0..65534]: multiplicity set at   # A barrier provides a method that synchronizes tasks. The calling task blocks until all participating tasks reach the barrier. Only one task per core may participate in a barrier.
      reference OsBarrierTaskRef [0..*]: scope=ECU, multiplicity set at pre-compile, origin=Vector Informatik, set at pre-compile, destination=OsTask  # References to OsTasks which are participating in the barrier.
    container OsCore [1..32]: multiplicity set at pre-compile  # This container defines all configuration parameters for a MICROSAR OS-Core. Each physical core shall be represented by an OS-Core.
      string OsCoreEntrySymbol [0..1]: multiplicity set at pre-compile, origin=Vector Informatik, set at pre-compile  # This parameter defines the entry symbol (startup/reset vector) of the OS-Core. It shall be the linker label where the core starts on multi-core systems. Note: If no default entry symbol is configured, this parameter can be omitted.
      boolean OsCoreIsAutostart: multiplicity set at pre-compile, origin=Vector Informatik, set at pre-compile, default-value=false  # Specifies whether the core has been already started before the OS initialization. Note: This could be done by hardware or software (e.g. hypervisor or startup code). If in doubt use the proposed default value.
      boolean OsCoreIsAutosar: multiplicity set at pre-compile, origin=Vector Informatik, set at pre-compile, default-value=false  # Specifies whether the OS-Core is an AUTOSAR core or not. Which means this core is used with the MICROSAR OS.
      reference OsCoreIdleTask [0..1]: multiplicity set at pre-compile, origin=Vector Informatik, set at pre-compile, destination=OsTask  # References which OsTask is used as idle task for the OS-Core. The idle task runs if the core is in idle mode. Each OS-Core needs his own idle task.
      reference OsCorePreStartTask [0..1]: multiplicity set at pre-compile, origin=Vector Informatik, set at pre-compile, destination=OsTask  # Optional reference to an OsTask which shall be used as pre-start task for the OS-Core. A pre-start task is necessary if MemoryProtection, peripheral region services, trusted function or non-trusted functions shall be used before StartOS(). Each OS-Core needs his own pre-start task.
      reference OsCoreSystemApplication [0..1]: scope=ECU, multiplicity set at pre-compile, origin=Vector Informatik, set at pre-compile, destination=OsApplication  # References which OsApplication is used as system OS-Application for the OS-Core. Each OS-Core needs his own system OS-Application.
      reference OsCoreResScheduler [0..1]: multiplicity set at pre-compile, origin=Vector Informatik, set at pre-compile, destination=OsResource  # This parameter references the RES_SCHEDULER resource for this OS-Core. Note: For multi-core systems the RES_SCHEDULER is generated for each core with name 'RES_SCHEDULER_<CoreName>'.
      reference OsCoreTimingProtectionCounter [0..1]: multiplicity set at pre-compile, origin=Vector Informatik, set at pre-compile, destination=OsCounter  # Optional reference to a high resolution OsCounter which is used for timing protection on this OS-Core. Only necessary if timing protection shall be used. Timing protection is only allowed if /MICROSAR/Os/OsOS/OsScalabilityClass is set to SC2 or SC4.
      reference OsCorePhysicalCoreRef: multiplicity set at pre-compile, origin=Vector Informatik, set at pre-compile, destination=OsPhysicalCore  # Reference to the derivative specific definition of a hardware core. This reference is used to describe to which hardware core the OS-Core is bound.
      symbolic name reference OsCoreEcucCoreRef [0..1]: multiplicity set at pre-compile, origin=Vector Informatik, set at pre-compile, destination=EcucCoreDefinition  # Reference to the core definition in the Ecuc module where the CoreId is defined. This reference is used to describe to which core the OS-Core is bound. To map an OS-Application to this OS-Core the corresponding OsApplication needs an OsApplicationCoreRef to the same EcucCoreDefinition in the Ecuc module.
      reference OsCoreRoundRobinSchedulingAlarm [0..1]: multiplicity set at pre-compile, origin=Vector Informatik, set at pre-compile, destination=OsAlarm  # Optional reference to an alarm with the action OsAlarmScheduleEventRoundRobin. That alarm is used to trigger round robin scheduling events on this core. The reference is needed if one or more tasks on the core have round robin scheduling configured by means of the container: OsTaskRoundRobinScheduling. The reference shall not be available if no task on the core has round robin scheduling configured.
      container OsCoreStacks: multiplicity set at pre-compile  # Contains all stack configuration attributes for one OS-Core.
        integer OsCoreKernelStackSize: 0..4294967295, multiplicity set at pre-compile, origin=Vector Informatik, set at pre-compile, default-value=1024  # This attribute specifies the stack size of the OS kernel in bytes. The memory exception handling is executed on this stack.
        integer OsCoreStartupStackSize: 0..4294967295, multiplicity set at pre-compile, origin=Vector Informatik, set at pre-compile, default-value=1024  # This attribute specifies the OS startup stack size in bytes. All startup hooks (global and application specific) are executed on this stack.
        integer OsCoreShutdownStackSize: 0..4294967295, multiplicity set at pre-compile, origin=Vector Informatik, set at pre-compile, default-value=1024  # This attribute specifies the OS shutdown stack size in bytes. All shutdown hooks (global and application specific) are executed on this stack.
        integer OsCoreErrorStackSize: 0..4294967295, multiplicity set at pre-compile, origin=Vector Informatik, set at pre-compile, default-value=1024  # This attribute specifies the OS error stack size in bytes. All error hooks (global and application specific) are executed on this stack.
        integer OsCoreProtectionStackSize: 0..4294967295, multiplicity set at pre-compile, origin=Vector Informatik, set at pre-compile, default-value=1024  # This attribute specifies the OS protection stack size in bytes. The protection hook is executed on this stack.
        integer OsCoreInitStackSize: 0..4294967295, multiplicity set at pre-compile, origin=Vector Informatik, set at pre-compile, default-value=1024  # This attribute specifies the OS init stack size in bytes. The OS initialization is executed on this stack.
      container OsCoreXSignalChannel [0..31]: multiplicity set at pre-compile  # This container structures all parameters for a cross-core API call channel. It shall be used to trigger APIs on another OS-Core. Only one send channel per OS-Core is possible. Valid APIs to be callable cross-core shall be defined in the corresponding receiver ISR (OsIsr/OsIsrXSignalReceiver).
        integer OsCoreXSignalChannelSize: 0..65534, multiplicity set at pre-compile, origin=Vector Informatik, set at pre-compile, default-value=1  # Specifies the number of cross-core service requests that can be queued.
        reference OsCoreXSignalChannelReceiverIsr: multiplicity set at pre-compile, origin=Vector Informatik, set at pre-compile, destination=OsIsr  # References which ISR is used as receiver interrupt on a different OS-Core for the cross-core channel.
    container OsCounter [0..255]: multiplicity set at pre-compile  # Configuration information for the counters that belong to the OS-Application.
      integer OsCounterMaxAllowedValue: 1..4294967295, multiplicity set at pre-compile, set at pre-compile, default-value=1073741823  # Maximum allowed value of the system counter in ticks.
      integer OsCounterMinCycle: 1..4294967295, multiplicity set at pre-compile, set at pre-compile, default-value=1  # The MINCYCLE attribute specifies the minimum allowed number of counter ticks for a cyclic alarm linked to the counter.
      integer OsCounterTicksPerBase: 1..4294967295, multiplicity set at pre-compile, set at pre-compile, default-value=1  # The TICKSPERBASE attribute specifies the number of ticks required to reach a counter specific unit. The interpretation is implementation-specific. The value is calculated by dividing the desired counter period (OsSecondsPerTick) by the period of a single hardware tick, which is calculated by the reciprocal of the frequency (1/fosc).
      enumeration OsCounterType: {HARDWARE, SOFTWARE}, scope=ECU, multiplicity set at pre-compile, set at pre-compile, default-value=SOFTWARE  # This parameter contains the natural type or unit of the counter.
      float OsSecondsPerTick: 0..4294967295, scope=ECU, multiplicity set at pre-compile, set at pre-compile, default-value=0.001  # Time of one counter tick in seconds. The value specifies the desired tick period of the counter in seconds. (0.001 = 1ms)
      enumeration OsCounterAlgorithm: {HEAP, LIST}, multiplicity set at pre-compile, origin=Vector Informatik, set at pre-compile, default-value=HEAP  # This parameter specifies the algorithm for working off the alarms and schedule tables of the counter. An appropriate choice of the algorithm improves performance (run-time). HEAP: A sorted data structure. Recommended if on average only a small percentage (at most approx. 10%) of the active alarms and schedule tables are expiring during a counter cycle (Timer-ISR). LIST: An unsorted data structure. Recommended if on average at least approx. 10% of the active alarms and schedule tables are expiring during a counter cycle. The higher the percentage, the better the performance of LIST compared to HEAP. Not available for High Resolution Timer. Example: If one or more of ten active alarms (at least 10%) expire every counter cycle, LIST is better than HEAP.
      reference OsCounterAccessingApplication [0..*]: multiplicity set at pre-compile, set at pre-compile, destination=OsApplication  # Reference to applications which have an access to this object.
      container OsDriver [0..1]: multiplicity set at pre-compile  # This Container contains information of the driver of a hardware counter. | This configuration is only valid if the counter has OsCounterType set to HARDWARE. If the container does not exist (multiplicity=0) the timer is managed by the OS internally (OSINTERNAL). If the container exists the OS can use the GPT interface to manage the timer. The user have to supply the GPT channel. If the counter is driven by some other (external to the OS) source (like a TPU for example) this must be described as a vendor specific extension.
        boolean OsDriverHighResolution: multiplicity set at pre-compile, origin=Vector Informatik, set at pre-compile, default-value=false  # Specifies whether the counter is a high resolution timer or not.
        reference OsGptChannelRef [0..0]: scope=ECU, multiplicity set at pre-compile, set at pre-compile, destination=GptChannelConfiguration  # Not Used: Reference to the GPT channel.
        reference OsDriverHardwareTimerChannelRef: multiplicity set at pre-compile, origin=Vector Informatik, set at pre-compile, destination=OsHardwareTimerChannel  # References the hardware timer channel.
        reference OsDriverIsrRef: multiplicity set at pre-compile, origin=Vector Informatik, set at pre-compile, destination=OsIsr  # References which OsIsr is used as timer interrupt for the counter.
      container OsTimeConstant [0..*]: multiplicity set at pre-compile  # Allows the user to define constants which can be e.g. used to compare time values with timer tick values. | A time value will be converted to a timer tick value during generation and can later on accessed via the OsConstName. The conversation is done by rounding time values to the nearest fitting tick value.
        float OsTimeValue: 0..4294967295, scope=ECU, multiplicity set at pre-compile, set at pre-compile  # This parameter contains the value of the constant in seconds.
    container OsEvent [0..*]: multiplicity set at pre-compile  # Representation of OS events in the configuration context.
      integer OsEventMask [0..1]: 1..18446744073709551615, multiplicity set at pre-compile, set at pre-compile, default-value=1  # This parameter can be used to specify the bit mask for the event. If empty the event mask is automatically calculated. It is recommended to use automatically calculated event masks.
    container OsIoc [0..1]: multiplicity set at pre-compile  # Configuration of the IOC (Inter OS Application Communicator).
      string OsIocIncludeHeader [0..*]: scope=ECU, multiplicity set at pre-compile, origin=Vector Informatik, set at pre-compile  # This parameter is used to specify header files to be included in the generated IOC header file. It could be necessary to provide user specific datatypes to the IOC module. Insert complete filenames including extension (e.g. MyHeader.h).
      container OsIocCommunication [0..65535]: multiplicity set at pre-compile  # Representation of a 1:1 or N:1 or N:M (unqueued only) communication between software parts located in different OS-Applications that are bound to the same or to different cores. | The name shall begin with the name of the sending software service and be followed by a unique identifier delivered by the sending software service. In the case of RTE as user attention shall be paid on the fact that uniqueness for identifier names has to be reached over ports, data elements, object instances and maybe additional identification properties (E.g. Case 1:N mapping to 1:1). Example: - <NameSpace>_UniqueID
        integer OsIocBufferLength [0..1]: 0..65534, multiplicity set at pre-compile, set at pre-compile, default-value=0  # This attribute defines the size of the IOC internal queue to be allocated for a queued communication. | This configuration information shall allow the optimization of the needed memory for communications requiring buffers within the RTE and within the IOC.
        reference OsIocSpinlock [0..1]: multiplicity set at pre-compile, origin=Vector Informatik, set at pre-compile, destination=OsSpinlock  # References the OsSpinlock which shall be used for this IOC communication. This reference is automatically filled by the OS generator if a Spinlock is necessary for the communication.
        container OsIocDataProperties [1..127]: multiplicity set at pre-compile  # Data properties of the data to be transferred on the IOC communication channel.
          integer OsIocDataPropertyIndex [0..1]: 0..126, multiplicity set at pre-compile, set at pre-compile, default-value=0  # This parameter is used to define in which order the data is send, e.g. whether IocSendGroup(A,B) or IocSendGroup(B,A) shall be used.
          string OsIocInitValue [0..1]: multiplicity set at pre-compile, set at pre-compile, default-value=0  # Initial Value for the data to be transferred on the IOC communication channel. Note: If the used data is of a complex type the parameter has to define a name of a constant (not a value) which contains the initial value for the data. In case an intergral type is used the parameter may be both: a literal value or a name of a constant containing the value as above.
          string OsIocDataType [0..1]: multiplicity set at pre-compile, origin=Vector Informatik, set at pre-compile, default-value=uint32  # This is the type of the data to be transferred on the IOC communication channel. This attribute is necessary to generate the parameter type of the IOC functions. Note: This parameter is an optional addition to the reference parameter (/OsIocDataProperties/OsIocDataTypeRef) specified by AUTOSAR to define the type of data to be transferred. Either this parameter or OsIocDataTypeRef must be set for each IOC data property. If both parameters are set, the data type retrieved from OsIocDataTypeRef will be used. The following types are recognised as primitive: All integer and float based types defined by AUTOSAR in StdTypes and PlatformTypes. Additionally, also the public integer based types and enumerations defined in Os_Types.h and Os_Types_Lcfg.h are recognised. These are: AccessType AlarmType ApplicationStateType ApplicationType AppModeType boolean char CoreIdType CounterType double EventMaskType float float32 float64 IdleModeType int ISRType long long double long int long long long long int MemorySizeType ObjectAccessType ObjectTypeType OSServiceIdType Os_BarrierIdType Os_ErrorParmIndexType Os_ExceptionSourceIdType Os_FastTrustedFunctionIndexType Os_InterruptSourceIdType Os_MemAccessType Os_NonTrustedFunctionIndexType Os_ObjectIdType Os_PeripheralIdType Os_StatusType Os_TickDiffType Os_TraceSpinlockIdType Os_TraceThreadIdType PhysicalTimeType ProtectionReturnType ResourceType RestartType ScheduleTableStatusType ScheduleTableType short short int signed signed char signed int signed long signed long int signed long long signed long long int signed short signed short int sint8 sint8_least sint16 sint16_least sint32 sint32_least sint64 SpinlockIdType StatusType Std_ReturnType TaskStateType TaskType TickType TrustedFunctionIndexType TryToGetSpinlockType uint8 uint8_least uint16 uint16_least uint32 uint32_least uint64 unsigned unsigned char unsigned int unsigned long unsigned long int unsigned long long unsigned long long int unsigned short unsigned short int All other types used as OsIocDataType are handled as reference and invoke memory copy actions which increase runtime in comparison.
          boolean OsIocDataTypeIsAtomic: multiplicity set at pre-compile, origin=Vector Informatik, set at pre-compile, default-value=false  # Specifies if the type in OsIocDataType is an atomic data type or not. Which means it can be copied with one copy instruction and no locks are necessary.
          foreign reference OsIocDataTypeRef [0..1]: multiplicity set at pre-compile, set at pre-compile, destination-type=IMPLEMENTATION-DATA-TYPE  # This is the type of the data to be transferred on the IOC communication channel. This attribute is necessary to generate the parameter type of the Ioc functions. Additionally this information should be used to compute the data size for necessary data copy operations within the Ioc module. Note: In addition to the AUTOSAR standard, the MICROSAR OS provides another optional parameter (/OsIocDataProperties/OsIocDataType) to define the type of data to be transferred. Either this reference or OsIocDataType must be set for each IOC data property. If both parameters are set, the data type retrieved from OsIocDataTypeRef will be used. | If more than one attribute is defined, the IOC generator should generate an IocXxxGroup function (Xxx= CHOICE [Send, Receive, Write, Read]). N:1 or N:M communication (Multiplicity of OsIocSenderProperties > 1) is only allowed for multiplicity of OsIocDataTypeRef = 1
        container OsIocReceiverProperties [1..*]: multiplicity set at pre-compile  # Representation of receiver properties for one communication. For each OsIocCommunication one (1:1) or many receivers (N:M) have to be defined. This container should be instantiated within an OsIocCommunication.
          enumeration OsIocFunctionImplementationKind [0..1]: {DO_NOT_CARE, FUNCTION, MACRO}, multiplicity set at pre-compile, set at pre-compile, default-value=DO_NOT_CARE  # This parameter is used to select whether this communication is implemented as a macro or as a function. Not all implementation kinds are allowed for each kind of communication. DO_NOT_CARE: Implementation kind is selected by the OS FUNCTION: User functions are generated as functions MACRO: User functions are generated as macros
          function name OsIocReceiverPullCB [0..1]: multiplicity set at pre-compile, set at pre-compile  # This attribute defines the name of a callback function that the IOC shall call on the receiving core for each data reception. | In case of non existence of this attribute no ReceiverPullCB notification shall be applied by the IOC. The name of the function shall begin with the name of the receiving module, followed with a callback name and followed by the IocId. Example: void RTE_ReceiverPullCB_RTE25 (void). If this attribute does not exist, it means that no ReceiverPullCB shall be called (No notification from IOC is required). If this attribute exists the IOC shall call the callback function on the receiving core.
          integer OsIocReceiverPullCBStackSize [0..1]: 0..4294967295, multiplicity set at pre-compile, origin=Vector Informatik, set at pre-compile, default-value=1024  # This attribute specifies the stack size of the IOC pull callback function in bytes.
          reference OsIocReceivingOsApplicationRef: multiplicity set at pre-compile, set at pre-compile, destination=OsApplication  # This attribute is a reference to the receiving OsApplication. | This information allows for the generator to get additional information necessary for the code generation like: * The protection properties of the communicating OsApplications to find out which protections have to be crossed * The core identifiers to find out if an intra or an inter core communication has to be realized * Interrupt details in case of cross core notification to realize over IRQs
        container OsIocSenderProperties [1..*]: multiplicity set at pre-compile  # Representation of sender properties for one communication. For each OsIocCommunication one (1:1) or many senders (N:1 or N:M) have to be defined. Multiplicity > 1 (N:1 or N:M communication) is only allowed for Multiplicity of OsIocDataTypeRef = 1. | This container should be instantiated within an OsIocCommunication.
          enumeration OsIocFunctionImplementationKind [0..1]: {DO_NOT_CARE, FUNCTION, MACRO}, multiplicity set at pre-compile, set at pre-compile, default-value=DO_NOT_CARE  # This parameter is used to select whether this communication is implemented as a macro or as a function. Not all implementation kinds are allowed for each kind of communication. DO_NOT_CARE: Implementation kind is selected by the OS FUNCTION: User functions are generated as functions MACRO: User functions are generated as macros
          integer OsIocSenderId [0..1]: 0..255, scope=ECU, multiplicity set at pre-compile, set at pre-compile, default-value=0  # Representation of a sender in a N:1 or N:M communication to distinguish between senders. | This parameter does not exist in 1:1 communication.
          reference OsIocSendingOsApplicationRef: multiplicity set at pre-compile, set at pre-compile, destination=OsApplication  # This attribute is a reference to the sending OS-Application. | This information shall allows the generator to get additional information necessary for the code generation like: * The protection properties of the communicating OS-Applications to find out which protection boundaries have to be crossed. * The core identifiers to find out if an intra or an inter core communication has to be realized * Interrupt details in case of cross core notification to realize over IRQs
    container OsIsr [0..*]: multiplicity set at pre-compile  # The OsIsr container represents an interrupt service routine.
      enumeration OsIsrCategory: {CATEGORY_0, CATEGORY_1, CATEGORY_2}, scope=ECU, multiplicity set at pre-compile, set at pre-compile, default-value=CATEGORY_2  # This attribute specifies the category of this ISR. | CATEGORY_2: The interrupt is handled by the OS. The application does not need to take care about how to enter or return from the ISR function. CATEGORY_1: The interrupt is NOT considered by the OS. The complete handling must be done by the application code. CATEGORY_0: The interrupt is NOT considered by the OS. The complete handling must be done by the application code. It has the shortest latency times.
      enumeration OsIsrInterruptType: {EXTERNAL, EXCEPTION}, scope=ECU, multiplicity set at pre-compile, origin=Vector Informatik, set at pre-compile, default-value=EXTERNAL  # This parameter specifies the interrupt source type of the ISR.
      integer OsIsrInterruptSource: 0..4294967295, scope=ECU, multiplicity set at pre-compile, origin=Vector Informatik, set at pre-compile, default-value=1  # Specifies the interrupt source number of the ISR.
      integer OsIsrInterruptPriority: 0..4294967295, scope=ECU, multiplicity set at pre-compile, origin=Vector Informatik, set at pre-compile, default-value=0  # The priority (level) of an ISR is defined by the value of this attribute. This value represents the hardware specific interrupt priority, so refer to hardware manual for ordering and number of maximum priorities.
      integer OsIsrStackSize: 0..4294967295, multiplicity set at pre-compile, origin=Vector Informatik, set at pre-compile, default-value=1024  # This attribute specifies the stack size of the Interrupt in bytes. Interrupts with disabled nesting will share one stack per core. Interrupts on the same level (priority) and enabled nesting will share one stack per level and core. In both cases the biggest configured size will be used to set up the stack size. Only applicable for category 2 ISRs. Category 1 ISRs will use the current active stack.
      integer OsIsrMemoryProtectionIdentifier [0..1]: 0..4294967295, multiplicity set at pre-compile, origin=Vector Informatik, set at pre-compile, default-value=0  # This optional parameter can be used to specify a memory protection identifier for the ISR. If this parameter is not set but the owner OS-Application has a memory protection identifier specified this value will be used for the interrupt.
      function name OsIsrSpecialFunctionName [0..1]: scope=ECU, multiplicity set at pre-compile, origin=Vector Informatik, set at pre-compile  # This parameter can be used to specify an user defined function name which is called if the configured interrupt occurs. By default the function name is created by the container name. This can be used if multiple interrupt sources shall share the same interrupt handler function. In case of a category 2 ISR the prefix "Os_Isr_" is internally added to the function name.
      boolean OsIsrEnableNesting: multiplicity set at pre-compile, origin=Vector Informatik, set at pre-compile, default-value=false  # Specifies whether the ISR is interruptible by another ISR or not. true: Interrupts will be enabled before entering the interrupt handler function. So ISRs with higher priority can interrupt the ISR. false: Interrupting of the ISR is only possible by FIQs, NMIs or exceptions (Depending on hardware).
      boolean OsIsrUsesFpu: multiplicity set at pre-compile, origin=Vector Informatik, set at pre-compile, default-value=false  # This parameter is used to specify if this ISR uses the FPU unit. This parameter only takes effect, if the parameter /MICROSAR/Os/OsOS/OsFpuUsage is set to "INDIVIDUAL".
      boolean OsIsrInitialEnableInterruptSource: multiplicity set at pre-compile, origin=Vector Informatik, set at pre-compile, default-value=true  # Specifies whether the interrupt source shall be enabled by a call to Os_InitialEnableInterruptSources(). true: Os_InitialEnableInterruptSources() will enable the interrupt source. false: Os_InitialEnableInterruptSources() will ignore the interrupt source.
      float OsIsrPeriod [0..1]: -1.7976931348623157E+308..1.7976931348623157E+308, scope=ECU, multiplicity set at pre-compile, set at pre-compile  # This parameter specifies the period in seconds of this ISR in case of a cyclically triggered interrupt. If this parameter is not given the interrupt can be activated sporadicly or cyclically with a unknown period value. This value is information, e.g. for time base calculations in the RTE in case Timing Events are mapped onto this OsIsr. Be aware, that this parameter is not supposed to be relevant for the OS! It's the responsibility of the integrator to ensure the activation of the ISR according the configured period. This information is given as part of the OS configuration to support configuration work flows using a fixed set of OsIsrs.
      reference OsIsrResourceRef [0..*]: multiplicity set at pre-compile, set at pre-compile, destination=OsResource  # This reference defines the resources accessed by this ISR.
      choice reference OsIsrInterruptMapping [0..1]: multiplicity set at pre-compile, origin=Vector Informatik, set at pre-compile, destination=[OsInterruptSupportedType, OsPhysicalCoreIntCtrlSlaveConfig, OsSystemIntCtrlSlaveConfig]  # This optional parameter can be used to configure the interrupt mapping of certain interrupts to a hardware defined type.
      container OsIsrTimingProtection [0..1]: multiplicity set at pre-compile  # This container contains all parameters which are related to timing protection. Timing protection is only allowed if OS scalability class is set to SC2 or SC4. | If the container exists, the timing protection is used for this interrupt. If the container does not exist, the interrupt is not supervised regarding timing violations.
        float OsIsrAllInterruptLockBudget [0..1]: 0..4294967295, scope=ECU, multiplicity set at pre-compile, set at pre-compile, default-value=0  # This parameter contains the maximum time for which the ISR is allowed to lock all interrupts (via SuspendAllInterrupts() or DisableAllInterrupts()) (in seconds).
        float OsIsrExecutionBudget [0..1]: 0..4294967295, scope=ECU, multiplicity set at pre-compile, set at pre-compile, default-value=0  # The parameter contains the maximum allowed execution time of the interrupt (in seconds).
        float OsIsrOsInterruptLockBudget [0..1]: 0..4294967295, scope=ECU, multiplicity set at pre-compile, set at pre-compile, default-value=0  # This parameter contains the maximum time for which the ISR is allowed to lock all Category 2 interrupts (via SuspendOSInterrupts()) (in seconds).
        float OsIsrTimeFrame [0..1]: 0..4294967295, scope=ECU, multiplicity set at pre-compile, set at pre-compile  # This parameter contains the minimum inter-arrival time between successive interrupts (in seconds).
        container OsIsrResourceLock [0..*]: multiplicity set at pre-compile  # This container contains a list of times the interrupt uses resources.
          float OsIsrResourceLockBudget: 0..4294967295, scope=ECU, multiplicity set at pre-compile, set at pre-compile, default-value=0  # This parameter contains the maximum time the interrupt is allowed to hold the given resource (in seconds).
          reference OsIsrResourceLockResourceRef: scope=ECU, multiplicity set at pre-compile, set at pre-compile, destination=OsResource  # Reference to the resource the locking time is depending on.
      container OsIsrXSignalReceiver [0..1]: multiplicity set at pre-compile  # This container structures all parameters for a cross-core channel receiver interrupt.
        enumeration OsIsrXSignalReceiverProvidedApis [1..*]: {ActivateTask, CancelAlarm, ChainTask, ControlIdle, GetAlarm, GetApplicationState, GetCounterValue, GetElapsedValue, GetErrorHookStackUsage, GetEvent, GetInitHookStackUsage, GetISRStackUsage, GetKernelStackUsage, GetNonTrustedFunctionStackUsage, GetProtectionHookStackUsage, GetScheduleTableStatus, GetShutdownHookStackUsage, GetStartupHookStackUsage, GetTaskStackUsage, GetTaskState, HookCallCallback, NextScheduleTable, SetAbsAlarm, SetEvent, SetRelAlarm, ShutdownAllCores, StartScheduleTableAbs, StartScheduleTableRel, StopScheduleTable, TerminateApplication}, multiplicity set at pre-compile, origin=Vector Informatik, set at pre-compile, default-value=ShutdownAllCores  # Specify all APIs which shall be usable via a cross-core API call.
    container OsMemoryProtection [0..1]: multiplicity set at pre-compile  # Container to structure all memory protection relevant configuration parameters. Memory protection is only allowed if OS scalability class is set to SC3 or SC4.
      container OsMemoryRegion [0..*]: multiplicity set at pre-compile  # Container to structure the configuration parameters of one memory protection region.
        string OsMemoryRegionStartAddress: multiplicity set at pre-compile, origin=Vector Informatik, set at pre-compile  # Start address of a memory protection region. The address can be specified either as a valid decimal (1024) or hexadecimal (0x4000) value, or as a valid linker symbol. StartAddress <= Memory to be accessed
        string OsMemoryRegionEndAddress: multiplicity set at pre-compile, origin=Vector Informatik, set at pre-compile  # End address of a memory protection region. The address can be specified either as a valid decimal (1024) or hexadecimal (0x4000) value, or as a valid linker symbol. Depending on the underlying hardware: Memory to be accessed <= EndAddress or Memory to be accessed < EndAddress
        integer OsMemoryRegionIdentifier [0..1]: 0..4294967295, multiplicity set at pre-compile, origin=Vector Informatik, set at pre-compile, default-value=0  # Defines the optional hardware specific memory protection region identifier. The interpretation of this parameter is hardware specific (e.g. PID, ProtectionSet or ASID).
        integer OsMemoryRegionProtectionUnitSlot [0..1]: 0..4294967295, multiplicity set at pre-compile, origin=Vector Informatik, set at pre-compile, default-value=0  # This optional parameter specifies on which MPU slot the memory protection region shall be used. The interpretation of this parameter is hardware specific.
        choice reference OsMemoryRegionOwner [0..1]: multiplicity set at pre-compile, origin=Vector Informatik, set at pre-compile, destination=[OsApplication, OsIsr, OsTask]  # Specifies whether a memory protection region is OS-Application, Task or ISR specific or Global. Application specific: Add reference to an OsApplication, so the region gets active everytime the configured OS-Application is entered. Task specific: Add reference to an OsTask, so the region gets active everytime the configured Task is entered. ISR specific: Add reference to a category 2 OsIsr, so the region gets active everytime the configured ISR is entered. Global: If no owner (reference) is configured, the region is always active.
        choice reference OsMemoryRegionProtectionUnit: multiplicity set at pre-compile, origin=Vector Informatik, set at pre-compile, destination=[OsSystemMpu, OsPhysicalCoreMpu]  # References on which memory protection unit (core or system) the memory protection region shall be used.
        reference OsMemoryRegionAccessRights [1..*]: multiplicity set at pre-compile, origin=Vector Informatik, set at pre-compile, destination=OsMemoryRegionAccess  # This reference is used to set access rights for the memory protection region.
        reference OsMemoryRegionFlags [0..*]: multiplicity set at pre-compile, origin=Vector Informatik, set at pre-compile, destination=OsMemoryRegionFlag  # References hardware specific region flags to be active for this memory protection region.
        reference OsMemoryRegionBusMasters [0..*]: multiplicity set at pre-compile, origin=Vector Informatik, set at pre-compile, destination=OsMemoryRegionBusMaster  # References each bus master for which the memory protection region shall be valid for.
      container OsAccessCheckRegion [0..*]: multiplicity set at pre-compile  # Container to structure the configuration parameters of one check memory access region. These regions are used for the AUTOSAR Check[Task|ISR]MemoryAccess() APIs.
        string OsAccessCheckRegionStartAddress: multiplicity set at pre-compile, origin=Vector Informatik, set at pre-compile  # Start address of a check memory access region. The address can be specified either as a valid decimal (1024) or hexadecimal (0x4000) value, or as a valid linker symbol. StartAddress <= Memory to be accessed
        string OsAccessCheckRegionEndAddress: multiplicity set at pre-compile, origin=Vector Informatik, set at pre-compile  # End address of a check memory access region. The address can be specified either as a valid decimal (1024) or hexadecimal (0x4000) value, or as a valid linker symbol. Memory to be accessed <= EndAddress
        enumeration OsAccessCheckRegionAccessRights [0..4]: {READ, WRITE, EXECUTE, STACK}, multiplicity set at pre-compile, origin=Vector Informatik, set at pre-compile, default-value=READ  # This parameter specifies the expected access rights for a check memory access region. It is possible to combine access types. READ: Read access right is granted WRITE: Write access right is granted EXECUTE: Execution right is granted STACK: It is a stack region If nothing selected, no access rights are granted.
        choice reference OsAccessCheckRegionOwners [1..*]: multiplicity set at pre-compile, origin=Vector Informatik, set at pre-compile, destination=[OsIsr, OsTask]  # Specifies the owners of the check memory access region.
      container OsPeripheralRegion [0..65534]: multiplicity set at pre-compile  # Container to structure the configuration parameters of one peripheral region. The container short name can be used to access this region.
        string OsPeripheralRegionStartAddress: multiplicity set at pre-compile, origin=Vector Informatik, set at pre-compile  # Start address of a peripheral region. The address can be specified either as a valid decimal (1024) or hexadecimal (0x4000) value, or as a valid linker symbol. StartAddress <= Memory to be accessed
        string OsPeripheralRegionEndAddress: multiplicity set at pre-compile, origin=Vector Informatik, set at pre-compile  # End address of a peripheral region. The address can be specified either as a valid decimal (1024) or hexadecimal (0x4000) value, or as a valid linker symbol. Memory to be accessed <= EndAddress
        reference OsPeripheralRegionAccessingApp [1..*]: multiplicity set at pre-compile, origin=Vector Informatik, set at pre-compile, destination=OsApplication  # Reference to applications which have access to this object.
    container OsOS: multiplicity set at pre-compile  # This container structures basic OS configuration attributes. | Per CPU exactly one OS object has to be defined.
      integer OsNumberOfCores [0..1]: 1..65535, scope=ECU, multiplicity set at pre-compile, set at pre-compile, default-value=1  # Maximum number of cores that are controlled by the OS. | The OS uses the value internally. It depends on the ECU HW.
      enumeration OsScalabilityClass [0..1]: {SC1, SC2, SC3, SC4}, scope=ECU, multiplicity set at pre-compile, set at pre-compile, default-value=SC1  # A scalability class for each System Object "OS" has to be selected. In order to customize the operating system to the needs of the user and to take full advantage of the processor features the operating system can be scaled according to the scalability classes. SC1: OSEK compliant with AUTOSAR extensions SC2: Timing Protection SC3: Memory Protection SC4: Memory and Timing Protection | If the scalability class is omitted this translates to the OIL AUTO mechanism.
      boolean OsStackMonitoring: scope=ECU, multiplicity set at pre-compile, set at pre-compile, default-value=true  # Enable stack monitoring of Tasks and Category 2 ISRs. | true: Stacks are monitored false: Stacks are not monitored
      enumeration OsStatus: {EXTENDED, STANDARD}, multiplicity set at pre-compile, set at pre-compile, default-value=EXTENDED  # This parameter specifies if the system shall use standard or extended status checks.
      boolean OsUseArti: multiplicity set at pre-compile, origin=Vector Informatik, set at pre-compile, default-value=false  # The OsUseArti attribute defines whether the OS uses and calls ARTI hooks. This includes also the generation of related ARTI artifacts by the generator. Note: In addition to the AUTOSAR standard, the MICROSAR OS provides the possibility to enable only certain of the specified OS ArtiHooks. For example: Enable ArtiHooks only for OS service call tracing. To enable the different ArtiHook sets, please refer to '/MICROSAR/Os/OsOS/OsDebug/OsArtiHooks'.
      boolean OsUseGetServiceId: multiplicity set at pre-compile, set at pre-compile, default-value=false  # If selected, the usage of the access macros to get the service ID information in the error hook is enabled. | true: Service ID information macros enabled false: Service ID information macros disabled
      boolean OsUseParameterAccess: multiplicity set at pre-compile, set at pre-compile, default-value=false  # If selected, the usage of the access macros to get the context related information in the error hook is enabled. | true: Context related information macros enabled false: Context related information macros disabled
      boolean OsUseResScheduler: multiplicity set at pre-compile, set at pre-compile, default-value=false  # The OsUseResScheduler attribute defines whether the resource RES_SCHEDULER is used within the application. Note: For multi-core systems the RES_SCHEDULER is generated for each core with name 'RES_SCHEDULER_<CoreName>'.
      boolean OsForcibleTermination: multiplicity set at pre-compile, origin=Vector Informatik, set at pre-compile, default-value=false  # This parameter specifies whether forcible termination (killing) is enabled or not.
      boolean OsGenerateCalloutStubs: multiplicity set at pre-compile, origin=Vector Informatik, set at pre-compile, default-value=true  # Enable user callout function stub generation for system and OS-Application specific hooks. true: User callout function stubs will be generated into file Os_Callout_Stubs.c false: No callout stubs will be generated
      enumeration OsGenerateMemMap: {COMPLETE, USERCODE_AND_STACKS_GROUPED_PER_CORE, EMPTY}, multiplicity set at pre-compile, origin=Vector Informatik, set at pre-compile, default-value=COMPLETE  # This parameter defines if complete, reduced or empty AUTOSAR MemMap files (Os_MemMap*.h) are generated. Note: The parameter /Os/OsOS/OsGenerateMemMapForThreads could also be used to reduce compile time or number of user defined sections. COMPLETE: Generate complete MemMap files including compiler specific pragmas (recommended for systems with memory protection). USERCODE_AND_STACKS_GROUPED_PER_CORE: Same as COMPLETE but some sections are grouped to decrease number of user defined linker sections: - User callout code sections (Tasks, ISRs, Hooks, etc.) of a core are grouped into one user code section - All stack sections of a core are grouped into one stack data section If selected and memory protection is enabled, all configured stack sizes must match the MPU granularity and alignment. Otherwise stack protection cannot be ensured. EMPTY: Generate empty MemMap files to reduce compile time. If selected, the AUTOSAR memory mapping mechanism cannot be used.
      boolean OsGenerateMemMapForNearAddressing: multiplicity set at pre-compile, origin=Vector Informatik, set at pre-compile, default-value=true  # This parameter specifies if additional memory sections for near addressing mode (e.g. sdata, sbss, sconst) shall be generated into Os_MemMap.h or not. This feature could be used to decrease compile time if memory sections for near addressing mode are not necessary according to the used compiler options. true: Generate additional memory sections for near addressing into Os_MemMap.h false: No memory sections for near addressing will be generated
      boolean OsGenerateMemMapForThreads: multiplicity set at pre-compile, origin=Vector Informatik, set at pre-compile, default-value=false  # This parameter specifies if additional memory sections for threads (Tasks and ISRs) shall be generated into Os_MemMap.h or not. This feature could be used to decrease compile time if memory sections for threads are not necessary. true: Generate additional memory sections for threads into Os_MemMap.h false: No memory sections for threads will be generated
      boolean OsServiceProtection: multiplicity set at pre-compile, origin=Vector Informatik, set at pre-compile, default-value=false  # Enables service checks specified by AUTOSAR.
      boolean OsStackUsageMeasurement: multiplicity set at pre-compile, origin=Vector Informatik, set at pre-compile, default-value=false  # Enables the MICROSAR OS feature to measure stack usage during runtime. There are several API functions (Os_Get*StackUsage) which can be used by the application to determine the current stack usage. Please refer to the TechnicalReference to see all available stack usage API functions and how to use this feature. This feature will increase OS start-up time because all configured stacks have to be filled with a check pattern.
      boolean OsUseXSignalAsyncApiCalls: multiplicity set at pre-compile, origin=Vector Informatik, set at pre-compile, default-value=false  # This parameter is used to specify if cross-core API calls (XSignal) shall be performed synchronous (false) or asynchronous (true). It is only considered if at least one valid /MICROSAR/Os/OsCore/OsCoreXSignalChannel is configured.
      enumeration OsFpuUsage: {NONE, ALL, INDIVIDUAL}, multiplicity set at pre-compile, origin=Vector Informatik, set at pre-compile, default-value=NONE  # This parameter is used to specify the usage of the FPU unit, if it is available on the microcontroller. Using the FPU unit typically increases the size of the register context, which is saved and restored during a context switch. NONE: No thread uses the FPU unit. ALL: All the threads use the FPU unit. INDIVIDUAL: The usage is set individual for each thread. This parameter only takes effect on platforms, where the FPU context is great. On other platforms, the FPU context is always saved. Please refer to the Technical Reference for more detailed information about the concrete platforms.
      enumeration OsUseCase: {STANDARD, INTERRUPT_ONLY}, multiplicity set at pre-compile, origin=Vector Informatik, set at pre-compile, default-value=STANDARD  # This parameter specifies the use case for the Operating System. STANDARD: If selected, the OS provides all functionalities described in the AUTOSAR Standard and the documentation provided by Vector. INTERRUPT_ONLY: If selected, the OS is only suitable for interrupt and exception handling. The user can only configure category 1 interrupts and exceptions. The user has to call the OS API Os_InitInterruptOnly() to enable interrupt handling. The user must not call the OS APIs Os_Init() and StartOs().
      reference OsMasterCore: multiplicity set at pre-compile, origin=Vector Informatik, set at pre-compile, destination=OsCore  # Specifies which OS-Core is used as master core for the system.
      reference OsHardwareInitCore [0..1]: multiplicity set at pre-compile, origin=Vector Informatik, set at pre-compile, destination=OsCore  # Specifies which OS-Core should initialize the system peripheral register, e.g.: system MPU, system interrupt controller. If nothing selected, the core referenced in /MICROSAR/Os/OsOS/OsMasterCore is used.
      reference OsSystemTimer [0..1]: multiplicity set at pre-compile, origin=Vector Informatik, set at pre-compile, destination=OsCounter  # Specifies which OsCounter is used as system timer. Only necessary for OSEK compatibility.
      container OsDebug [0..1]: multiplicity set at pre-compile  # Optional container to structure all debug support parameters for the OS. If not present all debug supports will be disabled.
        boolean OsAssertions: multiplicity set at pre-compile, origin=Vector Informatik, set at pre-compile, default-value=false  # Enables additional OS assertions. Warning: These assertions are intended for OS internal test purposes. They shall not be activated for software used in series production.
        enumeration OsORTIDebugSupport [0..1]: {ORTI_22_STANDARD, ORTI_22_ADDITIONAL, ORTI_23_STANDARD, ORTI_23_ADDITIONAL}, multiplicity set at pre-compile, origin=Vector Informatik, set at pre-compile, default-value=ORTI_22_ADDITIONAL  # This parameter specifies if ORTI debug information is generated or not. ORTI_22_*: Support of standard ORTI 2.2 - one file for each AUTOSAR core is created (Os_Trace_<CoreName>.ORT) ORTI_23_*: Support of ORTI 2.2 inclusive SMP proposals (multi-core support) - single file (Os_Trace.ORT) *_STANDARD: Enables ORTI with tracing of Tasks and Isrs -- causes a small offset in runtime and memory consumption compared to non ORTI. *_ADDITIONAL: Same as *_STANDARD plus Service tracing -- causes a bigger offset in runtime and memory consumption than *_STANDARD. If nothing is selected (Parameter does not exist), no ORTI debug file is created.
        string OsTimingHooksIncludeHeader [0..*]: multiplicity set at pre-compile, origin=Vector Informatik, set at pre-compile  # This optional parameter is used to specify include files for the MICROSAR OS timing hooks. To enable timing hooks at least one include file has to be specified. Insert complete filenames including extension (e.g. MyTimingHooks.h).
        enumeration OsArtiHooks [0..*]: {TASK, CAT2ISR, APPLICATION, SERVICECALLS, SPINLOCK, PROTECTIONHOOK}, multiplicity set at pre-compile, origin=Vector Informatik, set at pre-compile, default-value=TASK  # Defines which ARTI Hooks should be activated and thus usable. Each entry enables a set of ARTI hooks for a class ('_className') specified by AUTOSAR. If nothing is selected, no hooks are entered in the ARTI module under '/Arti/ArtiValues/ArtiHook'. Also '/Os/OsOS/OsUseArti' must be set to TRUE to enable the ARTI Hook usage.
      container OsHooks: multiplicity set at pre-compile  # Container to structure all hooks belonging to the OS.
        boolean OsErrorHook: multiplicity set at pre-compile, set at pre-compile, default-value=true  # If selected, the ErrorHook routine is called, if an API function returns with an error code unequal to E_OK. It is also called if OS internal errors are detected. The function ErrorHook has to be provided by the application. | true: Hook is called false: Hook is not called
        boolean OsPostTaskHook: multiplicity set at pre-compile, set at pre-compile, default-value=false  # If selected, the PostTaskHook routine will be called any time the operating system interrupts or terminates a task. The function PostTaskHook has to be provided by the application. | true: Hook is called false: Hook is not called
        boolean OsPreTaskHook: multiplicity set at pre-compile, set at pre-compile, default-value=false  # If selected, the PreTaskHook routine will be called any time the operating system starts or resumes a task. The function PreTaskHook has to be provided by the application. | true: Hook is called false: Hook is not called
        boolean OsProtectionHook [0..1]: scope=ECU, multiplicity set at pre-compile, set at pre-compile, default-value=false  # Switch to enable/disable the call to the (user supplied) protection hook. | true: Protection hook is called on protection error false: Protection hook is not called
        boolean OsShutdownHook: multiplicity set at pre-compile, set at pre-compile, default-value=false  # If selected, the ShutdownHook routine will be called, if the API-function ShutdownOS is either called by the application or by the operating system. The function ShutdownHook has to be provided by the application. | true: Hook is called false: Hook is not called
        boolean OsStartupHook: multiplicity set at pre-compile, set at pre-compile, default-value=false  # If selected, the StartupHook routine will be called by the operating system in the startup phase (after calling StartOS and before starting the first task). The function StartupHook has to be provided by the application. | true: Hook is called false: Hook is not called
        boolean OsPanicHook [0..1]: multiplicity set at pre-compile, origin=Vector Informatik, set at pre-compile, default-value=false  # If selected, the PanicHook routine will be called by the operating system if an inconsistent OS state is detected and regular shutdown cannot be reached. The function Os_PanicHook has to be provided by the application.
      container OsStackSummary: multiplicity set at pre-compile  # This container provides an overview of all internal calculated OS stacks. For example it can be used to determine which task uses which stack and how the size is configured. The size has to be configured at the stack size parameter of the container which is referenced as user. Note: This stack summary is automatically created and updated during configuration. Manual configuration of stacks in this summary is not supported.
        container OsStack [0..*]: multiplicity set at pre-compile  # This container represents an OS stack.
          integer OsStackSize: 0..4294967295, scope=ECU, multiplicity set at pre-compile, origin=Vector Informatik, set at pre-compile, default-value=1024  # This value specifies the size of the stack in bytes. Note: For shared stacks the biggest configured stack size is used to set up this value.
          enumeration OsStackType: {CORE_CALLBACK_STACK, CORE_ERROR_STACK, CORE_INIT_STACK, CORE_KERNEL_STACK, CORE_PROTECTION_STACK, CORE_STARTUP_STACK, CORE_SHUTDOWN_STACK, ISR_SHARED_CORE_STACK, ISR_SHARED_LEVEL_STACK, NTF_CALLER_STACK, TASK_EXTENDED_STACK, TASK_SHARED_INTRES_STACK, TASK_SHARED_NONPRE_STACK, TASK_SHARED_PRIORITY_STACK}, multiplicity set at pre-compile, origin=Vector Informatik, set at pre-compile, default-value=CORE_KERNEL_STACK  # This parameter defines the type of the stack. Note: Each type refers to users assigned to the same core. CORE_CALLBACK_STACK: This stack is shared by all IOC receiver PullCBs. CORE_ERROR_STACK: This stack is shared by the global and all OS-Application specific ErrorHooks. CORE_INIT_STACK: This stack is used by the OS initialization. CORE_KERNEL_STACK: This stack is used by the memory exception handling. CORE_PROTECTION_STACK: This stack is used by the global ProtectionHook. CORE_STARTUP_STACK: This stack is shared by the global and all OS-Application specific StartupHooks. CORE_SHUTDOWN_STACK: This stack is shared by the global and all OS-Application specific ShutdownHooks. ISR_SHARED_CORE_STACK: This stack is shared by all non-nestable category 2 ISRs. ISR_SHARED_LEVEL_STACK: This stack is shared by all nestable category 2 ISRs configured to the same interrupt priority level. NTF_CALLER_STACK: This stack is used by exactly one caller of a non-trusted function. TASK_EXTENDED_STACK: This stack is only used by the extended user Task. TASK_SHARED_INTRES_STACK: This stack is shared by all basic Tasks with active stack sharing and the same internal resouce. TASK_SHARED_NONPRE_STACK: This stack is shared by all non-preemptable basic Tasks with active stack sharing. TASK_SHARED_PRIORITY_STACK: This stack is shared by all basic Tasks with the same priority.
          reference OsStackCore: scope=ECU, multiplicity set at pre-compile, origin=Vector Informatik, set at pre-compile, destination=OsCore  # Reference to the AUTOSAR OS-Core where this stack belongs to.
          choice reference OsStackUser [0..*]: multiplicity set at pre-compile, origin=Vector Informatik, set at pre-compile, destination=[OsApplication, OsIocReceiverProperties, OsIsr, OsTask, OsApplicationNonTrustedFunction, OsCore]  # Reference to all users of the stack. In case multiple users are referenced, these users share the stack.
    container OsPublishedInformation: multiplicity set at pre-compile  # OsPublishedInformation is used for additional published parameters and information.
      integer OsKernelVersion: 0..4294967295, scope=ECU, multiplicity set at pre-compile, origin=Vector Informatik, set at pre-compile, default-value=0  # Defines the kernel source code generation.
      string OsPlatformName: scope=ECU, multiplicity set at pre-compile, origin=Vector Informatik, set at pre-compile, default-value=Platform  # Defines the name of the platform supported with this BSWMD.
      container OsDerivativeInformation [1..*]: multiplicity set at   # Contains all derivative specific information needed by the OS generator.
        string OsMpuAlignment: multiplicity set at pre-compile, origin=Vector Informatik, set at pre-compile, default-value=0  # Defines the derivative specific linker section alignment in bytes. The alignment needs to fulfill the restrictions given by the underlying MPU (e.g. read-only bits in address registers for region configuration). 0: No alignment will be generated SIZE: Sections will be aligned to configured size
        string OsMpuMemoryGapSize [0..1]: multiplicity set at pre-compile, origin=Vector Informatik, set at pre-compile, default-value=16  # Defines the memory gap size in bytes between two consecutive memory sections.
        boolean OsMpuEndAddressAccessible: multiplicity set at pre-compile, origin=Vector Informatik, set at pre-compile, default-value=false  # Defines whether the configured memory region end address is accessible or not. This depends on the hardware MPU evaluation of the effective address (EA): StartAddress <= EA <= EndAddress: True StartAddress <= EA < EndAddress: False
        boolean OsMpuPrivilegedRegionsConfigurable: multiplicity set at pre-compile, origin=Vector Informatik, set at pre-compile, default-value=false  # Defines whether privileged OS Applications can be configured as Memory Region Owner. This may be needed for derivatives with a limited MPU. Limited means, that the MPU does not allow overlapping regions or certain access right combinations. On all other derivatives this parameter must be "false". true: It is allowed to configure Memory Regions for privileged OS Applications (executed in Supervisor mode). false: It is NOT allowed to configure Memory Regions for privileged OS Applications (Default).
        string OsStackAlignment: multiplicity set at pre-compile, origin=Vector Informatik, set at pre-compile, default-value=0  # Defines the derivative specific alignment of stack linker sections in bytes. 0: No alignment will be generated
        string OsInterruptVectorTableAlignment: multiplicity set at pre-compile, origin=Vector Informatik, set at pre-compile, default-value=0  # Defines the derivative specific alignment of interrupt vector table linker sections in bytes. 0: No alignment will be generated
        string OsExceptionVectorTableAlignment: multiplicity set at pre-compile, origin=Vector Informatik, set at pre-compile, default-value=0  # Defines the derivative specific alignment of exception vector table linker sections in bytes. 0: No alignment will be generated
        multiline string OsHardwareManuals: multiplicity set at pre-compile, origin=Vector Informatik, set at pre-compile, default-value=Hardware Manual  # Specifies the derivative specific hardware manuals including all relevant chapters. Specify name, version, release date of the document and all relevant chapters. e.g. Vendor Reference Manual, Rev. 1, 10/2016, chapters CORE, INTC, PIT, STM, MPU
        boolean OsCyberSecurityConfiguration: multiplicity set at pre-compile, origin=Vector Informatik, set at pre-compile  # Specifies whether the cyber security bit (CS) in the service request control registers (SRC) is assigned to the security application or not. true: Service request is assigned to the security application. false: Service request is not assigned to the security application.
        container OsPhysicalCore [1..*]: multiplicity set at pre-compile  # Derivative specific definition of a physical core.
          integer OsPhysicalCoreId: 0..4294967295, multiplicity set at pre-compile, origin=Vector Informatik, set at pre-compile, default-value=0  # This parameter defines the physical Id of the core.
          string OsPhysicalCoreType [0..1]: multiplicity set at pre-compile, origin=Vector Informatik, set at pre-compile, default-value=PhysicalCore  # Physical type of the physical core.
          string OsPhysicalCoreDefaultEntrySymbol [0..1]: multiplicity set at pre-compile, origin=Vector Informatik, set at pre-compile, default-value=start  # Defines the default entry symbol of the core. It is used to setup OsCoreEntrySymbol of the referencing OsCore.
          integer OsPhysicalCoreExceptionSources: 0..4294967295, multiplicity set at pre-compile, origin=Vector Informatik, set at pre-compile, default-value=0  # Defines the number of available exception sources on the physical core.
          boolean OsPhysicalCoreIsAutostart: multiplicity set at pre-compile, origin=Vector Informatik, set at pre-compile, default-value=false  # Defines whether the core is auto started after system reset.
          boolean OsPhysicalCoreMasterStartAllowed: multiplicity set at pre-compile, origin=Vector Informatik, set at pre-compile, default-value=false  # Defines whether the core is allowed to start the master core. Note that at most one physical core can be configured with this flag equal to True. Note that when this parameter is set to True, this core must be an auto-start core.
          boolean OsPhysicalCorePrivelegedHwAccess: multiplicity set at pre-compile, origin=Vector Informatik, set at pre-compile, default-value=false  # Defines whether the core has the privilege to initialize peripheral registers, e.g.: interrupt source registers in system interrupt controllers.
          choice reference OsPhysicalCoreStackProtectionUnit [0..1]: multiplicity set at pre-compile, origin=Vector Informatik, set at pre-compile, destination=[OsSystemMpu, OsPhysicalCoreMpu]  # Reference to the memory protection that is used for stack protection
          container OsPhysicalCoreIntCtrl [0..1]: multiplicity set at pre-compile  # Container to structure all core interrupt controller attributes.
            integer OsPhysicalCoreIntCtrlMaxSources: 0..4294967295, multiplicity set at pre-compile, origin=Vector Informatik, set at pre-compile, default-value=999  # This parameter specifies the highest configurable interrupt source. Example: If the interrupt controller supports 1024 interrupt sources (0-1023), the highest configurable interrupt source is 1023.
            integer OsPhysicalCoreIntCtrlMaxPrios: 0..4294967295, multiplicity set at pre-compile, origin=Vector Informatik, set at pre-compile, default-value=255  # This parameter specifies the highest configurable interrupt priority. Example: If an interrupt controller supports 64 priorities (0-63), the highest configurable priority is 63.
            enumeration OsPhysicalCoreIntCtrlPrioOrder: {ASC, DESC}, multiplicity set at pre-compile, origin=Vector Informatik, set at pre-compile, default-value=ASC  # This parameter is used to describe the interrupt priority interpretation. ASC: Higher values lead to higher priorities DESC: Lower values lead to higher priorities
            container OsPhysicalCoreIntCtrlAddress [0..*]: multiplicity set at pre-compile  # Container to define a hardware specific address.
              integer OsPhysicalCoreIntCtrlAddressValue: 0..4294967295, multiplicity set at pre-compile, origin=Vector Informatik, set at pre-compile, default-value=0  # This parameter specifies a hardware specific address value.
            container OsPhysicalCoreIntCtrlSlaveConfig [0..*]: multiplicity set at pre-compile  # Container for interrupt controller cascading. Mapping of configurable slave ports to physical master ports.
              integer OsPhysicalCoreIntCtrlMasterSource: 0..4294967295, multiplicity set at pre-compile, origin=Vector Informatik, set at pre-compile  # This parameter specifies the physical master port of the interrupt controller.
              integer OsPhysicalCoreIntCtrlSlaveMinSource [0..1]: 0..4294967295, multiplicity set at pre-compile, origin=Vector Informatik, set at pre-compile  # This parameter specifies the lower limit of the slave port interval mapped to the physical port of the interrupt controller.
              integer OsPhysicalCoreIntCtrlSlaveMaxSource [0..1]: 0..4294967295, multiplicity set at pre-compile, origin=Vector Informatik, set at pre-compile  # This parameter specifies the upper limit of the slave port interval mapped to the physical port of the interrupt controller.
          container OsPhysicalCoreMpu [0..*]: multiplicity set at pre-compile  # Container to structure all core memory protection unit attributes.
            integer OsPhysicalCoreMpuId: 0..4294967295, multiplicity set at pre-compile, origin=Vector Informatik, set at pre-compile, default-value=0  # This parameter defines the physical Id of the core MPU.
            string OsPhysicalCoreMpuType [0..1]: multiplicity set at pre-compile, origin=Vector Informatik, set at pre-compile, default-value=CoreMpu  # Derivative specific type of the core MPU.
            integer OsPhysicalCoreMpuMaxRegions: 0..4294967295, multiplicity set at pre-compile, origin=Vector Informatik, set at pre-compile, default-value=16  # This parameter specifies the maximum number of regions for the core MPU.
            container OsPhysicalCoreMpuAddress [0..*]: multiplicity set at pre-compile  # Container to define a hardware specific address.
              integer OsPhysicalCoreMpuAddressValue: 0..4294967295, multiplicity set at pre-compile, origin=Vector Informatik, set at pre-compile, default-value=0  # This parameter specifies a hardware specific address value.
          container OsPhysicalCoreAddress [0..*]: multiplicity set at   # Container to define a hardware specific address.
            integer OsPhysicalCoreAddressValue: 0..4294967295, multiplicity set at pre-compile, origin=Vector Informatik, set at pre-compile, default-value=0  # This parameter specifies a hardware specific address value.
        container OsHardwareTimer [1..*]: multiplicity set at pre-compile  # Derivative specific definition of a hardware timer module.
          integer OsHardwareTimerId: 0..4294967295, multiplicity set at pre-compile, origin=Vector Informatik, set at pre-compile, default-value=0  # This parameter defines the physical Id of the hardware timer.
          enumeration OsHardwareTimerUnit: {FRT, PIT, FRTPIT}, multiplicity set at pre-compile, origin=Vector Informatik, set at pre-compile, default-value=FRT  # Specifies the counting mode supported by the underlying hardware unit. FRT: A free running up counting timer. PIT: A periodic interrupt timer. FRTPIT: Hardware can be configured as PIT or FRT (e.g. via register flag).
          string OsHardwareTimerType [0..1]: multiplicity set at pre-compile, origin=Vector Informatik, set at pre-compile, default-value=HardwareTimer  # Derivative specific type of the hardware timer.
          integer OsHardwareTimerSize: 4..32, multiplicity set at pre-compile, origin=Vector Informatik, set at pre-compile, default-value=32  # Derivative specific Bit size for the hardware timer.
          integer OsHardwareTimerBaseAddress: 0..4294967295, multiplicity set at pre-compile, origin=Vector Informatik, set at pre-compile, default-value=0  # Hardware specific base address of the timer module.
          container OsHardwareTimerChannel [1..*]: multiplicity set at pre-compile  # Container to structure all hardware timer channel parameters.
            integer OsHardwareTimerChannelId: 0..4294967295, multiplicity set at pre-compile, origin=Vector Informatik, set at pre-compile, default-value=0  # This parameter defines the physical Id of the hardware timer channel.
            integer OsHardwareTimerChannelIntSource: 0..4294967295, multiplicity set at pre-compile, origin=Vector Informatik, set at pre-compile, default-value=0  # Specifies the hardware specific interrupt source number for the hardware timer channel.
            integer OsHardwareTimerChannelOffset: 0..4294967295, multiplicity set at pre-compile, origin=Vector Informatik, set at pre-compile, default-value=0  # Specifies the offset from hardware timer unit base address (OsHardwareTimerBaseAddress) to timer channel register.
          container OsHardwareTimerAddress [0..*]: multiplicity set at pre-compile  # Container to define a hardware specific address.
            integer OsHardwareTimerAddressValue: 0..4294967295, multiplicity set at pre-compile, origin=Vector Informatik, set at pre-compile, default-value=0  # This parameter specifies a hardware specific address value.
        container OsSystemIntCtrl [0..1]: multiplicity set at pre-compile  # Derivative specific definition of a system interrupt controller module.
          string OsSystemIntCtrlType [0..1]: multiplicity set at pre-compile, origin=Vector Informatik, set at pre-compile, default-value=SystemIntCtrl  # Derivative specific type of the system interrupt controller.
          integer OsSystemIntCtrlMaxSources: 0..4294967295, multiplicity set at pre-compile, origin=Vector Informatik, set at pre-compile, default-value=999  # This parameter specifies the highest configurable interrupt source. Example: If the interrupt controller supports 1024 interrupt sources (0-1023), the highest configurable interrupt source is 1023.
          integer OsSystemIntCtrlMaxPrios: 0..4294967295, multiplicity set at pre-compile, origin=Vector Informatik, set at pre-compile, default-value=255  # This parameter specifies the highest configurable interrupt priority. Example: If an interrupt controller supports 64 priorities (0-63), the highest configurable priority is 63.
          enumeration OsSystemIntCtrlPrioOrder: {ASC, DESC}, multiplicity set at pre-compile, origin=Vector Informatik, set at pre-compile, default-value=ASC  # This parameter is used to describe the interrupt priority interpretation. ASC: Higher values lead to higher priorities DESC: Lower values lead to higher priorities
          integer OsSystemIntCtrlBaseAddress: 0..4294967295, multiplicity set at pre-compile, origin=Vector Informatik, set at pre-compile, default-value=0  # Hardware specific base address of the system interrupt controller.
          container OsSystemIntCtrlAddress [0..*]: multiplicity set at pre-compile  # Container to define a hardware specific address.
            integer OsSystemIntCtrlAddressValue: 0..4294967295, multiplicity set at pre-compile, origin=Vector Informatik, set at pre-compile, default-value=0  # This parameter specifies a hardware specific address value.
          container OsSystemIntCtrlSlaveConfig [0..*]: multiplicity set at pre-compile  # Container for interrupt controller cascading. Mapping of configurable slave ports to physical master ports.
            integer OsSystemIntCtrlMasterSource: 0..4294967295, multiplicity set at pre-compile, origin=Vector Informatik, set at pre-compile  # This parameter specifies the physical master port of the interrupt controller.
            integer OsSystemIntCtrlSlaveMinSource [0..1]: 0..4294967295, multiplicity set at pre-compile, origin=Vector Informatik, set at pre-compile  # This parameter specifies the lower limit of the slave port interval mapped to the physical port of the interrupt controller.
            integer OsSystemIntCtrlSlaveMaxSource [0..1]: 0..4294967295, multiplicity set at pre-compile, origin=Vector Informatik, set at pre-compile  # This parameter specifies the upper limit of the slave port interval mapped to the physical port of the interrupt controller.
        container OsSystemMpu [0..*]: multiplicity set at pre-compile  # Derivative specific definition of a system memory protection unit.
          integer OsSystemMpuId: 0..4294967295, multiplicity set at pre-compile, origin=Vector Informatik, set at pre-compile, default-value=0  # This parameter defines the physical Id of the system MPU.
          string OsSystemMpuType [0..1]: multiplicity set at pre-compile, origin=Vector Informatik, set at pre-compile, default-value=SystemMpu  # Derivative specific type of the system MPU.
          integer OsSystemMpuMaxRegions: 0..4294967295, multiplicity set at pre-compile, origin=Vector Informatik, set at pre-compile, default-value=16  # This parameter specifies the maximum number of regions for the system MPU.
          integer OsSystemMpuBaseAddress: 0..4294967295, multiplicity set at pre-compile, origin=Vector Informatik, set at pre-compile, default-value=0  # Hardware specific base address of the system MPU.
          container OsSystemMpuAddress [0..*]: multiplicity set at pre-compile  # Container to define a hardware specific address.
            integer OsSystemMpuAddressValue: 0..4294967295, multiplicity set at pre-compile, origin=Vector Informatik, set at pre-compile, default-value=0  # This parameter specifies a hardware specific address value.
        container OsMemoryRegionSpecifics [0..1]: multiplicity set at pre-compile  # Derivative specific settings for a memory protection region.
          container OsMemoryRegionAccess [1..*]: multiplicity set at pre-compile
            enumeration OsMemoryRegionAccessRights: {NONE, R, W, X, RW, RX, WX, RWX}, multiplicity set at pre-compile, origin=Vector Informatik, set at pre-compile, default-value=NONE  # Defines the access rights for a memory protection region. NONE: No access rights R: Read access rights W: Write access rights X: Execution access rights
            enumeration OsMemoryRegionAccessType: {SUPERVISOR, USER, PROTECTION_SET0, PROTECTION_SET1, PROTECTION_SET2, PROTECTION_SET3, PROTECTION_SET4, PROTECTION_SET5, PROTECTION_SET6, PROTECTION_SET7}, multiplicity set at pre-compile, origin=Vector Informatik, set at pre-compile, default-value=SUPERVISOR  # Defines the access type for a memory protection region.
          container OsMemoryRegionBusMaster [0..*]: multiplicity set at pre-compile  # Defines a derivative specific bus master for a memory protection region.
            integer OsMemoryRegionBusMasterId: 0..4294967295, multiplicity set at pre-compile, origin=Vector Informatik, set at pre-compile, default-value=0  # This parameter defines the physical Id of the memory region bus master.
          container OsMemoryRegionFlag [0..*]: multiplicity set at pre-compile  # Defines a derivative specific memory protection region flag. e.g. Debug, Cachable, ...
        container OsMemoryRegionDefaults [0..2]: multiplicity set at pre-compile  # Default settings for automatically created OsMemoryRegions.
          enumeration OsMemoryRegionDefType: {APPLICATION_PRIVILEGED, APPLICATION_NONPRIVILEGED}, multiplicity set at pre-compile, origin=Vector Informatik, set at pre-compile, default-value=APPLICATION_NONPRIVILEGED  # This parameter defines for which type of MPU region these default values shall be used.
          integer OsMemoryRegionDefIdentifier [0..1]: 0..4294967295, multiplicity set at pre-compile, origin=Vector Informatik, set at pre-compile, default-value=0  # Optional default value for OsMemoryRegionIdentifier.
          integer OsMemoryRegionDefProtectionUnitSlot [0..1]: 0..4294967295, multiplicity set at pre-compile, origin=Vector Informatik, set at pre-compile, default-value=0  # Optional default value for OsMemoryRegionProtectionUnitSlot.
          string OsMemoryRegionDefAccessRights [0..*]: multiplicity set at pre-compile, origin=Vector Informatik, set at pre-compile  # Optional default values for OsMemoryRegionAccessRights.
          string OsMemoryRegionDefFlags [0..*]: multiplicity set at pre-compile, origin=Vector Informatik, set at pre-compile  # Optional default references for OsMemoryRegionFlags.
          string OsMemoryRegionDefBusMasters [0..*]: multiplicity set at pre-compile, origin=Vector Informatik, set at pre-compile  # Optional default references for OsMemoryRegionBusMasters.
          choice reference OsMemoryRegionDefProtectionUnit [0..1]: multiplicity set at pre-compile, origin=Vector Informatik, set at pre-compile, destination=[OsSystemMpu, OsPhysicalCoreMpu]  # Optional default reference for OsMemoryRegionProtectionUnit.
        container OsInterruptSupportedType [0..*]: multiplicity set at pre-compile  # Defines the derivative specific supported interrupt types.
          boolean OsInterruptSupportedTypeSeparateSources: multiplicity set at pre-compile, origin=Vector Informatik, set at pre-compile, default-value=false  # This parameter defines whether the interrupt type (e.g. FIQ) has separate sources or not. true: The interrupt type has its own sources. false: Interrupt sources shall be unique independent from the type.
          boolean OsInterruptSupportedTypeSeparatePriority: multiplicity set at pre-compile, origin=Vector Informatik, set at pre-compile, default-value=false  # This parameter defines whether the interrupt type (e.g. DMA) has a separate priority or not. true: The interrupt type has its own priority. false: The priority value needs to be validated according to interrupt category settings.
          boolean OsInterruptSupportedTypeIsMapped: multiplicity set at pre-compile, origin=Vector Informatik, set at pre-compile, default-value=false  # This parameter defines whether the interrupt type is mapped. The MICROSAR OS implementation uses special functions for mapped interrupt handling. true: The interrupt type is mapped. false: The interrupt type has no mapping.
          boolean OsInterruptSupportedTypePostActionRequired: multiplicity set at pre-compile, origin=Vector Informatik, set at pre-compile, default-value=false  # This parameter defines whether the interrupt type needs an additional action before signaling the end of interrupt to the hardware. true: The interrupt type needs an additional post action after the execution of the user code and before the "EndOfInterrupt" call. false: The interrupt type does not need a post action.
        container OsVirtualizationSupported [0..1]: multiplicity set at pre-compile  # This container must only be available if the derivative supports virtualization! It can be used for platform specific information regarding virtualization and para-virtualization support. The OS Core uses the existence of the container to validate HW virtualization support.
    container OsResource [0..8192]: multiplicity set at pre-compile  # An OsResource object is used to co-ordinate the concurrent access by tasks and ISRs to a shared resource, e.g. the scheduler, any program sequence, memory or any hardware area.
      enumeration OsResourceProperty: {INTERNAL, LINKED, STANDARD}, multiplicity set at pre-compile, set at pre-compile, default-value=STANDARD  # This specifies the type of the resource.
      reference OsResourceAccessingApplication [0..*]: multiplicity set at pre-compile, set at pre-compile, destination=OsApplication  # Reference to applications which have an access to this object.
      reference OsResourceLinkedResourceRef [0..1]: multiplicity set at pre-compile, set at pre-compile, destination=OsResource  # The link to the resource. Must be valid if OsResourceProperty is LINKED. If OsResourceProperty is not LINKED the value is ignored.
    container OsScheduleTable [0..16383]: multiplicity set at pre-compile  # An OsScheduleTable addresses the synchronization issue by providing an encapsulation of a statically defined set of alarms that cannot be modified at runtime.
      integer OsScheduleTableDuration: 0..4294967295, multiplicity set at pre-compile, set at pre-compile, default-value=1073741823  # This parameter defines the modulus of the schedule table (in ticks).
      boolean OsScheduleTableRepeating: scope=ECU, multiplicity set at pre-compile, set at pre-compile, default-value=false  # true: First expiry point on the schedule table shall be processed at final expiry point delay ticks after the final expiry point is processed. false: The schedule table processing stops when the final expiry point is processed.
      reference OsSchTblAccessingApplication [0..*]: multiplicity set at pre-compile, set at pre-compile, destination=OsApplication  # Reference to applications which have an access to this object.
      reference OsScheduleTableCounterRef: scope=ECU, multiplicity set at pre-compile, set at pre-compile, destination=OsCounter  # This parameter contains a reference to the counter which drives the schedule table.
      container OsScheduleTableAutostart [0..1]: multiplicity set at pre-compile  # This container specifies if and how the schedule table is started on startup of the Operating System. The options to start a schedule table correspond to the API calls to start schedule tables during runtime.
        enumeration OsScheduleTableAutostartType: {ABSOLUTE, RELATIVE, SYNCHRON}, multiplicity set at pre-compile, set at pre-compile, default-value=ABSOLUTE  # This specifies the type of the autostart for the schedule table.
        integer OsScheduleTableStartValue [0..1]: 0..4294967295, scope=ECU, multiplicity set at pre-compile, set at pre-compile, default-value=0  # Absolute autostart tick value when the schedule table starts. Only used if the OsScheduleTableAutostartType is ABSOLUTE. | Relative offset in ticks when the schedule table starts. Only used if the OsScheduleTableAutostartType is RELATIVE.
        reference OsScheduleTableAppModeRef [1..*]: scope=ECU, multiplicity set at pre-compile, set at pre-compile, destination=OsAppMode  # Reference in which application modes the schedule table should be started during startup.
      container OsScheduleTableExpiryPoint [1..65535]: multiplicity set at pre-compile  # The point on a Schedule Table at which the OS activates tasks and/or sets events.
        integer OsScheduleTblExpPointOffset: 0..4294967295, multiplicity set at pre-compile, set at pre-compile  # The offset from zero (in ticks) at which the expiry point is to be processed.
        container OsScheduleTableEventSetting [0..*]: multiplicity set at pre-compile  # Event that is triggered by that schedule table.
          reference OsScheduleTableSetEventRef: multiplicity set at pre-compile, set at pre-compile, destination=OsEvent  # Reference to event that will be set by action.
          reference OsScheduleTableSetEventTaskRef: multiplicity set at pre-compile, set at pre-compile, destination=OsTask  # Reference to the task of the event that will be set by action.
        container OsScheduleTableTaskActivation [0..*]: multiplicity set at pre-compile  # Task that is triggered by that schedule table.
          reference OsScheduleTableActivateTaskRef: scope=ECU, multiplicity set at pre-compile, set at pre-compile, destination=OsTask  # Reference to task that will be activated by action.
        container OsScheduleTblAdjustableExpPoint [0..1]: multiplicity set at pre-compile  # Adjustable expiry point.
          integer OsScheduleTableMaxLengthen: 0..4294967295, multiplicity set at pre-compile, set at pre-compile  # The maximum positive adjustment that can be made to the expiry point offset (in ticks).
          integer OsScheduleTableMaxShorten: 0..4294967295, multiplicity set at pre-compile, set at pre-compile  # The maximum negative adjustment that can be made to the expiry point offset (in ticks).
      container OsScheduleTableSync [0..1]: multiplicity set at pre-compile  # This container specifies the synchronization parameters of the schedule table.
        integer OsScheduleTblExplicitPrecision [0..1]: 0..4294967295, scope=ECU, multiplicity set at pre-compile, set at pre-compile, default-value=0  # This configuration is only valid if the explicit synchronization is used (in ticks).
        enumeration OsScheduleTblSyncStrategy: {EXPLICIT, IMPLICIT, NONE}, scope=ECU, multiplicity set at pre-compile, origin=AUTOSAR ECUC, set at pre-compile, default-value=NONE  # AUTOSAR OS provides support for synchronization in two ways: explicit and implicit.
    container OsSpinlock [0..65534]: multiplicity set at pre-compile  # An OsSpinlock object is used to co-ordinate concurrent access by tasks and category 2 ISRs on different cores to a shared resource. An OsSpinlock object that is used by an OsIocCommunication object is always created with OsSpinlockLockMethod LOCK_NOTHING as the required lock mechanism is handled by the OS IOC module. An OsSpinlock object that is used by an OsIocCommunication object is always created with OsSpinlockLockType OPTIMIZED as the Spinlock must only be used by the OS during the IOC function call.
      enumeration OsSpinlockLockMethod: {LOCK_ALL_INTERRUPTS, LOCK_CAT2_INTERRUPTS, LOCK_NOTHING, LOCK_WITH_RES_SCHEDULER}, scope=ECU, multiplicity set at pre-compile, set at pre-compile, default-value=LOCK_CAT2_INTERRUPTS  # Lock method which is used when a spinlock is taken. Note that it is possible that a user (e.g. a Task) might hold more than one spinlock. In this case the last lock taken is forced to use at least a lock methode which locks as strong as the current one.
      enumeration OsSpinlockLockType: {STANDARD, OPTIMIZED}, multiplicity set at pre-compile, origin=Vector Informatik, set at pre-compile, default-value=STANDARD  # Allows to select an optimized fast way for spinlock administration. STANDARD: Standard AUTOSAR implementation OPTIMIZED: Fast optimized MICROSAR OS implementation
      reference OsSpinlockAccessingApplication [1..*]: multiplicity set at pre-compile, set at pre-compile, destination=OsApplication  # Reference to OS-Applications that have an access to this object.
      reference OsSpinlockSuccessor [0..1]: multiplicity set at pre-compile, set at pre-compile, destination=OsSpinlock  # To check whether a spinlock can be occupied (in a nested way) without any danger of deadlock, a linked list of spinlocks can be defined. A spinlock can only be occupied in the order of the linked list. It is allowed to skip a spinlock. If no linked list is specified, spinlocks cannot be nested.
    container OsTask [0..65534]: multiplicity set at pre-compile  # This container represents a task.
      integer OsTaskActivation: 1..255, scope=ECU, multiplicity set at pre-compile, set at pre-compile, default-value=1  # This attribute defines the maximum number of queued activation requests for the task. A value equal to "1" means that at any time only a single activation is permitted for this task. Note that the value must be a natural number starting at 1.
      integer OsTaskPriority: 0..4294967295, scope=ECU, multiplicity set at pre-compile, set at pre-compile, default-value=0  # The priority of a task is defined by the value of this attribute. This value has to be understood as a relative value, i.e. the values show only the relative ordering of the tasks. Note: The generator has a special treatment for the idle task. The idle task has the virtual priority 0xFFFFFFFF to differentiate it from regular tasks. It will be generated to have the lowest priority, even if there are tasks configured with priority 0. | OSEK OS defines the lowest priority as zero (0) - so larger values correspond to higher priorities.
      enumeration OsTaskSchedule: {FULL, NON}, scope=ECU, multiplicity set at pre-compile, set at pre-compile, default-value=FULL  # The OsTaskSchedule attribute defines the preemptability of the task. | If this attribute is set to NON, no internal resources may be assigned to this task.
      integer OsTaskMemoryProtectionIdentifier [0..1]: 0..4294967295, multiplicity set at pre-compile, origin=Vector Informatik, set at pre-compile, default-value=0  # This optional parameter can be used to specify a memory protection identifier for the task. If this parameter is not set but the owner OS-Application has a memory protection identifier specified this value will be used for the task.
      boolean OsTaskStackSharing: multiplicity set at pre-compile, origin=Vector Informatik, set at pre-compile, default-value=false  # Specifies whether the task shall share a stack with other basic tasks or not. Basic tasks with same priority always share a stack independently from this parameter. For detailed information about task stack sharing please refer to the TechnicalReference_Os.pdf chapter "Task Stack Sharing". true: The task is enabled for additional stack sharing. false: The task is not marked for additional stack sharing. Attention: Basic tasks which have this attribute set to TRUE must never call the OS service Schedule(). Note: For shared stacks the biggest configured size will be used to set up the stack size.
      integer OsTaskStackSize: 0..4294967295, multiplicity set at pre-compile, origin=Vector Informatik, set at pre-compile, default-value=1024  # This attribute specifies the stack size of the task in bytes.
      enumeration OsTaskType: {AUTO, BASIC, EXTENDED}, scope=ECU, multiplicity set at pre-compile, origin=Vector Informatik, set at pre-compile, default-value=AUTO  # This parameter specifies the type of task. If AUTO (should be used) the type is calculated automatically from other parameters. It is possible to preselect the type, if there are restrictions to use a special task type. An error message is created if there are differences between the preselected and the calculated task type.
      boolean OsTaskUsesFpu: multiplicity set at pre-compile, origin=Vector Informatik, set at pre-compile, default-value=false  # This parameter is used to specify if this task uses the FPU unit. This parameter only takes effect, if the parameter /MICROSAR/Os/OsOS/OsFpuUsage is set to "INDIVIDUAL".
      float OsTaskPeriod [0..1]: -1.7976931348623157E+308..1.7976931348623157E+308, scope=ECU, multiplicity set at pre-compile, set at pre-compile  # This parameter specifies the period in seconds of this task in case of a cyclically activated task. If this parameter is not given the task can be activated sporadicly or cyclically with a unknown period value. This value is information, e.g. for time base calculations in the RTE in case Timing Events are mapped onto this OsTask. Be aware, that this parameter is not supposed to be relevant for the OS! This information is given as part of the OS configuration to support configuration work flows using a fixed set of OsTasks.
      reference OsTaskAccessingApplication [0..*]: multiplicity set at pre-compile, set at pre-compile, destination=OsApplication  # Reference to applications which have an access to this object.
      reference OsTaskEventRef [0..64]: multiplicity set at pre-compile, set at pre-compile, destination=OsEvent  # This reference defines the list of events the extended task may react on.
      reference OsTaskResourceRef [0..*]: multiplicity set at pre-compile, set at pre-compile, destination=OsResource  # This reference defines a list of resources accessed by this task.
      container OsTaskAutostart [0..1]: multiplicity set at pre-compile  # This container determines whether the task is activated during the system start-up procedure or not for some specific application modes. | If the task shall be activated during the system start-up, this container is present and holds the references to the application modes in which the task is auto-started.
        reference OsTaskAppModeRef [1..*]: multiplicity set at pre-compile, set at pre-compile, destination=OsAppMode  # Reference to application modes in which that task is activated on startup of the OS.
      container OsTaskTimingProtection [0..1]: multiplicity set at pre-compile  # This container contains all parameters regarding timing protection of the task. Timing protection is only allowed if OS scalability class is set to SC2 or SC4. | If the container exists, the timing protection is used for this task. If not, the task is not supervised regarding timing violations.
        float OsTaskAllInterruptLockBudget [0..1]: 0..4294967295, scope=ECU, multiplicity set at pre-compile, set at pre-compile, default-value=0  # This parameter contains the maximum time for which the task is allowed to lock all interrupts (via SuspendAllInterrupts() or DisableAllInterrupts()) (in seconds).
        float OsTaskExecutionBudget [0..1]: 0..4294967295, scope=ECU, multiplicity set at pre-compile, set at pre-compile, default-value=0  # This parameter contains the maximum allowed execution time of the task (in seconds).
        float OsTaskOsInterruptLockBudget [0..1]: 0..4294967295, scope=ECU, multiplicity set at pre-compile, set at pre-compile, default-value=0  # This parameter contains the maximum time for which the task is allowed to lock all Category 2 interrupts (via SuspendOSInterrupts()) (in seconds).
        float OsTaskTimeFrame [0..1]: 0..4294967295, scope=ECU, multiplicity set at pre-compile, set at pre-compile  # The minimum inter-arrival time between activations and/or releases of a task (in seconds).
        container OsTaskResourceLock [0..*]: multiplicity set at pre-compile  # This container contains the worst case time between getting and releasing a given resource (in seconds).
          float OsTaskResourceLockBudget: 0..4294967295, scope=ECU, multiplicity set at pre-compile, set at pre-compile, default-value=0  # This parameter contains the maximum time the task is allowed to lock the resource (in seconds).
          reference OsTaskResourceLockResourceRef: scope=ECU, multiplicity set at pre-compile, set at pre-compile, destination=OsResource  # Reference to the resource used by the task.
      container OsTaskRoundRobinScheduling [0..1]: multiplicity set at pre-compile  # This container holds the parameter needed for round robin scheduling. If this container exists for a task, the task is considered to participate in round robin scheduling. If a task has this container configured, all tasks on the same core with the same priority shall also have this container configured (So round robin scheduling has either to be used for all tasks of a specific priority or for none of these).
        integer OsTaskNumScheduleEventsRoundRobin: 1..4294967295, multiplicity set at pre-compile, origin=Vector Informatik, set at pre-compile, default-value=1  # Defines the number of TimeSlices this task may consume.
    container OsVirtualization [0..1]: multiplicity set at pre-compile  # Contains all para-virtualized parameters.
      integer OsVirtualMachineId: 0..4294967295, multiplicity set at pre-compile, origin=Vector Informatik, set at pre-compile  # The virtual machine identifier used by this OS instance.
  bsw implementation Os_Impl: programming-language=C, sw-version=2.72.00, used-code-generator=DaVinci Configurator, vendor-id=30, ar-release-version=4.02.01, preconfigured-configuration=Os_Pre, recommended-configuration=Os_Rec, vendor-specific-module-def=Os
