AUTOSAR XML (schema 4-2-1)
package /MICROSAR
  module config Os_Rec: definition=Os
    OsMemoryProtection
      30 x OsMemoryRegion:
        EXC_ALL_Core{0..2}: OsMemoryRegionStartAddress=0, OsMemoryRegionEndAddress=0xFFFFFFF8, OsMemoryRegionProtectionUnit=OsPhysicalCore{0..2}CodeMpu, OsMemoryRegionAccessRights=PS0_X, OsMemoryRegionAccessRights=PS1_X, OsMemoryRegionAccessRights=PS2_X, OsMemoryRegionAccessRights=PS3_X, OsMemoryRegionAccessRights=PS4_X, OsMemoryRegionAccessRights=PS5_X
        READ_ALL_Core{0..2}: OsMemoryRegionStartAddress=0, OsMemoryRegionEndAddress=0xFFFFFFF8, OsMemoryRegionProtectionUnit=OsPhysicalCore{0..2}DataMpu, OsMemoryRegionAccessRights=PS0_R, OsMemoryRegionAccessRights=PS1_R, OsMemoryRegionAccessRights=PS2_R, OsMemoryRegionAccessRights=PS3_R, OsMemoryRegionAccessRights=PS4_R, OsMemoryRegionAccessRights=PS5_R
        TRUSTED_WRITE_OWN_SPR_Core0: OsMemoryRegionEndAddress=0x7FFFFFF8, OsMemoryRegionStartAddress=_OS_CORE0_STACKS_END, OsMemoryRegionProtectionUnit=OsPhysicalCore0DataMpu, OsMemoryRegionAccessRights=PS0_W
        TRUSTED_WRITE_OWN_SPR_Core1: OsMemoryRegionEndAddress=0x6FFFFFF8, OsMemoryRegionStartAddress=_OS_CORE1_STACKS_END, OsMemoryRegionProtectionUnit=OsPhysicalCore1DataMpu, OsMemoryRegionAccessRights=PS0_W
        TRUSTED_WRITE_OWN_SPR_Core2: OsMemoryRegionEndAddress=0x5FFFFFF8, OsMemoryRegionStartAddress=_OS_CORE2_STACKS_END, OsMemoryRegionProtectionUnit=OsPhysicalCore2DataMpu, OsMemoryRegionAccessRights=PS0_W
        EXC_ALL_Core{3..5}: OsMemoryRegionStartAddress=0, OsMemoryRegionEndAddress=0xFFFFFFF8, OsMemoryRegionProtectionUnit=OsPhysicalCore{3..5}CodeMpu, OsMemoryRegionAccessRights=PS0_X, OsMemoryRegionAccessRights=PS1_X, OsMemoryRegionAccessRights=PS2_X, OsMemoryRegionAccessRights=PS3_X, OsMemoryRegionAccessRights=PS4_X, OsMemoryRegionAccessRights=PS5_X
        READ_ALL_Core{3..5}: OsMemoryRegionStartAddress=0, OsMemoryRegionEndAddress=0xFFFFFFF8, OsMemoryRegionProtectionUnit=OsPhysicalCore{3..5}DataMpu, OsMemoryRegionAccessRights=PS0_R, OsMemoryRegionAccessRights=PS1_R, OsMemoryRegionAccessRights=PS2_R, OsMemoryRegionAccessRights=PS3_R, OsMemoryRegionAccessRights=PS4_R, OsMemoryRegionAccessRights=PS5_R
        TRUSTED_WRITE_OWN_SPR_Core3: OsMemoryRegionEndAddress=0x4FFFFFF8, OsMemoryRegionStartAddress=_OS_CORE3_STACKS_END, OsMemoryRegionProtectionUnit=OsPhysicalCore3DataMpu, OsMemoryRegionAccessRights=PS0_W
        TRUSTED_WRITE_OWN_SPR_Core4: OsMemoryRegionEndAddress=0x3FFFFFF8, OsMemoryRegionStartAddress=_OS_CORE4_STACKS_END, OsMemoryRegionProtectionUnit=OsPhysicalCore4DataMpu, OsMemoryRegionAccessRights=PS0_W
        TRUSTED_WRITE_OWN_SPR_Core5: OsMemoryRegionEndAddress=0x1FFFFFF8, OsMemoryRegionStartAddress=_OS_CORE5_STACKS_END, OsMemoryRegionProtectionUnit=OsPhysicalCore5DataMpu, OsMemoryRegionAccessRights=PS0_W
        TRUSTED_WRITE_SEGMENT_8_To_B_Core0: OsMemoryRegionStartAddress=0x80000000, OsMemoryRegionEndAddress=0xBFFFFFF8, OsMemoryRegionProtectionUnit=OsPhysicalCore0DataMpu, OsMemoryRegionAccessRights=PS0_W
        TRUSTED_WRITE_SEGMENT_E_To_F_Core0: OsMemoryRegionStartAddress=0xE0000000, OsMemoryRegionEndAddress=0xFFFFFFF8, OsMemoryRegionProtectionUnit=OsPhysicalCore0DataMpu, OsMemoryRegionAccessRights=PS0_W
        TRUSTED_WRITE_SEGMENT_8_To_B_Core1: OsMemoryRegionStartAddress=0x80000000, OsMemoryRegionEndAddress=0xBFFFFFF8, OsMemoryRegionProtectionUnit=OsPhysicalCore1DataMpu, OsMemoryRegionAccessRights=PS0_W
        TRUSTED_WRITE_SEGMENT_E_To_F_Core1: OsMemoryRegionStartAddress=0xE0000000, OsMemoryRegionEndAddress=0xFFFFFFF8, OsMemoryRegionProtectionUnit=OsPhysicalCore1DataMpu, OsMemoryRegionAccessRights=PS0_W
        TRUSTED_WRITE_SEGMENT_8_To_B_Core2: OsMemoryRegionStartAddress=0x80000000, OsMemoryRegionEndAddress=0xBFFFFFF8, OsMemoryRegionProtectionUnit=OsPhysicalCore2DataMpu, OsMemoryRegionAccessRights=PS0_W
        TRUSTED_WRITE_SEGMENT_E_To_F_Core2: OsMemoryRegionStartAddress=0xE0000000, OsMemoryRegionEndAddress=0xFFFFFFF8, OsMemoryRegionProtectionUnit=OsPhysicalCore2DataMpu, OsMemoryRegionAccessRights=PS0_W
        TRUSTED_WRITE_SEGMENT_8_To_B_Core3: OsMemoryRegionStartAddress=0x80000000, OsMemoryRegionEndAddress=0xBFFFFFF8, OsMemoryRegionProtectionUnit=OsPhysicalCore3DataMpu, OsMemoryRegionAccessRights=PS0_W
        TRUSTED_WRITE_SEGMENT_E_To_F_Core3: OsMemoryRegionStartAddress=0xE0000000, OsMemoryRegionEndAddress=0xFFFFFFF8, OsMemoryRegionProtectionUnit=OsPhysicalCore3DataMpu, OsMemoryRegionAccessRights=PS0_W
        TRUSTED_WRITE_SEGMENT_8_To_B_Core4: OsMemoryRegionStartAddress=0x80000000, OsMemoryRegionEndAddress=0xBFFFFFF8, OsMemoryRegionProtectionUnit=OsPhysicalCore4DataMpu, OsMemoryRegionAccessRights=PS0_W
        TRUSTED_WRITE_SEGMENT_E_To_F_Core4: OsMemoryRegionStartAddress=0xE0000000, OsMemoryRegionEndAddress=0xFFFFFFF8, OsMemoryRegionProtectionUnit=OsPhysicalCore4DataMpu, OsMemoryRegionAccessRights=PS0_W
        TRUSTED_WRITE_SEGMENT_8_To_B_Core5: OsMemoryRegionStartAddress=0x80000000, OsMemoryRegionEndAddress=0xBFFFFFF8, OsMemoryRegionProtectionUnit=OsPhysicalCore5DataMpu, OsMemoryRegionAccessRights=PS0_W
        TRUSTED_WRITE_SEGMENT_E_To_F_Core5: OsMemoryRegionStartAddress=0xE0000000, OsMemoryRegionEndAddress=0xFFFFFFF8, OsMemoryRegionProtectionUnit=OsPhysicalCore5DataMpu, OsMemoryRegionAccessRights=PS0_W
    OsOS: OsScalabilityClass=SC3
