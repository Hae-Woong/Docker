AUTOSAR XML (schema 4-2-1)
package /MICROSAR
  module config Os_Rec: definition=Os
    SystemTimer (OsCounter)
      OsDriver: OsDriverHardwareTimerChannelRef=STM6_Ch0
