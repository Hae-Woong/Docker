AUTOSAR XML (schema 4-2-1)
package /MICROSAR
  module config Os_Pre: definition=Os
    OsPublishedInformation
      TC26x (OsDerivativeInformation):
        OsMpuAlignment = 8
        OsMpuMemoryGapSize = 16
        OsMpuEndAddressAccessible = 0
        OsStackAlignment = 8
        OsExceptionVectorTableAlignment = 256
        OsInterruptVectorTableAlignment = 8192
        OsHardwareManuals = User Manual: tc26xB_um_v1.3._usermanual_rev1v3.pdf V1.3 Errata Sheet: TC26x_BB_Errata_Sheet_rev1v2_03989A_2016-04-18.pdf V1.2 Safety Manual: AURIX Safety Manual_3.pdf V1.3 2015-09
        OsCyberSecurityConfiguration = 0
        Core0 (OsPhysicalCore):
          OsPhysicalCoreId = 0
          OsPhysicalCoreDefaultEntrySymbol = _start_tc0
          OsPhysicalCoreType = TC1.6.1E
          OsPhysicalCoreExceptionSources = 8
          OsPhysicalCoreMasterStartAllowed = 1
          OsPhysicalCorePrivelegedHwAccess = 1
          OsPhysicalCoreIsAutostart = 1
          OsPhysicalCoreStackProtectionUnit = OsPhysicalCore0DataMpu
          OsPhysicalCore0DataMpu (OsPhysicalCoreMpu): OsPhysicalCoreMpuId=0, OsPhysicalCoreMpuMaxRegions=16, OsPhysicalCoreMpuType=DATA
          OsPhysicalCore0CodeMpu (OsPhysicalCoreMpu): OsPhysicalCoreMpuId=1, OsPhysicalCoreMpuMaxRegions=8, OsPhysicalCoreMpuType=CODE
        Core1 (OsPhysicalCore):
          OsPhysicalCoreId = 1
          OsPhysicalCoreDefaultEntrySymbol = _start_tc1
          OsPhysicalCoreType = TC1.6.1P
          OsPhysicalCoreExceptionSources = 8
          OsPhysicalCoreMasterStartAllowed = 0
          OsPhysicalCorePrivelegedHwAccess = 1
          OsPhysicalCoreIsAutostart = 0
          OsPhysicalCoreStackProtectionUnit = OsPhysicalCore1DataMpu
          OsPhysicalCore1DataMpu (OsPhysicalCoreMpu): OsPhysicalCoreMpuId=0, OsPhysicalCoreMpuMaxRegions=16, OsPhysicalCoreMpuType=DATA
          OsPhysicalCore1CodeMpu (OsPhysicalCoreMpu): OsPhysicalCoreMpuId=1, OsPhysicalCoreMpuMaxRegions=8, OsPhysicalCoreMpuType=CODE
        STM0 (OsHardwareTimer): OsHardwareTimerSize=32, OsHardwareTimerUnit=FRT, OsHardwareTimerBaseAddress=4026531840, OsHardwareTimerId=0, OsHardwareTimerType=STM
          STM0_Ch0 (OsHardwareTimerChannel): OsHardwareTimerChannelIntSource=1168, OsHardwareTimerChannelOffset=0, OsHardwareTimerChannelId=0
          STM0_Ch1 (OsHardwareTimerChannel): OsHardwareTimerChannelIntSource=1172, OsHardwareTimerChannelOffset=1, OsHardwareTimerChannelId=1
        STM1 (OsHardwareTimer): OsHardwareTimerSize=32, OsHardwareTimerUnit=FRT, OsHardwareTimerBaseAddress=4026532096, OsHardwareTimerId=1, OsHardwareTimerType=STM
          STM1_Ch0 (OsHardwareTimerChannel): OsHardwareTimerChannelIntSource=1176, OsHardwareTimerChannelOffset=0, OsHardwareTimerChannelId=0
          STM1_Ch1 (OsHardwareTimerChannel): OsHardwareTimerChannelIntSource=1180, OsHardwareTimerChannelOffset=1, OsHardwareTimerChannelId=1
        AURIXTC2XX_IR (OsSystemIntCtrl): OsSystemIntCtrlMaxPrios=255, OsSystemIntCtrlPrioOrder=ASC, OsSystemIntCtrlMaxSources=8188, OsSystemIntCtrlBaseAddress=4026757120  # InterruptRouter
        GPT (OsHardwareTimer): OsHardwareTimerSize=16, OsHardwareTimerUnit=PIT, OsHardwareTimerBaseAddress=4026543616, OsHardwareTimerId=0, OsHardwareTimerType=PIT
          GPT_Ch0 (OsHardwareTimerChannel): OsHardwareTimerChannelIntSource=1128, OsHardwareTimerChannelOffset=0, OsHardwareTimerChannelId=0
          GPT_Ch1 (OsHardwareTimerChannel): OsHardwareTimerChannelIntSource=1140, OsHardwareTimerChannelOffset=1, OsHardwareTimerChannelId=1
        OsMemoryRegionSpecifics
          12 x OsMemoryRegionAccess:
            PS0_R: OsMemoryRegionAccessRights=R, OsMemoryRegionAccessType=PROTECTION_SET0
            PS0_W: OsMemoryRegionAccessRights=W, OsMemoryRegionAccessType=PROTECTION_SET0
            PS0_X: OsMemoryRegionAccessRights=X, OsMemoryRegionAccessType=PROTECTION_SET0
            PS1_R: OsMemoryRegionAccessRights=R, OsMemoryRegionAccessType=PROTECTION_SET1
            PS1_W: OsMemoryRegionAccessRights=W, OsMemoryRegionAccessType=PROTECTION_SET1
            PS1_X: OsMemoryRegionAccessRights=X, OsMemoryRegionAccessType=PROTECTION_SET1
            PS2_R: OsMemoryRegionAccessRights=R, OsMemoryRegionAccessType=PROTECTION_SET2
            PS2_W: OsMemoryRegionAccessRights=W, OsMemoryRegionAccessType=PROTECTION_SET2
            PS2_X: OsMemoryRegionAccessRights=X, OsMemoryRegionAccessType=PROTECTION_SET2
            PS3_R: OsMemoryRegionAccessRights=R, OsMemoryRegionAccessType=PROTECTION_SET3
            PS3_W: OsMemoryRegionAccessRights=W, OsMemoryRegionAccessType=PROTECTION_SET3
            PS3_X: OsMemoryRegionAccessRights=X, OsMemoryRegionAccessType=PROTECTION_SET3
        DMA (OsInterruptSupportedType):
          OsInterruptSupportedTypeSeparateSources = 0
          OsInterruptSupportedTypeSeparatePriority = 1
          OsInterruptSupportedTypeIsMapped = 0
          OsInterruptSupportedTypePostActionRequired = 0
