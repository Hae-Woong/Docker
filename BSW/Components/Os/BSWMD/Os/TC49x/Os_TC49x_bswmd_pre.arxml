AUTOSAR XML (schema 4-2-1)
package /MICROSAR
  module config Os_Pre: definition=Os
    OsPublishedInformation
      TC49x (OsDerivativeInformation):
        OsMpuAlignment = 8
        OsMpuMemoryGapSize = 16
        OsMpuEndAddressAccessible = 0
        OsStackAlignment = 8
        OsExceptionVectorTableAlignment = 256
        OsInterruptVectorTableAlignment = 8192
        OsHardwareManuals = TC49x_UM_v0.73_DRAFT_2021-12-02.pdf TriCore_TC1.8_architecture_manual_volume_1_2023-02-14_v0.9.1.pdf TriCore_TC1.8_architecture_manual_volume_2_2023-02-14_ v0.9.1.pdf
        OsCyberSecurityConfiguration = 0
        6 x OsPhysicalCore, all with OsPhysicalCoreType=TC1.8, OsPhysicalCoreExceptionSources=8, OsPhysicalCorePrivelegedHwAccess=1:
          Core0: OsPhysicalCoreId=0, OsPhysicalCoreDefaultEntrySymbol=_start_tc0, OsPhysicalCoreMasterStartAllowed=1, OsPhysicalCoreIsAutostart=1, OsPhysicalCoreStackProtectionUnit=OsPhysicalCore0DataMpu
            OsPhysicalCore0DataMpu (OsPhysicalCoreMpu): OsPhysicalCoreMpuId=0, OsPhysicalCoreMpuMaxRegions=24, OsPhysicalCoreMpuType=DATA
            OsPhysicalCore0CodeMpu (OsPhysicalCoreMpu): OsPhysicalCoreMpuId=1, OsPhysicalCoreMpuMaxRegions=16, OsPhysicalCoreMpuType=CODE
          Core1: OsPhysicalCoreId=1, OsPhysicalCoreDefaultEntrySymbol=_start_tc1, OsPhysicalCoreMasterStartAllowed=0, OsPhysicalCoreIsAutostart=0, OsPhysicalCoreStackProtectionUnit=OsPhysicalCore1DataMpu
            OsPhysicalCore1DataMpu (OsPhysicalCoreMpu): OsPhysicalCoreMpuId=0, OsPhysicalCoreMpuMaxRegions=24, OsPhysicalCoreMpuType=DATA
            OsPhysicalCore1CodeMpu (OsPhysicalCoreMpu): OsPhysicalCoreMpuId=1, OsPhysicalCoreMpuMaxRegions=16, OsPhysicalCoreMpuType=CODE
          Core2: OsPhysicalCoreId=2, OsPhysicalCoreDefaultEntrySymbol=_start_tc2, OsPhysicalCoreMasterStartAllowed=0, OsPhysicalCoreIsAutostart=0, OsPhysicalCoreStackProtectionUnit=OsPhysicalCore2DataMpu
            OsPhysicalCore2DataMpu (OsPhysicalCoreMpu): OsPhysicalCoreMpuId=0, OsPhysicalCoreMpuMaxRegions=24, OsPhysicalCoreMpuType=DATA
            OsPhysicalCore2CodeMpu (OsPhysicalCoreMpu): OsPhysicalCoreMpuId=1, OsPhysicalCoreMpuMaxRegions=16, OsPhysicalCoreMpuType=CODE
          Core3: OsPhysicalCoreId=3, OsPhysicalCoreDefaultEntrySymbol=_start_tc3, OsPhysicalCoreMasterStartAllowed=0, OsPhysicalCoreIsAutostart=0, OsPhysicalCoreStackProtectionUnit=OsPhysicalCore3DataMpu
            OsPhysicalCore3DataMpu (OsPhysicalCoreMpu): OsPhysicalCoreMpuId=0, OsPhysicalCoreMpuMaxRegions=24, OsPhysicalCoreMpuType=DATA
            OsPhysicalCore3CodeMpu (OsPhysicalCoreMpu): OsPhysicalCoreMpuId=1, OsPhysicalCoreMpuMaxRegions=16, OsPhysicalCoreMpuType=CODE
          Core4: OsPhysicalCoreId=4, OsPhysicalCoreDefaultEntrySymbol=_start_tc4, OsPhysicalCoreMasterStartAllowed=0, OsPhysicalCoreIsAutostart=0, OsPhysicalCoreStackProtectionUnit=OsPhysicalCore4DataMpu
            OsPhysicalCore4DataMpu (OsPhysicalCoreMpu): OsPhysicalCoreMpuId=0, OsPhysicalCoreMpuMaxRegions=24, OsPhysicalCoreMpuType=DATA
            OsPhysicalCore4CodeMpu (OsPhysicalCoreMpu): OsPhysicalCoreMpuId=1, OsPhysicalCoreMpuMaxRegions=16, OsPhysicalCoreMpuType=CODE
          Core5: OsPhysicalCoreId=5, OsPhysicalCoreDefaultEntrySymbol=_start_tc5, OsPhysicalCoreMasterStartAllowed=0, OsPhysicalCoreIsAutostart=0, OsPhysicalCoreStackProtectionUnit=OsPhysicalCore5DataMpu
            OsPhysicalCore5DataMpu (OsPhysicalCoreMpu): OsPhysicalCoreMpuId=0, OsPhysicalCoreMpuMaxRegions=24, OsPhysicalCoreMpuType=DATA
            OsPhysicalCore5CodeMpu (OsPhysicalCoreMpu): OsPhysicalCoreMpuId=1, OsPhysicalCoreMpuMaxRegions=16, OsPhysicalCoreMpuType=CODE
        6 x OsHardwareTimer, all with OsHardwareTimerSize=32, OsHardwareTimerUnit=FRT, OsHardwareTimerType=CoreSTM:
          STM0: OsHardwareTimerBaseAddress=4169138176, OsHardwareTimerId=0
            STM0_Ch0 (OsHardwareTimerChannel): OsHardwareTimerChannelIntSource=40, OsHardwareTimerChannelOffset=0, OsHardwareTimerChannelId=0
            STM0_Ch1 (OsHardwareTimerChannel): OsHardwareTimerChannelIntSource=44, OsHardwareTimerChannelOffset=1, OsHardwareTimerChannelId=1
          STM1: OsHardwareTimerBaseAddress=4169400320, OsHardwareTimerId=1
            STM1_Ch0 (OsHardwareTimerChannel): OsHardwareTimerChannelIntSource=104, OsHardwareTimerChannelOffset=0, OsHardwareTimerChannelId=0
            STM1_Ch1 (OsHardwareTimerChannel): OsHardwareTimerChannelIntSource=108, OsHardwareTimerChannelOffset=1, OsHardwareTimerChannelId=1
          STM2: OsHardwareTimerBaseAddress=4169662464, OsHardwareTimerId=2
            STM2_Ch0 (OsHardwareTimerChannel): OsHardwareTimerChannelIntSource=168, OsHardwareTimerChannelOffset=0, OsHardwareTimerChannelId=0
            STM2_Ch1 (OsHardwareTimerChannel): OsHardwareTimerChannelIntSource=172, OsHardwareTimerChannelOffset=1, OsHardwareTimerChannelId=1
          STM3: OsHardwareTimerBaseAddress=4169924608, OsHardwareTimerId=3
            STM3_Ch0 (OsHardwareTimerChannel): OsHardwareTimerChannelIntSource=232, OsHardwareTimerChannelOffset=0, OsHardwareTimerChannelId=0
            STM3_Ch1 (OsHardwareTimerChannel): OsHardwareTimerChannelIntSource=236, OsHardwareTimerChannelOffset=1, OsHardwareTimerChannelId=1
          STM4: OsHardwareTimerBaseAddress=4170186752, OsHardwareTimerId=4
            STM4_Ch0 (OsHardwareTimerChannel): OsHardwareTimerChannelIntSource=296, OsHardwareTimerChannelOffset=0, OsHardwareTimerChannelId=0
            STM4_Ch1 (OsHardwareTimerChannel): OsHardwareTimerChannelIntSource=300, OsHardwareTimerChannelOffset=1, OsHardwareTimerChannelId=1
          STM5: OsHardwareTimerBaseAddress=4170448896, OsHardwareTimerId=5
            STM5_Ch0 (OsHardwareTimerChannel): OsHardwareTimerChannelIntSource=360, OsHardwareTimerChannelOffset=0, OsHardwareTimerChannelId=0
            STM5_Ch1 (OsHardwareTimerChannel): OsHardwareTimerChannelIntSource=364, OsHardwareTimerChannelOffset=1, OsHardwareTimerChannelId=1
        AURIXTC4XX_IR (OsSystemIntCtrl): OsSystemIntCtrlMaxPrios=255, OsSystemIntCtrlPrioOrder=ASC, OsSystemIntCtrlMaxSources=8188, OsSystemIntCtrlBaseAddress=4026728448  # InterruptRouter
        OsMemoryRegionSpecifics
          24 x OsMemoryRegionAccess:
            PS0_R: OsMemoryRegionAccessRights=R, OsMemoryRegionAccessType=PROTECTION_SET0
            PS0_W: OsMemoryRegionAccessRights=W, OsMemoryRegionAccessType=PROTECTION_SET0
            PS0_X: OsMemoryRegionAccessRights=X, OsMemoryRegionAccessType=PROTECTION_SET0
            PS1_R: OsMemoryRegionAccessRights=R, OsMemoryRegionAccessType=PROTECTION_SET1
            PS1_W: OsMemoryRegionAccessRights=W, OsMemoryRegionAccessType=PROTECTION_SET1
            PS1_X: OsMemoryRegionAccessRights=X, OsMemoryRegionAccessType=PROTECTION_SET1
            PS2_R: OsMemoryRegionAccessRights=R, OsMemoryRegionAccessType=PROTECTION_SET2
            PS2_W: OsMemoryRegionAccessRights=W, OsMemoryRegionAccessType=PROTECTION_SET2
            PS2_X: OsMemoryRegionAccessRights=X, OsMemoryRegionAccessType=PROTECTION_SET2
            PS3_R: OsMemoryRegionAccessRights=R, OsMemoryRegionAccessType=PROTECTION_SET3
            PS3_W: OsMemoryRegionAccessRights=W, OsMemoryRegionAccessType=PROTECTION_SET3
            PS3_X: OsMemoryRegionAccessRights=X, OsMemoryRegionAccessType=PROTECTION_SET3
            PS4_R: OsMemoryRegionAccessRights=R, OsMemoryRegionAccessType=PROTECTION_SET4
            PS4_W: OsMemoryRegionAccessRights=W, OsMemoryRegionAccessType=PROTECTION_SET4
            PS4_X: OsMemoryRegionAccessRights=X, OsMemoryRegionAccessType=PROTECTION_SET4
            PS5_R: OsMemoryRegionAccessRights=R, OsMemoryRegionAccessType=PROTECTION_SET5
            PS5_W: OsMemoryRegionAccessRights=W, OsMemoryRegionAccessType=PROTECTION_SET5
            PS5_X: OsMemoryRegionAccessRights=X, OsMemoryRegionAccessType=PROTECTION_SET5
            PS6_R: OsMemoryRegionAccessRights=R, OsMemoryRegionAccessType=PROTECTION_SET6
            PS6_W: OsMemoryRegionAccessRights=W, OsMemoryRegionAccessType=PROTECTION_SET6
            PS6_X: OsMemoryRegionAccessRights=X, OsMemoryRegionAccessType=PROTECTION_SET6
            PS7_R: OsMemoryRegionAccessRights=R, OsMemoryRegionAccessType=PROTECTION_SET7
            PS7_W: OsMemoryRegionAccessRights=W, OsMemoryRegionAccessType=PROTECTION_SET7
            PS7_X: OsMemoryRegionAccessRights=X, OsMemoryRegionAccessType=PROTECTION_SET7
        4 x OsInterruptSupportedType, all with OsInterruptSupportedTypeSeparateSources=0, OsInterruptSupportedTypeSeparatePriority=1, OsInterruptSupportedTypeIsMapped=0, OsInterruptSupportedTypePostActionRequired=0:
          DMA0
          DMA1
          GTM
          PPU
        OsVirtualizationSupported
