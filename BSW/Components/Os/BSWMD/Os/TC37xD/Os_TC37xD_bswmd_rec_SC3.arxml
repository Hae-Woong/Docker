AUTOSAR XML (schema 4-2-1)
package /MICROSAR
  module config Os_Rec: definition=Os
    OsMemoryProtection
      10 x OsMemoryRegion:
        EXC_ALL_Core0: OsMemoryRegionStartAddress=0, OsMemoryRegionEndAddress=0xFFFFFFF8, OsMemoryRegionProtectionUnit=OsPhysicalCore0CodeMpu, OsMemoryRegionAccessRights=PS0_X, OsMemoryRegionAccessRights=PS1_X, OsMemoryRegionAccessRights=PS2_X, OsMemoryRegionAccessRights=PS3_X, OsMemoryRegionAccessRights=PS4_X, OsMemoryRegionAccessRights=PS5_X
        EXC_ALL_Core1: OsMemoryRegionStartAddress=0, OsMemoryRegionEndAddress=0xFFFFFFF8, OsMemoryRegionProtectionUnit=OsPhysicalCore1CodeMpu, OsMemoryRegionAccessRights=PS0_X, OsMemoryRegionAccessRights=PS1_X, OsMemoryRegionAccessRights=PS2_X, OsMemoryRegionAccessRights=PS3_X, OsMemoryRegionAccessRights=PS4_X, OsMemoryRegionAccessRights=PS5_X
        READ_ALL_Core0: OsMemoryRegionStartAddress=0, OsMemoryRegionEndAddress=0xFFFFFFF8, OsMemoryRegionProtectionUnit=OsPhysicalCore0DataMpu, OsMemoryRegionAccessRights=PS0_R, OsMemoryRegionAccessRights=PS1_R, OsMemoryRegionAccessRights=PS2_R, OsMemoryRegionAccessRights=PS3_R, OsMemoryRegionAccessRights=PS4_R, OsMemoryRegionAccessRights=PS5_R
        READ_ALL_Core1: OsMemoryRegionStartAddress=0, OsMemoryRegionEndAddress=0xFFFFFFF8, OsMemoryRegionProtectionUnit=OsPhysicalCore1DataMpu, OsMemoryRegionAccessRights=PS0_R, OsMemoryRegionAccessRights=PS1_R, OsMemoryRegionAccessRights=PS2_R, OsMemoryRegionAccessRights=PS3_R, OsMemoryRegionAccessRights=PS4_R, OsMemoryRegionAccessRights=PS5_R
        TRUSTED_WRITE_OWN_SPR_Core0: OsMemoryRegionEndAddress=0x7FFFFFF8, OsMemoryRegionStartAddress=_OS_CORE0_STACKS_END, OsMemoryRegionProtectionUnit=OsPhysicalCore0DataMpu, OsMemoryRegionAccessRights=PS0_W
        TRUSTED_WRITE_OWN_SPR_Core1: OsMemoryRegionEndAddress=0x6FFFFFF8, OsMemoryRegionStartAddress=_OS_CORE1_STACKS_END, OsMemoryRegionProtectionUnit=OsPhysicalCore1DataMpu, OsMemoryRegionAccessRights=PS0_W
        TRUSTED_WRITE_SEGMENT_8_To_B_Core0: OsMemoryRegionStartAddress=0x80000000, OsMemoryRegionEndAddress=0xBFFFFFF8, OsMemoryRegionProtectionUnit=OsPhysicalCore0DataMpu, OsMemoryRegionAccessRights=PS0_W
        TRUSTED_WRITE_SEGMENT_E_To_F_Core0: OsMemoryRegionStartAddress=0xE0000000, OsMemoryRegionEndAddress=0xFFFFFFF8, OsMemoryRegionProtectionUnit=OsPhysicalCore0DataMpu, OsMemoryRegionAccessRights=PS0_W
        TRUSTED_WRITE_SEGMENT_8_To_B_Core1: OsMemoryRegionStartAddress=0x80000000, OsMemoryRegionEndAddress=0xBFFFFFF8, OsMemoryRegionProtectionUnit=OsPhysicalCore1DataMpu, OsMemoryRegionAccessRights=PS0_W
        TRUSTED_WRITE_SEGMENT_E_To_F_Core1: OsMemoryRegionStartAddress=0xE0000000, OsMemoryRegionEndAddress=0xFFFFFFF8, OsMemoryRegionProtectionUnit=OsPhysicalCore1DataMpu, OsMemoryRegionAccessRights=PS0_W
    OsOS: OsScalabilityClass=SC3
