AUTOSAR XML (schema 4-2-1)
package /MICROSAR
  module config Os_Pre: definition=Os
    OsPublishedInformation
      TC49xN_CSRM (OsDerivativeInformation):
        OsMpuAlignment = 8
        OsMpuMemoryGapSize = 16
        OsMpuEndAddressAccessible = 0
        OsStackAlignment = 8
        OsExceptionVectorTableAlignment = 256
        OsInterruptVectorTableAlignment = 8192
        OsHardwareManuals = TC49x-N_UM_v0.71_DRAFT_2024-02-29.pdf TriCore_TC1.8_architecture_manual_volume_1 v1.0.0_2024-02-14.pdf TriCore_TC1.8_architecture_manual_volume_2 v1.0.0_2024-02-14.pdf
        OsCyberSecurityConfiguration = 1
        Core_CS (OsPhysicalCore):
          OsPhysicalCoreId = 6
          OsPhysicalCoreDefaultEntrySymbol = _start_tc0
          OsPhysicalCoreType = TC1.8
          OsPhysicalCoreExceptionSources = 8
          OsPhysicalCoreMasterStartAllowed = 1
          OsPhysicalCorePrivelegedHwAccess = 1
          OsPhysicalCoreIsAutostart = 1
          OsPhysicalCoreStackProtectionUnit = OsPhysicalCoreCSDataMpu
          OsPhysicalCoreCSDataMpu (OsPhysicalCoreMpu): OsPhysicalCoreMpuId=0, OsPhysicalCoreMpuMaxRegions=24, OsPhysicalCoreMpuType=DATA
          OsPhysicalCoreCSCodeMpu (OsPhysicalCoreMpu): OsPhysicalCoreMpuId=1, OsPhysicalCoreMpuMaxRegions=16, OsPhysicalCoreMpuType=CODE
        AURIXTC4XX_IR (OsSystemIntCtrl): OsSystemIntCtrlMaxPrios=255, OsSystemIntCtrlPrioOrder=ASC, OsSystemIntCtrlMaxSources=8188, OsSystemIntCtrlBaseAddress=4026728448  # InterruptRouter
        OsMemoryRegionSpecifics
          24 x OsMemoryRegionAccess:
            PS0_R: OsMemoryRegionAccessRights=R, OsMemoryRegionAccessType=PROTECTION_SET0
            PS0_W: OsMemoryRegionAccessRights=W, OsMemoryRegionAccessType=PROTECTION_SET0
            PS0_X: OsMemoryRegionAccessRights=X, OsMemoryRegionAccessType=PROTECTION_SET0
            PS1_R: OsMemoryRegionAccessRights=R, OsMemoryRegionAccessType=PROTECTION_SET1
            PS1_W: OsMemoryRegionAccessRights=W, OsMemoryRegionAccessType=PROTECTION_SET1
            PS1_X: OsMemoryRegionAccessRights=X, OsMemoryRegionAccessType=PROTECTION_SET1
            PS2_R: OsMemoryRegionAccessRights=R, OsMemoryRegionAccessType=PROTECTION_SET2
            PS2_W: OsMemoryRegionAccessRights=W, OsMemoryRegionAccessType=PROTECTION_SET2
            PS2_X: OsMemoryRegionAccessRights=X, OsMemoryRegionAccessType=PROTECTION_SET2
            PS3_R: OsMemoryRegionAccessRights=R, OsMemoryRegionAccessType=PROTECTION_SET3
            PS3_W: OsMemoryRegionAccessRights=W, OsMemoryRegionAccessType=PROTECTION_SET3
            PS3_X: OsMemoryRegionAccessRights=X, OsMemoryRegionAccessType=PROTECTION_SET3
            PS4_R: OsMemoryRegionAccessRights=R, OsMemoryRegionAccessType=PROTECTION_SET4
            PS4_W: OsMemoryRegionAccessRights=W, OsMemoryRegionAccessType=PROTECTION_SET4
            PS4_X: OsMemoryRegionAccessRights=X, OsMemoryRegionAccessType=PROTECTION_SET4
            PS5_R: OsMemoryRegionAccessRights=R, OsMemoryRegionAccessType=PROTECTION_SET5
            PS5_W: OsMemoryRegionAccessRights=W, OsMemoryRegionAccessType=PROTECTION_SET5
            PS5_X: OsMemoryRegionAccessRights=X, OsMemoryRegionAccessType=PROTECTION_SET5
            PS6_R: OsMemoryRegionAccessRights=R, OsMemoryRegionAccessType=PROTECTION_SET6
            PS6_W: OsMemoryRegionAccessRights=W, OsMemoryRegionAccessType=PROTECTION_SET6
            PS6_X: OsMemoryRegionAccessRights=X, OsMemoryRegionAccessType=PROTECTION_SET6
            PS7_R: OsMemoryRegionAccessRights=R, OsMemoryRegionAccessType=PROTECTION_SET7
            PS7_W: OsMemoryRegionAccessRights=W, OsMemoryRegionAccessType=PROTECTION_SET7
            PS7_X: OsMemoryRegionAccessRights=X, OsMemoryRegionAccessType=PROTECTION_SET7
        STMCS (OsHardwareTimer): OsHardwareTimerSize=32, OsHardwareTimerUnit=FRT, OsHardwareTimerBaseAddress=4170711040, OsHardwareTimerId=6, OsHardwareTimerType=CoreSTM
          STMCS_Ch0 (OsHardwareTimerChannel): OsHardwareTimerChannelIntSource=424, OsHardwareTimerChannelOffset=0, OsHardwareTimerChannelId=0
          STMCS_Ch1 (OsHardwareTimerChannel): OsHardwareTimerChannelIntSource=428, OsHardwareTimerChannelOffset=1, OsHardwareTimerChannelId=1
        4 x OsInterruptSupportedType, all with OsInterruptSupportedTypeSeparateSources=0, OsInterruptSupportedTypeSeparatePriority=1, OsInterruptSupportedTypeIsMapped=0, OsInterruptSupportedTypePostActionRequired=0:
          DMA0
          DMA1
          GTM
          PPU
