AUTOSAR XML (schema 4-2-1)
package /MICROSAR
  module config Os_Pre: definition=Os
    OSDEFAULTAPPMODE (OsAppMode)
    OS_APPMODE_ANY (OsAppMode)
    OsPublishedInformation: OsKernelVersion=7, OsPlatformName=TriCoreAurix
  module config Os_Pre_Class1: definition=Os
    OsPublishedInformation
      OsDerivativeInformation: OsMpuPrivilegedRegionsConfigurable=0, OsCyberSecurityConfiguration=(unset)
