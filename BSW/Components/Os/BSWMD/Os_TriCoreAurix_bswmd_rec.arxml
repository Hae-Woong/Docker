AUTOSAR XML (schema 4-2-1)
package /MICROSAR
  module config Os_Rec: definition=Os
    SystemTimer (OsCounter): OsCounterMaxAllowedValue=2147483647, OsCounterMinCycle=1, OsCounterType=HARDWARE, OsSecondsPerTick=0.001, OsCounterAlgorithm=HEAP
    OsOS: OsScalabilityClass=SC1, OsSystemTimer=SystemTimer
  module config Os_Rec_Class1: definition=Os
    OsIsr: OsIsrInterruptPriority=1
