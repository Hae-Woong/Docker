AUTOSAR XML (schema 4-0-3)
package /MICROSAR
  module config LdCom_Rec: definition=LdCom
    LdComGeneral: LdComSafeBswChecks=1
