AUTOSAR XML (schema 4-0-3)
package /MICROSAR
  bsw implementation LdCom_Impl: programming-language=C, sw-version=5.00.00, used-code-generator=DaVinci Configurator, vendor-id=30, ar-release-version=4.02.02, behavior=LdComBehavior, preconfigured-configuration=LdCom_Pre, recommended-configuration=LdCom_Rec, vendor-specific-module-def=LdCom
  module definition LdCom [0..1]: category=VENDOR_SPECIFIC_MODULE_DEFINITION, refined-module-def=LdCom, variants pre-compile/post-build-loadable/post-build-selectable  # The large data communication module (LdCom) is a wrapper module which provides efficient communication between the PduR and RTE module. It simply forwards all communication APIs between the RTE and the PduR. #Communication #RuntimeEnvironment #PduR #AUTOSAR
    container LdComGeneral  # Contains the general configuration parameters of the AUTOSAR LdCom module.
      boolean LdComDevErrorDetect: set at pre-compile, origin=Vector Informatik, default-value=true  # If 'Development Error Detection' is enabled, all development errors are reported to the Development Error Tracer (DET). The errors are described in the technical reference. Note: In general, the development error detection is recommended during pre-test phase. It is not recommended to enable the development error detection in production code due to increased runtime and ROM needs.
      boolean LdComVersionInfoApi: set at pre-compile, origin=Vector Informatik, default-value=false  # Activate/Deactivate the version information API (LdCom_GetVersionInfo). Activate/Deactivate the version information API LdCom_GetVersionInfo(). - True: version information API activated - False: version information API deactivated
      string LdComUserConfigFile [0..1]: set at pre-compile, origin=Vector Informatik  # Reference to an external user configuration file that will be included during generation. The content of the user configuration file will be added at the end of the generated module configuration file and allows altering or extending the generated code. Caution: User configuration files can cause the software module to malfunction and must only be used with great care!
      boolean LdComSafeBswChecks: set at pre-compile, origin=Vector Informatik, default-value=false  # Selects if safety checks are used. These checks improve robustness as e.g. invalid parameters are checked before function is executed. This attribute has to be enabled for safety projects where this component is mapped to an ASIL partition.
      container LdComGeneration  # Contains the generation configuration parameters of the module LdCom.
        boolean LdComReduceConstantData2Define: set at pre-compile, origin=Vector Informatik, default-value=false  # This parameter activates/deactivates the capability to generate CONFIG-CLASS PRE-COMPILE ROM arrays as constant define. FALSE: ROM arrays are generated as data even if all values are identical. TRUE: ROM arrays are generated as constant define if all values are identical.
        integer LdComReduceBoolDataByNumericalComparisonThreshold: 0..255, set at pre-compile, origin=Vector Informatik, default-value=2  # This parameter activates/deactivates the capability to compress boolean CONFIG-CLASS PRE-COMPILE ROM data by using numerical comparison with other ROM data. 0: The optimization is not performed. >0: This is the threshold to activate the data optimization. Code: the code size is increased due to the usage of the operation in the data access. RAM: no change expected. ROM: the ROM size is minimized. Runtime: the runtime is increased due to the usage of the operation in the data access.
        boolean LdComReduceDataByStreaming: set at pre-compile, origin=Vector Informatik, default-value=false  # This parameter activates/deactivates the capability to pack generated CONFIG-CLASS PRE-COMPILE ROM data into a data type dependent stream. TRUE: generated const data is packed into a data type dependent stream. Code: no change expected. RAM: no change expected. ROM: configuration dependent smaller than with FALSE. Runtime: no change expected. FALSE: generated const data is not packed into a data type dependent stream.
        integer LdComReduceBoolDataByNumericalRelationThreshold: 0..255, set at pre-compile, origin=Vector Informatik, default-value=2  # This parameter activates/deactivates the capability to compress boolean CONFIG-CLASS PRE-COMPILE ROM data by using relational comparison with other ROM data. 0: The optimization is not performed. >0: This is the threshold to activate the data optimization. Code: the code size is increased due to the usage of the operation in the data access. RAM: no change expected. ROM: the ROM size is minimized. Runtime: the runtime is increased due to the usage of the operation in the data access.
        boolean LdComOutOfBoundsReadSanitizer: set at pre-compile, origin=Vector Informatik, default-value=false  # This parameter activates/deactivates the generation of runtime checks which call a DET error notification function to find easily out of bounds read problems. FALSE: no checks are generated in the data access. TRUE: the data access is enriched with DET checks to validate indexes.
        boolean LdComShortSymbols: set at pre-compile, origin=Vector Informatik, default-value=false  # This parameter activates/deactivates the capability to generate shortened symbol names. FALSE: symbol names are generated in a human readable style based on the MIP, tags and variant names. TRUE: symbol names are generated based on the MIP and a CRC32.
        boolean LdComInterfacesForDeactivatedData: set at pre-compile, origin=Vector Informatik, default-value=false  # This parameter activates/deactivates the capability to generate bsw data interfaces for deactivated data elements. This is an advantage for the BSW developer to reduce the time to market with a development environment using auto completition and to investigate potential interfaces. FALSE: data interfaces are not generated if the data elementis deactivated. TRUE: data interfaces are generated as e.g. empty macros.
        boolean LdComReferringKeysInComments: set at pre-compile, origin=Vector Informatik, default-value=false  # This parameter activates/deactivates the capability to generate referring keys in comments. This is an advantage for the developer to investigate indirections, but this feature reduces the overall readability of the generated data. FALSE: referring keys are not generated in comments. TRUE: referring keys are generated in comments.
    container LdComConfig  # This container contains the configuration parameters and sub containers of the AUTOSAR LdCom module. This container is a MultipleConfigurationContainer, i.e. this container and its sub-containers exist once per configuration set.
      container LdComIPdu [0..*]: post-build-changeable=true  # Contains the configuration parameters of the IPdu inside LdCom.
        integer LdComHandleId: 0..65535, set at pre-compile, origin=Vector Informatik, symbolic-name-value=true, default-value=0  # The numerical value used as the ID of this I-PDU. This ID is used by Rte to invoke LdCom. A corresponding shortName is created, which is used for the invocations of the Rte. The same ID is used for invocations by PduR.
        enumeration LdComApiType: {LDCOM_IF, LDCOM_TP}, set at post-build in variant post-build-loadable+post-build-selectable / pre-compile in variant pre-compile, origin=Vector Informatik, default-value=LDCOM_IF  # Indicates the desired API Type of the I-PDU. LDCOM_IF: indicates that the I-PDU is sent/received via communication interface API. LDCOM_TP: indicates that the I-PDU is send/received via transport protocol API.
        enumeration LdComIPduDirection: {LDCOM_RECEIVE, LDCOM_SEND}, set at post-build in variant post-build-loadable+post-build-selectable / pre-compile in variant pre-compile, origin=Vector Informatik  # The direction defines if this I-PDU, and therefore the contributing signal, shall be sent or received.
        function name LdComRxIndication [0..1]: set at post-build in variant post-build-selectable / pre-compile in variant pre-compile+post-build-loadable, origin=Vector Informatik  # Only on receiver side: Name of Rte_LdComCbkRxIndication callback function to be called.
        function name LdComRxStartOfReception [0..1]: set at post-build in variant post-build-selectable / pre-compile in variant pre-compile+post-build-loadable, origin=Vector Informatik  # Only on receiver side: Name of Rte_LdComCbkStartOfReception callback function to be called.
        function name LdComRxCopyRxData [0..1]: set at post-build in variant post-build-selectable / pre-compile in variant pre-compile+post-build-loadable, origin=Vector Informatik  # Only on receiver side: Name of Rte_LdComCbkCopyRxData callback function to be called.
        function name LdComTpRxIndication [0..1]: set at post-build in variant post-build-selectable / pre-compile in variant pre-compile+post-build-loadable, origin=Vector Informatik  # Only on receiver side: Name of Rte_LdComCbkTpRxIndication callback function to be called.
        function name LdComTxTriggerTransmit [0..1]: set at post-build in variant post-build-selectable / pre-compile in variant pre-compile+post-build-loadable, origin=Vector Informatik  # Only on sender side: Name of Rte_LdComCbkTriggerTransmit callback function to be called.
        function name LdComTxConfirmation [0..1]: set at post-build in variant post-build-selectable / pre-compile in variant pre-compile+post-build-loadable, origin=Vector Informatik  # Only on sender side: Name of Rte_LdComCbkTxConfirmation callback function to be called.
        function name LdComTxCopyTxData [0..1]: set at post-build in variant post-build-selectable / pre-compile in variant pre-compile+post-build-loadable, origin=Vector Informatik  # Only on sender side: Name of Rte_LdComCbkCopyTxData callback function to be called.
        function name LdComTpTxConfirmation [0..1]: set at post-build in variant post-build-selectable / pre-compile in variant pre-compile+post-build-loadable, origin=Vector Informatik  # Only on sender side: Name of Rte_LdComCbkTpTxConfirmation callback function to be called.
        foreign reference LdComSystemTemplateSignalRef: set at post-build in variant post-build-loadable+post-build-selectable / pre-compile in variant pre-compile, origin=Vector Informatik, destination-type=I-SIGNAL-TO-I-PDU-MAPPING  # Reference to the ISignalToIPduMapping that contains a reference to the ISignal (System Template) which this LdCom signal represents.
        reference LdComPduRef: set at post-build in variant post-build-loadable+post-build-selectable / pre-compile in variant pre-compile, origin=Vector Informatik, destination=Pdu  # Reference to the global PDU.
  module config LdCom_Pre: definition=LdCom
  module config LdCom_Rec: definition=LdCom
