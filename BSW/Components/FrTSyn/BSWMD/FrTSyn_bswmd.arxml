AUTOSAR XML (schema 4-3-1)
package /MICROSAR
  module definition FrTSyn [0..1]: category=VENDOR_SPECIFIC_MODULE_DEFINITION, refined-module-def=FrTSyn, variants pre-compile  # The FlexRay Time Synchronization module (FrTSyn) handles the distribution of time information over FlexRay buses. #TimeSync #FR #FlexRay #AUTOSAR
    container FrTSynGeneral: multiplicity set at pre-compile  # This container holds the general parameters of the Flexray-specific Synchronized Time-base Manager
      boolean FrTSynDevErrorDetect: multiplicity set at pre-compile, set at pre-compile, default-value=true  # Switches the development error detection and notification on or off. | * true: detection and notification is enabled. * false: detection and notification is disabled.
      float FrTSynMainFunctionPeriod: 0..1, multiplicity set at pre-compile, set at pre-compile, default-value=0.005  # Schedule period of the main function FrTSyn_MainFunction.
      boolean FrTSynVersionInfoApi: multiplicity set at pre-compile, set at pre-compile, default-value=false  # Activate/Deactivate the version information API (FrTSyn_GetVersionInfo). True: version information API activated False: version information API deactivated.
      enumeration FrTSynMessageCompatibility: multiplicity set at pre-compile, origin=Vector Informatik, set at pre-compile, default-value=AR_4_3_X  # Switch between different message types. AR_4_2_X: Use message type as specified in Autosar 4.2.2 and below. AR_4_3_X: Use message type as specified in Autosar 4.3.0 and above.
        AR_4_2_X  # 4.2.x
        AR_4_3_X  # 4.3.x
      boolean FrTSynSafeBswChecks: multiplicity set at pre-compile, origin=Vector Informatik, set at pre-compile, default-value=false  # Selects if safety checks are used. These checks improve robustness as e.g. invalid parameters are checked before function is executed. This attribute has to be enabled for safety projects where this component is mapped to an ASIL partition.
    container FrTSynGlobalTimeDomain [1..*]: multiplicity set at pre-compile  # This represents the existence of a global time domain on Flexray. The FrTSyn module can administrate several global time domains at the same time that in itself form a hierarchy of domains and sub-domains. | If the FrTSyn exists it is assumed that at least one global time domain exists.
      integer FrTSynGlobalTimeDomainId: 0..31, multiplicity set at pre-compile, set at pre-compile, default-value=0  # The global time domain ID.
      symbolic name reference FrTSynSynchronizedTimeBaseRef: multiplicity set at pre-compile, set at pre-compile, requires-symbolic-name-value=true, destination=StbMSynchronizedTimeBase  # Mandatory reference to the required synchronized time-base.
      container FrTSynGlobalTimeMaster [0..*]: multiplicity set at pre-compile, post-build-variant-multiplicity=true  # Configuration of the global time master. Each global time domain is required to have exactly one global time master. This master may or may not exist on the configured ECU.
        float FrTSynCyclicMsgResumeTime [0..1]: 0..4294967, multiplicity set at pre-compile, post-build-variant-value=true, set at pre-compile, default-value=0.005  # Defines the time where the 1st regular cycle time based message transmission takes place, after an immediate transmission before.
        float FrTSynGlobalTimeDebounceTime: 0..4294967, multiplicity set at pre-compile, post-build-variant-value=true, set at pre-compile, default-value=0.005  # This represents the configuration of a TX debounce time for SYNC and OFS messages compared to a message before with the same PDU.
        enumeration FrTSynGlobalTimeTxCrcSecured: {CRC_NOT_SUPPORTED, CRC_SUPPORTED}, multiplicity set at pre-compile, post-build-variant-value=true, set at pre-compile, default-value=CRC_NOT_SUPPORTED  # This represents the configuration of whether or not CRC is supported.
        float FrTSynGlobalTimeTxPeriod: 0..4294967, multiplicity set at pre-compile, post-build-variant-value=true, set at pre-compile, default-value=0.005  # This represents the TX period.
        boolean FrTSynImmediateTimeSync: multiplicity set at pre-compile, post-build-variant-value=true, set at pre-compile, default-value=false  # Enables/Disables the cyclic polling of StbM_GetTimeBaseUpdateCounter() within FrTSyn_MainFunction().
        float FrTSynMasterTriggerTransmitTimeout: 0..4294967, multiplicity set at pre-compile, origin=Vector Informatik, post-build-variant-value=true, set at pre-compile, default-value=1  # This represents the trigger transmit timeout after transmission of a message.
        container FrTSynGlobalTimeMasterPdu: multiplicity set at pre-compile  # This container carries all properties required to configure the PDU sent by the global time master for the given global time domain.
          integer FrTSynGlobalTimeMasterHandleId: 0..65535, multiplicity set at pre-compile, post-build-variant-value=true, set at pre-compile, symbolic-name-value=true, default-value=0  # This represents the handle ID of the PDU that contains the global time information.
          reference FrTSynGlobalTimePduRef: multiplicity set at pre-compile, post-build-variant-value=true, set at pre-compile, destination=Pdu  # This represents the reference to the Pdu taken to transmit the global time information. The global time master of a global time domain acts as the sender of the Pdu while all the time slaves are supposed to receive the Pdu.
      container FrTSynGlobalTimeOfsDataIDList [0..1]: multiplicity set at pre-compile, post-build-variant-multiplicity=true  # The DataIDList for OFS messages ensures the identification of data elements due to CRC calculation process.
        container FrTSynGlobalTimeOfsDataIDListElement [16..16]: multiplicity set at pre-compile  # Element of the DataIDList for OFS messages ensures the identification of data elements due to CRC calculation process.
          integer FrTSynGlobalTimeOfsDataIDListIndex: 0..15, multiplicity set at pre-compile, post-build-variant-value=true, set at pre-compile, default-value=0  # Index of the DataIDList for OFS messages ensures the identification of data elements due to CRC calculation process.
          integer FrTSynGlobalTimeOfsDataIDListValue: 0..255, multiplicity set at pre-compile, post-build-variant-value=true, set at pre-compile, default-value=0  # Value of the DataIDList for OFS messages ensures the identification of data elements due to CRC calculation process.
      container FrTSynGlobalTimeSlave [0..1]: multiplicity set at pre-compile, post-build-variant-multiplicity=true  # This represents the time slave for the enclosing global time domain.
        integer FrTSynGlobalTimeSequenceCounterJumpWidth: 1..15, multiplicity set at pre-compile, post-build-variant-value=true, set at pre-compile, default-value=1  # The SequenceCounterJumpWidth specifies the maximum allowed gap of the Sequence Counter between two SYNC resp. two OFS messages.
        enumeration FrTSynRxCrcValidated: {CRC_IGNORED, CRC_NOT_VALIDATED, CRC_OPTIONAL, CRC_VALIDATED}, multiplicity set at pre-compile, post-build-variant-value=true, set at pre-compile, default-value=CRC_IGNORED  # This parameter controls whether or not CRC validation shall be supported.
        container FrTSynGlobalTimeSlavePdu: multiplicity set at pre-compile  # This container carries all properties required to configure the PDU received by the time slave for the given global time domain.
          integer FrTSynGlobalTimeSlaveHandleId: 0..65535, multiplicity set at pre-compile, post-build-variant-value=true, set at pre-compile, symbolic-name-value=true, default-value=0  # This represents the handle ID of the PDU that contains the global time information.
          reference FrTSynGlobalTimePduRef: multiplicity set at pre-compile, post-build-variant-value=true, set at pre-compile, destination=Pdu  # This represents the reference to the Pdu taken to transmit the global time information. The global time master of a global time domain acts as the sender of the Pdu while all the time slaves are supposed to receive the Pdu.
      container FrTSynGlobalTimeSyncDataIDList [0..1]: multiplicity set at pre-compile, post-build-variant-multiplicity=true  # The DataIDList for SYNC messages ensures the identification of data elements due to CRC calculation process.
        container FrTSynGlobalTimeSyncDataIDListElement [16..16]: multiplicity set at pre-compile  # Element of the DataIDList for SYNC messages ensures the identification of data elements due to CRC calculation process.
          integer FrTSynGlobalTimeSyncDataIDListIndex: 0..15, multiplicity set at pre-compile, post-build-variant-value=true, set at pre-compile, default-value=0  # Index of the DataIDList for SYNC messages ensures the identification of data elements due to CRC calculation process.
          integer FrTSynGlobalTimeSyncDataIDListValue: 0..255, multiplicity set at pre-compile, post-build-variant-value=true, set at pre-compile, default-value=0  # Value of the DataIDList for SYNC messages ensures the identification of data elements due to CRC calculation process.
  bsw implementation FrTSyn_Impl: programming-language=C, sw-version=6.03.00, used-code-generator=DaVinci Configurator, vendor-id=30, ar-release-version=4.04.00, behavior=FrTSynBehavior, preconfigured-configuration=FrTSyn_Pre, recommended-configuration=FrTSyn_Rec, vendor-specific-module-def=FrTSyn
  module config FrTSyn_Pre: definition=FrTSyn
  module config FrTSyn_Rec: definition=FrTSyn
