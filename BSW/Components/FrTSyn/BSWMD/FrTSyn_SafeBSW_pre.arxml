AUTOSAR XML (schema 4-3-1)
package /MICROSAR
  module config FrTSyn_Rec: definition=FrTSyn
    FrTSynGeneral: FrTSynSafeBswChecks=1
