AUTOSAR XML (schema 4-0-3)
# COPYRIGHT
# Copyright (c) 2023 by Vector Informatik GmbH. All rights reserved.
# This software is copyright protected and proprietary to Vector Informatik GmbH.
# Vector Informatik GmbH grants to you only those rights as set out in the license conditions.
package /MICROSAR/Crypto_30_vHsm
  bsw implementation Crypto_Impl: programming-language=C, sw-version=4.00.01, used-code-generator=DaVinci Configurator, vendor-id=30, ar-release-version=4.03.01, behavior=Crypto_30_vHsm, preconfigured-configuration=Crypto_Pre, recommended-configuration=Crypto_Rec, vendor-api-infix=vHsm, vendor-specific-module-def=Crypto
  module definition Crypto [0..1]: category=VENDOR_SPECIFIC_MODULE_DEFINITION, refined-module-def=Crypto, variants pre-compile  # Vector Crypto Driver for the MICROSAR vHSM. The Crypto Driver (CRYPTO) is called by the Crypto Interface (CRYIF) and forwards the specific cryptographic operations to the MICROSAR vHSM side. The Crypto Driver interfaces are specificed by AUTOSAR. This software-based Crypto Driver offers algorithms and features depending on the configuration of MICROSAR vHSM. #Security #Crypto #Cryptography #HSM #AUTOSAR
    container CryptoDriverObjects  # Container for Crypto Driver Objects
      container CryptoDriverObject [1..*]  # Container for configuration of Crypto Driver Object. The container name serves as a symbolic name for the identifier of a Crypto Driver Object.
        integer CryptoDriverObjectId: 0..4294967295, set at pre-compile, symbolic-name-value=true, default-value=0  # Identifier of the Crypto Driver Object. The Crypto Driver Object offers different crypto primitives.
        integer CryptoDriverObjectQueueSize: 1..1, set at pre-compile, default-value=1  # Size of the queue in the Crypto Driver. Defines the maximum number of jobs in the Crypto Driver Object queue. If it is set to 0, queueing is disabled in the Crypto Driver Object. This Crypto Driver does not support queuing but uses the buffer for asynchronous processing.
        integer CryptoBufferSize: 0..4294967294, set at pre-compile, origin=Vector Informatik, default-value=128  # Size of the buffer allocated in the global RAM for this driver object. This buffer stores all the input and output data, which is not directly accessible by the vHsm, of the to be processed job. If Memory is accessible or not is defined by the CryptoMemoryArea configuration, e.g. RAM accessible by local CPU only or protected by MPU. Attention: The buffer may contain the data of up to 5 pointers. For better performance, the driver inserts padding bytes between the different data to ensure aligned access for vHsm. Therefore, the needed buffer size could be greater than the total size of the buffered data. To avoid unnecessary big buffers and the time to copy the data, consider providing the data directly from code flash or global RAM. The buffer can also be configured to 0 to avoid unecessary pointer checks against the whitelist of the driver (the vHsm firmware will still check the pointers). Pay attention that all input and output needs to be mapped correctly in this case as the driver will not take care about copying the data to and from memory which can be accessed by the vHsm firmware. For SafeBsw it is also no possible to use a buffersize of 0.
        reference CryptoPrimitiveRef [1..*]: set at pre-compile, destination=CryptoPrimitive  # Refers to primitive in the CRYPTO. The CryptoPrimitive is a pre-configured container of the crypto service that shall be used.
        reference CryptoDriverObjectEcucPartitionRef [0..1]: set at pre-compile, destination=EcucPartition  # Maps a crypto driver object to zero or one ECUC partition. The ECUC partition referenced is a subset of the ECUC partitions where the Crypto driver is mapped to.
        container CryptovHsmBuffer [0..1]  # Use /MICROSAR/Crypto_30_vHsm/Crypto/CryptoDriverObjects/CryptoDriverObject/CryptoBufferSize instead. This parameter summarizes all buffers included in this container. Container to specify the size of the buffers for each parameter which will be used when the pointer points to invalid memory e.g. local RAM.
          integer CryptoInputBufferSize [0..1]: 0..4294967294, set at pre-compile, origin=Vector Informatik, default-value=0  # Parameter is deprecated and not used anymore. Only available for backward compatibility. Use /MICROSAR/Crypto_30_vHsm/Crypto/CryptoDriverObjects/CryptoDriverObject/CryptoBufferSize instead. Size of the buffer on the global RAM to store the input data which is provided from the local RAM.
          integer CryptoSecondaryInputBufferSize [0..1]: 0..4294967294, set at pre-compile, origin=Vector Informatik, default-value=0  # Parameter is deprecated and not used anymore. Only available for backward compatibility. Use /MICROSAR/Crypto_30_vHsm/Crypto/CryptoDriverObjects/CryptoDriverObject/CryptoBufferSize instead. Size of the buffer on the global RAM to store the secondary input data which is provided from the local RAM.
          integer CryptoTertiaryInputBufferSize [0..1]: 0..4294967294, set at pre-compile, origin=Vector Informatik, default-value=0  # Parameter is deprecated and not used anymore. Only available for backward compatibility. Use /MICROSAR/Crypto_30_vHsm/Crypto/CryptoDriverObjects/CryptoDriverObject/CryptoBufferSize instead. Size of the buffer on the global RAM to store the tertiary input data which is provided from the local RAM.
          integer CryptoOutputBufferSize [0..1]: 0..4294967294, set at pre-compile, origin=Vector Informatik, default-value=0  # Parameter is deprecated and not used anymore. Only available for backward compatibility. Use /MICROSAR/Crypto_30_vHsm/Crypto/CryptoDriverObjects/CryptoDriverObject/CryptoBufferSize instead. Size of the buffer on the global RAM to store the output data which will be written to the local RAM.
          integer CryptoSecondaryOutputBufferSize [0..1]: 0..4294967294, set at pre-compile, origin=Vector Informatik, default-value=0  # Parameter is deprecated and not used anymore. Only available for backward compatibility. Use /MICROSAR/Crypto_30_vHsm/Crypto/CryptoDriverObjects/CryptoDriverObject/CryptoBufferSize instead. Size of the buffer on the global RAM to store the secondary output data which will be written to the local RAM.
    container CryptoGeneral  # Container for common configuration options.
      boolean CryptoDevErrorDetect: set at pre-compile, default-value=true  # Switches the development error detection and notification on or off. - True: detection and notification is enabled. - False: detection and notification is disabled. | True: Development error detection enabled. False: Development error detection disabled
      boolean CryptoVersionInfoApi: set at pre-compile, default-value=false  # Pre-processor switch to enable and disable availability of the API Crypto_GetVersionInfo(). - True: API Crypto_GetVersionInfo() is available - False: API Crypto_GetVersionInfo() is not available.
      float CryptoMainFunctionPeriod: 0..3600, set at pre-compile, default-value=0.01  # Specifies the period of main function Crypto_MainFunction in seconds.
      string CryptoUserConfigFile [0..1]: set at pre-compile, origin=Vector Informatik  # Reference to an external user configuration file that will be included during generation. The content of the user configuration file will be added at the end of the generated module configuration file and allows altering or extending the generated code.
      boolean CryptoSafeBswChecks: set at pre-compile, origin=Vector Informatik, default-value=false  # Selects if safety checks are used. These checks improve robustness as e.g. invalid parameters are checked before function is executed. This attribute has to be enabled for safety projects where this component is mapped to an ASIL partition.
      boolean CryptoMultiPartitionRuntimeChecks: set at pre-compile, origin=Vector Informatik, default-value=false  # If enabled, additional checks are performed to prevent the usage of driver objects by wrong partitions.
      boolean CryptoTimeoutCallout: set at pre-compile, origin=Vector Informatik, default-value=false  # If this parameter is set to true, the following callout functions get called at each loop where the driver has to wait for the HSM core: Crypto_30_vHsm_TimeoutDetect_Start_Callout, Crypto_30_vHsm_TimeoutDetect_Loop_Callout, Crypto_30_vHsm_TimeoutDetect_End_Callout These callouts can be used to detect violations of freedom from interference with respect to timing of the loops. See the Technical Reference of this module for more information. If this parameter is set to false, the mentioned callout functions never get called.
      reference CryptoEcucPartitionRef [0..*]: set at pre-compile, destination=EcucPartition  # Maps the Crypto driver to zero or multiple ECUC partitions to make the modules API available in this partition. The module will operate as an independent instance in each of the partitions.
    container CryptoKeyElements [0..1]  # Container for CRYPTO key elements
      container CryptoKeyElement [1..*]  # Configuration of a CryptoKeyElement
        integer CryptoKeyElementId: 0..4294967295, set at pre-compile, symbolic-name-value=true, default-value=0  # Identifier of the CRYPTO key element
        integer CryptoKeyElementSize: 1..4294967295, set at pre-compile, default-value=16  # Maximum size of a CRYPTO key element in bytes
        string CryptoKeyElementInitValue [0..1]: set at pre-compile, default-value=0 0 0 0 0 0 0 0 0 0 0 0 0 0 0 0  # Value which will be used to fill the element during initialization, when the element is not already initialized.
        enumeration CryptoKeyElementReadAccess: {RA_ALLOWED, RA_DENIED, RA_ENCRYPTED, RA_INTERNAL_COPY}, set at pre-compile, default-value=RA_ALLOWED  # Define the reading access rights of the key element. CRYPTO_RA_DENIED = key element cannot be read from outside the Crypto Driver CRYPTO_RA INTERNAL_COPY = key element can be copied to another key element in the same crypto driver. CRYPTO_RA_ALLOWED = key element can be read as plaintext CRYPTO_RA_ENCRYPTED = key element can be read encrypted. E.g. SHE Ram- Key export.
        boolean CryptoKeyElementAllowPartialAccess: set at pre-compile, default-value=false  # Enable or disable writing and reading the key element with data smaller than the size of the element. - True: enable partial access of the key element - False: disable partial access of the key element
        boolean CryptoKeyElementPersist: set at pre-compile, default-value=false  # Enable or disable persisting of the key element in non-volatile storage. - True: enable persisting of the key element. - False: disable persisting of the key element.
        enumeration CryptoKeyElementWriteAccess: {WA_ALLOWED, WA_DENIED, WA_ENCRYPTED, WA_INTERNAL_COPY}, set at pre-compile, default-value=WA_ALLOWED  # Define the writing access rights of the key element CRYPTO_WA_DENIED = key element cannot be written from outside the Crypto Driver CRYPTO_WA INTERNAL_COPY = key element can be filled with another key element in the same crypto driver. CRYPTO_WA_ALLOWED = key element can be rewritten as plaintext CRYPTO_WA_ENCRYPTED = key element can be written encrypted. E.g. SHE load key.
        reference CryptoKeyElementVirtualTargetRef [0..1]: set at pre-compile, destination=CryptoKeyElement  # Refers to a key element which will contain the actual data. If the Reference is configured, the key element will be a virtual key element.
    container CryptoKeyTypes [0..1]  # Container for CRYPTO key types
      container CryptoKeyType [1..*]  # Configuration of a CryptoKeyType
        reference CryptoKeyElementRef [1..*]: set at pre-compile, destination=CryptoKeyElement  # Refers to a pointer in the CRYPTOCrypto Key Element, which holds the data of the crypto key element.
    container CryptoKeys [0..1]  # Container for CRYPTO keys
      container CryptoKey [1..*]  # Configuration of a CryptoKey
        integer CryptoKeyId: 0..4294967295, set at pre-compile, symbolic-name-value=true, default-value=0  # Identifier of the CRYPTO key
        integer CryptoKeyDeriveIterations: 1..4294967295, set at pre-compile, default-value=1  # Holds the number of iterations to be performed by the key derivation primitive
        reference CryptoKeyTypeRef: set at pre-compile, destination=CryptoKeyType  # Refers to a pointer in the CRYPTO to a CryptoKeyType. The CryptoKeyType provides the information which key elements are contained in a CryptoKey.
    container CryptoPrimitives [0..1]  # Container for CRYPTO primitives
      container CryptoPrimitive [0..*]  # Configuration of a CryptoPrimitive
        enumeration CryptoPrimitiveAlgorithmFamily [1..*]: {CRYPTO_ALGOFAM_NOT_SET, CRYPTO_ALGOFAM_SHA1, CRYPTO_ALGOFAM_SHA2_224, CRYPTO_ALGOFAM_SHA2_256, CRYPTO_ALGOFAM_SHA2_384, CRYPTO_ALGOFAM_SHA2_512, CRYPTO_ALGOFAM_SHA2_512_224, CRYPTO_ALGOFAM_SHA2_512_256, CRYPTO_ALGOFAM_SHA3_224, CRYPTO_ALGOFAM_SHA3_256, CRYPTO_ALGOFAM_SHA3_384, CRYPTO_ALGOFAM_SHA3_512, CRYPTO_ALGOFAM_SHAKE128, CRYPTO_ALGOFAM_SHAKE256, CRYPTO_ALGOFAM_RIPEMD160, CRYPTO_ALGOFAM_BLAKE_1_256, CRYPTO_ALGOFAM_BLAKE_1_512, CRYPTO_ALGOFAM_BLAKE_2s_256, CRYPTO_ALGOFAM_BLAKE_2s_512, CRYPTO_ALGOFAM_3DES, CRYPTO_ALGOFAM_AES, CRYPTO_ALGOFAM_CHACHA, CRYPTO_ALGOFAM_RSA, CRYPTO_ALGOFAM_ED25519, CRYPTO_ALGOFAM_BRAINPOOL, CRYPTO_ALGOFAM_ECCNIST, CRYPTO_ALGOFAM_SECURECOUNTER, CRYPTO_ALGOFAM_RNG, CRYPTO_ALGOFAM_SIPHASH, CRYPTO_ALGOFAM_ECIES, CRYPTO_ALGOFAM_CUSTOM, CRYPTO_ALGOFAM_CUSTOM_ECCANSI, CRYPTO_ALGOFAM_CUSTOM_DRBG, CRYPTO_ALGOFAM_CUSTOM_FIPS186, CRYPTO_ALGOFAM_CUSTOM_ECCSEC, CRYPTO_ALGOFAM_CUSTOM_VHSM_SECURE_BOOT, CRYPTO_ALGOFAM_CUSTOM_VHSM_SOFTWARE_DOWNLOAD, CRYPTO_ALGOFAM_CUSTOM_VHSM_FIRMWARE_UPDATE}, set at pre-compile, default-value=CRYPTO_ALGOFAM_NOT_SET  # Determines the algorithm family used for the crypto service.
        enumeration CryptoPrimitiveAlgorithmMode [1..*]: {CRYPTO_ALGOMODE_NOT_SET, CRYPTO_ALGOMODE_ECB, CRYPTO_ALGOMODE_CBC, CRYPTO_ALGOMODE_CFB, CRYPTO_ALGOMODE_OFB, CRYPTO_ALGOMODE_CTR, CRYPTO_ALGOMODE_GCM, CRYPTO_ALGOMODE_XTS, CRYPTO_ALGOMODE_RSAES_OAEP, CRYPTO_ALGOMODE_RSAES_PKCS1_v1_5, CRYPTO_ALGOMODE_RSASSA_PSS, CRYPTO_ALGOMODE_RSASSA_PKCS1_v1_5, CRYPTO_ALGOMODE_8ROUNDS, CRYPTO_ALGOMODE_12ROUNDS, CRYPTO_ALGOMODE_20ROUNDS, CRYPTO_ALGOMODE_HMAC, CRYPTO_ALGOMODE_CMAC, CRYPTO_ALGOMODE_GMAC, CRYPTO_ALGOMODE_CTRDRBG, CRYPTO_ALGOMODE_SIPHASH_2_4, CRYPTO_ALGOMODE_SIPHASH_4_8, CRYPTO_ALGOMODE_CUSTOM, CRYPTO_ALGOMODE_CUSTOM_P256R1, CRYPTO_ALGOMODE_CUSTOM_RSASSA_PKCS1_v1_5_CRT, CRYPTO_ALGOMODE_CUSTOM_USE_DF, CRYPTO_ALGOMODE_CUSTOM_P384R1}, set at pre-compile, default-value=CRYPTO_ALGOMODE_NOT_SET  # Determines the algorithm mode used for the crypto service
        enumeration CryptoPrimitiveService [1..*]: {CRYPTO_MAC_VERIFY, CRYPTO_MAC_GENERATE, CRYPTO_SIGNATURE_VERIFY, CRYPTO_SIGNATURE_GENERATE, CRYPTO_ENCRYPT, CRYPTO_DECRYPT, CRYPTO_AEADENCRYPT, CRYPTO_AEADDECRYPT, CRYPTO_HASH, CRYPTO_RANDOM, CRYPTO_KEY_SET_VALID, CRYPTO_RANDOM_SEED, CRYPTO_KEY_GENERATE, CRYPTO_KEY_DERIVE, CRYPTO_KEY_EXCHANGE_CALC_PUBVAL, CRYPTO_KEY_EXCHANGE_CALC_SECRET, CRYPTO_CERIFICATE_PARSE, CRYPTO_CERTIFICATE_VERIFY}, set at pre-compile, default-value=CRYPTO_MAC_VERIFY  # Determines the crypto service used for defining the capabilities
        enumeration CryptoPrimitiveAlgorithmSecondaryFamily [1..*]: {CRYPTO_ALGOFAM_NOT_SET, CRYPTO_ALGOFAM_SHA1, CRYPTO_ALGOFAM_SHA2_224, CRYPTO_ALGOFAM_SHA2_256, CRYPTO_ALGOFAM_SHA2_384, CRYPTO_ALGOFAM_SHA2_512, CRYPTO_ALGOFAM_SHA2_512_224, CRYPTO_ALGOFAM_SHA2_512_256, CRYPTO_ALGOFAM_SHA3_224, CRYPTO_ALGOFAM_SHA3_256, CRYPTO_ALGOFAM_SHA3_384, CRYPTO_ALGOFAM_SHA3_512, CRYPTO_ALGOFAM_SHAKE128, CRYPTO_ALGOFAM_SHAKE256, CRYPTO_ALGOFAM_RIPEMD160, CRYPTO_ALGOFAM_BLAKE_1_256, CRYPTO_ALGOFAM_BLAKE_1_512, CRYPTO_ALGOFAM_BLAKE_2s_256, CRYPTO_ALGOFAM_BLAKE_2s_512, CRYPTO_ALGOFAM_3DES, CRYPTO_ALGOFAM_AES, CRYPTO_ALGOFAM_CHACHA, CRYPTO_ALGOFAM_RSA, CRYPTO_ALGOFAM_ED25519, CRYPTO_ALGOFAM_BRAINPOOL, CRYPTO_ALGOFAM_ECCNIST, CRYPTO_ALGOFAM_SECURECOUNTER, CRYPTO_ALGOFAM_RNG, CRYPTO_ALGOFAM_SIPHASH, CRYPTO_ALGOFAM_ECIES, CRYPTO_ALGOFAM_CUSTOM, CRYPTO_ALGOFAM_CUSTOM_PADDING_PKCS7}, set at pre-compile, default-value=CRYPTO_ALGOFAM_NOT_SET  # Determines the algorithm secondary family used for the crypto service
        boolean CryptoPrimitiveSupportContext [0..1]: set at pre-compile, default-value=false  # Configures if the crypto primitive supports to store or restore context data of the workspace. Since this option is vulnerable to security, it shall only set to TRUE if absolutely needed.
        reference CryptoPrimitiveAlgorithmFamilyCustomRef [0..*]: set at pre-compile, origin=Vector Informatik, destination=CryptoPrimitiveAlgorithmFamilyCustom  # Reference to a customer specific algorithm family custom container
        reference CryptoPrimitiveAlgorithmModeCustomRef [0..*]: set at pre-compile, origin=Vector Informatik, destination=CryptoPrimitiveAlgorithmModeCustom  # Reference to a customer specific algorithm mode custom container
        reference CryptoPrimitiveAlgorithmSecondaryFamilyCustomRef [0..*]: set at pre-compile, origin=Vector Informatik, destination=CryptoPrimitiveAlgorithmFamilyCustom  # Reference to a customer specific algorithm family custom container
      container CryptoPrimitiveAlgorithmFamilyCustom [0..*]  # Container of custom algorithm family values. The container name serves as a symbolic name for the identifier of the custom algorithm family type.
        integer CryptoPrimitiveAlgorithmFamilyCustomId: 128..254, set at pre-compile, origin=Vector Informatik, symbolic-name-value=true, default-value=128  # The custom value of this algorithm family
      container CryptoPrimitiveAlgorithmModeCustom [0..*]  # Container of custom algorithm mode values. The container name serves as a symbolic name for the identifier of the custom algorithm mode type.
        integer CryptoPrimitiveAlgorithmModeCustomId: 128..254, set at pre-compile, origin=Vector Informatik, symbolic-name-value=true, default-value=128  # The custom value of this algorithm mode
    container CryptovHsm  # Basic configuration of the vHsm Driver
      boolean CryptoKeyElementDeleteSupport: set at pre-compile, origin=Vector Informatik, default-value=true  # If this option is enabled, it disables a DET check which checks if the keyLength and keyPtr is not zero. (This check is part of the AUTOSAR Specification.)
      boolean CryptoInterruptMode: set at pre-compile, origin=Vector Informatik, default-value=true  # If the interrupt mode is enabled, the vHsm will inform the application core about a finished job with the help of an interrupt. The interrupt will then call the CryIf callback from the interrupt context in case of an async job. If the interrupt mode is disabled, the driver will poll the IPC for finished jobs. - For async jobs, this will be done in the main function. Also the callback will be called from the main function. - For sync jobs, this will be done in the waiting loop during the job.
      integer CryptoIpcChannels: 1..255, set at pre-compile, origin=Vector Informatik, default-value=4  # Number of IPC channels used to communicate with the vHsm
      integer CryptoIpcProtocolVersion: 2..3, set at pre-compile, origin=Vector Informatik, default-value=3  # Protocol version used to communicate with the vHsm Firmware over IPC. The used protocol version must be the same on both the driver and vHsm Firmware. Info: IPC Protocol Version 2 is deprecated and will be removed in future versions.
      function name CryptoWaitLoopCallout [0..1]: set at pre-compile, origin=Vector Informatik, default-value=Appl_Crypto_30_vHsm_WaitLoopCallout  # Callout which is called while waiting for responses from the vHsm.
      string CryptoHsmUserRevision [0..1]: set at pre-compile, origin=Vector Informatik, default-value=0, max-length=255, min-length=1  # This parameter is always updated with the one located in the generated vHSM pre configuration file. Attention: This parameter is freely configurable in the vHSM (/MICROSAR/vHsm/vHsmGeneral/vHsmUserRevision) and changes only if was manually adapted in vHSM config. Use this to make sure that application and HSM on the same revision.
      boolean CryptoRedirection: set at pre-compile, origin=Vector Informatik, default-value=false  # Enable job input/output redirection to key elements. This is a Autosar 4.4 feature. Therefore a Csm and CryIf is required which also needs to support this feature
      boolean CryptoIpcMacJobOptimization: set at pre-compile, origin=Vector Informatik, default-value=true  # During MAC Verification only inputPtr, secondaryInputPtr and verifyPtr are needed. During MAC Generation only inputPtr and outputPtr are needed. This optimization reduces the transmission of mac jobs to this pointers. This will lead to a faster processing of the MAC because unnecessary checks for validity can be omitted. This feature may only be enabled if vHsm support this feature as well. This is true for vHsm starting from version 02.01.00 (R22)
      integer CryptoDetInstanceMask: 0..255, set at pre-compile, origin=Vector Informatik, default-value=0  # Det errors originating from the vHsm can be distinguished from det errors of the application cores by OR-ing the mask with instanceId before passing the received Det to Det_ErrorReport() on the application core.
      boolean CryptoKeyDeriveJobSupport: set at pre-compile, origin=Vector Informatik, default-value=true  # Enables support for KeyDerive operations processed as jobs. This needs to be supported by both the HSM and Csm.
      integer CryptoHost2HsmAddress: 0..4294967295, set at pre-compile, origin=Vector Informatik, default-value=0  # Host2Hsm Address | Address of the register which is used to communicate from Host to the HSM core
      integer CryptoHsm2HostAddress: 0..4294967295, set at pre-compile, origin=Vector Informatik, default-value=0  # Hsm2Host Address | Address of the register which is used to communicate from Hsm to the Host core
      integer CryptoIpcInstanceId: 0..255, set at pre-compile, origin=Vector Informatik, default-value=0  # Id of the Ipc instance inside the Hsm
      boolean CryptoIpcInitialization: set at pre-compile, origin=Vector Informatik, default-value=true  # If enabled, the driver will initialize the IPC memory and notify the vHsm firmware about the now usable IPC memory via the HOST2HSM interface
      symbolic name reference CryptoManagementDriverObject [1..*]: set at pre-compile, origin=Vector Informatik, destination=CryptoDriverObject  # This driver object will be used for the Key management Functions. The buffers of the referenced driver objects must be set to values sufficient for proper operation. The driver object is used as transport medium for the communication with the vHsm. Input data of Key functions will be handled as InputPtr Output data of Key functions will be handled as OutputPtr When multiple Key API calls need to be performed at the same time, multiple driver objects need to be referenced here. During runtime the first free driver object of the references will be used. To enable Key APIs to be processed on all driver objects, all referenced driver objects need to have the same buffer size configured. Hint: HSM Configuration: There is only one vHsm_KeyM driver object in the HSM for the key management API. As this driver object can already process parallel key requests, there is no need to create a further driver object. To provide multiple driver object to the driver on application side where key API calls can be transmitted, create an additional CryIfChannel inside the vHsm and reference the already existing vHsm_KeyM driver object. So multiple CryIfChannels will reference the same driver object vHsm_KeyM. Furthermore make the new CryIfChannel available in the IPC under /MICROSAR/vHsm/vHsmIpc/vHsmIpcInstance/vHsmDriverObjectMapping. The sync mechanism will make the new CryIfChannel visible as driver object in the Driver after the vHsm has been generated. Driver Configuration: Reference the new available driver object as additional management driver object. Now the number of referenced driver objects will be the number of possible parallel key management API calls.
      container CryptoMemoryArea [0..*]  # White list of memory areas used as input and output for crypto jobs or key management operations. The areas from the whitelist of the vHsm configuration can be used also in the driver.
        integer CryptoAreaStart: 0..4294967295, set at pre-compile, origin=Vector Informatik, default-value=0  # Start address of the memory area
        integer CryptoAreaStop: 0..4294967295, set at pre-compile, origin=Vector Informatik, default-value=4294967295  # End address of the memory area
        enumeration CryptoAreaType: {CRYPTO_AREA_HSM_READ_ACCESS, CRYPTO_AREA_HSM_READWRITE_ACCESS}, set at pre-compile, origin=Vector Informatik, default-value=CRYPTO_AREA_HSM_READ_ACCESS  # Type of the memory area as seen from the vHsm.
        integer CryptoAreaPriority: 0..4294967295, set at pre-compile, origin=Vector Informatik, default-value=0  # The priority of the memory area. The higher the value, the higher the areas priority. The area with the highest priority will be checked first. To get the best performance assign a high priority to areas which are used very often.
        boolean CryptoAreaEnabled: set at pre-compile, origin=Vector Informatik, default-value=true  # Memory areas can be disabled if needed. This can be used in the Safe Use-Case, when it is not allowed to have an enabled READWRITE area.
      container CryptoJobResponseInterrupt [1..*]  # Configures settings for receiving an interrupt from the hsm
        integer CryptoJobResponseInterruptFlagClearAddress: 0..4294967295, set at pre-compile, origin=Vector Informatik, default-value=0  # Address of the register which is used to clear the interrupt request flag
        integer CryptoJobResponseInterruptFlagClearMask: 0..4294967295, set at pre-compile, origin=Vector Informatik, default-value=1  # Mask which is used to set the value
        integer CryptoJobResponseInterruptFlagClearValue: 0..1, set at pre-compile, origin=Vector Informatik, default-value=1  # Value which will be set to the masked register
        boolean CryptoJobResponseInterruptFlagClearing: set at pre-compile, origin=Vector Informatik, default-value=true  # Clearing the flag is only needed when the OS does not clear the interrupt flag automatically.
        enumeration CryptoJobResponseInterruptFlagClearHandling: {CRYPTO_CLEAR_INCLUSIVE_OR_ASSIGNMENT, CRYPTO_CLEAR_INCLUSIVE_AND_NOT_ASSIGNMENT, CRYPTO_CLEAR_ONLY_READ, CRYPTO_CLEAR_CALLOUT}, set at pre-compile, origin=Vector Informatik, default-value=CRYPTO_CLEAR_INCLUSIVE_OR_ASSIGNMENT  # Configures the way, how the interrupt flag is cleared. On different platforms a different access to e.g. registers is needed. Below is the corresponding code to each option which will be generated when clearing a flag: CRYPTO_CLEAR_INCLUSIVE_OR_ASSIGNMENT -&gt; *ClearAddress |= mask CRYPTO_CLEAR_INCLUSIVE_AND_NOT_ASSIGNMENT -&gt; *ClearAddress &= ~mask CRYPTO_CLEAR_ONLY_READ -&gt; dummyVar = *ClearAddress CRYPTO_CLEAR_CALLOUT -&gt; call of Crypto_30_vHsm_ResponseInterruptClear_Callout()
      container CryptoJobRequestInterrupt [1..*]  # Configures settings for triggering an interrupt to the hsm
        integer CryptoJobRequestInterruptFlagSetAddress: 0..4294967295, set at pre-compile, origin=Vector Informatik, default-value=0  # Address of the register which is used to clear the interrupt request flag
        integer CryptoJobRequestInterruptFlagSetMask: 0..4294967295, set at pre-compile, origin=Vector Informatik, default-value=1  # Mask which is used to set the value
        boolean CryptoJobRequestInterruptFlagSetting: set at pre-compile, origin=Vector Informatik, default-value=true  # Setting the interrupt flag and thus triggering an interrupt to the vHsm is only needed when isr support in vHsm is enabled.
        enumeration CryptoJobRequestInterruptFlagSetHandling: {CRYPTO_SET_INCLUSIVE_OR_ASSIGNMENT, CRYPTO_SET_ONLY_ASSIGNMENT, CRYPTO_SET_CALLOUT}, set at pre-compile, origin=Vector Informatik, default-value=CRYPTO_SET_INCLUSIVE_OR_ASSIGNMENT  # Configures the way, how the interrupt flag is set. On different platforms a different access to e.g. registers is needed. Below is the corresponding code to each option which will be generated when clearing a flag: CRYPTO_SET_INCLUSIVE_OR_ASSIGNMENT -> *SetAddress |= mask CRYPTO_SET_ONLY_ASSIGNMENT -> *SetAddress = mask CRYPTO_SET_CALLOUT -> call of Crypto_30_vHsm_RequestInterruptSet_Callout()
      container CryptoIpcInstance [0..*]  # Specifies the Ecu MultiCore partitions to which each Ipc can be mapped to.
        integer CryptoIpcInstanceId: 0..255, set at pre-compile, origin=Vector Informatik, default-value=0  # Id of the Ipc instance inside the Hsm
        reference CryptoIpcInstanceEcucPartitionRef: set at pre-compile, origin=Vector Informatik, destination=EcucPartition  # Reference to a EcuC Partition for Multicore support. The referenced partition - must also be set for all driver objects referenced by this IpcInstance - must be contained in the partition referneces in CryptoGeneral
        symbolic name reference CryptoDriverObjectRef [1..*]: set at pre-compile, origin=Vector Informatik, destination=CryptoDriverObject  # Reference to driver objects which will be processed with this IPC
        reference CryptoJobRequestInterruptRef: set at pre-compile, origin=Vector Informatik, destination=CryptoJobRequestInterrupt  # Reference to Request interrupt information
        reference CryptoJobResponseInterruptRef: set at pre-compile, origin=Vector Informatik, destination=CryptoJobResponseInterrupt  # Reference to Response interrupt information
  module config Crypto_Pre: definition=Crypto  # Software Crypto Driver pre-configuration
    CryptoGeneral
    CryptoKeyTypes
      vHsmDummyKeyType (CryptoKeyType): CryptoKeyElementRef=CryptoKeyElements/vHsmDummyKeyElement
    CryptoKeyElements
      vHsmDummyKeyElement (CryptoKeyElement):
        CryptoKeyElementAllowPartialAccess = 1
        CryptoKeyElementId = 0
        CryptoKeyElementPersist = 0
        CryptoKeyElementReadAccess = RA_ALLOWED
        CryptoKeyElementWriteAccess = WA_ALLOWED
    CryptoDriverObjects
    CryptovHsm
  module config Crypto_Rec: definition=Crypto
    CryptoGeneral
    CryptoKeyElements
      vHsmDummyKeyElement (CryptoKeyElement): CryptoKeyElementSize=1
