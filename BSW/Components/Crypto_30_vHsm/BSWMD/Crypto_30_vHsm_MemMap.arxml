AUTOSAR XML (schema 00048)
# COPYRIGHT
# Copyright (c) 2023 by Vector Informatik GmbH. All rights reserved.
# This software is copyright protected and proprietary to Vector Informatik GmbH.
# Vector Informatik GmbH grants to you only those rights as set out in the license conditions.
package /MICROSAR/Crypto_30_vHsm
  bsw implementation Crypto_Impl
    resource consumption ResourceConsumption
      15 x memory section:
        CRYPTO_30_VHSM_CODE: sw-addrmethod=CODE, symbol=CODE
        CRYPTO_30_VHSM_APPL_CODE: sw-addrmethod=CODE, symbol=APPL_CODE
        CRYPTO_30_VHSM_CODE_ISR: sw-addrmethod=CODE, symbol=CODE_ISR
        CRYPTO_30_VHSM_RAMCODE: sw-addrmethod=CODE, symbol=RAMCODE
        CRYPTO_30_VHSM_CONST_8BIT: alignment=8, sw-addrmethod=CONST, symbol=CONST_8BIT
        CRYPTO_30_VHSM_CONST_32BIT: alignment=32, sw-addrmethod=CONST, symbol=CONST_32BIT
        CRYPTO_30_VHSM_CONST_UNSPECIFIED: alignment=UNSPECIFIED, sw-addrmethod=CONST, symbol=CONST_UNSPECIFIED
        CRYPTO_30_VHSM_IPC_MEMORY_VAR_NOINIT_32BIT: alignment=32, sw-addrmethod=VAR_NO_INIT, symbol=IPC_MEMORY_VAR_NOINIT_32BIT
        CRYPTO_30_VHSM_GLOBAL_VAR_NOINIT_32BIT: alignment=32, sw-addrmethod=VAR_NO_INIT, symbol=GLOBAL_VAR_NOINIT_32BIT
        CRYPTO_30_VHSM_GLOBAL_VAR_NOINIT_UNSPECIFIED: alignment=32, sw-addrmethod=VAR_NO_INIT, symbol=GLOBAL_VAR_NOINIT_UNSPECIFIED
        CRYPTO_30_VHSM_VAR_NO_INIT_8: alignment=8, sw-addrmethod=VAR_NO_INIT, symbol=VAR_NOINIT_8BIT
        CRYPTO_30_VHSM_CRYPTO_SINGLE_PARTITION_VAR_NO_INIT_8: alignment=8, sw-addrmethod=VAR_NO_INIT, symbol=CRYPTO_SINGLE_PARTITION_VAR_NOINIT_8BIT
        CRYPTO_30_VHSM_VAR_NO_INIT_32: alignment=32, sw-addrmethod=VAR_NO_INIT, symbol=VAR_NOINIT_32BIT
        CRYPTO_30_VHSM_VAR_NO_INIT_UNSPECIFIED: alignment=UNSPECIFIED, sw-addrmethod=VAR_NO_INIT, symbol=VAR_NOINIT_UNSPECIFIED
        CRYPTO_30_VHSM_VAR_ZERO_INIT_8BIT: alignment=UNSPECIFIED, sw-addrmethod=VAR_CLEARED, symbol=VAR_ZERO_INIT_8BIT
