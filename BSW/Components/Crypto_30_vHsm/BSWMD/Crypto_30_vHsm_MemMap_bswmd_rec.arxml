AUTOSAR XML (schema 4-2-1)
package /MICROSAR
  module config vLinkGen_Rec: definition=vLinkGen
    vLinkGenMemLayout
      vHsm (vLinkGenMemoryRegion): vLinkGenMemoryRegionSize=16384
        vGlobalRamBuffer (vLinkGenMemoryRegionBlock):
          vLinkGenMemoryRegionBlockPosition = 1
          vLinkGenMemoryRegionBlockSize = 15104
          vLinkGenMemoryRegionBlockContentType = vLinkGenContentTypes/vHsmGlobalRamBuffer
        vHsmIpcMemory (vLinkGenMemoryRegionBlock): vLinkGenMemoryRegionBlockPosition=0, vLinkGenMemoryRegionBlockSize=1280, vLinkGenMemoryRegionBlockContentType=vLinkGenContentTypes/vHsmIpcMemory
      vLinkGenLinkerSections
        10 x vLinkGenLinkerVarSection:
          vHsmGlobalRamBuffer: vLinkGenLinkerVarSectionName=vHsmGlobalRamBuffer
          vHsmIpcMemory: vLinkGenLinkerVarSectionName=vHsmIpcMemory
          svHsmGlobalRamBuffer: vLinkGenLinkerVarSectionName=svHsmGlobalRamBuffer
          svHsmIpcMemory: vLinkGenLinkerVarSectionName=svHsmIpcMemory
          vHsmGlobalRamBuffer_INIT: vLinkGenLinkerVarSectionName=vHsmGlobalRamBuffer_INIT
          vHsmGlobalRamBuffer_INIT_FAST: vLinkGenLinkerVarSectionName=vHsmGlobalRamBuffer_INIT_FAST, vLinkGenLinkerVarSectionFast=1
          vHsmGlobalRamBuffer_NO_INIT_FAST: vLinkGenLinkerVarSectionName=vHsmGlobalRamBuffer_NO_INIT_FAST, vLinkGenLinkerVarSectionFast=1
          vHsmIpcMemory_INIT: vLinkGenLinkerVarSectionName=vHsmIpcMemory_INIT
          vHsmIpcMemory_INIT_FAST: vLinkGenLinkerVarSectionName=vHsmIpcMemory_INIT_FAST, vLinkGenLinkerVarSectionFast=1
          vHsmIpcMemory_NO_INIT_FAST: vLinkGenLinkerVarSectionName=vHsmIpcMemory_NO_INIT_FAST, vLinkGenLinkerVarSectionFast=1
      vHsmIpcMemory (vLinkGenLogicalVarGroup):
        vLinkGenVarGroupPosition = 0
        vLinkGenVarGroupInitCore = 0
        vLinkGenVarGroupRegion = vHsm/vHsmIpcMemory
        vLinkGenVarGroupContentType = vLinkGenContentTypes/vHsmIpcMemory
        vHsmIpcMemory (vLinkGenVarSectionGroup):
          vLinkGenVarSectionGroupPosition = 0
          vLinkGenVarSectionGroupAlignment = 64
          vLinkGenVarSectionGroupRef = vLinkGenLinkerSections/vHsmIpcMemory
          vLinkGenVarSectionGroupRef = svHsmIpcMemory
          vLinkGenVarSectionGroupRef = vHsmIpcMemory_NO_INIT_FAST
        vHsmIpcMemory_INIT (vLinkGenVarSectionGroup):
          vLinkGenVarSectionGroupPosition = 0
          vLinkGenVarSectionGroupAlignment = 64
          vLinkGenVarSectionGroupInit = INIT
          vLinkGenVarSectionGroupRef = vLinkGenLinkerSections/vHsmIpcMemory_INIT
          vLinkGenVarSectionGroupRef = vHsmIpcMemory_INIT_FAST
      vHsmGlobalRamBuffer (vLinkGenLogicalVarGroup):
        vLinkGenVarGroupPosition = 1
        vLinkGenVarGroupInitCore = 0
        vLinkGenVarGroupRegion = vGlobalRamBuffer
        vLinkGenVarGroupContentType = vLinkGenContentTypes/vHsmGlobalRamBuffer
        vHsmGlobalRamBuffer (vLinkGenVarSectionGroup):
          vLinkGenVarSectionGroupPosition = 1
          vLinkGenVarSectionGroupAlignment = 4
          vLinkGenVarSectionGroupRef = vLinkGenLinkerSections/vHsmGlobalRamBuffer
          vLinkGenVarSectionGroupRef = svHsmGlobalRamBuffer
          vLinkGenVarSectionGroupRef = vHsmGlobalRamBuffer_NO_INIT_FAST
        vHsmGlobalRamBuffer_INIT (vLinkGenVarSectionGroup):
          vLinkGenVarSectionGroupPosition = 1
          vLinkGenVarSectionGroupAlignment = 4
          vLinkGenVarSectionGroupInit = INIT
          vLinkGenVarSectionGroupRef = vLinkGenLinkerSections/vHsmGlobalRamBuffer_INIT
          vLinkGenVarSectionGroupRef = vHsmGlobalRamBuffer_INIT_FAST
    vLinkGenContentTypes
      vHsmGlobalRamBuffer (vLinkGenVarContentType): vLinkGenVarContentTypeCopyRef=GLOBAL_CONST
      vHsmIpcMemory (vLinkGenVarContentType): vLinkGenVarContentTypeCopyRef=GLOBAL_CONST
  module config MemMap_Rec: definition=MemMap
    vHsmGlobalRamBuffer (MemMapAddressingModeSet)
      vHsmGlobalRamBuffer (MemMapAddressingMode): MemMapAlignmentSelector=UNSPECIFIED, MemMapAlignmentSelector=32, MemMapLinkerLogicalGroupRef=vLinkGenMemLayout/vHsmGlobalRamBuffer
    vHsmIpcMemory (MemMapAddressingModeSet)
      vHsmIpcMemory (MemMapAddressingMode): MemMapAlignmentSelector=32, MemMapLinkerLogicalGroupRef=vLinkGenMemLayout/vHsmIpcMemory
    vHsm_Generic (MemMapAllocation)
      3 x MemMapSectionSpecificMapping:
        vHsmGlobalRamBuffer: MemMapAddressingModeSetRef=vHsmGlobalRamBuffer, MemMapMemorySectionRef=CRYPTO_30_VHSM_GLOBAL_VAR_NOINIT_32BIT, MemMapMemorySectionRef=CRYPTO_30_VHSM_GLOBAL_VAR_NOINIT_UNSPECIFIED
        vHsmIpcMemory: MemMapAddressingModeSetRef=vHsmIpcMemory, MemMapMemorySectionRef=CRYPTO_30_VHSM_IPC_MEMORY_VAR_NOINIT_32BIT
        vHsmRamCode: MemMapAddressingModeSetRef=vHsmRamCode, MemMapMemorySectionRef=CRYPTO_30_VHSM_RAMCODE
    vHsmRamCode (MemMapAddressingModeSet)
      vHsmRamCode (MemMapAddressingMode): MemMapAlignmentSelector=UNSPECIFIED
