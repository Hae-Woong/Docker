AUTOSAR XML (schema 00048)
package /MICROSAR
  module definition DoIP [0..1]: category=VENDOR_SPECIFIC_MODULE_DEFINITION, post-build-variant-support=true, refined-module-def=DoIP, variants pre-compile/post-build  # The Diagnostic over IP module implements a transport protocol for diagnostic data over the Internet Protocol. It is developed according to ISO Standard 13400. #Ethernet #Diag #AUTOSAR
    container DoIPConfigSet: multiplicity set at pre-compile  # This container contains the configuration parameters and sub containers of the AUTOSAR DoIP module. This container is a MultipleConfigurationContainer, i.e. this container and its sub-containers exist once per configuration set.
      integer DoIPEid [0..1]: 1..281474976710655, multiplicity set at pre-compile, set at pre-compile, default-value=1103823438081  # EID | This parameter defines the EID (Entity ID) of the DoIP entity used for vehicle identification. Note: This parameter is ignored for interfaces with enabled DoIPUseMacAddressForIdentification.
      integer DoIPGid [0..1]: 1..281474976710655, multiplicity set at pre-compile, set at pre-compile, default-value=1103823438081  # GID | This parameter defines the GID (Group ID) for vehicle identification response/vehicle announcement.
      integer DoIPLogicalAddress: 1..65535, multiplicity set at pre-compile, post-build-variant-value=true, set at post-build in variant post-build / pre-compile in variant pre-compile  # This parameter defines the logical address of the DoIP entity. This address is sent within messages like Routing Activation Response when no specific target address is available.
      container DoIPInterface [1..255]: multiplicity set at pre-compile  # This container defines a logical IP interface and collects properties to configure this interface.
        float DoIPAliveCheckResponseTimeout: 0..30, multiplicity set at pre-compile, set at pre-compile, default-value=0.5  # This parameter defines a timeout for a response to an Alive Check Request before the connection is considered to be disconnected. Represents parameter T_TCP_AliveCheck of ISO 13400-2. Note: In case the timeout is configured to a value smaller than the DoIPMainFunctionPeriod the value is interpreted as one main function cycle.
        float DoIPGeneralInactivityTime: 0..1200, multiplicity set at pre-compile, set at pre-compile, default-value=300  # This parameter defines a timeout for an inactive TCP connection before DoIP module will close the according socket connection. Inactive means that no data is transmitted or received. Represents parameter T_TCP_General_Inactivity of ISO 13400-2:2012. Note: In case the time is configured to a value smaller than the DoIPMainFunctionPeriod the value is interpreted as one main function cycle.
        float DoIPInitialInactivityTime: 0..300, multiplicity set at pre-compile, set at pre-compile, default-value=2  # This parameter defines a timeout for a TCP connection where no routing is activated before DoIP module will close the according socket connection. Represents parameter T_TCP_Initial_Inactivity of ISO 13400-2. Note: In case the time is configured to a value smaller than the DoIPMainFunctionPeriod the value is interpreted as one main function cycle.
        integer DoIPInterfaceId: 0..255, multiplicity set at pre-compile, set at pre-compile, symbolic-name-value=true, default-value=0  # This parameter is an identifier of the DoIPInterface. The value of this parameter will be assigned to the symbolic name derived from the container short name. The Interfacel ID is required for API calls using interfaces (e.g. DoIP_ActivationLineSwitch()).
        integer DoIPMaxTesterConnections: 1..255, multiplicity set at pre-compile, set at pre-compile, default-value=1  # This parameter defines the maximum amount of tester connections that shall be maintained at one time before alive check is performed. Vector supports multiple local addresses (e.g. IPv4, IPv6, VLANs parallel). The value shall match the number of DoIPTcpConnections on the local address with the most DoIPTcpConnections except the 'n+1' TCP connection(s). Example 1: - Local address A with 5 DoIPTcpConnections on 1 SoAdSocketConnectionGroup. - Local address B with 3 DoIPTcpConnections on 1 SoAdSocketConnectionGroup. - Both local addresses have enabled DoIPUsePlusOneSocket in this example. -> Local address A has the most DoIPTcpConnections. -> DoIPMaxTesterConnections is set to (5-1) = 4. -> The status information response will set the max. concurrent TCP_DATA sockets field to 4 if the request has been received on local address A. -> The status information response will set the max. concurrent TCP_DATA sockets field to 2 if the request has been received on local address B. -> If DoIPUsePlusOneSocket is true in the above mentioned example the values will increase by 1. Example 2: - Local address A with 3 DoIPTcpConnections on SoAdSocketConnectionGroup X and with 2 DoIPTcpConnections on SoAdSocketConnectionGroup Y. - Local address B with 3 DoIPTcpConnections on 1 SoAdSocketConnectionGroup. - Both local addresses have enabled DoIPUsePlusOneSocket in this example. -> Local address A has the biggest sum of DoIPTcpConnections considering the 'n+1' TCP connections on both SoAdSocketConnectionGroups. -> DoIPMaxTesterConnections is set to ((3-1)+(2-1)) = 3. -> The status information response will set the max. concurrent TCP_DATA sockets field to 3 if the request has been received on local address A. -> The status information response will set the max. concurrent TCP_DATA sockets field to 2 if the request has been received on local address B. -> If DoIPUsePlusOneSocket is true in the above mentioned example the values will increase by 1.
        boolean DoIPInterfaceActLineCtrl: multiplicity set at pre-compile, set at pre-compile  # This parameter defines whether the network interface is started "on-demand" or is always available. true: Network interface is started "on-demand" when an activation line is sensed false: Network interface is always available
        float DoIPInitialVehicleAnnouncementTime: 0..30, multiplicity set at pre-compile, set at pre-compile, default-value=0.5  # This parameter defines a time to wait before sending first Vehicle Anouncement message after IP address assignment. Represents parameter A_DoIP_Announce_Wait of ISO 13400-2 Note: In case the time is configured to a value smaller than the DoIPMainFunctionPeriod the value is interpreted as one main function cycle.
        float DoIPVehicleAnnouncementInterval [0..1]: 0..30, multiplicity set at pre-compile, set at pre-compile, default-value=0.5  # This parameter defines a time to wait before sending subsequent Vehicle Announcement messages after IP address assignment and a first Vehicle Announcement message is sent. Represents parameter A_DoIP_Announce_Interval of ISO 13400-2. Note: In case the interval is configured to a value smaller than the DoIPMainFunctionPeriod the value is interpreted as one main function cycle.
        integer DoIPVehicleAnnouncementCount [0..1]: 1..255, multiplicity set at pre-compile, set at pre-compile, default-value=3  # This parameter defines the amount of repetitions of the Vehicle Announcement message after IP address assignment. Represents parameter A_DoIP_Annunce_Num of ISO 13400-2.
        boolean DoIPUseVehicleIdentificationSyncStatus: multiplicity set at pre-compile, set at pre-compile, default-value=false  # This parameter defines whether the optional VIN/GID synchronization status is used additionally in the Vehicle Identification/Announcement message.
        boolean DoIPUseMacAddressForIdentification: multiplicity set at pre-compile, set at pre-compile, default-value=false  # This parameter defines whether MAC address shall be used as EID in Vehicle Identification messages. true: Use MAC address as EID. false: Use configured EID (DoIPEid).
        enumeration DoIPInterfaceAnnouncementStart: multiplicity set at pre-compile, set at pre-compile, default-value=DOIP_AUTOMATIC_ANNOUNCE  # This parameter defines when vehicle announcement is started on a DoIPInterface. Automatic: As soon as the underlying UDP vehicle announcement connection switches to SOAD_SOCON_ONLINE. OnTrigger: As soon as the API DoIP_TriggerVehicleAnnouncement is called for the given DoIPInterface instance.
          DOIP_AUTOMATIC_ANNOUNCE  # AUTOMATIC announcement
          DOIP_ONTRIGGER_ANNOUNCE  # TRIGGERED announcement
        float DoIPInterfaceActLineInactiveTimeout: 0..4294967295, multiplicity set at pre-compile, origin=Vector Informatik, set at pre-compile, default-value=0  # This parameter defines a timeout for the activation line state change mechanism which is initiated by call to DoIP_ActivationLineSwitch(). If the parameter is set to 0 or if this timeout expires DoIP will switch to activation line state inactive even if sockets are not yet closed completely by sending a TCP RST. If the sockets could be closed completely within the timeout a TCP FIN is used for teardown. Note: In case the time is configured to a value smaller than the DoIPMainFunctionPeriod but bigger than 0 the value is interpreted as one main function cycle.
        boolean DoIPGeneralInactivityTimeWithAliveCheck: multiplicity set at pre-compile, origin=Vector Informatik, set at pre-compile, default-value=false  # This parameter defines if an Alive Check is performed before the general inactivity time is reached. If enabled the Alive Check Request is triggered after DoIPGeneralInactivityTime - DoIPAliveCheckResponseTimeout.
        container DoIPChannel [1..65535]: multiplicity set at pre-compile  # Configuration of one DoIPChannel. A DoIPChannel describes a link to PDUR,
          boolean DoIPIsDefaultChannel [0..1]: multiplicity set at pre-compile, origin=Vector Informatik, set at pre-compile, default-value=true  # This parameter defines whether this channel is used as default channel if multiple channels with same target address value are configured to use Pdu size depending routing. It must exist in mentioned case only.
          integer DoIPChannelId: 0..65534, multiplicity set at pre-compile, origin=Vector Informatik, set at pre-compile, symbolic-name-value=true, default-value=0  # This parameter defines the Channel ID required for API calls using channels (e.g. DoIP_OverwriteLogicalTargetAddress()).
          integer DoIPTargetMaxBufSize [0..1]: 1..4294967291, multiplicity set at pre-compile, origin=Vector Informatik, set at pre-compile, default-value=4095  # This parameter defines the maximum buffer size the DoIP target can provide for buffering incoming messages. If this size is exceeded a DoIP Diagnostic Mesage Negative Acknowledge message with error code 0x04 is sent. For non default channels (DoIPIsDefaultChannel=false) the value of DoIPTargetMaxBufSize should not be configured bigger than DoIPTargetMaxPduSize. In case of UUDT this parameter must not exist.
          integer DoIPTargetMaxPduSize [0..1]: 1..4294967291, multiplicity set at pre-compile, origin=Vector Informatik, set at pre-compile, default-value=4095  # This parameter defines the maximum Pdu size which is accepted for this DoIPChannel instance. A second DoIPChannel instance with same target address value (refer to referenced DoIPTargetAddress) but different DoIPTargetMaxPduSize can be used to configure Pdu size depending routing. This means the module will choose the DoIPChannel which has the more suitable length. In case of UUDT this parameter must not exist.
          boolean DoIPChannelReadyNotification: multiplicity set at pre-compile, origin=Vector Informatik, set at pre-compile, default-value=false  # This parameter defines whether this channel is related to the channel ready notification. true: BswM is notified when a routing activation succeeded on a related TCP connection. false: BswM is not notified.
          reference DoIPChannelSARef: multiplicity set at pre-compile, set at pre-compile, destination=DoIPTester  # Reference to the DoIPTester's Source Address which can communicate over this channel.
          reference DoIPChannelTARef: multiplicity set at pre-compile, set at pre-compile, destination=DoIPTargetAddress  # Reference to the ECU's DoIPTargetAddress which is sent within DoIP frames.
          container DoIPPduRRxPdu [0..1]: multiplicity set at pre-compile  # This container contains the Rx Pdus to connect with the Rx Pdus of the PDUR.
            integer DoIPPduRRxPduId: 0..65535, multiplicity set at pre-compile, set at pre-compile, symbolic-name-value=true, default-value=0  # PduR Rx PDU ID | This parameter defines the Pdu ID required by the API call DoIP_CancelReceive().
            reference DoIPPduRRxPduRef: multiplicity set at pre-compile, set at pre-compile, destination=Pdu  # PduR Rx PDU Ref | Reference to the "global" Pdu structure to allow harmonization of handle IDs in the COM-Stack.
          container DoIPPduRTxPdu [0..1]: multiplicity set at pre-compile  # This container contains the Tx Pdus to connect with the Tx Pdus of the PDUR.
            integer DoIPPduRTxPduId: 0..65535, multiplicity set at pre-compile, set at pre-compile, symbolic-name-value=true, default-value=0  # PduR Tx PDU ID | This parameter defines the Pdu ID required for DoIP_Transmit() and DoIP_CancelTransmit() function calls.
            enumeration DoIPPduType [0..1]: {DOIP_IFPDU, DOIP_TPPDU}, multiplicity set at pre-compile, post-build-variant-multiplicity=true, post-build-variant-value=true, set at pre-compile, default-value=DOIP_TPPDU  # This parameter defines the API Type to use for communication with PduR. DOIP_IFPDU for UUDT messages, DOIP_TPPDU for all other diagnostic messages.
            reference DoIPPduRTxPduRef: multiplicity set at pre-compile, set at pre-compile, destination=Pdu  # PduR Tx PDU Ref | Reference to the "global" Pdu structure to allow harmonization of handle IDs in the COM-Stack.
        container DoIPConnections: multiplicity set at pre-compile  # This container includes all lower layer connection specific information, i.e. the single Pdu References, Handle IDs to the SOAD and target adresses which are used to identify a DoIPChannel.
          container DoIPTargetAddress [1..65535]: multiplicity set at pre-compile  # This container includes target addresses that are known by this DoIP entity.
            integer DoIPTargetAddressValue: 1..65535, multiplicity set at pre-compile, post-build-variant-value=true, set at post-build in variant post-build / pre-compile in variant pre-compile, default-value=1  # This parameter defines the logical target address which is sent within DoIP frames.
            integer DoIPTargetAddressBitMask [0..1]: 1..65535, multiplicity set at pre-compile, origin=Vector Informatik, set at pre-compile, default-value=65535  # This parameter defines a bit mask which is used on reception of a diagnostic message to mask the target address value and choose the channel with matching masked bits. Example: Configured DoIPTagetAddressValue is 0x1234. This parameter is set to 0xFF. All diagnostic messages sent to 0xXY34 are received on this target addres. Note: To behave as specified by AUTOSAR value has to be set to 0xFFFF.
            boolean DoIPTargetAddressVerification: multiplicity set at pre-compile, origin=Vector Informatik, set at pre-compile, default-value=false  # This parameter defines if the DoIPVerifyTargetAddressCallback is called on reception of a diagnostic message.
          container DoIPTcpConnection [1..255]: multiplicity set at pre-compile  # This container includes TCP connection parameter to the lower layer SOAD module.
            boolean DoIPTcpConnectionSecurityRequired [0..1]: multiplicity set at pre-compile, set at pre-compile, default-value=false  # This parameter indicates if the associated TCP socket uses a secure connection (e.g. TLS).
            boolean DoIPRequestAddressAssignment: multiplicity set at pre-compile, set at pre-compile, default-value=true  # The DoIP module shall request IP address assignment by calling SoAd_RequestIpAddrAssignment() for the TcpIpLocalAddr related to this DoIpConnection. Note: This parameter does not influence the behavior. The request IP address assignment is configured for each TcpIpIpAddressAssignment used by the DoIP via /MICROSAR/DoIP/DoIPConfigSet/DoIPInterface/DoIPConnections/DoIPIpAddressAssignment/DoIPControlIpAssignment.
            boolean DoIPUsePlusOneSocket: multiplicity set at pre-compile, origin=Vector Informatik, set at pre-compile, default-value=true  # Use n+1 Socket | This parameter indicates if the associated SoAdSocketConnectionGroup uses a "n+1" socket. TRUE: The "+1" socket is used to decline additional tester connections. FALSE: The "+1" handling is not used and all sockets can be used as tester connections. Example: There is a SoAdSocketConnectionGroup with 2 SoAdSocketConnections (each is referenced via PDUs by an own DoIPTcpConnection). If this parameter is enabled, only one tester connection is possible at the same time. If this parameter is disabled, two tester connections are possible at the same time. Note: For the same SoAdSocketConnectionGroup this parameter has to be set consistent for all related DoIPTcpConnections.
            integer DoIPTcpConnectionId: 0..65535, multiplicity set at pre-compile, origin=Vector Informatik, set at pre-compile, symbolic-name-value=true  # This parameter gives a unique identifier for TCP, UDP and UDP vehicle announcement connections required for API calls using connections (e.g. DoIP_CloseConnection(), DoIP_TransmitOemSpecificPayloadType()).
            container DoIPSoAdTcpRxPdu: multiplicity set at pre-compile  # SoAd Tcp Rx Pdu | This container contains the Rx Pdus for TCP connections.
              integer DoIPSoAdTcpRxPduId: 0..65535, multiplicity set at pre-compile, set at pre-compile, symbolic-name-value=true, default-value=0  # SoAd Tcp Rx Pdu Id | This parameter defines the Pdu ID required for the TP API calls. (e.g. DoIP_SoAdTpRxIndication()) to receive TCP data from SOAD.
              reference DoIPSoAdTcpRxPduRef: multiplicity set at pre-compile, set at pre-compile, destination=Pdu  # SoAd Tcp Rx Pdu Ref | Reference to the "global" Pdu structure to allow harmonization of handle IDs in the COM-Stack.
            container DoIPSoAdTcpTxPdu: multiplicity set at pre-compile  # SoAd Tcp Tx Pdu | This container contains the Tx Pdus for TCP connections.
              integer DoIPSoAdTcpTxPduId: 0..65535, multiplicity set at pre-compile, set at pre-compile, symbolic-name-value=true, default-value=0  # SoAd Tcp Tx Pdu Id | This parameter defines the Pdu ID required for the TP API calls. (e.g. DoIP_SoAdTpTxConfirmation() when TCP data are transmitted to SOAD.
              reference DoIPSoAdTcpTxPduRef: multiplicity set at pre-compile, set at pre-compile, destination=Pdu  # SoAd Tcp Tx Pdu Ref | Reference to the "global" Pdu structure to allow harmonization of handle IDs in the COM-Stack.
          container DoIPUdpConnection [1..255]: multiplicity set at pre-compile  # This container includes UDP connection parameter to the lower layer SOAD module.
            boolean DoIPRequestAddressAssignment: multiplicity set at pre-compile, set at pre-compile, default-value=true  # The DoIP module shall request IP address assignment by calling SoAd_RequestIpAddrAssignment() for the TcpIpLocalAddr related to this DoIpConnection. Note: This parameter does not influence the behavior. The request IP address assignment is configured for each TcpIpIpAddressAssignment used by the DoIP via /MICROSAR/DoIP/DoIPConfigSet/DoIPInterface/DoIPConnections/DoIPIpAddressAssignment/DoIPControlIpAssignment.
            integer DoIPUdpConnectionId: 0..65535, multiplicity set at pre-compile, origin=Vector Informatik, set at pre-compile, symbolic-name-value=true  # This parameter gives a unique identifier for TCP, UDP and UDP vehicle announcement connections required for API calls using connections (e.g. DoIP_CloseConnection(), DoIP_TransmitOemSpecificPayloadType()).
            container DoIPSoAdUdpRxPdu: multiplicity set at pre-compile  # SoAd Udp Rx Pdu | This container contains the Rx Pdus for UDP connections.
              integer DoIPSoAdUdpRxPduId: 0..65535, multiplicity set at pre-compile, set at pre-compile, symbolic-name-value=true, default-value=0  # SoAd Udp Rx Pdu Id | This parameter defines the Pdu ID required for the IF API calls. (e.g. DoIP_SoAdIfRxIndication()) to receive UDP data from SOAD.
              reference DoIPSoAdUdpRxPduRef: multiplicity set at pre-compile, set at pre-compile, destination=Pdu  # SoAd Udp Rx Pdu Ref | Reference to the "global" Pdu structure to allow harmonization of handle IDs in the COM-Stack.
            container DoIPSoAdUdpTxPdu: multiplicity set at pre-compile  # SoAd Udp Tx Pdu | This container contains the Tx Pdus for UDP connections.
              integer DoIPSoAdUdpTxPduId: 0..65535, multiplicity set at pre-compile, set at pre-compile, symbolic-name-value=true, default-value=0  # SoAd Udp Tx Pdu Id | This parameter defines the Pdu ID required for the IF API calls. (e.g. DoIP_SoAdIfTxConfirmation() when UDP data are transmitted to SOAD.
              reference DoIPSoAdUdpTxPduRef: multiplicity set at pre-compile, set at pre-compile, destination=Pdu  # SoAd Udp Tx Pdu Ref | Reference to the "global" Pdu structure to allow harmonization of handle IDs in the COM-Stack.
          container DoIPUdpVehicleAnnouncementConnection [0..255]: multiplicity set at pre-compile  # This container describes the UDP multicast connections to the lower layer SoAd module.
            boolean DoIPRequestAddressAssignment: multiplicity set at pre-compile, set at pre-compile, default-value=true  # The DoIP module shall request IP address assignment by calling SoAd_RequestIpAddrAssignment() for the TcpIpLocalAddr related to this DoIpConnection. Note: This parameter does not influence the behavior. The request IP address assignment is configured for each TcpIpIpAddressAssignment used by the DoIP via /MICROSAR/DoIP/DoIPConfigSet/DoIPInterface/DoIPConnections/DoIPIpAddressAssignment/DoIPControlIpAssignment.
            integer DoIPUdpVehicleAnnouncementConnectionId: 0..65535, multiplicity set at pre-compile, origin=Vector Informatik, set at pre-compile, symbolic-name-value=true  # This parameter gives a unique identifier for TCP, UDP and UDP vehicle announcement connections required for API calls using connections (e.g. DoIP_CloseConnection(), DoIP_TransmitOemSpecificPayloadType()).
            container DoIPSoAdUdpVehicleAnnouncementTxPdu: multiplicity set at pre-compile  # SoAd Udp Vehicle Announcement Tx Pdu | This container describes the vehicle announcement TxPdu sent via the SoAd.
              integer DoIPSoAdUdpVehicleAnnouncementTxPduId: 0..65535, multiplicity set at pre-compile, set at pre-compile, symbolic-name-value=true, default-value=0  # SoAd Udp Vehicle Announcement Tx Pdu Id | The DoIPSoAdUdpVehicleAnnouncementTxPduId is required by the API call DoIP_SoAdIfTxConfirmation() that is called by the SoAd to confirm that the IPdu has been transmitted successfully.
              reference DoIPSoAdUdpVehicleAnnouncementTxPduRef: multiplicity set at pre-compile, set at pre-compile, destination=Pdu  # SoAd Udp Vehicle Announcement Tx Pdu Ref | Reference to the "global" PDU structure to allow harmonization of handle
          container DoIPIpAddressAssignment [0..255]: multiplicity set at pre-compile  # This container describes an IP address assignment which is related to the module. An IP address assignment is related if at least a TcpConnection, UdpConnection or a DoIPUdpVehicleAnnouncementConnection references the corresponding local address via SoAd. WARNING: This container is designed to be created automatically by configuration tool. Add TcpConnections, UdpConnections and DoIPUdpVehicleAnnouncementConnections to configure the module for a specific local address and corresponding IP assignments.
            boolean DoIPControlIpAssignment: multiplicity set at pre-compile, origin=Vector Informatik, set at pre-compile, default-value=true  # This parameter enables/disables the control of local IP address assignment. If enabled DoIP requests/releases the local IP address assignment via SoAd if activation line state changes. If disabled DoIP does not request/release the local IP address assignment.
            reference DoIPIpAddressAssignmentRef: multiplicity set at pre-compile, origin=Vector Informatik, set at pre-compile, destination=TcpIpAddrAssignment  # This parameter references an IP address assignment which is related to the module. An IP address assignment is related if at least a TcpConnection, UdpConnection or a DoIPUdpVehicleAnnouncementConnection references the corresponding local address via SoAd.
        container DoIPRoutingActivation [0..255]: multiplicity set at pre-compile  # This container contains the routing activation possibilities by representing for each container a possible routing activation request message to the DoIP entity and the according references to the activated diagnostic messages (i.e. DoIPTargetAddress).
          integer DoIPRoutingActivationNumber: 0..255, multiplicity set at pre-compile, set at pre-compile, default-value=0  # This parameter defines the Routing Activation Number which is received for a DoIP routing activation request message and expected for this Routing Activation instance.
          boolean DoIPRoutingActivationSecurityRequired [0..1]: multiplicity set at pre-compile, set at pre-compile, default-value=false  # This parameter indicates if a routing activation requires a secure TCP connection (e.g. TLS). On reception of a routing activation request on a DoIPTcpConnection this parameter is checked against the value specified by DoIPTcpConnectionSecurityRequired.
          reference DoIPTargetAddressRef [1..65535]: multiplicity set at pre-compile, set at pre-compile, destination=DoIPTargetAddress  # Reference to all DoIPTargetAddress which are activated on this routing activation.
          container DoIPRoutingActivationAuthenticationCallback [0..1]: multiplicity set at pre-compile  # This container contains a callback function to call on a Routing Activation Request for Authentication.
            function name DoIPRoutingActivationAuthenticationFunc [0..1]: multiplicity set at pre-compile, set at pre-compile  # This parameter defines a callback function to trigger the authentication function for routing activation.
            integer DoIPRoutingActivationAuthenticationReqLength: 0..4, multiplicity set at pre-compile, set at pre-compile, default-value=4  # This parameter defines the amount of bytes used to handle to the authentication function on routing activation. If 0 is configured as length the parameter AuthenticationReqData will not be handled to the API.
            integer DoIPRoutingActivationAuthenticationResLength: 0..4, multiplicity set at pre-compile, set at pre-compile, default-value=4  # This parameter defines the amount of bytes used to read by the authentication function on routing activation. If 0 is configured as length the parameter AuthenticationResData will not be handled to the API.
            boolean DoIPRoutingActivationAuthenticationParamRemAddr: multiplicity set at pre-compile, origin=Vector Informatik, set at pre-compile, default-value=false  # This parameter defines if an additional function parameter is used when calling callback to forward remote address of tester which has sent the corresponding routing activation request.
          container DoIPRoutingActivationConfirmationCallback [0..1]: multiplicity set at pre-compile  # This container contains a callback function to call on a Routing Activation Request for Confirmation.
            function name DoIPRoutingActivationConfirmationFunc [0..1]: multiplicity set at pre-compile, set at pre-compile  # This parameter defines a callback function to trigger the confirmation function for routing activation.
            integer DoIPRoutingActivationConfirmationReqLength: 0..4, multiplicity set at pre-compile, set at pre-compile, default-value=4  # This parameter defines the amount of bytes used to handle to the confirmation function on routing activation. If 0 is configured as length the parameter ConfirmedReqData will not be handled to the API.
            integer DoIPRoutingActivationConfirmationResLength: 0..4, multiplicity set at pre-compile, set at pre-compile, default-value=4  # This parameter defines the amount of bytes used to read by the confirmation function on routing activation. If 0 is configured as length the parameter ConfirmedResData will not be fetched via the API.
            boolean DoIPRoutingActivationConfirmationParamRemAddr: multiplicity set at pre-compile, origin=Vector Informatik, set at pre-compile, default-value=false  # This parameter defines if an additional function parameter is used when calling callback to forward remote address of tester which has sent the corresponding routing activation request.
        container DoIPTester [1..255]: multiplicity set at pre-compile  # This container includes the properties of the possible connectable testers for the DoIP entity.
          integer DoIPNumByteDiagAckNack: 0..4294967295, multiplicity set at pre-compile, set at pre-compile, default-value=256  # This parameter defines the number of user data received within a Diagnostic Message the DoIP entity shall sent back to tester within corresponding Diagnostic Message Acknowledge.
          integer DoIPTesterSA: 1..65535, multiplicity set at pre-compile, set at pre-compile, default-value=3584  # This parameter defines the logical source address of tester sent within TCP messages (e.g. Diagnostic Message).
          reference DoIPRoutingActivationRef [1..255]: multiplicity set at pre-compile, set at pre-compile, destination=DoIPRoutingActivation  # Reference to a DoIPRoutingActivation describing the possible routing activations of the DoIPTester.
        container DoIPOemPayload [0..1]: multiplicity set at pre-compile  # This container defines parameter (Tx/Rx buffer and callback configuration) for OEM payload type messages.
          function name DoIPOemPayloadRxCallback [0..1]: multiplicity set at pre-compile, origin=Vector Informatik, set at pre-compile, max-length=255, min-length=1  # This parameter defines a callback function to forward received manufacturer-specific payload types to a user via <User>_DoIPReceiveOemSpecificPayloadType. Note: The reception of a TCP OEM specific message is skipped if no DoIPOemPayloadRxBuffer is configured for the TCP connection (neither dedicated nor globally).
          container DoIPOemPayloadTxBuffer [0..65535]: multiplicity set at pre-compile  # This container provides parameter to configure a Tx buffer which is used for messages with OEM payload type.
            integer DoIPOemPayloadTxBufferSize: 1..65535, multiplicity set at pre-compile, origin=Vector Informatik, set at pre-compile, default-value=1500  # This parameter defines the size of the Tx buffer for OEM payload type. The size only refers to the payload data and does not include the generic header.
            choice reference DoIPOemPayloadTxBufferTcpOrUdpConnectionRef [0..765]: multiplicity set at pre-compile, origin=Vector Informatik, set at pre-compile, destination=[DoIPTcpConnection, DoIPUdpConnection, DoIPUdpVehicleAnnouncementConnection]  # Reference to the dedicated TCP, UDP or UDP vehicle announcement connections the Tx buffer is used for. In case a reference exists this buffer is reserved for the dedicated connections. In case no reference exists the buffer can be used for transmission on any connection.
          container DoIPOemPayloadRxBuffer [0..65535]: multiplicity set at pre-compile  # This container provides parameter to configure an Rx buffer which is used for messages with OEM payload type.
            integer DoIPOemPayloadRxBufferSize: 1..65535, multiplicity set at pre-compile, origin=Vector Informatik, set at pre-compile, default-value=1500  # This parameter defines the size of the Rx buffer for OEM payload type. The size only refers to the payload data and does not include the generic header.
            reference DoIPOemPayloadRxBufferTcpConnectionRef [0..255]: multiplicity set at pre-compile, origin=Vector Informatik, set at pre-compile, destination=DoIPTcpConnection  # Reference to the dedicated TCP connections the Rx buffer is used for. In case a reference exists this buffer is reserved for the dedicated connections. In case no reference exists the buffer can be used for reception on any TCP connection.
    container DoIPGeneral: multiplicity set at pre-compile  # General configuration parameters of the DoIP.
      boolean DoIPDevelopmentErrorDetect: multiplicity set at pre-compile, set at pre-compile, default-value=true  # Dev Error Detect | This parameter switches the Development Error Detection and Notification ON or OFF. true: Development error detection is enabled. false: Development error detection is disabled. Note: In general, the development error detection is recommended during pre-test phase. It is not recommended to enable the development error detection in production code due to increased runtime and ROM needs.
      boolean DoIPDhcpOptionVinUse: multiplicity set at pre-compile, set at pre-compile, default-value=false  # DHCP Option VIN use | This parameter defines if DoIP module will add the VIN to the DHCP host name if no valid DHCP host name is already set. true: DoIP module will add the VIN. false: DoIP module will not add the VIN (will set value to "DoIP-").
      boolean DoIPEntityStatusMaxByteFieldUse: multiplicity set at pre-compile, set at pre-compile, default-value=false  # This parameter defines if the optional support of the max data size element of a diagnostic entity status response. true: DoIP module will add max data size element. false: DoIP module will not add max data size element.
      integer DoIPGIDInvalidityPattern: 0..255, multiplicity set at pre-compile, set at pre-compile, default-value=0  # This parameter defines the byte pattern that is used for response messages if no valid GID could be retrieved.
      string DoIPHeaderFileInclusion [0..*]: multiplicity set at pre-compile, origin=Vector Informatik, set at pre-compile  # This parameter defines a possibiliy to include header file(s) containing callback declarations.
      string DoIPHostNameSizeMax: multiplicity set at pre-compile, set at pre-compile, default-value=DoIP-, max-length=255, min-length=5  # This parameter defines the maximum size of the DHCP HostName in ASCII. The parameter is necessary to reserve the correct amount of bytes for working with the DHCP HostName option. Minimum range is 5 because Dhcp Host Name should be at least "DoIP-" on any configuration.
      float DoIPMainFunctionPeriod: 0..0.1, multiplicity set at pre-compile, set at pre-compile, default-value=0.005  # This parameter defines the main function call period.
      integer DoIPMaxRequestBytes: 1..4294967295, multiplicity set at pre-compile, set at pre-compile, default-value=4099  # This parameter defines the maximum allowed bytes of a DoIP message request without the DoIP header. If a message is received with a bigger size DoIP entity will sent a Generic Negative Acknowledge message with error code 0x02 (Message too large).
      integer DoIPMaxUDPRequestPerMessage: 1..255, multiplicity set at pre-compile, set at pre-compile, default-value=1  # This parameter captures the maximum amont of UDP Requests necessary to handle parallel within a single UDP connection.
      enumeration DoIPNodeType: {DOIP_GATEWAY, DOIP_NODE}, multiplicity set at pre-compile, set at pre-compile, default-value=DOIP_GATEWAY  # This parameter defines the type of the DoIP entity. DOIP_GATEWAY DoIP entity can route diagnostic data to other ECUs DOIP_NODE DoIP entity has a local diagnostic instance only The type is sent within the DoIP entity status response.
      boolean DoIPUseEIDasGID: multiplicity set at pre-compile, set at pre-compile, default-value=false  # Use EID as GID | This parameter defines if the DoIP entity shall use its EID if it is the Master for vehicle identification gid on the vehicle identification/vehicle announcement.
      boolean DoIPGetAndResetMeasurementDataApi: multiplicity set at pre-compile, origin=Vector Informatik, set at pre-compile, default-value=false  # Enable Get Reset Measurement Data API | This parameter enables/disables the function DoIP_GetAndResetMeasurementData() to get/reset the measurement data.
      boolean DoIPVersionInfoApi: multiplicity set at pre-compile, set at pre-compile, default-value=false  # Version Info API | This parameter enables/disables the function DoIP_GetVersionInfo() to get major, minor and patch version information. | TRUE: Enables the DoIP_GetVersionInfo() API. FALSE: DoIP_GetVersionInfo() API is not included.
      boolean DoIPVinGidMaster: multiplicity set at pre-compile, set at pre-compile, default-value=false  # VIN GID Master | This parameter defines if the DoIP entity is the Vehicle identification Master for the GID (Group ID).
      integer DoIPVinInvalidityPattern: 0..255, multiplicity set at pre-compile, set at pre-compile, default-value=0  # VIN Invalidity Pattern | This parameter defines the byte pattern that is used for response messages if no valid VIN could be retrieved.
      boolean DoIPSupportEntityState: multiplicity set at pre-compile, origin=Vector Informatik, set at pre-compile, default-value=false  # This parameter defines support of DoIP Entity Status messages. If disabled a DoIP Entity Status Request is handled as unknown payload type and will be responded with Generic DoIP Header Negative Acknowledge with error code 0x01.
      boolean DoIPSupportVidWithEId: multiplicity set at pre-compile, origin=Vector Informatik, set at pre-compile, default-value=false  # Support VID with EID | This parameter defines support of DoIP Vehicle Identification Request with EID (Entity ID). If disabled a Vehcile Identification Requeset with EID is handled as unknown payload type and will be responded with Generic DoIP Header Negative Acknowledge with error code 0x01.
      boolean DoIPSupportPduSizeRouting: multiplicity set at pre-compile, origin=Vector Informatik, set at pre-compile, default-value=false  # Support PDU Size Routing | This parameter defines support of PDU size depended routing. PDU size depended routing means that a specific target address can have multiple destinations (multiple DoIPTargetAddress container with same address). Destination is chosen according to length given in DoIPTargetMaxPduSize.
      string DoIPUserConfigFile [0..1]: multiplicity set at pre-compile, origin=Vector Informatik, set at pre-compile  # Reference to an external user configuration file that will be included during generation. The content of the user configuration file will be added at the end of the generated module configuration file and allows altering or extending the generated code. Caution: User configuration files can cause the software module to malfunction and must only be used with great care!
      integer DoIPTcpTxMgtQueueSize: 2..65535, multiplicity set at pre-compile, origin=Vector Informatik, set at pre-compile, default-value=2  # TCP Tx Queue Size | This parameter defines the number of TCP transmission requests the DoIP module can handle at the same time. All types of TCP messages will be stored in this queue (not Diagnostic Message only, e.g. Diagnostic Message Acknowledge).
      integer DoIPUdpTxMgtListSize: 1..65535, multiplicity set at pre-compile, origin=Vector Informatik, set at pre-compile, default-value=2  # UDP Tx List Size | This parameter defines the number of UDP transmission requests the DoIP module can handle at the same time. All types of UDP messages will be stored in this list. The list is shared by all UDP connections. All inital Vehicle Announcements are handled within one list entry.
      boolean DoIPSupportShutdown: multiplicity set at pre-compile, origin=Vector Informatik, set at pre-compile, default-value=false  # This parameter defines a service to shutdown TcpIp stack. Shutdown means that all sockets will be closed and modules will be set to a special shutdown state which can be revoked by an ECU reset.
      boolean DoIPSafeBswChecks: multiplicity set at pre-compile, origin=Vector Informatik, set at pre-compile, default-value=true  # Selects if safety checks are used. These checks improve robustness as e.g. invalid parameters are checked before function is executed. This attribute has to be enabled for safety projects where this component is mapped to an ASIL partition.
      boolean DoIPTcpRxMultiMessage: multiplicity set at pre-compile, origin=Vector Informatik, set at pre-compile, default-value=false  # TCP Rx Multi Message | This parameter defines if the DoIP multi message processing per receive cycle is enabled.
      integer DoIPTcpTxMgtQueueProcessLimit: 1..255, multiplicity set at pre-compile, origin=Vector Informatik, set at pre-compile, default-value=2  # TCP Tx Queue Process Limit | This parameter defines the number of TCP transmission requests the DoIP module can process in one main function cycle.
      boolean DoIPDhcpOptionVendorEntNum3210Use: multiplicity set at pre-compile, origin=Vector Informatik, set at pre-compile, default-value=false  # DHCP Option Vendor Enterprise Number 3210 use | This parameter defines if the DHCP vendor option for enterprise number 3210 is supported. This DHCP option contains a list of 1 to 4 IP addresses. After IP address assignment, additional vehicle announcements are sent to the IP addresses of this list.
      boolean DoIPOverwriteLogicalTargetAddressApi: multiplicity set at pre-compile, origin=Vector Informatik, set at pre-compile, default-value=false  # This parameter enables/disables the function DoIP_OverwriteLogicalTargetAddress() to overwrite the configured logical target address for a DoIP channel during runtime.
      boolean DoIPSupportGracefulClose: multiplicity set at pre-compile, origin=Vector Informatik, set at pre-compile, default-value=true  # This parameter enables/disables the graceful close strategy described in AUTOSAR AR-94866 where the DoIP closes a socket connection gracefully with a TCP FIN wherever possible instead of using a TCP RST. Starting with AUTOSAR R21-11 the graceful close strategy is the new DoIP default behavior.
      integer DoIPIfPayloadType [0..1]: 0..65535, multiplicity set at pre-compile, origin=Vector Informatik, set at pre-compile, default-value=32769  # This parameter specifies which payload type shall be used for IF-PDUs. This parameter is only applicable if an IF-PDU is configured.
      integer DoIPUserDataSizeOnStartOfReception: 1..65535, multiplicity set at pre-compile, origin=Vector Informatik, set at pre-compile, default-value=2  # User Data Size on StartOfReception | This parameter specifies the size of user data that shall be forwarded to the user on StartOfReception. By default, the value is set to 2 Byte which is in general the length of a UDS tester present. By forwarding the first part of the user data to the diagnostic application at this point in time enables the diagnostic application to identify tester present messages and it can decide to ignore those messages instead of rejecting them completely in case it is still busy with a previous message.
      integer DoIPProtocolVersion: 2..255, multiplicity set at pre-compile, origin=Vector Informatik, set at pre-compile, default-value=3  # This value specifies the DoIP protocol version used in the generic DoIP header. The valid range of this parameter is defined by the always latest release of ISO 13400-2 and can be extended with every new release of the ISO document. As example a value of 0x03 defines the ISO 13400-2:2019 release. Note: The version 0xFF should not be used as it is the default protocol version of the ISO.
      container DoIPGetVinCallback: multiplicity set at pre-compile  # This container includes a callback function to get the VIN (Vehicle Identification Number) of the DoIP entity.
        function name DoIPGetVinDirect: multiplicity set at pre-compile, origin=Vector Informatik, set at pre-compile  # This parameter defines a callback function to get the VIN (Vehicle Identification Number) of the DoIP entity.
      container DoIPShutdownFinishedCallback [0..1]: multiplicity set at pre-compile  # This container includes a callback function to notify an user about a finished shutdown which was previously requested by user.
        function name DoIPShutdownFinishedDirect: multiplicity set at pre-compile, origin=Vector Informatik, set at pre-compile  # This parameter defines a callback function to notify an user about a finished shutdown which was previously requested by user.
      container DoIPGetGidCallback [0..1]: multiplicity set at pre-compile  # This container describes the usage of a callback function to get the GID. (If this container is not present no callback function shall be used by DoIP module to retrive the GID.)
        function name DoIPGetGidDirect [0..1]: multiplicity set at pre-compile, set at pre-compile  # If the DoIPGetGidDirect parameter exist the DoIP module shall call the configured callback function (<User>_DoIPGetGID) direct. | If the DoIPGetGidDirect parameter does NOT exist the DoIP module shall use a RPort with a CallbackGetGID type of client-server port interface to retrive the GID.
      container DoIPPowerModeCallback: multiplicity set at pre-compile  # This container describes the usage of a callback function to retrieve the current power mode. This container shall always be present.
        function name DoIPPowerModeDirect [0..1]: multiplicity set at pre-compile, set at pre-compile  # If the DoIPPowerModeDirect parameter exist the DoIP module shall call the configured callback function (<User>_DoIPGetPowerModeCallback) direct. | If the DoIPPowerModeDirect parameter does NOT present the DoIP module shall use a RPort with a CallbackGetPowerMode type of client-server port interface to retrive the current power mode.
      container DoIPTriggerGidSyncCallback [0..1]: multiplicity set at pre-compile  # This container describes the usage of a callback function to trigger the GID synchronization. (If this container does not exist no callback function shall be used by DoIP module to trigger the GID synchronization.)
        function name DoIPTriggerGidSyncDirect [0..1]: multiplicity set at pre-compile, set at pre-compile  # If the DoIPTriggerGidSyncDirect parameter exist the DoIP module shall call the configured callback function (<User>_DoIPTriggerGidSyncCallback) direct. | If the DoIPTriggerGidSyncDirect parameter does NOT present the DoIP module shall use a RPort with a CallbackTriggerGIDSynchnonization type of client-server port interface to trigger the GID synchronization.
      container DoIPVerifyTargetAddressCallback [0..1]: multiplicity set at pre-compile  # This container includes a callback function to forward logical target address received within a diagnostic message to a user.
        function name DoIPVerifyTargetAddressDirect: multiplicity set at pre-compile, origin=Vector Informatik, set at pre-compile  # This parameter defines a callback function to forward logical target address received within a diagnostic message to a user. Via return value user can indicate if target address is accepted.
      container DoIPVerifyRxPduCallback [0..1]: multiplicity set at pre-compile  # This container contains a callback to verify if an Rx PDU is allowed to be received. The callback forwards local socket address, remote socket address, local tester logical address, remote tester logical address and a configured number of PDU data to a user. If callback fails SoAd drops the received PDU completely. Otherwise DoIP forwards the received diagnostic message.
        function name DoIPVerifyRxPduDirect: multiplicity set at pre-compile, origin=Vector Informatik, set at pre-compile, max-length=255, min-length=0  # This parameter defines the callback name for the Rx PDU verification.
        integer DoIPVerifyRxPduMaxDataLength: 0..255, multiplicity set at pre-compile, origin=Vector Informatik, set at pre-compile, default-value=0  # This parameter defines the number of received PDU data which are forwarded to the user for Rx PDU verification.
      container DoIPGeneration: multiplicity set at pre-compile  # Contains the generation configuration parameters of the module DoIP.
        enumeration DoIPOutOfBoundsWriteProtectionStrategy: multiplicity set at pre-compile, origin=Vector Informatik, set at pre-compile, default-value=NONE  # This parameter is used to configure a strategy to protect the code to write out of bounds. NONE: no protection strategy is generated in the data access. INDEX_SATURATION: arrays are blown up and the data access index is saturated by an appropriate mask. The advantage is the speed of the data access, but own data elements at other indexes of the same variable can be overridden. INDEX_CHECKING: the data access index is validated by a runtime check. The advantage is that values are never written to incorrect indexes of the data access.
          NONE  # none
          INDEX_SATURATION  # index saturation
          INDEX_CHECKING  # index checking
        boolean DoIPOutOfBoundsWriteSanitizer: multiplicity set at pre-compile, origin=Vector Informatik, set at pre-compile, default-value=false  # This parameter activates/deactivates the generation of runtime checks which call a DET error notification function to find easily out of bounds write problems. FALSE: no checks are generated in the data access. TRUE: the data access is enriched with DET checks to validate indexes.
        boolean DoIPOutOfBoundsReadSanitizer: multiplicity set at pre-compile, origin=Vector Informatik, set at pre-compile, default-value=false  # This parameter activates/deactivates the generation of runtime checks which call a DET error notification function to find easily out of bounds read problems. FALSE: no checks are generated in the data access. TRUE: the data access is enriched with DET checks to validate indexes.
        boolean DoIPReduceConstantData2Define: multiplicity set at pre-compile, origin=Vector Informatik, set at pre-compile, default-value=false  # Reduce Constant Data To a Define | This parameter activates/deactivates the capability to generate CONFIG-CLASS PRE-COMPILE ROM arrays as constant define. FALSE: ROM arrays are generated as data even if all values are identical. TRUE: ROM arrays are generated as constant define if all values are identical.
        enumeration DoIPBoolDataInArrayOfStructStrategy: multiplicity set at pre-compile, origin=Vector Informatik, set at pre-compile, default-value=BITMASKING  # This parameter is used to tailor the usage of boolean data in structures in all CONFIG-CLASSES ROM data. The difference between BITFIELD and BITMASKING depends on your compiler options and memory mapping. BOOLEAN: the datatype of boolean data is native boolean. BITFIELD: the bitfield type is used and the compiler extracts the boolean data from structures. BITMASKING: generated masks are used to extract the boolean data from structures.
          BOOLEAN  # boolean
          BITFIELD  # bitfield
          BITMASKING  # bitmasking
        boolean DoIPDeduplicateIndirectedData: multiplicity set at pre-compile, origin=Vector Informatik, set at pre-compile, default-value=true  # This parameter activates/deactivates the capability to compress 0:N relational ROM data in all CONFIG-CLASSES without increasing the runtime. FALSE: 0:N relational ROM data is not compressed. TRUE: 0:N relational ROM data is compressed without increasing the runtime.
        enumeration DoIPDataDeduplicationStrategy: multiplicity set at pre-compile, origin=Vector Informatik, set at pre-compile, default-value=DEDUPLICATE_CONST_DATA_WITH_CAST  # This parameter is used to taylor the the deduplication of CONFIG-CLASS PRE-COMPILE ROM data. NONE: The generated data is not deduplicated. DEDUPLICATE_CONST_DATA_WITHOUT_CAST: The data is deduplicated without using casts. DEDUPLICATE_CONST_DATA_WITH_CAST: The data is deduplicated using casts.
          NONE  # none
          DEDUPLICATE_CONST_DATA_WITHOUT_CAST  # deduplicate const data without cast
          DEDUPLICATE_CONST_DATA_WITH_CAST  # deduplicate const data with cast
        integer DoIPReduceBoolDataByNegationThreshold: 0..9223372036854775807, multiplicity set at pre-compile, origin=Vector Informatik, set at pre-compile, default-value=2  # This parameter activates/deactivates the capability to compress boolean CONFIG-CLASS PRE-COMPILE ROM data by using the negation operator. 0: The optimization is deactivated. >0: If the number of deduplicateable elements is greater than this threshold the data optimization can be performed.
        integer DoIPReduceBoolDataByNumericalComparisonThreshold: 0..9223372036854775807, multiplicity set at pre-compile, origin=Vector Informatik, set at pre-compile, default-value=2  # This parameter activates/deactivates the capability to compress boolean CONFIG-CLASS PRE-COMPILE ROM data by using numerical comparison with other ROM data. 0: The optimization is deactivated. >0: If the number of deduplicateable elements is greater than this threshold the data optimization can be performed.
        integer DoIPReduceBoolDataByNumericalRelationThreshold: 0..9223372036854775807, multiplicity set at pre-compile, origin=Vector Informatik, set at pre-compile, default-value=2  # This parameter activates/deactivates the capability to compress boolean CONFIG-CLASS PRE-COMPILE ROM data by using relational comparison with other ROM data. 0: The optimization is deactivated. >0: If the number of deduplicateable elements is greater than this threshold the data optimization can be performed.
        enumeration DoIPReduceBoolDataByNumericalOperandStrategy: multiplicity set at pre-compile, origin=Vector Informatik, set at pre-compile, default-value=DEDUPLICATE_DATA_WITH_ANY_VALUE  # This parameter is used to taylor the CONFIG-CLASS PRE-COMPILE ROM bool data with number deduplication mechanisms. A comparison with 0 is very efficient, but a numerical comparison with a value not 0 can be used to increase the ROM data compression rate. NONE: ROM data deduplications are switched off. DEDUPLICATE_DATA_WITH_ZERO: ROM data deduplications can be applied with the value 0. DEDUPLICATE_DATA_WITH_ANY_VALUE: ROM data deduplications can be applied with any numerical value.
          NONE  # none
          DEDUPLICATE_DATA_WITH_ZERO  # deduplicate data with zero
          DEDUPLICATE_DATA_WITH_ANY_VALUE  # deduplicate data with any value
        integer DoIPReduceNumericalDataByOffsetThreshold: 0..9223372036854775807, multiplicity set at pre-compile, origin=Vector Informatik, set at pre-compile, default-value=2  # This parameter activates/deactivates the capability to compress numerical CONFIG-CLASS PRE-COMPILE ROM data by using a constant offset. 0: The optimization is deactivated. >0: If the number of deduplicateable elements is greater than this threshold the data optimization can be performed.
        integer DoIPReduceNumericalDataByArraySubtractionThreshold: 0..9223372036854775807, multiplicity set at pre-compile, origin=Vector Informatik, set at pre-compile, default-value=2  # This parameter activates/deactivates the capability to compress numerical CONFIG-CLASS PRE-COMPILE ROM data by using a subtraction with other ROM data. 0: The optimization is deactivated. >0: If the number of deduplicateable elements is greater than this threshold the data optimization can be performed.
        boolean DoIPShortSymbols: multiplicity set at pre-compile, origin=Vector Informatik, set at pre-compile, default-value=false  # This parameter activates/deactivates the capability to generate shortened symbol names. FALSE: symbol names are generated in a human readable style based on the MIP, tags and variant names. TRUE: symbol names are generated based on the MIP and a CRC32.
        boolean DoIPInterfacesForDeactivatedData: multiplicity set at pre-compile, origin=Vector Informatik, set at pre-compile, default-value=false  # This parameter activates/deactivates the capability to generate bsw data interfaces for deactivated data elements. This is an advantage for the BSW developer to reduce the time to market with a development environment using auto completition and to investigate potential interfaces. FALSE: data interfaces are not generated if the data elementis deactivated. TRUE: data interfaces are generated as e.g. emty macros.
        boolean DoIPReferringKeysInComments: multiplicity set at pre-compile, origin=Vector Informatik, set at pre-compile, default-value=false  # This parameter activates/deactivates the capability to generate referring keys in comments. This is an advantage for the developer to investigate indirections, but this feature reduces the overall readability of the generated data. FALSE: referring keys are not generated in comments. TRUE: referring keys are generated in comments.
      container DoIPActivationLineStateChgCallback [0..1]: multiplicity set at pre-compile  # This container includes a callback to notify a user about an activation line state change.
        function name DoIPActivationLineStateChg: multiplicity set at pre-compile, origin=Vector Informatik, set at pre-compile  # This parameter defines a callback function to notify a user about an activation line state change which was previously requested by user.
      container DoIpUseSecureCommunicationCallback [0..1]: multiplicity set at pre-compile  # This container includes a callback function to check if secure communication shall be used.
        function name DoIpUseSecureCommunicationDirect: multiplicity set at pre-compile, origin=Vector Informatik, set at pre-compile  # This parameter defines a callback function to check if secure communication shall be used.
  bsw implementation DoIP_Impl: programming-language=C, sw-version=16.00.00, used-code-generator=DaVinci Configurator, vendor-id=30, ar-release-version=4.05.00, behavior=DoIPBehavior, preconfigured-configuration=DoIP_Pre, recommended-configuration=DoIP_Rec, vendor-specific-module-def=DoIP
  module config DoIP_Pre: definition=DoIP
  module config DoIP_Rec: definition=DoIP
