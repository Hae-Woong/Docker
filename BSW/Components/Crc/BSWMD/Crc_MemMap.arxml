AUTOSAR XML (schema 00048)
# COPYRIGHT
# Copyright (c) 2022 by Vector Informatik GmbH. All rights reserved.
# This software is copyright protected and proprietary to Vector Informatik GmbH.
# Vector Informatik GmbH grants to you only those rights as set out in the license conditions.
package /MICROSAR
  bsw implementation Crc_Impl
    required-artifacts:
      dependency on artifact Crc_MemMap: category=MEMMAP, artifact-descriptor={short-label=Crc_MemMap.h, category=SWHDR}
    resource consumption ResourceConsumption
      5 x memory section:
        CRC_CODE: sw-addrmethod=CODE, symbol=CODE
        CRC_CONST_8: alignment=8, sw-addrmethod=CONST, symbol=CONST_8
        CRC_CONST_16: alignment=16, sw-addrmethod=CONST, symbol=CONST_16
        CRC_CONST_32: alignment=32, sw-addrmethod=CONST, symbol=CONST_32
        CRC_CONST_64: alignment=64, sw-addrmethod=CONST, symbol=CONST_64
