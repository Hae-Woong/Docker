AUTOSAR XML (schema 4-0-3)
package /MICROSAR
  bsw implementation IpBase_Impl: programming-language=C, sw-version=4.02.01, vendor-id=30, ar-release-version=4.00.03, vendor-specific-module-def=IpBase
  module definition IpBase: category=VENDOR_SPECIFIC_MODULE_DEFINITION, refined-module-def=IpBase, variants pre-compile
    container IpBaseGeneral
      boolean IpBaseDevErrorReport: set at pre-compile, origin=Vector Informatik, default-value=true  # If true then IpBase will enable the error-reporting to the Development Error Tracer (DET).
      boolean IpBaseEnableInlineFunctions: set at pre-compile, origin=Vector Informatik, default-value=true  # If true then IpBase will enable inline functions for Byte swap, put and get macros and internal functions. Can be switched off to ease white box testing and debugging.
      boolean IpBaseOneStepChecksumCopy: set at pre-compile, origin=Vector Informatik, default-value=false  # If true then IpBase will copy and checksum calculation in one step. Enabling will speed up the calculation but increase the code size (ROM). Switching off may help in case of memory alignment issues.
      enumeration IpBaseSizeOfRamPointer: {uint32, uint64}, set at pre-compile, origin=Vector Informatik, default-value=uint32  # Configure the bit size of RAM pointers used for the UDP and TCP data type for the checksumm calculation. Pointer size equals the CPU register size on most platforms.
