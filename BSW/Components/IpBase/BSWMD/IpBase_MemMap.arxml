AUTOSAR XML (schema 00048)
# COPYRIGHT
# Copyright (c) 2022 by Vector Informatik GmbH. All rights reserved.
# This software is copyright protected and proprietary to Vector Informatik GmbH.
# Vector Informatik GmbH grants to you only those rights as set out in the license conditions.
package /MICROSAR
  bsw implementation IpBase_Impl
    required-artifacts:
      dependency on artifact IpBase_MemMap: category=MEMMAP, artifact-descriptor={short-label=IpBase_MemMap.h, category=SWHDR}
    resource consumption ResourceConsumption
      9 x memory section:
        IPBASE_CODE: sw-addrmethod=CODE, symbol=CODE
        IPBASE_CONST_8: alignment=8, sw-addrmethod=CONST, symbol=CONST_8
        IPBASE_CONST_16: alignment=16, sw-addrmethod=CONST, symbol=CONST_16
        IPBASE_CONST_32: alignment=32, sw-addrmethod=CONST, symbol=CONST_32
        IPBASE_CONST_UNSPECIFIED: alignment=UNSPECIFIED, sw-addrmethod=CONST, symbol=CONST_UNSPECIFIED
        IPBASE_VAR_NO_INIT_8: alignment=8, sw-addrmethod=VAR_NO_INIT, symbol=VAR_NO_INIT_8
        IPBASE_VAR_NO_INIT_16: alignment=16, sw-addrmethod=VAR_NO_INIT, symbol=VAR_NO_INIT_16
        IPBASE_VAR_NO_INIT_32: alignment=32, sw-addrmethod=VAR_NO_INIT, symbol=VAR_NO_INIT_32
        IPBASE_VAR_NO_INIT_UNSPECIFIED: alignment=UNSPECIFIED, sw-addrmethod=VAR_NO_INIT, symbol=VAR_NO_INIT_UNSPECIFIED
