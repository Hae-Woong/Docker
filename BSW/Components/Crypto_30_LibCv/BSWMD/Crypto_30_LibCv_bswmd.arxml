AUTOSAR XML (schema 4-0-3)
# COPYRIGHT
# Copyright (c) 2024 by Vector Informatik GmbH. All rights reserved.
# This software is copyright protected and proprietary to Vector Informatik GmbH.
# Vector Informatik GmbH grants to you only those rights as set out in the license conditions.
package /MICROSAR/Crypto_30_LibCv
  bsw implementation Crypto_Impl: programming-language=C, sw-version=14.00.00, used-code-generator=DaVinci Configurator, vendor-id=30, ar-release-version=4.03.00, behavior=Crypto_30_LibCv, preconfigured-configuration=Crypto_Pre, recommended-configuration=Crypto_Rec, vendor-api-infix=LibCv, vendor-specific-module-def=Crypto
  module definition Crypto [0..1]: category=VENDOR_SPECIFIC_MODULE_DEFINITION, refined-module-def=Crypto, variants pre-compile  # The Crypto Driver (CRYPTO) is called by the Crypto Interface (CRYIF) and performs the specific cryptographic functionality. The Crypto Driver specification by AUTOSAR offers a key storage and a superset of algorithms which can be extended by custom algorithms. This software-based Crypto Driver offers a subset of algorithms and features. #Security #Crypto #Cryptography #Key #SHE #AUTOSAR
    container CryptoDriverObjects  # Container for Crypto Driver Objects
      container CryptoDriverObject [1..*]  # Container for configuration of Crypto Driver Object. The container name serves as a symbolic name for the identifier of a Crypto Driver Object.
        integer CryptoDriverObjectId: 0..4294967295, set at pre-compile, symbolic-name-value=true, default-value=0  # Identifier of the Crypto Driver Object. The Crypto Driver Object offers different crypto primitives.
        integer CryptoDriverObjectQueueSize: 1..1, set at pre-compile, default-value=1  # Size of the queue in the Crypto Driver. Defines the maximum number of jobs in the Crypto Driver Object queue. If it is set to 0, queueing is disabled in the Crypto Driver Object. This Crypto Driver does not support queuing but uses the buffer for asynchronous processing therefore the value need to be set to 1.
        reference CryptoPrimitiveRef [1..*]: set at pre-compile, destination=CryptoPrimitive  # Refers to primitive in the CRYPTO. The CryptoPrimitive is a pre-configured container of the crypto service that shall be used.
        reference CryptoDefaultRandomKeyRef [0..1]: set at pre-compile, destination=CryptoKey  # This is a reference to the CryptoKey that is used by the CryptoDefaultRandomPrimitiveRef. The key contains key elements that are necessary to seed the random number generator. This element shall only be set if the primitive referenced by CryptoDefaultRandomPrimitiveRef requires a seed value. The reference has to be different for each partition.
        reference CryptoDefaultRandomPrimitiveRef [0..1]: set at pre-compile, destination=CryptoPrimitive  # This is a reference to a primitive that configures a default random number generator. If a crypto driver object needs to perform a crypto primitive that requires a random number generator, but the configuration of this primitive does not provide parameter for a random number generator, then this default random number generator shall be used (i.e. the elements of algorithm family, secondary algorithm family and algorithm mode do not provide this information). Example: The crypto driver shall generate a signature based on elliptic curve but the primitive for signature generation lacks information about a random number generator.
        reference CryptoDriverObjectEcucPartitionRef [0..1]: set at pre-compile, destination=EcucPartition  # Maps a crypto driver object to zero or one ECUC partition. The ECUC partition referenced is a subset of the ECUC partitions where the Crypto driver is mapped to.
    container CryptoGeneral  # Container for common configuration options.
      boolean CryptoVersionInfoApi: set at pre-compile, default-value=false  # Pre-processor switch to enable and disable availability of the API Crypto_GetVersionInfo(). - True: API Crypto_GetVersionInfo() is available - False: API Crypto_GetVersionInfo() is not available.
      float CryptoMainFunctionPeriod: 0..3600, set at pre-compile, default-value=0.01  # Specifies the period of main function Crypto_MainFunction in seconds.
      boolean CryptoDevErrorDetect: set at pre-compile, default-value=true  # Switches the development error detection and notification on or off. - True: detection and notification is enabled. - False: detection and notification is disabled. | True: Development error detection enabled. False: Development error detection disabled
      boolean CryptoSafeBswChecks: set at pre-compile, origin=Vector Informatik, default-value=false  # Selects if safety checks are used. These checks improve robustness as e.g. invalid parameters are checked before function is executed. This attribute has to be enabled for safety projects where this component is mapped to an ASIL partition.
      boolean CryptoUseVStdLib: set at pre-compile, origin=Vector Informatik, default-value=true  # Use VStdLib | If enabled the VStdLib is used for copy and clear data operations. If there is no VStdLib, disable the switch to use the implementation of the Crypto.
      boolean CryptoKeyElementDelete: set at pre-compile, origin=Vector Informatik, default-value=false  # If Crypto_KeyElementSet is called with the length 0 the key will be overwritten with 0 and the length is set to 0. If KeyElementDelete is enabled the standard AUTOSAR DET check for the given key element length in Crypto_KeyElementSet will be disabled.
      boolean CryptoAlignKeyStorage: set at pre-compile, origin=Vector Informatik, default-value=false  # Enable, to align each key inside the KeyStorage. The KeyStorage size will increase but the access will be faster.
      boolean CryptoNvMEnableSetRamBlockStatus: set at pre-compile, origin=Vector Informatik, default-value=true  # NvM Enable SetRamBlockStatus | Select if SetRamBlockStatus shall be called in KeyValidSet.
      boolean CryptoRedirection: set at pre-compile, origin=Vector Informatik, default-value=false  # Enable job input/output redirection to key elements. This is a Autosar 4.4 feature. Therefore a Csm and CryIf is required which also supports this feature
      function name CryptoWatchdogTriggerFunction [0..1]: set at pre-compile, origin=Vector Informatik, default-value=Appl_WatchdogTriggerFunction, min-length=1  # This function is called by the vSecPrim to trigger the watchdog. The vSecPrim watchdog level need to be set additional. void "WatchdogTriggerFunction"(void)
      integer CryptoDefaultRandomMaxRetries: 1..65535, set at pre-compile, origin=Vector Informatik, default-value=10  # Number of max retries for default random number generation. The calculation is reexecuted if the default random source is used from two driver objects at the same time.
      string CryptoUserConfigFile [0..1]: set at pre-compile, origin=Vector Informatik, min-length=1  # Reference to an external user configuration file that will be included during generation. The content of the user configuration file will be added at the end of the generated module configuration file and allows altering or extending the generated code. Caution: User configuration files can cause the software module to malfunction and must only be used with great care!
      integer CryptoNumberOfLongTermPrimitiveWorkspace: 0..255, set at pre-compile, origin=Vector Informatik, default-value=0  # Determines the number of workspaces used for long term primitive execution. See Technical Reference for more information including which primitives use this workspace, (for example Spake2+ and ECBD Key Exchange).
      boolean CryptoStrictLengthCheckForKeyElementGet: set at pre-compile, origin=Vector Informatik, default-value=true  # This option only affects key elements which have partial access enabled. Enabled: KeyElementGet does not allow partially reading key elements, only complete reads of key elements are allowed. Disabled: KeyElementGet allows partially reading key elements depending on the available buffer size.
      boolean CryptoEnableKeyLocking: set at pre-compile, origin=Vector Informatik, default-value=true  # true: Enables the protection of keys while they are used. It is recommended for single-partition usecases. If this should be used for multi-partition usecases, please check the technical references for the necessary adaptions. false: Disables the protection of keys while they are used. This is recommended to be set for multi-partition usecases. The user must ensure that key elements are only changed when they are not accessed (read or write) by any other user (different contexts or cores). Please see the individual API definitions to check when a key element is changed.
      boolean CryptoMultiPartitionRuntimeChecks: set at pre-compile, origin=Vector Informatik, default-value=false  # If enabled, additional checks are performed to - prevent the usage of driver objects by wrong partitions - prevent the usage of SHE functionality by other partitions than the main partition - prevent the initialization of the module by unknown partitions - prevent the usage of default random source by unknown partitions. All partitions referenced in CryptoEcucPartitionRef are known to the module.
      reference CryptoEcucPartitionRef [0..*]: set at pre-compile, destination=EcucPartition  # Maps the Crypto driver to zero or multiple ECUC partitions to make the modules API available in this partition. It must contain all partitions which will use the Crypto driver.
      reference CryptoMainEcucPartitionRef [0..1]: set at pre-compile, origin=Vector Informatik, destination=EcucPartition  # Defines the main partition is responsible for the initialization of the shared data of the Crypto driver. The main partition also is the only partition which can use SHE functionality and persist key elements. NvM has to be located on this partition if key element persisting should be used.
      container CryptoKeyExchangePrimitives  # Configuration of a Crypto Key Exchange Primitive. If there is an algorithm configured, key exchange is usable via Crypto_KeyExchangeCalcPubVal and Crypto_KeyExchangeCalcSecret API.
        enumeration CryptoKeyExchangeAlgorithm [0..*]: {CRYPTO_KEY_EXCHANGE_ALGORITHM_X25519, CRYPTO_KEY_EXCHANGE_ALGORITHM_ANSIP256R1, CRYPTO_KEY_EXCHANGE_ALGORITHM_SECP256R1, CRYPTO_KEY_EXCHANGE_ALGORITHM_SECP384R1, CRYPTO_KEY_EXCHANGE_ALGORITHM_SPAKE2_PLUS_CIPHERSUITE_8, CRYPTO_KEY_EXCHANGE_ALGORITHM_NISTP224R1_BD, CRYPTO_KEY_EXCHANGE_ALGORITHM_SECP521R1, CRYPTO_KEY_EXCHANGE_ALGORITHM_X448, CRYPTO_KEY_EXCHANGE_ALGORITHM_P256R1_BD}, set at pre-compile, origin=Vector Informatik, default-value=CRYPTO_KEY_EXCHANGE_ALGORITHM_X25519  # Determines the algorithm used for the crypto key exchange. The exact algorithm specification can be found in the technical reference of this component. Disable to save ROM. Equivalent algorithms: - SECp384r1 = NIST P-384 - SECp521r1 = NIST P-521
      container CryptoKeyDerivePrimitives  # If enabled, key derivation is usable via Crypto_KeyDerive API.
        enumeration CryptoKeyDeriveAlgorithm [0..*]: {CRYPTO_KDF_ALGO_ASYM_NIST_FIPS_186_4_ERB, CRYPTO_KDF_ALGO_SYM_NIST_800_108_CNT_MODE_SHA256, CRYPTO_KDF_ALGO_ISO_15118_CERTIFICATE_HANDLING, CRYPTO_KDF_ALGO_NIST_800_56_A_ONE_PASS_C1E1S_SINGLE_STEP_KDF_SHA256, CRYPTO_KDF_ALGO_X963_SHA256, CRYPTO_KDF_ALGO_PBKDF2_HMAC_SHA1, CRYPTO_KDF_ALGO_PBKDF2_HMAC_SHA256, CRYPTO_KDF_ALGO_X963_SHA512, CRYPTO_KDF_ALGO_HKDF_HMAC_SHA256, CRYPTO_KDF_ALGO_SPAKE2_PLUS_P256R1, CRYPTO_KDF_ALGO_HKDF_OPTION1_SHA256, CRYPTO_KDF_ALGO_HKDF_HMAC_SHA384, CRYPTO_KDF_ALGO_HKDF_OPTION1_SHA512, CRYPTO_KDF_ALGO_ISO_15118_20_CERTIFICATE_HANDLING, CRYPTO_KDF_ALGO_HKDF_EXPAND_HMAC_SHA256, CRYPTO_KDF_ALGO_HKDF_EXPAND_HMAC_SHA384}, set at pre-compile, origin=Vector Informatik, default-value=CRYPTO_KDF_ALGO_SYM_NIST_800_108_CNT_MODE_SHA256  # Determines the algorithm used for the crypto key derive. The exact algorithm specification can be found in the technical reference of this component. Disable to save ROM.
      container CryptoMacPrimitives  # Determines the algorithm used for the crypto mac jobs.
        boolean CryptoCmacAesRoundkeyReuse: set at pre-compile, origin=Vector Informatik, default-value=false  # The AES CMAC supports the reuse of calculated AES round keys. If this feature is enabled the round keys are hold in the driver object. The round keys are hold until a different job type is processed (not CMAC AES128 and CMAC AES256) or the corresponding key has changed.
      container CryptoCipherPrimitives  # Determines the algorithm used for the crypto cipher jobs.
        boolean CryptoEnableAES192: set at pre-compile, origin=Vector Informatik, default-value=false  # Enable AES 192 for driver objects with AES. Otherwise only AES 128 is available.
        boolean CryptoEnableAES256: set at pre-compile, origin=Vector Informatik, default-value=false  # Enable AES 256 for driver objects with AES. Otherwise only AES 128 is available.
      container CryptoKeyGeneratePrimitives  # If enabled, key generate is usable via Crypto_KeyGenerate API.
        enumeration CryptoKeyGenerateAlgorithm [0..*]: {CRYPTO_KEY_GENERATE_ALGORITHM_SYMMETRIC_GENERIC, CRYPTO_KEY_GENERATE_ALGORITHM_ANSI_NIST_SEC_P256R1, CRYPTO_KEY_GENERATE_ALGORITHM_NIST_SEC_P384R1, CRYPTO_KEY_GENERATE_ALGORITHM_ED25519, CRYPTO_KEY_GENERATE_ALGORITHM_NIST_SEC_P521R1, CRYPTO_KEY_GENERATE_ALGORITHM_SM2P256V1}, set at pre-compile, origin=Vector Informatik, default-value=CRYPTO_KEY_GENERATE_ALGORITHM_SYMMETRIC_GENERIC  # Determines the algorithm used for the crypto key generation. Disable to save ROM.
        integer CryptoKeyGenerateMaxLength: 1..65535, set at pre-compile, origin=Vector Informatik, default-value=32  # Select the max key length in bytes.This parameter is only used for CRYPTO_KEY_GENERATE_ALGORITHM_SYMMETRIC_GENERIC.
      container CryptoConfigurableCallouts  # This container is used for the callouts to notify the application. Activating the callouts costs runtime, so it is recommended to activate them only when needed.
        function name CryptoKeyValueChangedCalloutFctName [0..1]: set at pre-compile, origin=Vector Informatik, default-value=Appl_KeyValueChangedCallout, min-length=1  # This function is called by the LibCv to notify the application when a key value was changed. This function is only available if the callout name is set, otherwise it is disabled. It notifies which key element of the key was changed. If the keys are set to their initial value, the callout will not occur. The limitations are documented in the technical reference.
        function name CryptoKeyValiditySetCalloutFctName [0..1]: set at pre-compile, origin=Vector Informatik, default-value=Appl_KeyValiditySetCallout, min-length=1  # This function is called by the LibCv to notify the application when the validity of the key has changed. This function is only available if the callout name is set, otherwise it is disabled. The limitations are documented in the technical reference.
    container CryptoKeyElements [0..1]  # Container for CRYPTO key elements.
      container CryptoKeyElement [1..*]  # Configuration of a CryptoKeyElement
        integer CryptoKeyElementId: 0..4294967295, set at pre-compile, symbolic-name-value=true, default-value=1  # Identifier of the CRYPTO key element
        integer CryptoKeyElementSize: 1..4294967295, set at pre-compile, default-value=16  # Maximum size of a CRYPTO key element in bytes
        string CryptoKeyElementInitValue [0..1]: set at pre-compile, default-value=0 0 0 0 0 0 0 0 0 0 0 0 0 0 0 0  # Value which will be used to fill the element during initialization, when the element is not already initialized.
        enumeration CryptoKeyElementReadAccess: {RA_ALLOWED, RA_DENIED, RA_ENCRYPTED, RA_INTERNAL_COPY}, set at pre-compile, default-value=RA_ALLOWED  # Define the reading access rights of the key element. CRYPTO_RA_DENIED = key element cannot be read from outside the Crypto Driver CRYPTO_RA INTERNAL_COPY = key element can be copied to another key element in the same crypto driver. CRYPTO_RA_ALLOWED = key element can be read as plaintext CRYPTO_RA_ENCRYPTED = key element can be read encrypted. E.g. SHE Ram-Key export.
        boolean CryptoKeyElementAllowPartialAccess: set at pre-compile, default-value=false  # Enable or disable writing and reading the key element with data smaller than the size of the element. - True: enable partial access of the key element - False: disable partial access of the key element
        boolean CryptoKeyElementPersist: set at pre-compile, default-value=false  # Enable or disable persisting of the key element in non-volatile storage. - True: enable persisting of the key element. - False: disable persisting of the key element.
        enumeration CryptoKeyElementWriteAccess: {WA_ALLOWED, WA_DENIED, WA_ENCRYPTED, WA_INTERNAL_COPY}, set at pre-compile, default-value=WA_ALLOWED  # Define the writing access rights of the key element CRYPTO_WA_DENIED = key element cannot be written from outside the Crypto Driver CRYPTO_WA INTERNAL_COPY = key element can be filled with another key element in the same crypto driver. CRYPTO_WA_ALLOWED = key element can be rewritten as plaintext CRYPTO_WA_ENCRYPTED = key element can be written encrypted. E.g. SHE load key.
        enumeration CryptoKeyElementFormat: {CRYPTO_KE_FORMAT_BIN_OCTET, CRYPTO_KE_FORMAT_BIN_SHEKEYS, CRYPTO_KE_FORMAT_BIN_IDENT_PRIVATEKEY_PKCS8, CRYPTO_KE_FORMAT_BIN_IDENT_PUBLICKEY, CRYPTO_KE_FORMAT_BIN_RSA_PRIVATEKEY, CRYPTO_KE_FORMAT_BIN_RSA_PUBLICKEY}, set at pre-compile, default-value=CRYPTO_KE_FORMAT_BIN_OCTET  # Defines the format for the key element. This is the format used to provide or extract the key data from the driver. Parameter not used.
        boolean CryptoKeyElementWriteOnce: set at pre-compile, origin=Vector Informatik, default-value=false  # Determine if a key shall only be writeable once. - non-persist keys: Only once after start-up. - persist keys: Only once for all time. A init value does not affects this behavior. If a init value shall not be overwritable use CRYPTO_WA_DENIED.
        reference CryptoKeyElementVirtualTargetRef [0..1]: set at pre-compile, destination=CryptoKeyElement  # Refers to a key element which will contain the actual data. If the Reference is configured, the key element will be a virtual key element. Parameter not used.
    container CryptoKeyTypes [0..1]  # Container for CRYPTO key types
      container CryptoKeyType [1..*]  # Configuration of a CryptoKeyType
        reference CryptoKeyElementRef [1..*]: set at pre-compile, destination=CryptoKeyElement  # Refers to a pointer in the CRYPTO Key Element, which holds the data of the crypto key element.
    container CryptoKeys [0..1]  # Container for CRYPTO keys
      container CryptoKey [1..*]  # Configuration of a CryptoKey
        integer CryptoKeyId: 0..4294967295, set at pre-compile, symbolic-name-value=true, default-value=0  # Identifier of the CRYPTO key
        integer CryptoKeyDeriveIterations: 1..4294967295, set at pre-compile, default-value=1  # Holds the number of iterations to be performed by the key derivation primitive. Parameter not used.
        integer CryptoKeyNvId: 0..65535, set at pre-compile, origin=Vector Informatik, default-value=0  # The CRYPTO_KEY_NV_ID is used to give a key a unique id for the complete lifecycle even if the CRYPTO_KEY_ID changed. The CRYPTO_KEY_NV_ID is used to identify a key within the Nv Block over several different configurations.
        reference CryptoKeyTypeRef: set at pre-compile, destination=CryptoKeyType  # Refers to a pointer in the CRYPTO to a CryptoKeyType. The CryptoKeyType provides the information which key elements are contained in a CryptoKey.
    container CryptoPrimitives [0..1]  # Container for CRYPTO primitives
      container CryptoPrimitive [0..*]  # Configuration of a CryptoPrimitive
        enumeration CryptoPrimitiveAlgorithmFamily [1..*]: {CRYPTO_ALGOFAM_3DES, CRYPTO_ALGOFAM_AES, CRYPTO_ALGOFAM_BLAKE_1_256, CRYPTO_ALGOFAM_BLAKE_1_512, CRYPTO_ALGOFAM_BLAKE_2s_256, CRYPTO_ALGOFAM_BLAKE_2s_512, CRYPTO_ALGOFAM_BRAINPOOL, CRYPTO_ALGOFAM_CHACHA, CRYPTO_ALGOFAM_CUSTOM, CRYPTO_ALGOFAM_CUSTOM_DRBG, CRYPTO_ALGOFAM_CUSTOM_ECCANSI, CRYPTO_ALGOFAM_CUSTOM_ECCSEC, CRYPTO_ALGOFAM_CUSTOM_FIPS186, CRYPTO_ALGOFAM_CUSTOM_HKDF, CRYPTO_ALGOFAM_CUSTOM_ISO15118, CRYPTO_ALGOFAM_CUSTOM_MD5, CRYPTO_ALGOFAM_CUSTOM_SPAKE2_PLUS, CRYPTO_ALGOFAM_CUSTOM_X25519, CRYPTO_ALGOFAM_DH, CRYPTO_ALGOFAM_DRBG, CRYPTO_ALGOFAM_ECCANSI, CRYPTO_ALGOFAM_ECCNIST, CRYPTO_ALGOFAM_ECCSEC, CRYPTO_ALGOFAM_ECDH, CRYPTO_ALGOFAM_ECDSA, CRYPTO_ALGOFAM_ECIES, CRYPTO_ALGOFAM_ED25519, CRYPTO_ALGOFAM_EEA3, CRYPTO_ALGOFAM_EIA3, CRYPTO_ALGOFAM_FIPS186, CRYPTO_ALGOFAM_HKDF, CRYPTO_ALGOFAM_KDFX963, CRYPTO_ALGOFAM_NOT_SET, CRYPTO_ALGOFAM_PADDING_ONEWITHZEROS, CRYPTO_ALGOFAM_PADDING_PKCS7, CRYPTO_ALGOFAM_PBKDF2, CRYPTO_ALGOFAM_POLY1305, CRYPTO_ALGOFAM_RIPEMD160, CRYPTO_ALGOFAM_RNG, CRYPTO_ALGOFAM_RSA, CRYPTO_ALGOFAM_SECURECOUNTER, CRYPTO_ALGOFAM_SHA1, CRYPTO_ALGOFAM_SHA2_224, CRYPTO_ALGOFAM_SHA2_256, CRYPTO_ALGOFAM_SHA2_384, CRYPTO_ALGOFAM_SHA2_512, CRYPTO_ALGOFAM_SHA2_512_224, CRYPTO_ALGOFAM_SHA2_512_256, CRYPTO_ALGOFAM_SHA3_224, CRYPTO_ALGOFAM_SHA3_256, CRYPTO_ALGOFAM_SHA3_384, CRYPTO_ALGOFAM_SHA3_512, CRYPTO_ALGOFAM_SHAKE128, CRYPTO_ALGOFAM_SHAKE256, CRYPTO_ALGOFAM_SIPHASH, CRYPTO_ALGOFAM_SM2, CRYPTO_ALGOFAM_SM3, CRYPTO_ALGOFAM_X25519}, set at pre-compile, default-value=CRYPTO_ALGOFAM_NOT_SET  # Determines the algorithm family used for the crypto service.
        enumeration CryptoPrimitiveAlgorithmMode [1..*]: {CRYPTO_ALGOMODE_12ROUNDS, CRYPTO_ALGOMODE_20ROUNDS, CRYPTO_ALGOMODE_8ROUNDS, CRYPTO_ALGOMODE_CBC, CRYPTO_ALGOMODE_CFB, CRYPTO_ALGOMODE_CMAC, CRYPTO_ALGOMODE_CTR, CRYPTO_ALGOMODE_CTRDRBG, CRYPTO_ALGOMODE_CUSTOM, CRYPTO_ALGOMODE_CUSTOM_CCM, CRYPTO_ALGOMODE_CUSTOM_MODE_1, CRYPTO_ALGOMODE_CUSTOM_P160R1, CRYPTO_ALGOMODE_CUSTOM_P256R1, CRYPTO_ALGOMODE_CUSTOM_P384R1, CRYPTO_ALGOMODE_CUSTOM_RSAES_OAEP_CRT, CRYPTO_ALGOMODE_CUSTOM_RSASSA_PKCS1_v1_5_CRT, CRYPTO_ALGOMODE_CUSTOM_USE_DF, CRYPTO_ALGOMODE_ECB, CRYPTO_ALGOMODE_GCM, CRYPTO_ALGOMODE_GMAC, CRYPTO_ALGOMODE_HMAC, CRYPTO_ALGOMODE_NOT_SET, CRYPTO_ALGOMODE_OFB, CRYPTO_ALGOMODE_PXXXR, CRYPTO_ALGOMODE_RSAES_OAEP, CRYPTO_ALGOMODE_RSAES_PKCS1_v1_5, CRYPTO_ALGOMODE_RSASSA_PKCS1_v1_5, CRYPTO_ALGOMODE_RSASSA_PSS, CRYPTO_ALGOMODE_SIPHASH_2_4, CRYPTO_ALGOMODE_SIPHASH_4_8, CRYPTO_ALGOMODE_XTS, CRYPTO_ALGOMODE_CUSTOM_P224R1, CRYPTO_ALGOMODE_CUSTOM_P521R1}, set at pre-compile, default-value=CRYPTO_ALGOMODE_NOT_SET  # Determines the algorithm mode used for the crypto service
        enumeration CryptoPrimitiveService [1..*]: {CRYPTO_AEADDECRYPT, CRYPTO_AEADENCRYPT, CRYPTO_CERTIFICATE_PARSE, CRYPTO_CERTIFICATE_VERIFY, CRYPTO_DECRYPT, CRYPTO_ENCRYPT, CRYPTO_HASH, CRYPTO_KEY_DERIVE, CRYPTO_KEY_EXCHANGE_CALC_PUBVAL, CRYPTO_KEY_EXCHANGE_CALC_SECRET, CRYPTO_KEY_GENERATE, CRYPTO_KEY_SET_VALID, CRYPTO_MAC_GENERATE, CRYPTO_MAC_VERIFY, CRYPTO_RANDOM, CRYPTO_RANDOM_SEED, CRYPTO_SIGNATURE_GENERATE, CRYPTO_SIGNATURE_VERIFY}, set at pre-compile, default-value=CRYPTO_MAC_VERIFY  # Determines the crypto service used for defining the capabilities
        enumeration CryptoPrimitiveAlgorithmSecondaryFamily [1..*]: {CRYPTO_ALGOFAM_3DES, CRYPTO_ALGOFAM_AES, CRYPTO_ALGOFAM_BLAKE_1_256, CRYPTO_ALGOFAM_BLAKE_1_512, CRYPTO_ALGOFAM_BLAKE_2s_256, CRYPTO_ALGOFAM_BLAKE_2s_512, CRYPTO_ALGOFAM_BRAINPOOL, CRYPTO_ALGOFAM_CHACHA, CRYPTO_ALGOFAM_CUSTOM, CRYPTO_ALGOFAM_CUSTOM_CIPHER_SUITE_8, CRYPTO_ALGOFAM_CUSTOM_CMD_GET_ID, CRYPTO_ALGOFAM_CUSTOM_PADDING_PKCS7, CRYPTO_ALGOFAM_CUSTOM_POLY_1305, CRYPTO_ALGOFAM_DRBG, CRYPTO_ALGOFAM_ECCANSI, CRYPTO_ALGOFAM_ECCNIST, CRYPTO_ALGOFAM_ECCSEC, CRYPTO_ALGOFAM_ECIES, CRYPTO_ALGOFAM_ED25519, CRYPTO_ALGOFAM_FIPS186, CRYPTO_ALGOFAM_NOT_SET, CRYPTO_ALGOFAM_PADDING_ONEWITHZEROS, CRYPTO_ALGOFAM_PADDING_PKCS7, CRYPTO_ALGOFAM_POLY1305, CRYPTO_ALGOFAM_RIPEMD160, CRYPTO_ALGOFAM_RNG, CRYPTO_ALGOFAM_RSA, CRYPTO_ALGOFAM_SECURECOUNTER, CRYPTO_ALGOFAM_SHA1, CRYPTO_ALGOFAM_SHA2_224, CRYPTO_ALGOFAM_SHA2_256, CRYPTO_ALGOFAM_SHA2_384, CRYPTO_ALGOFAM_SHA2_512, CRYPTO_ALGOFAM_SHA2_512_224, CRYPTO_ALGOFAM_SHA2_512_256, CRYPTO_ALGOFAM_SHA3_224, CRYPTO_ALGOFAM_SHA3_256, CRYPTO_ALGOFAM_SHA3_384, CRYPTO_ALGOFAM_SHA3_512, CRYPTO_ALGOFAM_SHAKE128, CRYPTO_ALGOFAM_SHAKE256, CRYPTO_ALGOFAM_SIPHASH, CRYPTO_ALGOFAM_X25519, CRYPTO_ALGOFAM_CUSTOM_BD}, set at pre-compile, default-value=CRYPTO_ALGOFAM_NOT_SET  # Determines the algorithm secondary family used for the crypto service. See Technical Reference for cipher suites.
        boolean CryptoPrimitiveSupportContext [0..1]: set at pre-compile, default-value=false  # Configures if the crypto primitive supports to store or restore context data of the workspace. Since this option is vulnerable to security, it shall only set to TRUE if absolutely needed.
        reference CryptoPrimitiveAlgorithmFamilyCustomRef [0..*]: set at pre-compile, destination=CryptoPrimitiveAlgorithmFamilyCustom  # Reference to a customer specific algorithm family custom container
        reference CryptoPrimitiveAlgorithmModeCustomRef [0..*]: set at pre-compile, destination=CryptoPrimitiveAlgorithmModeCustom  # Reference to a customer specific algorithm mode custom container
        reference CryptoPrimitiveAlgorithmSecondaryFamilyCustomRef [0..*]: set at pre-compile, destination=CryptoPrimitiveAlgorithmFamilyCustom  # Reference to a customer specific algorithm family custom container
      container CryptoPrimitiveAlgorithmFamilyCustom [0..*]  # Container of custom algorithm family values. The container name serves as a symbolic name for the identifier of the custom algorithm family type.
        integer CryptoPrimitiveAlgorithmFamilyCustomId: 128..254, set at pre-compile, symbolic-name-value=true  # The custom value of this algorithm family
      container CryptoPrimitiveAlgorithmModeCustom [0..*]  # Container of custom algorithm mode values. The container name serves as a symbolic name for the identifier of the custom algorithm mode type.
        integer CryptoPrimitiveAlgorithmModeCustomId: 128..254, set at pre-compile, symbolic-name-value=true  # The custom value of this algorithm mode
    container CryptoSheKeyUpdate [0..1]  # Container for She key update, Present Container, the She key update with M1,M2 and M3 can be used for setting/updating a She key. Remove Container to save ROM and Runtime.
      boolean CryptoSheEnableFid: set at pre-compile, origin=Vector Informatik, default-value=true  # Enable check of FID. If the check is disabled all flags will be interpreted as 0 and the keys can be used for each service.
      boolean CryptoSheEnableCounter: set at pre-compile, origin=Vector Informatik, default-value=true  # Enable check of Counter. If the feature is enabled ech she key requires a key element with the Id CRYPTO_KE_CUSTOM_SHE_COUNTER. Otherwise the key element can be exclude to reduce KeyStorage size.
      boolean CryptoSheDebugCmd: set at pre-compile, origin=Vector Informatik, default-value=false  # Enable She DEBUG_CMD. If the check is enabled the DEBUG_CMD requires the CryptoSheInfoKeyRef.
      symbolic name reference CryptoSheInfoKeyRef: set at pre-compile, origin=Vector Informatik, destination=CryptoKey  # Reference to a key which holds information's for the she key update. Information's are: UID key element Boot Protection control key element (Only required if CryptoSheEnableFid is enabled.) Debugger Protection control key element (Only required if CryptoSheEnableFid is enabled.)
      reference CryptoSheKeyRefSecretKey [0..1]: set at pre-compile, origin=Vector Informatik, destination=CryptoKey  # SECRET_KEY | Reference to a key which shall be used as SECRET_KEY She key. The SECRET_KEY is mapped to She page 1 and She Id 0,
      reference CryptoSheKeyRefMasterKey [0..1]: set at pre-compile, origin=Vector Informatik, destination=CryptoKey  # MASTER_ECU_KEY | Reference to a key which shall be used as MASTER_ECU_KEY She key. The MASTER_ECU_KEY is mapped to She page 1 and She Id 1,
      reference CryptoSheKeyRefBootMacKey [0..1]: set at pre-compile, origin=Vector Informatik, destination=CryptoKey  # BOOT_MAC_KEY | Reference to a key which shall be used as BOOT_MAC_KEY She key. The BOOT_MAC_KEY is mapped to She page 1 and She Id 2,
      reference CryptoSheKeyRefBootMac [0..1]: set at pre-compile, origin=Vector Informatik, destination=CryptoKey  # BOOT_MAC | Reference to a key which shall be used as BOOT_MAC She key. The BOOT_MAC is mapped to She page 1 and She Id 3,
      reference CryptoSheDebugCmdAdditionalKeys [0..*]: set at pre-compile, origin=Vector Informatik, destination=CryptoKey  # Reference a non-She key which shall be additionally be cleared by the She DEBUG_CMD. This key will be cleared additional to the She keys.
      container CryptoShePage [1..255]  # Container for a She page. A she page includes up to 11 She keys. Key_1 - Key_10 and one RAM_Key. The Encryption and Mac constants are defined for each page. The SECRET_KEY, MASTER_ECU_KEY, BOOT_MAC_KEY and BOOT_MAC are mapped to page 1,
        string CryptoShePageEncryptionConstant: set at pre-compile, origin=Vector Informatik, default-value=010153484500800000000000000000B0, max-length=32, min-length=32  # KEY_UPDATE_ENC_C | KEY_UPDATE_ENC_C Page_1: 010153484500800000000000000000B0 h Page_2: 018153484500800000000000000000B0 h Page_N: Not Specified String may only consist concatenated hex values without leading 0x and any spaces. 32 Bytes are needed.
        string CryptoShePageMacConstant: set at pre-compile, origin=Vector Informatik, default-value=010253484500800000000000000000B0, max-length=32, min-length=32  # KEY_UPDATE_MAC_C | KEY_UPDATE_MAC_C Page_1: 010253484500800000000000000000B0 h Page_2: 018253484500800000000000000000B0 h Page_N: Not Specified String may only consist concatenated hex values without leading 0x and any spaces. 32 Bytes are needed.
        integer CryptoShePageId: 1..255, set at pre-compile, origin=Vector Informatik, symbolic-name-value=true, default-value=1  # Id of the She Page.
        container CryptoSheKey [1..11]  # Container for a She key. It is possible to configure Key_1 - Key_10 and Ram_Key for each page. Key_1 = She Id 4 ... Key_10 = She Id 13 RAM_Key = She Id 14
          integer CryptoSheKeyId: 4..14, set at pre-compile, origin=Vector Informatik, default-value=4  # Set the She key Id. Key_1 = She Id 4 ... Key_10 = She Id 13 RAM_Key = She Id 14
          reference CryptoSheKeyRef: set at pre-compile, origin=Vector Informatik, destination=CryptoKey  # Reference a key which shall be used as She key.
    container CryptoNvStorage  # Nv Storage | This container is used for the non-volatile storage of the key information
      integer CryptoNvManagementDataPerKey: 4..4, set at pre-compile, origin=Vector Informatik, default-value=4  # This parameter is for information purposes only and can not be changed. This Parameter shows how many additional bytes are needed per key element when it is stored in the NVRAM. e.g. 16 bytes AES key needs 20 bytes of data flash inside the NvRam if the management data is 4 bytes long.
      string CryptoNvWriteBlockFctName: set at pre-compile, origin=Vector Informatik, default-value=NvM_WriteBlock, min-length=1  # This function is called by the LibCv to write a Nv Block.
      container CryptoNvBlock [0..*]  # A NvBlock describes the mapping of to be persisted keys and a NvM Decsriptor.
        integer CryptoNvBlockId: 0..4294967294, set at pre-compile, origin=Vector Informatik, symbolic-name-value=true, default-value=0  # Id of the NvBlock. This value has to be unique.
        integer CryptoNvBlockLength: 0..4294967295, set at pre-compile, origin=Vector Informatik, default-value=0  # Size of the Nv Block Must be the same size as the referenced Nv Block.
        integer CryptoNvBlockFillLevel: 0..4294967295, set at pre-compile, origin=Vector Informatik, default-value=0  # Number of used bytes inside the Nv Block. This value is for information only.
        enumeration CryptoNvBlockProcessing: {NV_PROCESSING_IMMEDIATE, NV_PROCESSING_DEFERRED}, set at pre-compile, origin=Vector Informatik, default-value=NV_PROCESSING_DEFERRED  # Set the block processing type. DEFERRED: write block will not be triggered by the crypto.The block can be written manually and is written on shutdown. IMMEDIATE: write block will be triggered by the crypto with validation of the key.This cannot be used if key locking is disabled.
        enumeration CryptoNvBlockConsistencyLevel: {NV_CONSISTENCY_LEVEL_NONE, NV_CONSISTENCY_LEVEL_DETECT}, set at pre-compile, origin=Vector Informatik, default-value=NV_CONSISTENCY_LEVEL_DETECT  # Select the storage kind. NONE: none (deprecated) DETECT: CRC layout checksum, checks if the key storage layout has changed. If the layout has change the initial data is restored.
        integer CryptoNvBlockRevision: 0..4294967295, set at pre-compile, origin=Vector Informatik, default-value=0  # Revision of the NvBlock.
        integer CryptoNvBlockCrcLayoutChecksum: 0..4294967294, set at pre-compile, origin=Vector Informatik, default-value=0  # CRC checksum over the NvBlock layout. CRC Calculation is influenced by: - CRYPTO_ALIGN_KEY_STORAGE - CRYPTO_NV_MANAGEMENT_DATA_PER_KEY - For each Block - CRYPTO_NV_BLOCK_REVISION - For each Key within the Block - CRYPTO_KEY_NV_ID - For each KeyElement within the Key - CRYPTO_KEY_ELEMENT_ID - CRYPTO_KEY_ELEMENT_SIZE
        symbolic name reference CryptoNvBlockDescriptor: set at pre-compile, origin=Vector Informatik, destination=NvMBlockDescriptor  # NvM Block which will be used for this CryptoNvBlock.
        symbolic name reference CryptoNvBlockKeyRef [1..*]: set at pre-compile, origin=Vector Informatik, destination=CryptoKey  # Reference to the key which will be stored inside this NvBlock
  module config Crypto_Pre: definition=Crypto  # Software Crypto Driver pre-configuration
    CryptoPrimitives
      147 x CryptoPrimitive:
        AesGCMEncrypt: CryptoPrimitiveAlgorithmSecondaryFamily=CRYPTO_ALGOFAM_NOT_SET, CryptoPrimitiveAlgorithmMode=CRYPTO_ALGOMODE_GCM, CryptoPrimitiveService=CRYPTO_AEADENCRYPT, CryptoPrimitiveAlgorithmFamily=CRYPTO_ALGOFAM_AES
        AesGCMDecrypt: CryptoPrimitiveAlgorithmSecondaryFamily=CRYPTO_ALGOFAM_NOT_SET, CryptoPrimitiveAlgorithmMode=CRYPTO_ALGOMODE_GCM, CryptoPrimitiveService=CRYPTO_AEADDECRYPT, CryptoPrimitiveAlgorithmFamily=CRYPTO_ALGOFAM_AES
        AesEncrypt: CryptoPrimitiveAlgorithmSecondaryFamily=CRYPTO_ALGOFAM_NOT_SET, CryptoPrimitiveAlgorithmMode=CRYPTO_ALGOMODE_ECB, CryptoPrimitiveService=CRYPTO_ENCRYPT, CryptoPrimitiveAlgorithmFamily=CRYPTO_ALGOFAM_AES, CryptoPrimitiveAlgorithmMode=CRYPTO_ALGOMODE_CBC, CryptoPrimitiveAlgorithmSecondaryFamily=CRYPTO_ALGOFAM_CUSTOM_PADDING_PKCS7, CryptoPrimitiveAlgorithmSecondaryFamily=CRYPTO_ALGOFAM_PADDING_ONEWITHZEROS, CryptoPrimitiveAlgorithmMode=CRYPTO_ALGOMODE_CTR, CryptoPrimitiveAlgorithmSecondaryFamily=CRYPTO_ALGOFAM_PADDING_PKCS7, CryptoPrimitiveAlgorithmSecondaryFamilyCustomRef=Crypto_30_LibCv_PaddingPKCS7
        AesDecrypt: CryptoPrimitiveAlgorithmSecondaryFamily=CRYPTO_ALGOFAM_NOT_SET, CryptoPrimitiveAlgorithmMode=CRYPTO_ALGOMODE_ECB, CryptoPrimitiveService=CRYPTO_DECRYPT, CryptoPrimitiveAlgorithmFamily=CRYPTO_ALGOFAM_AES, CryptoPrimitiveAlgorithmMode=CRYPTO_ALGOMODE_CBC, CryptoPrimitiveAlgorithmSecondaryFamily=CRYPTO_ALGOFAM_CUSTOM_PADDING_PKCS7, CryptoPrimitiveAlgorithmSecondaryFamily=CRYPTO_ALGOFAM_PADDING_ONEWITHZEROS, CryptoPrimitiveAlgorithmMode=CRYPTO_ALGOMODE_CTR, CryptoPrimitiveAlgorithmSecondaryFamily=CRYPTO_ALGOFAM_PADDING_PKCS7, CryptoPrimitiveAlgorithmSecondaryFamilyCustomRef=Crypto_30_LibCv_PaddingPKCS7
        SHA1: CryptoPrimitiveAlgorithmSecondaryFamily=CRYPTO_ALGOFAM_NOT_SET, CryptoPrimitiveAlgorithmMode=CRYPTO_ALGOMODE_NOT_SET, CryptoPrimitiveService=CRYPTO_HASH, CryptoPrimitiveAlgorithmFamily=CRYPTO_ALGOFAM_SHA1
        SHA256: CryptoPrimitiveAlgorithmSecondaryFamily=CRYPTO_ALGOFAM_NOT_SET, CryptoPrimitiveAlgorithmMode=CRYPTO_ALGOMODE_NOT_SET, CryptoPrimitiveService=CRYPTO_HASH, CryptoPrimitiveAlgorithmFamily=CRYPTO_ALGOFAM_SHA2_256
        SHA512: CryptoPrimitiveAlgorithmSecondaryFamily=CRYPTO_ALGOFAM_NOT_SET, CryptoPrimitiveAlgorithmMode=CRYPTO_ALGOMODE_NOT_SET, CryptoPrimitiveService=CRYPTO_HASH, CryptoPrimitiveAlgorithmFamily=CRYPTO_ALGOFAM_SHA2_512
        AesCmacGenerate: CryptoPrimitiveAlgorithmSecondaryFamily=CRYPTO_ALGOFAM_NOT_SET, CryptoPrimitiveAlgorithmMode=CRYPTO_ALGOMODE_CMAC, CryptoPrimitiveService=CRYPTO_MAC_GENERATE, CryptoPrimitiveAlgorithmFamily=CRYPTO_ALGOFAM_AES
        AesCmacVerify: CryptoPrimitiveAlgorithmSecondaryFamily=CRYPTO_ALGOFAM_NOT_SET, CryptoPrimitiveAlgorithmMode=CRYPTO_ALGOMODE_CMAC, CryptoPrimitiveService=CRYPTO_MAC_VERIFY, CryptoPrimitiveAlgorithmFamily=CRYPTO_ALGOFAM_AES
        RngFips186Sha1: CryptoPrimitiveAlgorithmMode=CRYPTO_ALGOMODE_NOT_SET, CryptoPrimitiveService=CRYPTO_RANDOM, CryptoPrimitiveAlgorithmFamily=CRYPTO_ALGOFAM_CUSTOM_FIPS186, CryptoPrimitiveAlgorithmSecondaryFamily=CRYPTO_ALGOFAM_SHA1, CryptoPrimitiveAlgorithmFamily=CRYPTO_ALGOFAM_CUSTOM, CryptoPrimitiveAlgorithmFamilyCustomRef=Crypto_30_LibCv_FIPS186
        EcDsaEd25519Generate: CryptoPrimitiveAlgorithmSecondaryFamily=CRYPTO_ALGOFAM_NOT_SET, CryptoPrimitiveAlgorithmMode=CRYPTO_ALGOMODE_NOT_SET, CryptoPrimitiveService=CRYPTO_SIGNATURE_GENERATE, CryptoPrimitiveAlgorithmFamily=CRYPTO_ALGOFAM_ED25519, CryptoPrimitiveAlgorithmSecondaryFamily=CRYPTO_ALGOFAM_SHA2_512
        EcDsaEd25519Verify: CryptoPrimitiveAlgorithmSecondaryFamily=CRYPTO_ALGOFAM_NOT_SET, CryptoPrimitiveAlgorithmMode=CRYPTO_ALGOMODE_NOT_SET, CryptoPrimitiveService=CRYPTO_SIGNATURE_VERIFY, CryptoPrimitiveAlgorithmFamily=CRYPTO_ALGOFAM_ED25519, CryptoPrimitiveAlgorithmSecondaryFamily=CRYPTO_ALGOFAM_SHA2_512
        SipHashGenerate: CryptoPrimitiveService=CRYPTO_MAC_GENERATE, CryptoPrimitiveAlgorithmFamily=CRYPTO_ALGOFAM_SIPHASH, CryptoPrimitiveAlgorithmMode=CRYPTO_ALGOMODE_SIPHASH_2_4, CryptoPrimitiveAlgorithmSecondaryFamily=CRYPTO_ALGOFAM_NOT_SET
        SipHashVerify: CryptoPrimitiveService=CRYPTO_MAC_VERIFY, CryptoPrimitiveAlgorithmFamily=CRYPTO_ALGOFAM_SIPHASH, CryptoPrimitiveAlgorithmMode=CRYPTO_ALGOMODE_SIPHASH_2_4, CryptoPrimitiveAlgorithmSecondaryFamily=CRYPTO_ALGOFAM_NOT_SET
        RsaPkcs1Sha1Generate: CryptoPrimitiveAlgorithmFamily=CRYPTO_ALGOFAM_RSA, CryptoPrimitiveService=CRYPTO_SIGNATURE_GENERATE, CryptoPrimitiveAlgorithmMode=CRYPTO_ALGOMODE_RSASSA_PKCS1_v1_5, CryptoPrimitiveAlgorithmSecondaryFamily=CRYPTO_ALGOFAM_SHA1
        RsaPkcs1Sha1Verify: CryptoPrimitiveAlgorithmFamily=CRYPTO_ALGOFAM_RSA, CryptoPrimitiveService=CRYPTO_SIGNATURE_VERIFY, CryptoPrimitiveAlgorithmMode=CRYPTO_ALGOMODE_RSASSA_PKCS1_v1_5, CryptoPrimitiveAlgorithmSecondaryFamily=CRYPTO_ALGOFAM_SHA1
        RsaPkcs1Sha256Generate: CryptoPrimitiveAlgorithmFamily=CRYPTO_ALGOFAM_RSA, CryptoPrimitiveService=CRYPTO_SIGNATURE_GENERATE, CryptoPrimitiveAlgorithmMode=CRYPTO_ALGOMODE_RSASSA_PKCS1_v1_5, CryptoPrimitiveAlgorithmSecondaryFamily=CRYPTO_ALGOFAM_SHA2_256
        RsaPkcs1Sha256Verify: CryptoPrimitiveAlgorithmFamily=CRYPTO_ALGOFAM_RSA, CryptoPrimitiveService=CRYPTO_SIGNATURE_VERIFY, CryptoPrimitiveAlgorithmMode=CRYPTO_ALGOMODE_RSASSA_PKCS1_v1_5, CryptoPrimitiveAlgorithmSecondaryFamily=CRYPTO_ALGOFAM_SHA2_256
        RsaPssSha1Generate: CryptoPrimitiveAlgorithmFamily=CRYPTO_ALGOFAM_RSA, CryptoPrimitiveService=CRYPTO_SIGNATURE_GENERATE, CryptoPrimitiveAlgorithmMode=CRYPTO_ALGOMODE_RSASSA_PSS, CryptoPrimitiveAlgorithmSecondaryFamily=CRYPTO_ALGOFAM_SHA1
        RsaPssSha1Verify: CryptoPrimitiveAlgorithmFamily=CRYPTO_ALGOFAM_RSA, CryptoPrimitiveService=CRYPTO_SIGNATURE_VERIFY, CryptoPrimitiveAlgorithmMode=CRYPTO_ALGOMODE_RSASSA_PSS, CryptoPrimitiveAlgorithmSecondaryFamily=CRYPTO_ALGOFAM_SHA1
        RsaPssSha256Generate: CryptoPrimitiveAlgorithmFamily=CRYPTO_ALGOFAM_RSA, CryptoPrimitiveService=CRYPTO_SIGNATURE_GENERATE, CryptoPrimitiveAlgorithmMode=CRYPTO_ALGOMODE_RSASSA_PSS, CryptoPrimitiveAlgorithmSecondaryFamily=CRYPTO_ALGOFAM_SHA2_256
        RsaPssSha256Verify: CryptoPrimitiveAlgorithmFamily=CRYPTO_ALGOFAM_RSA, CryptoPrimitiveService=CRYPTO_SIGNATURE_VERIFY, CryptoPrimitiveAlgorithmMode=CRYPTO_ALGOMODE_RSASSA_PSS, CryptoPrimitiveAlgorithmSecondaryFamily=CRYPTO_ALGOFAM_SHA2_256
        RsaPkcs1Decrypt: CryptoPrimitiveAlgorithmFamily=CRYPTO_ALGOFAM_RSA, CryptoPrimitiveService=CRYPTO_DECRYPT, CryptoPrimitiveAlgorithmMode=CRYPTO_ALGOMODE_RSAES_PKCS1_v1_5, CryptoPrimitiveAlgorithmSecondaryFamily=CRYPTO_ALGOFAM_NOT_SET
        RsaPkcs1Encrypt: CryptoPrimitiveAlgorithmFamily=CRYPTO_ALGOFAM_RSA, CryptoPrimitiveService=CRYPTO_ENCRYPT, CryptoPrimitiveAlgorithmMode=CRYPTO_ALGOMODE_RSAES_PKCS1_v1_5, CryptoPrimitiveAlgorithmSecondaryFamily=CRYPTO_ALGOFAM_NOT_SET
        EccNistP256R1GenerateWithoutPreHashing: CryptoPrimitiveAlgorithmFamily=CRYPTO_ALGOFAM_ECCNIST, CryptoPrimitiveAlgorithmMode=CRYPTO_ALGOMODE_CUSTOM_P256R1, CryptoPrimitiveService=CRYPTO_SIGNATURE_GENERATE, CryptoPrimitiveAlgorithmSecondaryFamily=CRYPTO_ALGOFAM_NOT_SET, CryptoPrimitiveAlgorithmMode=CRYPTO_ALGOMODE_CUSTOM, CryptoPrimitiveAlgorithmModeCustomRef=Crypto_30_LibCv_P256r1
        EccNistP256R1VerifyWithoutPreHashing: CryptoPrimitiveAlgorithmFamily=CRYPTO_ALGOFAM_ECCNIST, CryptoPrimitiveAlgorithmMode=CRYPTO_ALGOMODE_CUSTOM_P256R1, CryptoPrimitiveService=CRYPTO_SIGNATURE_VERIFY, CryptoPrimitiveAlgorithmSecondaryFamily=CRYPTO_ALGOFAM_NOT_SET, CryptoPrimitiveAlgorithmMode=CRYPTO_ALGOMODE_CUSTOM, CryptoPrimitiveAlgorithmModeCustomRef=Crypto_30_LibCv_P256r1
        EccAnsiP256R1GenerateWithoutPreHashing: CryptoPrimitiveAlgorithmFamily=CRYPTO_ALGOFAM_CUSTOM_ECCANSI, CryptoPrimitiveAlgorithmMode=CRYPTO_ALGOMODE_CUSTOM_P256R1, CryptoPrimitiveService=CRYPTO_SIGNATURE_GENERATE, CryptoPrimitiveAlgorithmSecondaryFamily=CRYPTO_ALGOFAM_NOT_SET, CryptoPrimitiveAlgorithmMode=CRYPTO_ALGOMODE_CUSTOM, CryptoPrimitiveAlgorithmFamily=CRYPTO_ALGOFAM_CUSTOM, CryptoPrimitiveAlgorithmFamily=CRYPTO_ALGOFAM_ECCANSI, CryptoPrimitiveAlgorithmFamilyCustomRef=Crypto_30_LibCv_ECCANSI, CryptoPrimitiveAlgorithmModeCustomRef=Crypto_30_LibCv_P256r1
        EccSecP256R1GenerateWithoutPreHashing: CryptoPrimitiveAlgorithmFamily=CRYPTO_ALGOFAM_CUSTOM_ECCSEC, CryptoPrimitiveAlgorithmMode=CRYPTO_ALGOMODE_CUSTOM_P256R1, CryptoPrimitiveService=CRYPTO_SIGNATURE_GENERATE, CryptoPrimitiveAlgorithmSecondaryFamily=CRYPTO_ALGOFAM_NOT_SET, CryptoPrimitiveAlgorithmMode=CRYPTO_ALGOMODE_CUSTOM, CryptoPrimitiveAlgorithmFamily=CRYPTO_ALGOFAM_CUSTOM, CryptoPrimitiveAlgorithmFamily=CRYPTO_ALGOFAM_ECCSEC, CryptoPrimitiveAlgorithmFamilyCustomRef=Crypto_30_LibCv_ECCSEC, CryptoPrimitiveAlgorithmModeCustomRef=Crypto_30_LibCv_P256r1
        EccAnsiP256R1VerifyWithoutPreHashing: CryptoPrimitiveAlgorithmFamily=CRYPTO_ALGOFAM_CUSTOM_ECCANSI, CryptoPrimitiveAlgorithmMode=CRYPTO_ALGOMODE_CUSTOM_P256R1, CryptoPrimitiveService=CRYPTO_SIGNATURE_VERIFY, CryptoPrimitiveAlgorithmSecondaryFamily=CRYPTO_ALGOFAM_NOT_SET, CryptoPrimitiveAlgorithmMode=CRYPTO_ALGOMODE_CUSTOM, CryptoPrimitiveAlgorithmFamily=CRYPTO_ALGOFAM_CUSTOM, CryptoPrimitiveAlgorithmFamily=CRYPTO_ALGOFAM_ECCANSI, CryptoPrimitiveAlgorithmFamilyCustomRef=Crypto_30_LibCv_ECCANSI, CryptoPrimitiveAlgorithmModeCustomRef=Crypto_30_LibCv_P256r1
        EccSecP256R1VerifyWithoutPreHashing: CryptoPrimitiveAlgorithmFamily=CRYPTO_ALGOFAM_CUSTOM_ECCSEC, CryptoPrimitiveAlgorithmMode=CRYPTO_ALGOMODE_CUSTOM_P256R1, CryptoPrimitiveService=CRYPTO_SIGNATURE_VERIFY, CryptoPrimitiveAlgorithmSecondaryFamily=CRYPTO_ALGOFAM_NOT_SET, CryptoPrimitiveAlgorithmMode=CRYPTO_ALGOMODE_CUSTOM, CryptoPrimitiveAlgorithmFamily=CRYPTO_ALGOFAM_CUSTOM, CryptoPrimitiveAlgorithmFamily=CRYPTO_ALGOFAM_ECCSEC, CryptoPrimitiveAlgorithmFamilyCustomRef=Crypto_30_LibCv_ECCSEC, CryptoPrimitiveAlgorithmModeCustomRef=Crypto_30_LibCv_P256r1
        HmacSha1Generate: CryptoPrimitiveAlgorithmFamily=CRYPTO_ALGOFAM_SHA1, CryptoPrimitiveAlgorithmMode=CRYPTO_ALGOMODE_HMAC, CryptoPrimitiveAlgorithmSecondaryFamily=CRYPTO_ALGOFAM_NOT_SET, CryptoPrimitiveService=CRYPTO_MAC_GENERATE
        HmacSha1Verify: CryptoPrimitiveAlgorithmFamily=CRYPTO_ALGOFAM_SHA1, CryptoPrimitiveAlgorithmMode=CRYPTO_ALGOMODE_HMAC, CryptoPrimitiveAlgorithmSecondaryFamily=CRYPTO_ALGOFAM_NOT_SET, CryptoPrimitiveService=CRYPTO_MAC_VERIFY
        HmacSha256Generate: CryptoPrimitiveAlgorithmFamily=CRYPTO_ALGOFAM_SHA2_256, CryptoPrimitiveAlgorithmMode=CRYPTO_ALGOMODE_HMAC, CryptoPrimitiveAlgorithmSecondaryFamily=CRYPTO_ALGOFAM_NOT_SET, CryptoPrimitiveService=CRYPTO_MAC_GENERATE
        HmacSha256Verify: CryptoPrimitiveAlgorithmFamily=CRYPTO_ALGOFAM_SHA2_256, CryptoPrimitiveAlgorithmMode=CRYPTO_ALGOMODE_HMAC, CryptoPrimitiveAlgorithmSecondaryFamily=CRYPTO_ALGOFAM_NOT_SET, CryptoPrimitiveService=CRYPTO_MAC_VERIFY
        EccNistP256R1GenerateSha1: CryptoPrimitiveAlgorithmFamily=CRYPTO_ALGOFAM_ECCNIST, CryptoPrimitiveAlgorithmMode=CRYPTO_ALGOMODE_CUSTOM_P256R1, CryptoPrimitiveService=CRYPTO_SIGNATURE_GENERATE, CryptoPrimitiveAlgorithmSecondaryFamily=CRYPTO_ALGOFAM_SHA1, CryptoPrimitiveAlgorithmMode=CRYPTO_ALGOMODE_CUSTOM, CryptoPrimitiveAlgorithmModeCustomRef=Crypto_30_LibCv_P256r1
        EccNistP256R1GenerateSha256: CryptoPrimitiveAlgorithmFamily=CRYPTO_ALGOFAM_ECCNIST, CryptoPrimitiveAlgorithmMode=CRYPTO_ALGOMODE_CUSTOM_P256R1, CryptoPrimitiveService=CRYPTO_SIGNATURE_GENERATE, CryptoPrimitiveAlgorithmSecondaryFamily=CRYPTO_ALGOFAM_SHA2_256, CryptoPrimitiveAlgorithmMode=CRYPTO_ALGOMODE_CUSTOM, CryptoPrimitiveAlgorithmModeCustomRef=Crypto_30_LibCv_P256r1
        EccNistP256R1VerifySha1: CryptoPrimitiveAlgorithmFamily=CRYPTO_ALGOFAM_ECCNIST, CryptoPrimitiveAlgorithmMode=CRYPTO_ALGOMODE_CUSTOM_P256R1, CryptoPrimitiveService=CRYPTO_SIGNATURE_VERIFY, CryptoPrimitiveAlgorithmSecondaryFamily=CRYPTO_ALGOFAM_SHA1, CryptoPrimitiveAlgorithmMode=CRYPTO_ALGOMODE_CUSTOM, CryptoPrimitiveAlgorithmModeCustomRef=Crypto_30_LibCv_P256r1
        EccNistP256R1VerifySha256: CryptoPrimitiveAlgorithmFamily=CRYPTO_ALGOFAM_ECCNIST, CryptoPrimitiveAlgorithmMode=CRYPTO_ALGOMODE_CUSTOM_P256R1, CryptoPrimitiveService=CRYPTO_SIGNATURE_VERIFY, CryptoPrimitiveAlgorithmSecondaryFamily=CRYPTO_ALGOFAM_SHA2_256, CryptoPrimitiveAlgorithmMode=CRYPTO_ALGOMODE_CUSTOM, CryptoPrimitiveAlgorithmModeCustomRef=Crypto_30_LibCv_P256r1
        EccAnsiP256R1GenerateSha1: CryptoPrimitiveAlgorithmFamily=CRYPTO_ALGOFAM_CUSTOM_ECCANSI, CryptoPrimitiveAlgorithmMode=CRYPTO_ALGOMODE_CUSTOM_P256R1, CryptoPrimitiveService=CRYPTO_SIGNATURE_GENERATE, CryptoPrimitiveAlgorithmSecondaryFamily=CRYPTO_ALGOFAM_SHA1, CryptoPrimitiveAlgorithmMode=CRYPTO_ALGOMODE_CUSTOM, CryptoPrimitiveAlgorithmFamily=CRYPTO_ALGOFAM_CUSTOM, CryptoPrimitiveAlgorithmFamily=CRYPTO_ALGOFAM_ECCANSI, CryptoPrimitiveAlgorithmFamilyCustomRef=Crypto_30_LibCv_ECCANSI, CryptoPrimitiveAlgorithmModeCustomRef=Crypto_30_LibCv_P256r1
        EccAnsiP256R1GenerateSha256: CryptoPrimitiveAlgorithmFamily=CRYPTO_ALGOFAM_CUSTOM_ECCANSI, CryptoPrimitiveAlgorithmMode=CRYPTO_ALGOMODE_CUSTOM_P256R1, CryptoPrimitiveService=CRYPTO_SIGNATURE_GENERATE, CryptoPrimitiveAlgorithmSecondaryFamily=CRYPTO_ALGOFAM_SHA2_256, CryptoPrimitiveAlgorithmMode=CRYPTO_ALGOMODE_CUSTOM, CryptoPrimitiveAlgorithmFamily=CRYPTO_ALGOFAM_CUSTOM, CryptoPrimitiveAlgorithmFamily=CRYPTO_ALGOFAM_ECCANSI, CryptoPrimitiveAlgorithmFamilyCustomRef=Crypto_30_LibCv_ECCANSI, CryptoPrimitiveAlgorithmModeCustomRef=Crypto_30_LibCv_P256r1
        EccAnsiP256R1VerifySha1: CryptoPrimitiveAlgorithmFamily=CRYPTO_ALGOFAM_CUSTOM_ECCANSI, CryptoPrimitiveAlgorithmMode=CRYPTO_ALGOMODE_CUSTOM_P256R1, CryptoPrimitiveService=CRYPTO_SIGNATURE_VERIFY, CryptoPrimitiveAlgorithmSecondaryFamily=CRYPTO_ALGOFAM_SHA1, CryptoPrimitiveAlgorithmMode=CRYPTO_ALGOMODE_CUSTOM, CryptoPrimitiveAlgorithmFamily=CRYPTO_ALGOFAM_CUSTOM, CryptoPrimitiveAlgorithmFamily=CRYPTO_ALGOFAM_ECCANSI, CryptoPrimitiveAlgorithmFamilyCustomRef=Crypto_30_LibCv_ECCANSI, CryptoPrimitiveAlgorithmModeCustomRef=Crypto_30_LibCv_P256r1
        EccAnsiP256R1VerifySha256: CryptoPrimitiveAlgorithmFamily=CRYPTO_ALGOFAM_CUSTOM_ECCANSI, CryptoPrimitiveAlgorithmMode=CRYPTO_ALGOMODE_CUSTOM_P256R1, CryptoPrimitiveService=CRYPTO_SIGNATURE_VERIFY, CryptoPrimitiveAlgorithmSecondaryFamily=CRYPTO_ALGOFAM_SHA2_256, CryptoPrimitiveAlgorithmMode=CRYPTO_ALGOMODE_CUSTOM, CryptoPrimitiveAlgorithmFamily=CRYPTO_ALGOFAM_CUSTOM, CryptoPrimitiveAlgorithmFamily=CRYPTO_ALGOFAM_ECCANSI, CryptoPrimitiveAlgorithmFamilyCustomRef=Crypto_30_LibCv_ECCANSI, CryptoPrimitiveAlgorithmModeCustomRef=Crypto_30_LibCv_P256r1
        EccSecP256R1GenerateSha1: CryptoPrimitiveAlgorithmFamily=CRYPTO_ALGOFAM_CUSTOM_ECCSEC, CryptoPrimitiveAlgorithmMode=CRYPTO_ALGOMODE_CUSTOM_P256R1, CryptoPrimitiveService=CRYPTO_SIGNATURE_GENERATE, CryptoPrimitiveAlgorithmSecondaryFamily=CRYPTO_ALGOFAM_SHA1, CryptoPrimitiveAlgorithmMode=CRYPTO_ALGOMODE_CUSTOM, CryptoPrimitiveAlgorithmFamily=CRYPTO_ALGOFAM_CUSTOM, CryptoPrimitiveAlgorithmFamily=CRYPTO_ALGOFAM_ECCSEC, CryptoPrimitiveAlgorithmFamilyCustomRef=Crypto_30_LibCv_ECCSEC, CryptoPrimitiveAlgorithmModeCustomRef=Crypto_30_LibCv_P256r1
        EccSecP256R1GenerateSha256: CryptoPrimitiveAlgorithmFamily=CRYPTO_ALGOFAM_CUSTOM_ECCSEC, CryptoPrimitiveAlgorithmMode=CRYPTO_ALGOMODE_CUSTOM_P256R1, CryptoPrimitiveService=CRYPTO_SIGNATURE_GENERATE, CryptoPrimitiveAlgorithmSecondaryFamily=CRYPTO_ALGOFAM_SHA2_256, CryptoPrimitiveAlgorithmMode=CRYPTO_ALGOMODE_CUSTOM, CryptoPrimitiveAlgorithmFamily=CRYPTO_ALGOFAM_CUSTOM, CryptoPrimitiveAlgorithmFamily=CRYPTO_ALGOFAM_ECCSEC, CryptoPrimitiveAlgorithmFamilyCustomRef=Crypto_30_LibCv_ECCSEC, CryptoPrimitiveAlgorithmModeCustomRef=Crypto_30_LibCv_P256r1
        EccSecP256R1VerifySha1: CryptoPrimitiveAlgorithmFamily=CRYPTO_ALGOFAM_CUSTOM_ECCSEC, CryptoPrimitiveAlgorithmMode=CRYPTO_ALGOMODE_CUSTOM_P256R1, CryptoPrimitiveService=CRYPTO_SIGNATURE_VERIFY, CryptoPrimitiveAlgorithmSecondaryFamily=CRYPTO_ALGOFAM_SHA1, CryptoPrimitiveAlgorithmMode=CRYPTO_ALGOMODE_CUSTOM, CryptoPrimitiveAlgorithmFamily=CRYPTO_ALGOFAM_CUSTOM, CryptoPrimitiveAlgorithmFamily=CRYPTO_ALGOFAM_ECCSEC, CryptoPrimitiveAlgorithmFamilyCustomRef=Crypto_30_LibCv_ECCSEC, CryptoPrimitiveAlgorithmModeCustomRef=Crypto_30_LibCv_P256r1
        EccSecP256R1VerifySha256: CryptoPrimitiveAlgorithmFamily=CRYPTO_ALGOFAM_CUSTOM_ECCSEC, CryptoPrimitiveAlgorithmMode=CRYPTO_ALGOMODE_CUSTOM_P256R1, CryptoPrimitiveService=CRYPTO_SIGNATURE_VERIFY, CryptoPrimitiveAlgorithmSecondaryFamily=CRYPTO_ALGOFAM_SHA2_256, CryptoPrimitiveAlgorithmMode=CRYPTO_ALGOMODE_CUSTOM, CryptoPrimitiveAlgorithmFamily=CRYPTO_ALGOFAM_CUSTOM, CryptoPrimitiveAlgorithmFamily=CRYPTO_ALGOFAM_ECCSEC, CryptoPrimitiveAlgorithmFamilyCustomRef=Crypto_30_LibCv_ECCSEC, CryptoPrimitiveAlgorithmModeCustomRef=Crypto_30_LibCv_P256r1
        RngFips186: CryptoPrimitiveAlgorithmMode=CRYPTO_ALGOMODE_NOT_SET, CryptoPrimitiveService=CRYPTO_RANDOM, CryptoPrimitiveAlgorithmFamily=CRYPTO_ALGOFAM_RNG, CryptoPrimitiveAlgorithmSecondaryFamily=CRYPTO_ALGOFAM_NOT_SET
        RngDrbgAes128: CryptoPrimitiveAlgorithmMode=CRYPTO_ALGOMODE_NOT_SET, CryptoPrimitiveService=CRYPTO_RANDOM, CryptoPrimitiveAlgorithmFamily=CRYPTO_ALGOFAM_CUSTOM_DRBG, CryptoPrimitiveAlgorithmSecondaryFamily=CRYPTO_ALGOFAM_AES, CryptoPrimitiveAlgorithmFamily=CRYPTO_ALGOFAM_CUSTOM, CryptoPrimitiveAlgorithmFamilyCustomRef=Crypto_30_LibCv_DRBG
        RngDrbgAes128Df: CryptoPrimitiveAlgorithmMode=CRYPTO_ALGOMODE_CUSTOM_USE_DF, CryptoPrimitiveService=CRYPTO_RANDOM, CryptoPrimitiveAlgorithmFamily=CRYPTO_ALGOFAM_CUSTOM_DRBG, CryptoPrimitiveAlgorithmSecondaryFamily=CRYPTO_ALGOFAM_AES, CryptoPrimitiveAlgorithmFamily=CRYPTO_ALGOFAM_CUSTOM, CryptoPrimitiveAlgorithmMode=CRYPTO_ALGOMODE_CUSTOM, CryptoPrimitiveAlgorithmFamilyCustomRef=Crypto_30_LibCv_DRBG, CryptoPrimitiveAlgorithmModeCustomRef=Crypto_30_LibCv_UseDF
        RsaPkcs1CrtSha1Generate: CryptoPrimitiveAlgorithmFamily=CRYPTO_ALGOFAM_RSA, CryptoPrimitiveService=CRYPTO_SIGNATURE_GENERATE, CryptoPrimitiveAlgorithmMode=CRYPTO_ALGOMODE_CUSTOM_RSASSA_PKCS1_v1_5_CRT, CryptoPrimitiveAlgorithmSecondaryFamily=CRYPTO_ALGOFAM_SHA1, CryptoPrimitiveAlgorithmMode=CRYPTO_ALGOMODE_CUSTOM, CryptoPrimitiveAlgorithmModeCustomRef=Crypto_30_LibCv_RSASSA_PKCS1_v1_5_CRT
        RsaPkcs1CrtSha256Generate: CryptoPrimitiveAlgorithmFamily=CRYPTO_ALGOFAM_RSA, CryptoPrimitiveService=CRYPTO_SIGNATURE_GENERATE, CryptoPrimitiveAlgorithmMode=CRYPTO_ALGOMODE_CUSTOM_RSASSA_PKCS1_v1_5_CRT, CryptoPrimitiveAlgorithmSecondaryFamily=CRYPTO_ALGOFAM_SHA2_256, CryptoPrimitiveAlgorithmMode=CRYPTO_ALGOMODE_CUSTOM, CryptoPrimitiveAlgorithmModeCustomRef=Crypto_30_LibCv_RSASSA_PKCS1_v1_5_CRT
        EccNistP384R1GenerateWithoutPreHashing: CryptoPrimitiveAlgorithmFamily=CRYPTO_ALGOFAM_ECCNIST, CryptoPrimitiveAlgorithmMode=CRYPTO_ALGOMODE_CUSTOM_P384R1, CryptoPrimitiveService=CRYPTO_SIGNATURE_GENERATE, CryptoPrimitiveAlgorithmSecondaryFamily=CRYPTO_ALGOFAM_NOT_SET, CryptoPrimitiveAlgorithmMode=CRYPTO_ALGOMODE_CUSTOM, CryptoPrimitiveAlgorithmModeCustomRef=Crypto_30_LibCv_P384r1
        EccNistP384R1VerifyWithoutPreHashing: CryptoPrimitiveAlgorithmFamily=CRYPTO_ALGOFAM_ECCNIST, CryptoPrimitiveAlgorithmMode=CRYPTO_ALGOMODE_CUSTOM_P384R1, CryptoPrimitiveService=CRYPTO_SIGNATURE_VERIFY, CryptoPrimitiveAlgorithmSecondaryFamily=CRYPTO_ALGOFAM_NOT_SET, CryptoPrimitiveAlgorithmMode=CRYPTO_ALGOMODE_CUSTOM, CryptoPrimitiveAlgorithmModeCustomRef=Crypto_30_LibCv_P384r1
        EccSecP384R1GenerateWithoutPreHashing: CryptoPrimitiveAlgorithmFamily=CRYPTO_ALGOFAM_CUSTOM_ECCSEC, CryptoPrimitiveAlgorithmMode=CRYPTO_ALGOMODE_CUSTOM_P384R1, CryptoPrimitiveService=CRYPTO_SIGNATURE_GENERATE, CryptoPrimitiveAlgorithmSecondaryFamily=CRYPTO_ALGOFAM_NOT_SET, CryptoPrimitiveAlgorithmFamily=CRYPTO_ALGOFAM_CUSTOM, CryptoPrimitiveAlgorithmMode=CRYPTO_ALGOMODE_CUSTOM, CryptoPrimitiveAlgorithmFamily=CRYPTO_ALGOFAM_ECCSEC, CryptoPrimitiveAlgorithmModeCustomRef=Crypto_30_LibCv_P384r1, CryptoPrimitiveAlgorithmFamilyCustomRef=Crypto_30_LibCv_ECCSEC
        EccSecP384R1VerifyWithoutPreHashing: CryptoPrimitiveAlgorithmFamily=CRYPTO_ALGOFAM_CUSTOM_ECCSEC, CryptoPrimitiveAlgorithmMode=CRYPTO_ALGOMODE_CUSTOM_P384R1, CryptoPrimitiveService=CRYPTO_SIGNATURE_VERIFY, CryptoPrimitiveAlgorithmSecondaryFamily=CRYPTO_ALGOFAM_NOT_SET, CryptoPrimitiveAlgorithmFamily=CRYPTO_ALGOFAM_CUSTOM, CryptoPrimitiveAlgorithmMode=CRYPTO_ALGOMODE_CUSTOM, CryptoPrimitiveAlgorithmFamily=CRYPTO_ALGOFAM_ECCSEC, CryptoPrimitiveAlgorithmModeCustomRef=Crypto_30_LibCv_P384r1, CryptoPrimitiveAlgorithmFamilyCustomRef=Crypto_30_LibCv_ECCSEC
        EccNistP384R1GenerateSha1: CryptoPrimitiveAlgorithmFamily=CRYPTO_ALGOFAM_ECCNIST, CryptoPrimitiveAlgorithmMode=CRYPTO_ALGOMODE_CUSTOM_P384R1, CryptoPrimitiveService=CRYPTO_SIGNATURE_GENERATE, CryptoPrimitiveAlgorithmSecondaryFamily=CRYPTO_ALGOFAM_SHA1, CryptoPrimitiveAlgorithmMode=CRYPTO_ALGOMODE_CUSTOM, CryptoPrimitiveAlgorithmModeCustomRef=Crypto_30_LibCv_P384r1
        EccNistP384R1GenerateSha256: CryptoPrimitiveAlgorithmFamily=CRYPTO_ALGOFAM_ECCNIST, CryptoPrimitiveAlgorithmMode=CRYPTO_ALGOMODE_CUSTOM_P384R1, CryptoPrimitiveService=CRYPTO_SIGNATURE_GENERATE, CryptoPrimitiveAlgorithmSecondaryFamily=CRYPTO_ALGOFAM_SHA2_256, CryptoPrimitiveAlgorithmMode=CRYPTO_ALGOMODE_CUSTOM, CryptoPrimitiveAlgorithmModeCustomRef=Crypto_30_LibCv_P384r1
        EccNistP384R1VerifySha1: CryptoPrimitiveAlgorithmFamily=CRYPTO_ALGOFAM_ECCNIST, CryptoPrimitiveAlgorithmMode=CRYPTO_ALGOMODE_CUSTOM_P384R1, CryptoPrimitiveService=CRYPTO_SIGNATURE_VERIFY, CryptoPrimitiveAlgorithmSecondaryFamily=CRYPTO_ALGOFAM_SHA1, CryptoPrimitiveAlgorithmMode=CRYPTO_ALGOMODE_CUSTOM, CryptoPrimitiveAlgorithmModeCustomRef=Crypto_30_LibCv_P384r1
        EccNistP384R1VerifySha256: CryptoPrimitiveAlgorithmFamily=CRYPTO_ALGOFAM_ECCNIST, CryptoPrimitiveAlgorithmMode=CRYPTO_ALGOMODE_CUSTOM_P384R1, CryptoPrimitiveService=CRYPTO_SIGNATURE_VERIFY, CryptoPrimitiveAlgorithmSecondaryFamily=CRYPTO_ALGOFAM_SHA2_256, CryptoPrimitiveAlgorithmMode=CRYPTO_ALGOMODE_CUSTOM, CryptoPrimitiveAlgorithmModeCustomRef=Crypto_30_LibCv_P384r1
        EccSecP384R1GenerateSha1: CryptoPrimitiveAlgorithmFamily=CRYPTO_ALGOFAM_CUSTOM_ECCSEC, CryptoPrimitiveAlgorithmMode=CRYPTO_ALGOMODE_CUSTOM_P384R1, CryptoPrimitiveService=CRYPTO_SIGNATURE_GENERATE, CryptoPrimitiveAlgorithmSecondaryFamily=CRYPTO_ALGOFAM_SHA1, CryptoPrimitiveAlgorithmFamily=CRYPTO_ALGOFAM_CUSTOM, CryptoPrimitiveAlgorithmMode=CRYPTO_ALGOMODE_CUSTOM, CryptoPrimitiveAlgorithmFamily=CRYPTO_ALGOFAM_ECCSEC, CryptoPrimitiveAlgorithmFamilyCustomRef=Crypto_30_LibCv_ECCSEC, CryptoPrimitiveAlgorithmModeCustomRef=Crypto_30_LibCv_P384r1
        EccSecP384R1GenerateSha256: CryptoPrimitiveAlgorithmFamily=CRYPTO_ALGOFAM_CUSTOM_ECCSEC, CryptoPrimitiveAlgorithmMode=CRYPTO_ALGOMODE_CUSTOM_P384R1, CryptoPrimitiveService=CRYPTO_SIGNATURE_GENERATE, CryptoPrimitiveAlgorithmSecondaryFamily=CRYPTO_ALGOFAM_SHA2_256, CryptoPrimitiveAlgorithmFamily=CRYPTO_ALGOFAM_CUSTOM, CryptoPrimitiveAlgorithmMode=CRYPTO_ALGOMODE_CUSTOM, CryptoPrimitiveAlgorithmFamily=CRYPTO_ALGOFAM_ECCSEC, CryptoPrimitiveAlgorithmFamilyCustomRef=Crypto_30_LibCv_ECCSEC, CryptoPrimitiveAlgorithmModeCustomRef=Crypto_30_LibCv_P384r1
        EccSecP384R1VerifySha1: CryptoPrimitiveAlgorithmFamily=CRYPTO_ALGOFAM_CUSTOM_ECCSEC, CryptoPrimitiveAlgorithmMode=CRYPTO_ALGOMODE_CUSTOM_P384R1, CryptoPrimitiveService=CRYPTO_SIGNATURE_VERIFY, CryptoPrimitiveAlgorithmSecondaryFamily=CRYPTO_ALGOFAM_SHA1, CryptoPrimitiveAlgorithmFamily=CRYPTO_ALGOFAM_CUSTOM, CryptoPrimitiveAlgorithmMode=CRYPTO_ALGOMODE_CUSTOM, CryptoPrimitiveAlgorithmFamily=CRYPTO_ALGOFAM_ECCSEC, CryptoPrimitiveAlgorithmFamilyCustomRef=Crypto_30_LibCv_ECCSEC, CryptoPrimitiveAlgorithmModeCustomRef=Crypto_30_LibCv_P384r1
        EccSecP384R1VerifySha256: CryptoPrimitiveAlgorithmFamily=CRYPTO_ALGOFAM_CUSTOM_ECCSEC, CryptoPrimitiveAlgorithmMode=CRYPTO_ALGOMODE_CUSTOM_P384R1, CryptoPrimitiveService=CRYPTO_SIGNATURE_VERIFY, CryptoPrimitiveAlgorithmSecondaryFamily=CRYPTO_ALGOFAM_SHA2_256, CryptoPrimitiveAlgorithmFamily=CRYPTO_ALGOFAM_CUSTOM, CryptoPrimitiveAlgorithmMode=CRYPTO_ALGOMODE_CUSTOM, CryptoPrimitiveAlgorithmFamily=CRYPTO_ALGOFAM_ECCSEC, CryptoPrimitiveAlgorithmFamilyCustomRef=Crypto_30_LibCv_ECCSEC, CryptoPrimitiveAlgorithmModeCustomRef=Crypto_30_LibCv_P384r1
        RsaOaepSha1Encrypt: CryptoPrimitiveAlgorithmFamily=CRYPTO_ALGOFAM_RSA, CryptoPrimitiveAlgorithmMode=CRYPTO_ALGOMODE_RSAES_OAEP, CryptoPrimitiveAlgorithmSecondaryFamily=CRYPTO_ALGOFAM_SHA1, CryptoPrimitiveService=CRYPTO_ENCRYPT
        RsaOaepSha1Decrypt: CryptoPrimitiveAlgorithmFamily=CRYPTO_ALGOFAM_RSA, CryptoPrimitiveAlgorithmMode=CRYPTO_ALGOMODE_RSAES_OAEP, CryptoPrimitiveAlgorithmSecondaryFamily=CRYPTO_ALGOFAM_SHA1, CryptoPrimitiveService=CRYPTO_DECRYPT
        RsaOaepSha256Encrypt: CryptoPrimitiveAlgorithmFamily=CRYPTO_ALGOFAM_RSA, CryptoPrimitiveAlgorithmMode=CRYPTO_ALGOMODE_RSAES_OAEP, CryptoPrimitiveAlgorithmSecondaryFamily=CRYPTO_ALGOFAM_SHA2_256, CryptoPrimitiveService=CRYPTO_ENCRYPT
        RsaOaepSha256Decrypt: CryptoPrimitiveAlgorithmFamily=CRYPTO_ALGOFAM_RSA, CryptoPrimitiveAlgorithmMode=CRYPTO_ALGOMODE_RSAES_OAEP, CryptoPrimitiveAlgorithmSecondaryFamily=CRYPTO_ALGOFAM_SHA2_256, CryptoPrimitiveService=CRYPTO_DECRYPT
        RsaOaepCrtSha1Decrypt: CryptoPrimitiveAlgorithmFamily=CRYPTO_ALGOFAM_RSA, CryptoPrimitiveAlgorithmMode=CRYPTO_ALGOMODE_CUSTOM_RSAES_OAEP_CRT, CryptoPrimitiveAlgorithmSecondaryFamily=CRYPTO_ALGOFAM_SHA1, CryptoPrimitiveService=CRYPTO_DECRYPT, CryptoPrimitiveAlgorithmMode=CRYPTO_ALGOMODE_CUSTOM, CryptoPrimitiveAlgorithmModeCustomRef=Crypto_30_LibCv_RSAES_OAEP_CRT
        RsaOaepCrtSha256Decrypt: CryptoPrimitiveAlgorithmFamily=CRYPTO_ALGOFAM_RSA, CryptoPrimitiveAlgorithmMode=CRYPTO_ALGOMODE_CUSTOM_RSAES_OAEP_CRT, CryptoPrimitiveAlgorithmSecondaryFamily=CRYPTO_ALGOFAM_SHA2_256, CryptoPrimitiveService=CRYPTO_DECRYPT, CryptoPrimitiveAlgorithmMode=CRYPTO_ALGOMODE_CUSTOM, CryptoPrimitiveAlgorithmModeCustomRef=Crypto_30_LibCv_RSAES_OAEP_CRT
        EccNistP256R1GenerateSha512: CryptoPrimitiveAlgorithmFamily=CRYPTO_ALGOFAM_ECCNIST, CryptoPrimitiveAlgorithmMode=CRYPTO_ALGOMODE_CUSTOM_P256R1, CryptoPrimitiveService=CRYPTO_SIGNATURE_GENERATE, CryptoPrimitiveAlgorithmSecondaryFamily=CRYPTO_ALGOFAM_SHA2_512, CryptoPrimitiveAlgorithmMode=CRYPTO_ALGOMODE_CUSTOM, CryptoPrimitiveAlgorithmModeCustomRef=Crypto_30_LibCv_P256r1
        EccNistP256R1VerifySha512: CryptoPrimitiveAlgorithmFamily=CRYPTO_ALGOFAM_ECCNIST, CryptoPrimitiveAlgorithmMode=CRYPTO_ALGOMODE_CUSTOM_P256R1, CryptoPrimitiveService=CRYPTO_SIGNATURE_VERIFY, CryptoPrimitiveAlgorithmSecondaryFamily=CRYPTO_ALGOFAM_SHA2_512, CryptoPrimitiveAlgorithmMode=CRYPTO_ALGOMODE_CUSTOM, CryptoPrimitiveAlgorithmModeCustomRef=Crypto_30_LibCv_P256r1
        EccAnsiP256R1GenerateSha512: CryptoPrimitiveAlgorithmFamily=CRYPTO_ALGOFAM_CUSTOM_ECCANSI, CryptoPrimitiveAlgorithmMode=CRYPTO_ALGOMODE_CUSTOM_P256R1, CryptoPrimitiveService=CRYPTO_SIGNATURE_GENERATE, CryptoPrimitiveAlgorithmSecondaryFamily=CRYPTO_ALGOFAM_SHA2_512, CryptoPrimitiveAlgorithmFamily=CRYPTO_ALGOFAM_CUSTOM, CryptoPrimitiveAlgorithmMode=CRYPTO_ALGOMODE_CUSTOM, CryptoPrimitiveAlgorithmFamily=CRYPTO_ALGOFAM_ECCANSI, CryptoPrimitiveAlgorithmFamilyCustomRef=Crypto_30_LibCv_ECCANSI, CryptoPrimitiveAlgorithmModeCustomRef=Crypto_30_LibCv_P256r1
        EccAnsiP256R1VerifySha512: CryptoPrimitiveAlgorithmFamily=CRYPTO_ALGOFAM_CUSTOM_ECCANSI, CryptoPrimitiveAlgorithmMode=CRYPTO_ALGOMODE_CUSTOM_P256R1, CryptoPrimitiveService=CRYPTO_SIGNATURE_VERIFY, CryptoPrimitiveAlgorithmSecondaryFamily=CRYPTO_ALGOFAM_SHA2_512, CryptoPrimitiveAlgorithmFamily=CRYPTO_ALGOFAM_CUSTOM, CryptoPrimitiveAlgorithmMode=CRYPTO_ALGOMODE_CUSTOM, CryptoPrimitiveAlgorithmFamily=CRYPTO_ALGOFAM_ECCANSI, CryptoPrimitiveAlgorithmFamilyCustomRef=Crypto_30_LibCv_ECCANSI, CryptoPrimitiveAlgorithmModeCustomRef=Crypto_30_LibCv_P256r1
        EccSecP256R1GenerateSha512: CryptoPrimitiveAlgorithmFamily=CRYPTO_ALGOFAM_CUSTOM_ECCSEC, CryptoPrimitiveAlgorithmMode=CRYPTO_ALGOMODE_CUSTOM_P256R1, CryptoPrimitiveService=CRYPTO_SIGNATURE_GENERATE, CryptoPrimitiveAlgorithmSecondaryFamily=CRYPTO_ALGOFAM_SHA2_512, CryptoPrimitiveAlgorithmFamily=CRYPTO_ALGOFAM_CUSTOM, CryptoPrimitiveAlgorithmMode=CRYPTO_ALGOMODE_CUSTOM, CryptoPrimitiveAlgorithmFamily=CRYPTO_ALGOFAM_ECCSEC, CryptoPrimitiveAlgorithmFamilyCustomRef=Crypto_30_LibCv_ECCSEC, CryptoPrimitiveAlgorithmModeCustomRef=Crypto_30_LibCv_P256r1
        EccSecP256R1VerifySha512: CryptoPrimitiveAlgorithmFamily=CRYPTO_ALGOFAM_CUSTOM_ECCSEC, CryptoPrimitiveAlgorithmMode=CRYPTO_ALGOMODE_CUSTOM_P256R1, CryptoPrimitiveService=CRYPTO_SIGNATURE_VERIFY, CryptoPrimitiveAlgorithmSecondaryFamily=CRYPTO_ALGOFAM_SHA2_512, CryptoPrimitiveAlgorithmFamily=CRYPTO_ALGOFAM_CUSTOM, CryptoPrimitiveAlgorithmMode=CRYPTO_ALGOMODE_CUSTOM, CryptoPrimitiveAlgorithmFamily=CRYPTO_ALGOFAM_ECCSEC, CryptoPrimitiveAlgorithmFamilyCustomRef=Crypto_30_LibCv_ECCSEC, CryptoPrimitiveAlgorithmModeCustomRef=Crypto_30_LibCv_P256r1
        EccNistP384R1GenerateSha512: CryptoPrimitiveAlgorithmFamily=CRYPTO_ALGOFAM_ECCNIST, CryptoPrimitiveAlgorithmMode=CRYPTO_ALGOMODE_CUSTOM_P384R1, CryptoPrimitiveService=CRYPTO_SIGNATURE_GENERATE, CryptoPrimitiveAlgorithmSecondaryFamily=CRYPTO_ALGOFAM_SHA2_512, CryptoPrimitiveAlgorithmMode=CRYPTO_ALGOMODE_CUSTOM, CryptoPrimitiveAlgorithmModeCustomRef=Crypto_30_LibCv_P384r1
        EccNistP384R1VerifySha512: CryptoPrimitiveAlgorithmFamily=CRYPTO_ALGOFAM_ECCNIST, CryptoPrimitiveAlgorithmMode=CRYPTO_ALGOMODE_CUSTOM_P384R1, CryptoPrimitiveService=CRYPTO_SIGNATURE_VERIFY, CryptoPrimitiveAlgorithmSecondaryFamily=CRYPTO_ALGOFAM_SHA2_512, CryptoPrimitiveAlgorithmMode=CRYPTO_ALGOMODE_CUSTOM, CryptoPrimitiveAlgorithmModeCustomRef=Crypto_30_LibCv_P384r1
        EccSecP384R1GenerateSha512: CryptoPrimitiveAlgorithmFamily=CRYPTO_ALGOFAM_CUSTOM_ECCSEC, CryptoPrimitiveAlgorithmMode=CRYPTO_ALGOMODE_CUSTOM_P384R1, CryptoPrimitiveService=CRYPTO_SIGNATURE_GENERATE, CryptoPrimitiveAlgorithmSecondaryFamily=CRYPTO_ALGOFAM_SHA2_512, CryptoPrimitiveAlgorithmFamily=CRYPTO_ALGOFAM_CUSTOM, CryptoPrimitiveAlgorithmMode=CRYPTO_ALGOMODE_CUSTOM, CryptoPrimitiveAlgorithmFamily=CRYPTO_ALGOFAM_ECCSEC, CryptoPrimitiveAlgorithmFamilyCustomRef=Crypto_30_LibCv_ECCSEC, CryptoPrimitiveAlgorithmModeCustomRef=Crypto_30_LibCv_P384r1
        EccSecP384R1VerifySha512: CryptoPrimitiveAlgorithmFamily=CRYPTO_ALGOFAM_CUSTOM_ECCSEC, CryptoPrimitiveAlgorithmMode=CRYPTO_ALGOMODE_CUSTOM_P384R1, CryptoPrimitiveService=CRYPTO_SIGNATURE_VERIFY, CryptoPrimitiveAlgorithmSecondaryFamily=CRYPTO_ALGOFAM_SHA2_512, CryptoPrimitiveAlgorithmFamily=CRYPTO_ALGOFAM_CUSTOM, CryptoPrimitiveAlgorithmMode=CRYPTO_ALGOMODE_CUSTOM, CryptoPrimitiveAlgorithmFamily=CRYPTO_ALGOFAM_ECCSEC, CryptoPrimitiveAlgorithmFamilyCustomRef=Crypto_30_LibCv_ECCSEC, CryptoPrimitiveAlgorithmModeCustomRef=Crypto_30_LibCv_P384r1
        SHA384: CryptoPrimitiveAlgorithmSecondaryFamily=CRYPTO_ALGOFAM_NOT_SET, CryptoPrimitiveAlgorithmMode=CRYPTO_ALGOMODE_NOT_SET, CryptoPrimitiveService=CRYPTO_HASH, CryptoPrimitiveAlgorithmFamily=CRYPTO_ALGOFAM_SHA2_384
        EccNistP256R1GenerateSha384: CryptoPrimitiveAlgorithmFamily=CRYPTO_ALGOFAM_ECCNIST, CryptoPrimitiveAlgorithmMode=CRYPTO_ALGOMODE_CUSTOM_P256R1, CryptoPrimitiveService=CRYPTO_SIGNATURE_GENERATE, CryptoPrimitiveAlgorithmSecondaryFamily=CRYPTO_ALGOFAM_SHA2_384, CryptoPrimitiveAlgorithmMode=CRYPTO_ALGOMODE_CUSTOM, CryptoPrimitiveAlgorithmModeCustomRef=Crypto_30_LibCv_P256r1
        EccNistP256R1VerifySha384: CryptoPrimitiveAlgorithmFamily=CRYPTO_ALGOFAM_ECCNIST, CryptoPrimitiveAlgorithmMode=CRYPTO_ALGOMODE_CUSTOM_P256R1, CryptoPrimitiveService=CRYPTO_SIGNATURE_VERIFY, CryptoPrimitiveAlgorithmSecondaryFamily=CRYPTO_ALGOFAM_SHA2_384, CryptoPrimitiveAlgorithmMode=CRYPTO_ALGOMODE_CUSTOM, CryptoPrimitiveAlgorithmModeCustomRef=Crypto_30_LibCv_P256r1
        EccAnsiP256R1GenerateSha384: CryptoPrimitiveAlgorithmFamily=CRYPTO_ALGOFAM_CUSTOM_ECCANSI, CryptoPrimitiveAlgorithmMode=CRYPTO_ALGOMODE_CUSTOM_P256R1, CryptoPrimitiveService=CRYPTO_SIGNATURE_GENERATE, CryptoPrimitiveAlgorithmSecondaryFamily=CRYPTO_ALGOFAM_SHA2_384, CryptoPrimitiveAlgorithmFamily=CRYPTO_ALGOFAM_CUSTOM, CryptoPrimitiveAlgorithmMode=CRYPTO_ALGOMODE_CUSTOM, CryptoPrimitiveAlgorithmFamily=CRYPTO_ALGOFAM_ECCANSI, CryptoPrimitiveAlgorithmFamilyCustomRef=Crypto_30_LibCv_ECCANSI, CryptoPrimitiveAlgorithmModeCustomRef=Crypto_30_LibCv_P256r1
        EccAnsiP256R1VerifySha384: CryptoPrimitiveAlgorithmFamily=CRYPTO_ALGOFAM_CUSTOM_ECCANSI, CryptoPrimitiveAlgorithmMode=CRYPTO_ALGOMODE_CUSTOM_P256R1, CryptoPrimitiveService=CRYPTO_SIGNATURE_VERIFY, CryptoPrimitiveAlgorithmSecondaryFamily=CRYPTO_ALGOFAM_SHA2_384, CryptoPrimitiveAlgorithmFamily=CRYPTO_ALGOFAM_CUSTOM, CryptoPrimitiveAlgorithmMode=CRYPTO_ALGOMODE_CUSTOM, CryptoPrimitiveAlgorithmFamily=CRYPTO_ALGOFAM_ECCANSI, CryptoPrimitiveAlgorithmFamilyCustomRef=Crypto_30_LibCv_ECCANSI, CryptoPrimitiveAlgorithmModeCustomRef=Crypto_30_LibCv_P256r1
        EccSecP256R1GenerateSha384: CryptoPrimitiveAlgorithmFamily=CRYPTO_ALGOFAM_CUSTOM_ECCSEC, CryptoPrimitiveAlgorithmMode=CRYPTO_ALGOMODE_CUSTOM_P256R1, CryptoPrimitiveService=CRYPTO_SIGNATURE_GENERATE, CryptoPrimitiveAlgorithmSecondaryFamily=CRYPTO_ALGOFAM_SHA2_384, CryptoPrimitiveAlgorithmFamily=CRYPTO_ALGOFAM_CUSTOM, CryptoPrimitiveAlgorithmMode=CRYPTO_ALGOMODE_CUSTOM, CryptoPrimitiveAlgorithmFamily=CRYPTO_ALGOFAM_ECCSEC, CryptoPrimitiveAlgorithmFamilyCustomRef=Crypto_30_LibCv_ECCSEC, CryptoPrimitiveAlgorithmModeCustomRef=Crypto_30_LibCv_P256r1
        EccSecP256R1VerifySha384: CryptoPrimitiveAlgorithmFamily=CRYPTO_ALGOFAM_CUSTOM_ECCSEC, CryptoPrimitiveAlgorithmMode=CRYPTO_ALGOMODE_CUSTOM_P256R1, CryptoPrimitiveService=CRYPTO_SIGNATURE_VERIFY, CryptoPrimitiveAlgorithmSecondaryFamily=CRYPTO_ALGOFAM_SHA2_384, CryptoPrimitiveAlgorithmFamily=CRYPTO_ALGOFAM_CUSTOM, CryptoPrimitiveAlgorithmMode=CRYPTO_ALGOMODE_CUSTOM, CryptoPrimitiveAlgorithmFamily=CRYPTO_ALGOFAM_ECCSEC, CryptoPrimitiveAlgorithmFamilyCustomRef=Crypto_30_LibCv_ECCSEC, CryptoPrimitiveAlgorithmModeCustomRef=Crypto_30_LibCv_P256r1
        EccNistP384R1GenerateSha384: CryptoPrimitiveAlgorithmFamily=CRYPTO_ALGOFAM_ECCNIST, CryptoPrimitiveAlgorithmMode=CRYPTO_ALGOMODE_CUSTOM_P384R1, CryptoPrimitiveService=CRYPTO_SIGNATURE_GENERATE, CryptoPrimitiveAlgorithmSecondaryFamily=CRYPTO_ALGOFAM_SHA2_384, CryptoPrimitiveAlgorithmMode=CRYPTO_ALGOMODE_CUSTOM, CryptoPrimitiveAlgorithmModeCustomRef=Crypto_30_LibCv_P384r1
        EccNistP384R1VerifySha384: CryptoPrimitiveAlgorithmFamily=CRYPTO_ALGOFAM_ECCNIST, CryptoPrimitiveAlgorithmMode=CRYPTO_ALGOMODE_CUSTOM_P384R1, CryptoPrimitiveService=CRYPTO_SIGNATURE_VERIFY, CryptoPrimitiveAlgorithmSecondaryFamily=CRYPTO_ALGOFAM_SHA2_384, CryptoPrimitiveAlgorithmMode=CRYPTO_ALGOMODE_CUSTOM, CryptoPrimitiveAlgorithmModeCustomRef=Crypto_30_LibCv_P384r1
        EccSecP384R1GenerateSha384: CryptoPrimitiveAlgorithmFamily=CRYPTO_ALGOFAM_CUSTOM_ECCSEC, CryptoPrimitiveAlgorithmMode=CRYPTO_ALGOMODE_CUSTOM_P384R1, CryptoPrimitiveService=CRYPTO_SIGNATURE_GENERATE, CryptoPrimitiveAlgorithmSecondaryFamily=CRYPTO_ALGOFAM_SHA2_384, CryptoPrimitiveAlgorithmFamily=CRYPTO_ALGOFAM_CUSTOM, CryptoPrimitiveAlgorithmMode=CRYPTO_ALGOMODE_CUSTOM, CryptoPrimitiveAlgorithmFamily=CRYPTO_ALGOFAM_ECCSEC, CryptoPrimitiveAlgorithmFamilyCustomRef=Crypto_30_LibCv_ECCSEC, CryptoPrimitiveAlgorithmModeCustomRef=Crypto_30_LibCv_P384r1
        EccSecP384R1VerifySha384: CryptoPrimitiveAlgorithmFamily=CRYPTO_ALGOFAM_CUSTOM_ECCSEC, CryptoPrimitiveAlgorithmMode=CRYPTO_ALGOMODE_CUSTOM_P384R1, CryptoPrimitiveService=CRYPTO_SIGNATURE_VERIFY, CryptoPrimitiveAlgorithmSecondaryFamily=CRYPTO_ALGOFAM_SHA2_384, CryptoPrimitiveAlgorithmFamily=CRYPTO_ALGOFAM_CUSTOM, CryptoPrimitiveAlgorithmMode=CRYPTO_ALGOMODE_CUSTOM, CryptoPrimitiveAlgorithmFamily=CRYPTO_ALGOFAM_ECCSEC, CryptoPrimitiveAlgorithmFamilyCustomRef=Crypto_30_LibCv_ECCSEC, CryptoPrimitiveAlgorithmModeCustomRef=Crypto_30_LibCv_P384r1
        GmacAesGenerate: CryptoPrimitiveAlgorithmSecondaryFamily=CRYPTO_ALGOFAM_NOT_SET, CryptoPrimitiveAlgorithmMode=CRYPTO_ALGOMODE_GMAC, CryptoPrimitiveService=CRYPTO_MAC_GENERATE, CryptoPrimitiveAlgorithmFamily=CRYPTO_ALGOFAM_AES
        GmacAesVerify: CryptoPrimitiveAlgorithmSecondaryFamily=CRYPTO_ALGOFAM_NOT_SET, CryptoPrimitiveAlgorithmMode=CRYPTO_ALGOMODE_GMAC, CryptoPrimitiveService=CRYPTO_MAC_VERIFY, CryptoPrimitiveAlgorithmFamily=CRYPTO_ALGOFAM_AES
        HmacSha384Generate: CryptoPrimitiveAlgorithmFamily=CRYPTO_ALGOFAM_SHA2_384, CryptoPrimitiveAlgorithmMode=CRYPTO_ALGOMODE_HMAC, CryptoPrimitiveAlgorithmSecondaryFamily=CRYPTO_ALGOFAM_NOT_SET, CryptoPrimitiveService=CRYPTO_MAC_GENERATE
        HmacSha384Verify: CryptoPrimitiveAlgorithmFamily=CRYPTO_ALGOFAM_SHA2_384, CryptoPrimitiveAlgorithmMode=CRYPTO_ALGOMODE_HMAC, CryptoPrimitiveAlgorithmSecondaryFamily=CRYPTO_ALGOFAM_NOT_SET, CryptoPrimitiveService=CRYPTO_MAC_VERIFY
        KeySetValid: CryptoPrimitiveService=CRYPTO_KEY_SET_VALID, CryptoPrimitiveAlgorithmFamily=CRYPTO_ALGOFAM_NOT_SET, CryptoPrimitiveAlgorithmMode=CRYPTO_ALGOMODE_NOT_SET, CryptoPrimitiveAlgorithmSecondaryFamily=CRYPTO_ALGOFAM_NOT_SET
        KeyDeriveX963SHA256: CryptoPrimitiveService=CRYPTO_KEY_DERIVE, CryptoPrimitiveAlgorithmFamily=CRYPTO_ALGOFAM_KDFX963, CryptoPrimitiveAlgorithmMode=CRYPTO_ALGOMODE_NOT_SET, CryptoPrimitiveAlgorithmSecondaryFamily=CRYPTO_ALGOFAM_SHA2_256
        KeyExchangeCalcPubValX25519: CryptoPrimitiveService=CRYPTO_KEY_EXCHANGE_CALC_PUBVAL, CryptoPrimitiveAlgorithmFamily=CRYPTO_ALGOFAM_CUSTOM_X25519, CryptoPrimitiveAlgorithmMode=CRYPTO_ALGOMODE_NOT_SET, CryptoPrimitiveAlgorithmSecondaryFamily=CRYPTO_ALGOFAM_NOT_SET, CryptoPrimitiveAlgorithmFamily=CRYPTO_ALGOFAM_CUSTOM, CryptoPrimitiveAlgorithmFamily=CRYPTO_ALGOFAM_X25519, CryptoPrimitiveAlgorithmFamilyCustomRef=Crypto_30_LibCv_X25519
        KeyExchangeCalcSecretX25519: CryptoPrimitiveService=CRYPTO_KEY_EXCHANGE_CALC_SECRET, CryptoPrimitiveAlgorithmFamily=CRYPTO_ALGOFAM_CUSTOM_X25519, CryptoPrimitiveAlgorithmMode=CRYPTO_ALGOMODE_NOT_SET, CryptoPrimitiveAlgorithmSecondaryFamily=CRYPTO_ALGOFAM_NOT_SET, CryptoPrimitiveAlgorithmFamily=CRYPTO_ALGOFAM_CUSTOM, CryptoPrimitiveAlgorithmFamily=CRYPTO_ALGOFAM_X25519, CryptoPrimitiveAlgorithmFamilyCustomRef=Crypto_30_LibCv_X25519
        KeyExchangeCalcPubValSecP256R1: CryptoPrimitiveService=CRYPTO_KEY_EXCHANGE_CALC_PUBVAL, CryptoPrimitiveAlgorithmFamily=CRYPTO_ALGOFAM_ECCSEC, CryptoPrimitiveAlgorithmMode=CRYPTO_ALGOMODE_CUSTOM_P256R1, CryptoPrimitiveAlgorithmSecondaryFamily=CRYPTO_ALGOFAM_NOT_SET, CryptoPrimitiveAlgorithmMode=CRYPTO_ALGOMODE_CUSTOM, CryptoPrimitiveAlgorithmModeCustomRef=Crypto_30_LibCv_P256r1
        KeyExchangeCalcPubValSecP384R1: CryptoPrimitiveService=CRYPTO_KEY_EXCHANGE_CALC_PUBVAL, CryptoPrimitiveAlgorithmFamily=CRYPTO_ALGOFAM_ECCSEC, CryptoPrimitiveAlgorithmMode=CRYPTO_ALGOMODE_CUSTOM_P384R1, CryptoPrimitiveAlgorithmSecondaryFamily=CRYPTO_ALGOFAM_NOT_SET, CryptoPrimitiveAlgorithmMode=CRYPTO_ALGOMODE_CUSTOM, CryptoPrimitiveAlgorithmModeCustomRef=Crypto_30_LibCv_P384r1
        KeyExchangeCalcSecretSecP256R1: CryptoPrimitiveService=CRYPTO_KEY_EXCHANGE_CALC_SECRET, CryptoPrimitiveAlgorithmFamily=CRYPTO_ALGOFAM_ECCSEC, CryptoPrimitiveAlgorithmMode=CRYPTO_ALGOMODE_CUSTOM_P256R1, CryptoPrimitiveAlgorithmSecondaryFamily=CRYPTO_ALGOFAM_NOT_SET, CryptoPrimitiveAlgorithmMode=CRYPTO_ALGOMODE_CUSTOM, CryptoPrimitiveAlgorithmModeCustomRef=Crypto_30_LibCv_P256r1
        KeyExchangeCalcSecretSecP384R1: CryptoPrimitiveService=CRYPTO_KEY_EXCHANGE_CALC_SECRET, CryptoPrimitiveAlgorithmFamily=CRYPTO_ALGOFAM_ECCSEC, CryptoPrimitiveAlgorithmMode=CRYPTO_ALGOMODE_CUSTOM_P384R1, CryptoPrimitiveAlgorithmSecondaryFamily=CRYPTO_ALGOFAM_NOT_SET, CryptoPrimitiveAlgorithmMode=CRYPTO_ALGOMODE_CUSTOM, CryptoPrimitiveAlgorithmModeCustomRef=Crypto_30_LibCv_P384r1
        KeyExchangeCalcPubValAnsiP256R1: CryptoPrimitiveService=CRYPTO_KEY_EXCHANGE_CALC_PUBVAL, CryptoPrimitiveAlgorithmFamily=CRYPTO_ALGOFAM_ECCANSI, CryptoPrimitiveAlgorithmMode=CRYPTO_ALGOMODE_CUSTOM_P256R1, CryptoPrimitiveAlgorithmSecondaryFamily=CRYPTO_ALGOFAM_NOT_SET, CryptoPrimitiveAlgorithmMode=CRYPTO_ALGOMODE_CUSTOM, CryptoPrimitiveAlgorithmModeCustomRef=Crypto_30_LibCv_P256r1
        KeyExchangeCalcSecretAnsiP256R1: CryptoPrimitiveService=CRYPTO_KEY_EXCHANGE_CALC_SECRET, CryptoPrimitiveAlgorithmFamily=CRYPTO_ALGOFAM_ECCANSI, CryptoPrimitiveAlgorithmMode=CRYPTO_ALGOMODE_CUSTOM_P256R1, CryptoPrimitiveAlgorithmSecondaryFamily=CRYPTO_ALGOFAM_NOT_SET, CryptoPrimitiveAlgorithmMode=CRYPTO_ALGOMODE_CUSTOM, CryptoPrimitiveAlgorithmModeCustomRef=Crypto_30_LibCv_P256r1
        KeyExchangeCalcPubValNistP256R1: CryptoPrimitiveService=CRYPTO_KEY_EXCHANGE_CALC_PUBVAL, CryptoPrimitiveAlgorithmFamily=CRYPTO_ALGOFAM_ECCNIST, CryptoPrimitiveAlgorithmMode=CRYPTO_ALGOMODE_CUSTOM_P256R1, CryptoPrimitiveAlgorithmSecondaryFamily=CRYPTO_ALGOFAM_NOT_SET, CryptoPrimitiveAlgorithmMode=CRYPTO_ALGOMODE_CUSTOM, CryptoPrimitiveAlgorithmModeCustomRef=Crypto_30_LibCv_P256r1
        KeyExchangeCalcSecretNistP256R1: CryptoPrimitiveService=CRYPTO_KEY_EXCHANGE_CALC_SECRET, CryptoPrimitiveAlgorithmFamily=CRYPTO_ALGOFAM_ECCNIST, CryptoPrimitiveAlgorithmMode=CRYPTO_ALGOMODE_CUSTOM_P256R1, CryptoPrimitiveAlgorithmSecondaryFamily=CRYPTO_ALGOFAM_NOT_SET, CryptoPrimitiveAlgorithmMode=CRYPTO_ALGOMODE_CUSTOM, CryptoPrimitiveAlgorithmModeCustomRef=Crypto_30_LibCv_P256r1
        KeyExchangeCalcPubValNistP384R1: CryptoPrimitiveService=CRYPTO_KEY_EXCHANGE_CALC_PUBVAL, CryptoPrimitiveAlgorithmFamily=CRYPTO_ALGOFAM_ECCNIST, CryptoPrimitiveAlgorithmMode=CRYPTO_ALGOMODE_CUSTOM_P384R1, CryptoPrimitiveAlgorithmSecondaryFamily=CRYPTO_ALGOFAM_NOT_SET, CryptoPrimitiveAlgorithmMode=CRYPTO_ALGOMODE_CUSTOM, CryptoPrimitiveAlgorithmModeCustomRef=Crypto_30_LibCv_P384r1
        KeyExchangeCalcSecretNistP384R1: CryptoPrimitiveService=CRYPTO_KEY_EXCHANGE_CALC_SECRET, CryptoPrimitiveAlgorithmFamily=CRYPTO_ALGOFAM_ECCNIST, CryptoPrimitiveAlgorithmMode=CRYPTO_ALGOMODE_CUSTOM_P384R1, CryptoPrimitiveAlgorithmSecondaryFamily=CRYPTO_ALGOFAM_NOT_SET, CryptoPrimitiveAlgorithmMode=CRYPTO_ALGOMODE_CUSTOM, CryptoPrimitiveAlgorithmModeCustomRef=Crypto_30_LibCv_P384r1
        RandomSeedRngFips186Sha1: CryptoPrimitiveAlgorithmMode=CRYPTO_ALGOMODE_NOT_SET, CryptoPrimitiveService=CRYPTO_RANDOM_SEED, CryptoPrimitiveAlgorithmFamily=CRYPTO_ALGOFAM_FIPS186, CryptoPrimitiveAlgorithmSecondaryFamily=CRYPTO_ALGOFAM_SHA1
        RandomSeedRngDrbgAes128: CryptoPrimitiveAlgorithmMode=CRYPTO_ALGOMODE_NOT_SET, CryptoPrimitiveService=CRYPTO_RANDOM_SEED, CryptoPrimitiveAlgorithmFamily=CRYPTO_ALGOFAM_DRBG, CryptoPrimitiveAlgorithmSecondaryFamily=CRYPTO_ALGOFAM_AES
        RandomSeedRngDrbgAes128Df: CryptoPrimitiveAlgorithmMode=CRYPTO_ALGOMODE_CUSTOM_USE_DF, CryptoPrimitiveService=CRYPTO_RANDOM_SEED, CryptoPrimitiveAlgorithmFamily=CRYPTO_ALGOFAM_DRBG, CryptoPrimitiveAlgorithmSecondaryFamily=CRYPTO_ALGOFAM_AES, CryptoPrimitiveAlgorithmMode=CRYPTO_ALGOMODE_CUSTOM, CryptoPrimitiveAlgorithmModeCustomRef=Crypto_30_LibCv_UseDF
        KeyDeriveIso15118: CryptoPrimitiveService=CRYPTO_KEY_DERIVE, CryptoPrimitiveAlgorithmFamily=CRYPTO_ALGOFAM_CUSTOM_ISO15118, CryptoPrimitiveAlgorithmMode=CRYPTO_ALGOMODE_NOT_SET, CryptoPrimitiveAlgorithmSecondaryFamily=CRYPTO_ALGOFAM_NOT_SET, CryptoPrimitiveAlgorithmFamily=CRYPTO_ALGOFAM_CUSTOM, CryptoPrimitiveAlgorithmFamilyCustomRef=Crypto_30_LibCv_ISO15118
        KeyDeriveSymNist800108CntModeSha256: CryptoPrimitiveService=CRYPTO_KEY_DERIVE, CryptoPrimitiveAlgorithmFamily=CRYPTO_ALGOFAM_NOT_SET, CryptoPrimitiveAlgorithmMode=CRYPTO_ALGOMODE_CTR, CryptoPrimitiveAlgorithmSecondaryFamily=CRYPTO_ALGOFAM_SHA2_256
        KeyDeriveAsymNistFips1864Erb: CryptoPrimitiveService=CRYPTO_KEY_DERIVE, CryptoPrimitiveAlgorithmFamily=CRYPTO_ALGOFAM_FIPS186, CryptoPrimitiveAlgorithmMode=CRYPTO_ALGOMODE_NOT_SET, CryptoPrimitiveAlgorithmSecondaryFamily=CRYPTO_ALGOFAM_SHA2_256
        KeyDeriveNist80056AOnePassSha256: CryptoPrimitiveService=CRYPTO_KEY_DERIVE, CryptoPrimitiveAlgorithmFamily=CRYPTO_ALGOFAM_DH, CryptoPrimitiveAlgorithmMode=CRYPTO_ALGOMODE_CUSTOM_P256R1, CryptoPrimitiveAlgorithmSecondaryFamily=CRYPTO_ALGOFAM_SHA2_256, CryptoPrimitiveAlgorithmMode=CRYPTO_ALGOMODE_CUSTOM, CryptoPrimitiveAlgorithmModeCustomRef=Crypto_30_LibCv_P256r1
        KeyGenerateSymmetricGeneric: CryptoPrimitiveService=CRYPTO_KEY_GENERATE, CryptoPrimitiveAlgorithmFamily=CRYPTO_ALGOFAM_NOT_SET, CryptoPrimitiveAlgorithmMode=CRYPTO_ALGOMODE_NOT_SET, CryptoPrimitiveAlgorithmSecondaryFamily=CRYPTO_ALGOFAM_NOT_SET
        KeyGenerateSecP256R1: CryptoPrimitiveService=CRYPTO_KEY_GENERATE, CryptoPrimitiveAlgorithmFamily=CRYPTO_ALGOFAM_ECCSEC, CryptoPrimitiveAlgorithmMode=CRYPTO_ALGOMODE_CUSTOM_P256R1, CryptoPrimitiveAlgorithmSecondaryFamily=CRYPTO_ALGOFAM_NOT_SET, CryptoPrimitiveAlgorithmMode=CRYPTO_ALGOMODE_CUSTOM, CryptoPrimitiveAlgorithmModeCustomRef=Crypto_30_LibCv_P256r1
        KeyGenerateSecP384R1: CryptoPrimitiveService=CRYPTO_KEY_GENERATE, CryptoPrimitiveAlgorithmFamily=CRYPTO_ALGOFAM_ECCSEC, CryptoPrimitiveAlgorithmMode=CRYPTO_ALGOMODE_CUSTOM_P384R1, CryptoPrimitiveAlgorithmSecondaryFamily=CRYPTO_ALGOFAM_NOT_SET, CryptoPrimitiveAlgorithmMode=CRYPTO_ALGOMODE_CUSTOM, CryptoPrimitiveAlgorithmModeCustomRef=Crypto_30_LibCv_P384r1
        KeyGenerateNistP256R1: CryptoPrimitiveService=CRYPTO_KEY_GENERATE, CryptoPrimitiveAlgorithmFamily=CRYPTO_ALGOFAM_ECCNIST, CryptoPrimitiveAlgorithmMode=CRYPTO_ALGOMODE_CUSTOM_P256R1, CryptoPrimitiveAlgorithmSecondaryFamily=CRYPTO_ALGOFAM_NOT_SET, CryptoPrimitiveAlgorithmMode=CRYPTO_ALGOMODE_CUSTOM, CryptoPrimitiveAlgorithmModeCustomRef=Crypto_30_LibCv_P256r1
        KeyGenerateNistP384R1: CryptoPrimitiveService=CRYPTO_KEY_GENERATE, CryptoPrimitiveAlgorithmFamily=CRYPTO_ALGOFAM_ECCNIST, CryptoPrimitiveAlgorithmMode=CRYPTO_ALGOMODE_CUSTOM_P384R1, CryptoPrimitiveAlgorithmSecondaryFamily=CRYPTO_ALGOFAM_NOT_SET, CryptoPrimitiveAlgorithmMode=CRYPTO_ALGOMODE_CUSTOM, CryptoPrimitiveAlgorithmModeCustomRef=Crypto_30_LibCv_P384r1
        KeyGenerateAnsiP256R1: CryptoPrimitiveService=CRYPTO_KEY_GENERATE, CryptoPrimitiveAlgorithmFamily=CRYPTO_ALGOFAM_ECCANSI, CryptoPrimitiveAlgorithmMode=CRYPTO_ALGOMODE_CUSTOM_P256R1, CryptoPrimitiveAlgorithmSecondaryFamily=CRYPTO_ALGOFAM_NOT_SET, CryptoPrimitiveAlgorithmMode=CRYPTO_ALGOMODE_CUSTOM, CryptoPrimitiveAlgorithmModeCustomRef=Crypto_30_LibCv_P256r1
        HmacRipemd160Generate: CryptoPrimitiveService=CRYPTO_MAC_GENERATE, CryptoPrimitiveAlgorithmMode=CRYPTO_ALGOMODE_HMAC, CryptoPrimitiveAlgorithmFamily=CRYPTO_ALGOFAM_RIPEMD160, CryptoPrimitiveAlgorithmSecondaryFamily=CRYPTO_ALGOFAM_NOT_SET
        HmacRipemd160Verify: CryptoPrimitiveService=CRYPTO_MAC_VERIFY, CryptoPrimitiveAlgorithmMode=CRYPTO_ALGOMODE_HMAC, CryptoPrimitiveAlgorithmFamily=CRYPTO_ALGOFAM_RIPEMD160, CryptoPrimitiveAlgorithmSecondaryFamily=CRYPTO_ALGOFAM_NOT_SET
        EccSecP160R1GenerateWithoutPreHashing: CryptoPrimitiveService=CRYPTO_SIGNATURE_GENERATE, CryptoPrimitiveAlgorithmMode=CRYPTO_ALGOMODE_CUSTOM_P160R1, CryptoPrimitiveAlgorithmFamily=CRYPTO_ALGOFAM_ECCSEC, CryptoPrimitiveAlgorithmSecondaryFamily=CRYPTO_ALGOFAM_NOT_SET, CryptoPrimitiveAlgorithmMode=CRYPTO_ALGOMODE_CUSTOM, CryptoPrimitiveAlgorithmModeCustomRef=Crypto_30_LibCv_P160r1
        EccSecP160R1VerifyWithoutPreHashing: CryptoPrimitiveService=CRYPTO_SIGNATURE_VERIFY, CryptoPrimitiveAlgorithmMode=CRYPTO_ALGOMODE_CUSTOM_P160R1, CryptoPrimitiveAlgorithmFamily=CRYPTO_ALGOFAM_ECCSEC, CryptoPrimitiveAlgorithmSecondaryFamily=CRYPTO_ALGOFAM_NOT_SET, CryptoPrimitiveAlgorithmMode=CRYPTO_ALGOMODE_CUSTOM, CryptoPrimitiveAlgorithmModeCustomRef=Crypto_30_LibCv_P160r1
        HashRipemd160: CryptoPrimitiveService=CRYPTO_HASH, CryptoPrimitiveAlgorithmMode=CRYPTO_ALGOMODE_NOT_SET, CryptoPrimitiveAlgorithmFamily=CRYPTO_ALGOFAM_RIPEMD160, CryptoPrimitiveAlgorithmSecondaryFamily=CRYPTO_ALGOFAM_NOT_SET
        KeyDerivePbkdf2HmacSha1: CryptoPrimitiveService=CRYPTO_KEY_DERIVE, CryptoPrimitiveAlgorithmFamily=CRYPTO_ALGOFAM_PBKDF2, CryptoPrimitiveAlgorithmMode=CRYPTO_ALGOMODE_HMAC, CryptoPrimitiveAlgorithmSecondaryFamily=CRYPTO_ALGOFAM_SHA1
        KeyDerivePbkdf2HmacSha256: CryptoPrimitiveService=CRYPTO_KEY_DERIVE, CryptoPrimitiveAlgorithmFamily=CRYPTO_ALGOFAM_PBKDF2, CryptoPrimitiveAlgorithmMode=CRYPTO_ALGOMODE_HMAC, CryptoPrimitiveAlgorithmSecondaryFamily=CRYPTO_ALGOFAM_SHA2_256
        KeyDeriveX963SHA512: CryptoPrimitiveService=CRYPTO_KEY_DERIVE, CryptoPrimitiveAlgorithmMode=CRYPTO_ALGOMODE_NOT_SET, CryptoPrimitiveAlgorithmFamily=CRYPTO_ALGOFAM_KDFX963, CryptoPrimitiveAlgorithmSecondaryFamily=CRYPTO_ALGOFAM_SHA2_512
        AeadChaCha20Poly1305Encrypt: CryptoPrimitiveService=CRYPTO_AEADENCRYPT, CryptoPrimitiveAlgorithmMode=CRYPTO_ALGOMODE_20ROUNDS, CryptoPrimitiveAlgorithmFamily=CRYPTO_ALGOFAM_CHACHA, CryptoPrimitiveAlgorithmSecondaryFamily=CRYPTO_ALGOFAM_CUSTOM, CryptoPrimitiveAlgorithmSecondaryFamily=CRYPTO_ALGOFAM_CUSTOM_POLY_1305, CryptoPrimitiveAlgorithmSecondaryFamily=CRYPTO_ALGOFAM_POLY1305, CryptoPrimitiveAlgorithmSecondaryFamilyCustomRef=Crypto_30_LibCv_POLY1305
        AeadChaCha20Poly1305Decrypt: CryptoPrimitiveService=CRYPTO_AEADDECRYPT, CryptoPrimitiveAlgorithmMode=CRYPTO_ALGOMODE_20ROUNDS, CryptoPrimitiveAlgorithmFamily=CRYPTO_ALGOFAM_CHACHA, CryptoPrimitiveAlgorithmSecondaryFamily=CRYPTO_ALGOFAM_CUSTOM, CryptoPrimitiveAlgorithmSecondaryFamily=CRYPTO_ALGOFAM_CUSTOM_POLY_1305, CryptoPrimitiveAlgorithmSecondaryFamily=CRYPTO_ALGOFAM_POLY1305, CryptoPrimitiveAlgorithmSecondaryFamilyCustomRef=Crypto_30_LibCv_POLY1305
        RngHashDrbgSha512: CryptoPrimitiveService=CRYPTO_RANDOM, CryptoPrimitiveAlgorithmMode=CRYPTO_ALGOMODE_NOT_SET, CryptoPrimitiveAlgorithmFamily=CRYPTO_ALGOFAM_DRBG, CryptoPrimitiveAlgorithmSecondaryFamily=CRYPTO_ALGOFAM_SHA2_512
        RandomSeedRngHashDrbgSha512: CryptoPrimitiveService=CRYPTO_RANDOM_SEED, CryptoPrimitiveAlgorithmMode=CRYPTO_ALGOMODE_NOT_SET, CryptoPrimitiveAlgorithmFamily=CRYPTO_ALGOFAM_DRBG, CryptoPrimitiveAlgorithmSecondaryFamily=CRYPTO_ALGOFAM_SHA2_512
        SHA3_256: CryptoPrimitiveService=CRYPTO_HASH, CryptoPrimitiveAlgorithmMode=CRYPTO_ALGOMODE_NOT_SET, CryptoPrimitiveAlgorithmFamily=CRYPTO_ALGOFAM_SHA3_256, CryptoPrimitiveAlgorithmSecondaryFamily=CRYPTO_ALGOFAM_NOT_SET
        RngDrbgAes256: CryptoPrimitiveService=CRYPTO_RANDOM, CryptoPrimitiveAlgorithmMode=CRYPTO_ALGOMODE_NOT_SET, CryptoPrimitiveAlgorithmFamily=CRYPTO_ALGOFAM_DRBG, CryptoPrimitiveAlgorithmSecondaryFamily=CRYPTO_ALGOFAM_AES
        RngDrbgAes256Df: CryptoPrimitiveService=CRYPTO_RANDOM, CryptoPrimitiveAlgorithmMode=CRYPTO_ALGOMODE_CUSTOM_USE_DF, CryptoPrimitiveAlgorithmFamily=CRYPTO_ALGOFAM_DRBG, CryptoPrimitiveAlgorithmSecondaryFamily=CRYPTO_ALGOFAM_AES, CryptoPrimitiveAlgorithmMode=CRYPTO_ALGOMODE_CUSTOM, CryptoPrimitiveAlgorithmModeCustomRef=Crypto_30_LibCv_UseDF
        RandomSeedRngDrbgAes256: CryptoPrimitiveService=CRYPTO_RANDOM_SEED, CryptoPrimitiveAlgorithmMode=CRYPTO_ALGOMODE_NOT_SET, CryptoPrimitiveAlgorithmFamily=CRYPTO_ALGOFAM_DRBG, CryptoPrimitiveAlgorithmSecondaryFamily=CRYPTO_ALGOFAM_AES
        RandomSeedRngDrbgAes256Df: CryptoPrimitiveService=CRYPTO_RANDOM_SEED, CryptoPrimitiveAlgorithmMode=CRYPTO_ALGOMODE_CUSTOM_USE_DF, CryptoPrimitiveAlgorithmFamily=CRYPTO_ALGOFAM_DRBG, CryptoPrimitiveAlgorithmSecondaryFamily=CRYPTO_ALGOFAM_AES, CryptoPrimitiveAlgorithmMode=CRYPTO_ALGOMODE_CUSTOM, CryptoPrimitiveAlgorithmModeCustomRef=Crypto_30_LibCv_UseDF
        SheCmdGetId: CryptoPrimitiveService=CRYPTO_MAC_GENERATE, CryptoPrimitiveAlgorithmMode=CRYPTO_ALGOMODE_CMAC, CryptoPrimitiveAlgorithmFamily=CRYPTO_ALGOFAM_AES, CryptoPrimitiveAlgorithmSecondaryFamily=CRYPTO_ALGOFAM_CUSTOM_CMD_GET_ID, CryptoPrimitiveAlgorithmSecondaryFamily=CRYPTO_ALGOFAM_CUSTOM, CryptoPrimitiveAlgorithmSecondaryFamilyCustomRef=Crypto_30_LibCv_CmdGetId
        AesCCMEncrypt: CryptoPrimitiveAlgorithmSecondaryFamily=CRYPTO_ALGOFAM_NOT_SET, CryptoPrimitiveAlgorithmMode=CRYPTO_ALGOMODE_CUSTOM_CCM, CryptoPrimitiveService=CRYPTO_AEADENCRYPT, CryptoPrimitiveAlgorithmFamily=CRYPTO_ALGOFAM_AES, CryptoPrimitiveAlgorithmMode=CRYPTO_ALGOMODE_CUSTOM, CryptoPrimitiveAlgorithmModeCustomRef=Crypto_30_LibCv_CCM
        AesCCMDecrypt: CryptoPrimitiveAlgorithmSecondaryFamily=CRYPTO_ALGOFAM_NOT_SET, CryptoPrimitiveAlgorithmMode=CRYPTO_ALGOMODE_CUSTOM_CCM, CryptoPrimitiveService=CRYPTO_AEADDECRYPT, CryptoPrimitiveAlgorithmFamily=CRYPTO_ALGOFAM_AES, CryptoPrimitiveAlgorithmMode=CRYPTO_ALGOMODE_CUSTOM, CryptoPrimitiveAlgorithmModeCustomRef=Crypto_30_LibCv_CCM
        KeyDeriveHkdfHmacSHA256: CryptoPrimitiveService=CRYPTO_KEY_DERIVE, CryptoPrimitiveAlgorithmFamily=CRYPTO_ALGOFAM_CUSTOM_HKDF, CryptoPrimitiveAlgorithmMode=CRYPTO_ALGOMODE_HMAC, CryptoPrimitiveAlgorithmSecondaryFamily=CRYPTO_ALGOFAM_SHA2_256, CryptoPrimitiveAlgorithmFamily=CRYPTO_ALGOFAM_CUSTOM, CryptoPrimitiveAlgorithmFamily=CRYPTO_ALGOFAM_HKDF, CryptoPrimitiveAlgorithmFamilyCustomRef=Crypto_30_LibCv_HKDF
        KeyExchangeCalcPubValSpake2PlusCipherSuite8: CryptoPrimitiveService=CRYPTO_KEY_EXCHANGE_CALC_PUBVAL, CryptoPrimitiveAlgorithmFamily=CRYPTO_ALGOFAM_CUSTOM_SPAKE2_PLUS, CryptoPrimitiveAlgorithmMode=CRYPTO_ALGOMODE_CUSTOM_MODE_1, CryptoPrimitiveAlgorithmSecondaryFamily=CRYPTO_ALGOFAM_CUSTOM_CIPHER_SUITE_8, CryptoPrimitiveAlgorithmMode=CRYPTO_ALGOMODE_NOT_SET, CryptoPrimitiveAlgorithmFamily=CRYPTO_ALGOFAM_CUSTOM, CryptoPrimitiveAlgorithmMode=CRYPTO_ALGOMODE_CUSTOM, CryptoPrimitiveAlgorithmSecondaryFamily=CRYPTO_ALGOFAM_CUSTOM, CryptoPrimitiveAlgorithmSecondaryFamilyCustomRef=Crypto_30_LibCv_CipherSuite8, CryptoPrimitiveAlgorithmFamilyCustomRef=Crypto_30_LibCv_SPAKE2PLUS, CryptoPrimitiveAlgorithmModeCustomRef=Crypto_30_LibCv_Mode1
        KeyExchangeCalcSecretSpake2PlusCipherSuite8: CryptoPrimitiveService=CRYPTO_KEY_EXCHANGE_CALC_SECRET, CryptoPrimitiveAlgorithmFamily=CRYPTO_ALGOFAM_CUSTOM_SPAKE2_PLUS, CryptoPrimitiveAlgorithmMode=CRYPTO_ALGOMODE_CUSTOM_MODE_1, CryptoPrimitiveAlgorithmSecondaryFamily=CRYPTO_ALGOFAM_CUSTOM_CIPHER_SUITE_8, CryptoPrimitiveAlgorithmMode=CRYPTO_ALGOMODE_NOT_SET, CryptoPrimitiveAlgorithmFamily=CRYPTO_ALGOFAM_CUSTOM, CryptoPrimitiveAlgorithmMode=CRYPTO_ALGOMODE_CUSTOM, CryptoPrimitiveAlgorithmSecondaryFamily=CRYPTO_ALGOFAM_CUSTOM, CryptoPrimitiveAlgorithmSecondaryFamilyCustomRef=Crypto_30_LibCv_CipherSuite8, CryptoPrimitiveAlgorithmFamilyCustomRef=Crypto_30_LibCv_SPAKE2PLUS, CryptoPrimitiveAlgorithmModeCustomRef=Crypto_30_LibCv_Mode1
        KeyDeriveSpake2PlusP256R1: CryptoPrimitiveService=CRYPTO_KEY_DERIVE, CryptoPrimitiveAlgorithmFamily=CRYPTO_ALGOFAM_CUSTOM_SPAKE2_PLUS, CryptoPrimitiveAlgorithmMode=CRYPTO_ALGOMODE_CUSTOM_P256R1, CryptoPrimitiveAlgorithmSecondaryFamily=CRYPTO_ALGOFAM_NOT_SET, CryptoPrimitiveAlgorithmFamily=CRYPTO_ALGOFAM_CUSTOM, CryptoPrimitiveAlgorithmMode=CRYPTO_ALGOMODE_CUSTOM, CryptoPrimitiveAlgorithmFamilyCustomRef=Crypto_30_LibCv_SPAKE2PLUS, CryptoPrimitiveAlgorithmModeCustomRef=Crypto_30_LibCv_P256r1
        HashMD5: CryptoPrimitiveService=CRYPTO_HASH, CryptoPrimitiveAlgorithmMode=CRYPTO_ALGOMODE_NOT_SET, CryptoPrimitiveAlgorithmFamily=CRYPTO_ALGOFAM_CUSTOM_MD5, CryptoPrimitiveAlgorithmSecondaryFamily=CRYPTO_ALGOFAM_NOT_SET, CryptoPrimitiveAlgorithmFamily=CRYPTO_ALGOFAM_CUSTOM, CryptoPrimitiveAlgorithmFamilyCustomRef=Crypto_30_LibCv_MD5
        KeyGenerateEd25519: CryptoPrimitiveService=CRYPTO_KEY_GENERATE, CryptoPrimitiveAlgorithmMode=CRYPTO_ALGOMODE_NOT_SET, CryptoPrimitiveAlgorithmFamily=CRYPTO_ALGOFAM_ED25519, CryptoPrimitiveAlgorithmSecondaryFamily=CRYPTO_ALGOFAM_NOT_SET
      13 x CryptoPrimitiveAlgorithmFamilyCustom:
        Crypto_30_LibCv_PaddingPKCS7
        Crypto_30_LibCv_FIPS186
        Crypto_30_LibCv_ECCANSI
        Crypto_30_LibCv_ECCSEC
        Crypto_30_LibCv_DRBG
        Crypto_30_LibCv_X25519
        Crypto_30_LibCv_ISO15118
        Crypto_30_LibCv_POLY1305
        Crypto_30_LibCv_CmdGetId
        Crypto_30_LibCv_HKDF
        Crypto_30_LibCv_SPAKE2PLUS
        Crypto_30_LibCv_CipherSuite8
        Crypto_30_LibCv_MD5
      8 x CryptoPrimitiveAlgorithmModeCustom:
        Crypto_30_LibCv_CCM
        Crypto_30_LibCv_Mode1
        Crypto_30_LibCv_P160r1
        Crypto_30_LibCv_P256r1
        Crypto_30_LibCv_P384r1
        Crypto_30_LibCv_RSAES_OAEP_CRT
        Crypto_30_LibCv_RSASSA_PKCS1_v1_5_CRT
        Crypto_30_LibCv_UseDF
      KeyExchangeCalcPubValNistP224R1_BD (CryptoPrimitive):
        CryptoPrimitiveService = CRYPTO_KEY_EXCHANGE_CALC_PUBVAL
        CryptoPrimitiveAlgorithmFamily = CRYPTO_ALGOFAM_ECCNIST
        CryptoPrimitiveAlgorithmMode = CRYPTO_ALGOMODE_CUSTOM_P224R1
        CryptoPrimitiveAlgorithmSecondaryFamily = CRYPTO_ALGOFAM_CUSTOM_BD
        CryptoPrimitiveAlgorithmMode = CRYPTO_ALGOMODE_CUSTOM
        CryptoPrimitiveAlgorithmSecondaryFamily = CRYPTO_ALGOFAM_CUSTOM
        CryptoPrimitiveAlgorithmModeCustomRef = Crypto_30_LibCv_P224r1
        CryptoPrimitiveAlgorithmSecondaryFamilyCustomRef = Crypto_30_LibCv_BD
      KeyExchangeCalcSecretNistP224R1_BD (CryptoPrimitive):
        CryptoPrimitiveService = CRYPTO_KEY_EXCHANGE_CALC_SECRET
        CryptoPrimitiveAlgorithmFamily = CRYPTO_ALGOFAM_ECCNIST
        CryptoPrimitiveAlgorithmMode = CRYPTO_ALGOMODE_CUSTOM_P224R1
        CryptoPrimitiveAlgorithmSecondaryFamily = CRYPTO_ALGOFAM_CUSTOM_BD
        CryptoPrimitiveAlgorithmMode = CRYPTO_ALGOMODE_CUSTOM
        CryptoPrimitiveAlgorithmSecondaryFamily = CRYPTO_ALGOFAM_CUSTOM
        CryptoPrimitiveAlgorithmModeCustomRef = Crypto_30_LibCv_P224r1
        CryptoPrimitiveAlgorithmSecondaryFamilyCustomRef = Crypto_30_LibCv_BD
      Crypto_30_LibCv_P224r1 (CryptoPrimitiveAlgorithmModeCustom)
      Crypto_30_LibCv_BD (CryptoPrimitiveAlgorithmFamilyCustom)
      KeyDeriveHkdfOption1SHA256 (CryptoPrimitive):
        CryptoPrimitiveService = CRYPTO_KEY_DERIVE
        CryptoPrimitiveAlgorithmFamily = CRYPTO_ALGOFAM_CUSTOM_HKDF
        CryptoPrimitiveAlgorithmMode = CRYPTO_ALGOMODE_NOT_SET
        CryptoPrimitiveAlgorithmSecondaryFamily = CRYPTO_ALGOFAM_SHA2_256
        CryptoPrimitiveAlgorithmFamily = CRYPTO_ALGOFAM_CUSTOM
        CryptoPrimitiveAlgorithmFamily = CRYPTO_ALGOFAM_HKDF
        CryptoPrimitiveAlgorithmFamilyCustomRef = Crypto_30_LibCv_HKDF
      EccSecP521R1GenerateSha512 (CryptoPrimitive):
        CryptoPrimitiveAlgorithmFamily = CRYPTO_ALGOFAM_ECCSEC
        CryptoPrimitiveAlgorithmMode = CRYPTO_ALGOMODE_CUSTOM_P521R1
        CryptoPrimitiveAlgorithmSecondaryFamily = CRYPTO_ALGOFAM_SHA2_512
        CryptoPrimitiveService = CRYPTO_SIGNATURE_GENERATE
        CryptoPrimitiveAlgorithmMode = CRYPTO_ALGOMODE_CUSTOM
        CryptoPrimitiveAlgorithmModeCustomRef = Crypto_30_LibCv_P521r1
      Crypto_30_LibCv_P521r1 (CryptoPrimitiveAlgorithmModeCustom)
      15 x CryptoPrimitive:
        EccSecP521R1VerifySha512: CryptoPrimitiveAlgorithmFamily=CRYPTO_ALGOFAM_ECCSEC, CryptoPrimitiveAlgorithmMode=CRYPTO_ALGOMODE_CUSTOM_P521R1, CryptoPrimitiveAlgorithmSecondaryFamily=CRYPTO_ALGOFAM_SHA2_512, CryptoPrimitiveService=CRYPTO_SIGNATURE_VERIFY, CryptoPrimitiveAlgorithmMode=CRYPTO_ALGOMODE_CUSTOM, CryptoPrimitiveAlgorithmModeCustomRef=Crypto_30_LibCv_P521r1
        KeyExchangeCalcSecretSecP521R1: CryptoPrimitiveService=CRYPTO_KEY_EXCHANGE_CALC_SECRET, CryptoPrimitiveAlgorithmFamily=CRYPTO_ALGOFAM_ECCSEC, CryptoPrimitiveAlgorithmMode=CRYPTO_ALGOMODE_CUSTOM_P521R1, CryptoPrimitiveAlgorithmSecondaryFamily=CRYPTO_ALGOFAM_NOT_SET, CryptoPrimitiveAlgorithmMode=CRYPTO_ALGOMODE_CUSTOM, CryptoPrimitiveAlgorithmModeCustomRef=Crypto_30_LibCv_P521r1
        KeyExchangeCalcPubValSecP521R1: CryptoPrimitiveService=CRYPTO_KEY_EXCHANGE_CALC_PUBVAL, CryptoPrimitiveAlgorithmFamily=CRYPTO_ALGOFAM_ECCSEC, CryptoPrimitiveAlgorithmMode=CRYPTO_ALGOMODE_CUSTOM_P521R1, CryptoPrimitiveAlgorithmSecondaryFamily=CRYPTO_ALGOFAM_NOT_SET, CryptoPrimitiveAlgorithmMode=CRYPTO_ALGOMODE_CUSTOM, CryptoPrimitiveAlgorithmModeCustomRef=Crypto_30_LibCv_P521r1
        SHA3_224: CryptoPrimitiveService=CRYPTO_HASH, CryptoPrimitiveAlgorithmMode=CRYPTO_ALGOMODE_NOT_SET, CryptoPrimitiveAlgorithmFamily=CRYPTO_ALGOFAM_SHA3_224, CryptoPrimitiveAlgorithmSecondaryFamily=CRYPTO_ALGOFAM_NOT_SET
        SHA3_384: CryptoPrimitiveService=CRYPTO_HASH, CryptoPrimitiveAlgorithmMode=CRYPTO_ALGOMODE_NOT_SET, CryptoPrimitiveAlgorithmFamily=CRYPTO_ALGOFAM_SHA3_384, CryptoPrimitiveAlgorithmSecondaryFamily=CRYPTO_ALGOFAM_NOT_SET
        SHA3_512: CryptoPrimitiveService=CRYPTO_HASH, CryptoPrimitiveAlgorithmMode=CRYPTO_ALGOMODE_NOT_SET, CryptoPrimitiveAlgorithmFamily=CRYPTO_ALGOFAM_SHA3_512, CryptoPrimitiveAlgorithmSecondaryFamily=CRYPTO_ALGOFAM_NOT_SET
        SHAKE128: CryptoPrimitiveService=CRYPTO_HASH, CryptoPrimitiveAlgorithmMode=CRYPTO_ALGOMODE_NOT_SET, CryptoPrimitiveAlgorithmFamily=CRYPTO_ALGOFAM_SHAKE128, CryptoPrimitiveAlgorithmSecondaryFamily=CRYPTO_ALGOFAM_NOT_SET
        SHAKE256: CryptoPrimitiveService=CRYPTO_HASH, CryptoPrimitiveAlgorithmMode=CRYPTO_ALGOMODE_NOT_SET, CryptoPrimitiveAlgorithmFamily=CRYPTO_ALGOFAM_SHAKE256, CryptoPrimitiveAlgorithmSecondaryFamily=CRYPTO_ALGOFAM_NOT_SET
        EccNistP521R1GenerateSha512: CryptoPrimitiveAlgorithmFamily=CRYPTO_ALGOFAM_ECCNIST, CryptoPrimitiveAlgorithmMode=CRYPTO_ALGOMODE_CUSTOM_P521R1, CryptoPrimitiveAlgorithmSecondaryFamily=CRYPTO_ALGOFAM_SHA2_512, CryptoPrimitiveService=CRYPTO_SIGNATURE_GENERATE, CryptoPrimitiveAlgorithmMode=CRYPTO_ALGOMODE_CUSTOM, CryptoPrimitiveAlgorithmModeCustomRef=Crypto_30_LibCv_P521r1
        EccNistP521R1VerifySha512: CryptoPrimitiveAlgorithmFamily=CRYPTO_ALGOFAM_ECCNIST, CryptoPrimitiveAlgorithmMode=CRYPTO_ALGOMODE_CUSTOM_P521R1, CryptoPrimitiveAlgorithmSecondaryFamily=CRYPTO_ALGOFAM_SHA2_512, CryptoPrimitiveService=CRYPTO_SIGNATURE_VERIFY, CryptoPrimitiveAlgorithmMode=CRYPTO_ALGOMODE_CUSTOM, CryptoPrimitiveAlgorithmModeCustomRef=Crypto_30_LibCv_P521r1
        KeyExchangeCalcSecretNistP521R1: CryptoPrimitiveService=CRYPTO_KEY_EXCHANGE_CALC_SECRET, CryptoPrimitiveAlgorithmFamily=CRYPTO_ALGOFAM_ECCNIST, CryptoPrimitiveAlgorithmMode=CRYPTO_ALGOMODE_CUSTOM_P521R1, CryptoPrimitiveAlgorithmSecondaryFamily=CRYPTO_ALGOFAM_NOT_SET, CryptoPrimitiveAlgorithmMode=CRYPTO_ALGOMODE_CUSTOM, CryptoPrimitiveAlgorithmModeCustomRef=Crypto_30_LibCv_P521r1
        KeyExchangeCalcPubValNistP521R1: CryptoPrimitiveService=CRYPTO_KEY_EXCHANGE_CALC_PUBVAL, CryptoPrimitiveAlgorithmFamily=CRYPTO_ALGOFAM_ECCNIST, CryptoPrimitiveAlgorithmMode=CRYPTO_ALGOMODE_CUSTOM_P521R1, CryptoPrimitiveAlgorithmSecondaryFamily=CRYPTO_ALGOFAM_NOT_SET, CryptoPrimitiveAlgorithmMode=CRYPTO_ALGOMODE_CUSTOM, CryptoPrimitiveAlgorithmModeCustomRef=Crypto_30_LibCv_P521r1
        KeyDeriveHkdfHmacSHA384: CryptoPrimitiveService=CRYPTO_KEY_DERIVE, CryptoPrimitiveAlgorithmFamily=CRYPTO_ALGOFAM_CUSTOM_HKDF, CryptoPrimitiveAlgorithmMode=CRYPTO_ALGOMODE_HMAC, CryptoPrimitiveAlgorithmSecondaryFamily=CRYPTO_ALGOFAM_SHA2_384, CryptoPrimitiveAlgorithmFamily=CRYPTO_ALGOFAM_CUSTOM, CryptoPrimitiveAlgorithmFamily=CRYPTO_ALGOFAM_HKDF, CryptoPrimitiveAlgorithmFamilyCustomRef=Crypto_30_LibCv_HKDF
        KeyDeriveHkdfOption1SHA512: CryptoPrimitiveService=CRYPTO_KEY_DERIVE, CryptoPrimitiveAlgorithmFamily=CRYPTO_ALGOFAM_HKDF, CryptoPrimitiveAlgorithmMode=CRYPTO_ALGOMODE_NOT_SET, CryptoPrimitiveAlgorithmSecondaryFamily=CRYPTO_ALGOFAM_SHA2_512
        KeyDeriveIso15118_20: CryptoPrimitiveService=CRYPTO_KEY_DERIVE, CryptoPrimitiveAlgorithmFamily=CRYPTO_ALGOFAM_CUSTOM, CryptoPrimitiveAlgorithmMode=CRYPTO_ALGOMODE_NOT_SET, CryptoPrimitiveAlgorithmSecondaryFamily=CRYPTO_ALGOFAM_NOT_SET, CryptoPrimitiveAlgorithmFamilyCustomRef=Crypto_30_LibCv_ISO15118_20
      Crypto_30_LibCv_ISO15118_20 (CryptoPrimitiveAlgorithmFamilyCustom)
      KeyExchangeCalcPubValX448 (CryptoPrimitive):
        CryptoPrimitiveService = CRYPTO_KEY_EXCHANGE_CALC_PUBVAL
        CryptoPrimitiveAlgorithmFamily = CRYPTO_ALGOFAM_CUSTOM
        CryptoPrimitiveAlgorithmMode = CRYPTO_ALGOMODE_NOT_SET
        CryptoPrimitiveAlgorithmSecondaryFamily = CRYPTO_ALGOFAM_NOT_SET
        CryptoPrimitiveAlgorithmFamilyCustomRef = Crypto_30_LibCv_X448
      KeyExchangeCalcSecretX448 (CryptoPrimitive):
        CryptoPrimitiveService = CRYPTO_KEY_EXCHANGE_CALC_SECRET
        CryptoPrimitiveAlgorithmFamily = CRYPTO_ALGOFAM_CUSTOM
        CryptoPrimitiveAlgorithmMode = CRYPTO_ALGOMODE_NOT_SET
        CryptoPrimitiveAlgorithmSecondaryFamily = CRYPTO_ALGOFAM_NOT_SET
        CryptoPrimitiveAlgorithmFamilyCustomRef = Crypto_30_LibCv_X448
      Crypto_30_LibCv_X448 (CryptoPrimitiveAlgorithmFamilyCustom)
      Crypto_30_LibCv_ED448 (CryptoPrimitiveAlgorithmFamilyCustom)
      5 x CryptoPrimitiveAlgorithmModeCustom:
        Crypto_30_LibCv_EdDsaEd448Pure
        Crypto_30_LibCv_EdDsaEd448Ph
        Crypto_30_LibCv_EdDsaEd25519Pure
        Crypto_30_LibCv_EdDsaEd25519Ctx
        Crypto_30_LibCv_EdDsaEd25519Ph
      12 x CryptoPrimitive:
        EdDsaEd448PhGenerate: CryptoPrimitiveAlgorithmMode=CRYPTO_ALGOMODE_CUSTOM, CryptoPrimitiveService=CRYPTO_SIGNATURE_GENERATE, CryptoPrimitiveAlgorithmFamily=CRYPTO_ALGOFAM_CUSTOM, CryptoPrimitiveAlgorithmSecondaryFamily=CRYPTO_ALGOFAM_SHAKE256, CryptoPrimitiveAlgorithmFamilyCustomRef=Crypto_30_LibCv_ED448, CryptoPrimitiveAlgorithmModeCustomRef=Crypto_30_LibCv_EdDsaEd448Ph
        EdDsaEd448PhVerify: CryptoPrimitiveAlgorithmMode=CRYPTO_ALGOMODE_CUSTOM, CryptoPrimitiveService=CRYPTO_SIGNATURE_VERIFY, CryptoPrimitiveAlgorithmFamily=CRYPTO_ALGOFAM_CUSTOM, CryptoPrimitiveAlgorithmSecondaryFamily=CRYPTO_ALGOFAM_SHAKE256, CryptoPrimitiveAlgorithmFamilyCustomRef=Crypto_30_LibCv_ED448, CryptoPrimitiveAlgorithmModeCustomRef=Crypto_30_LibCv_EdDsaEd448Ph
        EdDsaEd25519PureVerify: CryptoPrimitiveAlgorithmSecondaryFamily=CRYPTO_ALGOFAM_NOT_SET, CryptoPrimitiveService=CRYPTO_SIGNATURE_VERIFY, CryptoPrimitiveAlgorithmFamily=CRYPTO_ALGOFAM_ED25519, CryptoPrimitiveAlgorithmMode=CRYPTO_ALGOMODE_CUSTOM, CryptoPrimitiveAlgorithmModeCustomRef=Crypto_30_LibCv_EdDsaEd25519Pure
        EdDsaEd25519PhVerify: CryptoPrimitiveService=CRYPTO_SIGNATURE_VERIFY, CryptoPrimitiveAlgorithmFamily=CRYPTO_ALGOFAM_ED25519, CryptoPrimitiveAlgorithmSecondaryFamily=CRYPTO_ALGOFAM_SHA2_512, CryptoPrimitiveAlgorithmMode=CRYPTO_ALGOMODE_CUSTOM, CryptoPrimitiveAlgorithmModeCustomRef=Crypto_30_LibCv_EdDsaEd25519Ph
        EdDsaEd25519CtxVerify: CryptoPrimitiveService=CRYPTO_SIGNATURE_VERIFY, CryptoPrimitiveAlgorithmFamily=CRYPTO_ALGOFAM_ED25519, CryptoPrimitiveAlgorithmSecondaryFamily=CRYPTO_ALGOFAM_NOT_SET, CryptoPrimitiveAlgorithmMode=CRYPTO_ALGOMODE_CUSTOM, CryptoPrimitiveAlgorithmModeCustomRef=Crypto_30_LibCv_EdDsaEd25519Ctx
        EdDsaEd25519PhGenerate: CryptoPrimitiveService=CRYPTO_SIGNATURE_GENERATE, CryptoPrimitiveAlgorithmFamily=CRYPTO_ALGOFAM_ED25519, CryptoPrimitiveAlgorithmSecondaryFamily=CRYPTO_ALGOFAM_SHA2_512, CryptoPrimitiveAlgorithmMode=CRYPTO_ALGOMODE_CUSTOM, CryptoPrimitiveAlgorithmModeCustomRef=Crypto_30_LibCv_EdDsaEd25519Ph
        EdDsaEd25519CtxGenerate: CryptoPrimitiveService=CRYPTO_SIGNATURE_GENERATE, CryptoPrimitiveAlgorithmFamily=CRYPTO_ALGOFAM_ED25519, CryptoPrimitiveAlgorithmSecondaryFamily=CRYPTO_ALGOFAM_NOT_SET, CryptoPrimitiveAlgorithmMode=CRYPTO_ALGOMODE_CUSTOM, CryptoPrimitiveAlgorithmModeCustomRef=Crypto_30_LibCv_EdDsaEd25519Ctx
        EdDsaEd25519PureGenerate: CryptoPrimitiveAlgorithmSecondaryFamily=CRYPTO_ALGOFAM_NOT_SET, CryptoPrimitiveService=CRYPTO_SIGNATURE_GENERATE, CryptoPrimitiveAlgorithmFamily=CRYPTO_ALGOFAM_ED25519, CryptoPrimitiveAlgorithmMode=CRYPTO_ALGOMODE_CUSTOM, CryptoPrimitiveAlgorithmModeCustomRef=Crypto_30_LibCv_EdDsaEd25519Pure
        EdDsaEd448PureGenerate: CryptoPrimitiveAlgorithmSecondaryFamily=CRYPTO_ALGOFAM_NOT_SET, CryptoPrimitiveAlgorithmMode=CRYPTO_ALGOMODE_CUSTOM, CryptoPrimitiveService=CRYPTO_SIGNATURE_GENERATE, CryptoPrimitiveAlgorithmFamily=CRYPTO_ALGOFAM_CUSTOM, CryptoPrimitiveAlgorithmFamilyCustomRef=Crypto_30_LibCv_ED448, CryptoPrimitiveAlgorithmModeCustomRef=Crypto_30_LibCv_EdDsaEd448Pure
        EdDsaEd448PureVerify: CryptoPrimitiveAlgorithmSecondaryFamily=CRYPTO_ALGOFAM_NOT_SET, CryptoPrimitiveAlgorithmMode=CRYPTO_ALGOMODE_CUSTOM, CryptoPrimitiveService=CRYPTO_SIGNATURE_VERIFY, CryptoPrimitiveAlgorithmFamily=CRYPTO_ALGOFAM_CUSTOM, CryptoPrimitiveAlgorithmFamilyCustomRef=Crypto_30_LibCv_ED448, CryptoPrimitiveAlgorithmModeCustomRef=Crypto_30_LibCv_EdDsaEd448Pure
        HmacSha512Generate: CryptoPrimitiveAlgorithmFamily=CRYPTO_ALGOFAM_SHA2_512, CryptoPrimitiveAlgorithmMode=CRYPTO_ALGOMODE_HMAC, CryptoPrimitiveAlgorithmSecondaryFamily=CRYPTO_ALGOFAM_NOT_SET, CryptoPrimitiveService=CRYPTO_MAC_GENERATE
        HmacSha512Verify: CryptoPrimitiveAlgorithmFamily=CRYPTO_ALGOFAM_SHA2_512, CryptoPrimitiveAlgorithmMode=CRYPTO_ALGOMODE_HMAC, CryptoPrimitiveAlgorithmSecondaryFamily=CRYPTO_ALGOFAM_NOT_SET, CryptoPrimitiveService=CRYPTO_MAC_VERIFY
      Crypto_30_LibCv_HKDF_Expand (CryptoPrimitiveAlgorithmFamilyCustom)
      KeyDeriveHkdfExpandHmacSHA256 (CryptoPrimitive):
        CryptoPrimitiveAlgorithmFamily = CRYPTO_ALGOFAM_CUSTOM
        CryptoPrimitiveService = CRYPTO_KEY_DERIVE
        CryptoPrimitiveAlgorithmMode = CRYPTO_ALGOMODE_HMAC
        CryptoPrimitiveAlgorithmSecondaryFamily = CRYPTO_ALGOFAM_SHA2_256
        CryptoPrimitiveAlgorithmFamilyCustomRef = Crypto_30_LibCv_HKDF_Expand
      KeyDeriveHkdfExpandHmacSHA384 (CryptoPrimitive):
        CryptoPrimitiveAlgorithmFamily = CRYPTO_ALGOFAM_CUSTOM
        CryptoPrimitiveService = CRYPTO_KEY_DERIVE
        CryptoPrimitiveAlgorithmMode = CRYPTO_ALGOMODE_HMAC
        CryptoPrimitiveAlgorithmSecondaryFamily = CRYPTO_ALGOFAM_SHA2_384
        CryptoPrimitiveAlgorithmFamilyCustomRef = Crypto_30_LibCv_HKDF_Expand
      Crypto_30_LibCv_IsPrivateKeyOnCurve (CryptoPrimitiveAlgorithmFamilyCustom)
      Crypto_30_LibCv_IsPublicKeyOnCurve (CryptoPrimitiveAlgorithmFamilyCustom)
      11 x CryptoPrimitive:
        IsKeyOnCurveP160R1: CryptoPrimitiveService=CRYPTO_SIGNATURE_VERIFY, CryptoPrimitiveAlgorithmMode=CRYPTO_ALGOMODE_CUSTOM, CryptoPrimitiveAlgorithmFamily=CRYPTO_ALGOFAM_ECCSEC, CryptoPrimitiveAlgorithmSecondaryFamily=CRYPTO_ALGOFAM_CUSTOM, CryptoPrimitiveAlgorithmModeCustomRef=Crypto_30_LibCv_P160r1, CryptoPrimitiveAlgorithmSecondaryFamilyCustomRef=Crypto_30_LibCv_IsPrivateKeyOnCurve, CryptoPrimitiveAlgorithmSecondaryFamilyCustomRef=Crypto_30_LibCv_IsPublicKeyOnCurve
        IsKeyOnCurveP256R1: CryptoPrimitiveService=CRYPTO_SIGNATURE_VERIFY, CryptoPrimitiveAlgorithmMode=CRYPTO_ALGOMODE_CUSTOM, CryptoPrimitiveAlgorithmSecondaryFamily=CRYPTO_ALGOFAM_CUSTOM, CryptoPrimitiveAlgorithmFamily=CRYPTO_ALGOFAM_ECCNIST, CryptoPrimitiveAlgorithmFamily=CRYPTO_ALGOFAM_ECCANSI, CryptoPrimitiveAlgorithmFamily=CRYPTO_ALGOFAM_ECCSEC, CryptoPrimitiveAlgorithmModeCustomRef=Crypto_30_LibCv_P256r1, CryptoPrimitiveAlgorithmSecondaryFamilyCustomRef=Crypto_30_LibCv_IsPrivateKeyOnCurve, CryptoPrimitiveAlgorithmSecondaryFamilyCustomRef=Crypto_30_LibCv_IsPublicKeyOnCurve
        IsKeyOnCurveP384R1: CryptoPrimitiveService=CRYPTO_SIGNATURE_VERIFY, CryptoPrimitiveAlgorithmMode=CRYPTO_ALGOMODE_CUSTOM, CryptoPrimitiveAlgorithmSecondaryFamily=CRYPTO_ALGOFAM_CUSTOM, CryptoPrimitiveAlgorithmFamily=CRYPTO_ALGOFAM_ECCNIST, CryptoPrimitiveAlgorithmFamily=CRYPTO_ALGOFAM_ECCSEC, CryptoPrimitiveAlgorithmModeCustomRef=Crypto_30_LibCv_P384r1, CryptoPrimitiveAlgorithmSecondaryFamilyCustomRef=Crypto_30_LibCv_IsPrivateKeyOnCurve, CryptoPrimitiveAlgorithmSecondaryFamilyCustomRef=Crypto_30_LibCv_IsPublicKeyOnCurve
        IsKeyOnCurveP521R1: CryptoPrimitiveService=CRYPTO_SIGNATURE_VERIFY, CryptoPrimitiveAlgorithmMode=CRYPTO_ALGOMODE_CUSTOM, CryptoPrimitiveAlgorithmSecondaryFamily=CRYPTO_ALGOFAM_CUSTOM, CryptoPrimitiveAlgorithmFamily=CRYPTO_ALGOFAM_ECCNIST, CryptoPrimitiveAlgorithmFamily=CRYPTO_ALGOFAM_ECCSEC, CryptoPrimitiveAlgorithmModeCustomRef=Crypto_30_LibCv_P521r1, CryptoPrimitiveAlgorithmSecondaryFamilyCustomRef=Crypto_30_LibCv_IsPrivateKeyOnCurve, CryptoPrimitiveAlgorithmSecondaryFamilyCustomRef=Crypto_30_LibCv_IsPublicKeyOnCurve
        IsKeyOnCurveEd25519: CryptoPrimitiveService=CRYPTO_SIGNATURE_VERIFY, CryptoPrimitiveAlgorithmMode=CRYPTO_ALGOMODE_NOT_SET, CryptoPrimitiveAlgorithmFamily=CRYPTO_ALGOFAM_ED25519, CryptoPrimitiveAlgorithmSecondaryFamily=CRYPTO_ALGOFAM_CUSTOM, CryptoPrimitiveAlgorithmSecondaryFamilyCustomRef=Crypto_30_LibCv_IsPrivateKeyOnCurve, CryptoPrimitiveAlgorithmSecondaryFamilyCustomRef=Crypto_30_LibCv_IsPublicKeyOnCurve
        IsKeyOnCurveEd448: CryptoPrimitiveService=CRYPTO_SIGNATURE_VERIFY, CryptoPrimitiveAlgorithmMode=CRYPTO_ALGOMODE_NOT_SET, CryptoPrimitiveAlgorithmFamily=CRYPTO_ALGOFAM_CUSTOM, CryptoPrimitiveAlgorithmSecondaryFamily=CRYPTO_ALGOFAM_CUSTOM, CryptoPrimitiveAlgorithmFamilyCustomRef=Crypto_30_LibCv_ED448, CryptoPrimitiveAlgorithmSecondaryFamilyCustomRef=Crypto_30_LibCv_IsPrivateKeyOnCurve, CryptoPrimitiveAlgorithmSecondaryFamilyCustomRef=Crypto_30_LibCv_IsPublicKeyOnCurve
        KeyExchangeCalcPubValP256R1_BD: CryptoPrimitiveService=CRYPTO_KEY_EXCHANGE_CALC_PUBVAL, CryptoPrimitiveAlgorithmMode=CRYPTO_ALGOMODE_CUSTOM, CryptoPrimitiveAlgorithmSecondaryFamily=CRYPTO_ALGOFAM_CUSTOM, CryptoPrimitiveAlgorithmFamily=CRYPTO_ALGOFAM_ECCNIST, CryptoPrimitiveAlgorithmFamily=CRYPTO_ALGOFAM_ECCSEC, CryptoPrimitiveAlgorithmFamily=CRYPTO_ALGOFAM_ECCANSI, CryptoPrimitiveAlgorithmModeCustomRef=Crypto_30_LibCv_P256r1, CryptoPrimitiveAlgorithmSecondaryFamilyCustomRef=Crypto_30_LibCv_BD
        KeyExchangeCalcSecretP256R1_BD: CryptoPrimitiveService=CRYPTO_KEY_EXCHANGE_CALC_SECRET, CryptoPrimitiveAlgorithmMode=CRYPTO_ALGOMODE_CUSTOM, CryptoPrimitiveAlgorithmSecondaryFamily=CRYPTO_ALGOFAM_CUSTOM, CryptoPrimitiveAlgorithmFamily=CRYPTO_ALGOFAM_ECCSEC, CryptoPrimitiveAlgorithmFamily=CRYPTO_ALGOFAM_ECCANSI, CryptoPrimitiveAlgorithmFamily=CRYPTO_ALGOFAM_ECCNIST, CryptoPrimitiveAlgorithmModeCustomRef=Crypto_30_LibCv_P256r1, CryptoPrimitiveAlgorithmSecondaryFamilyCustomRef=Crypto_30_LibCv_BD
        KeyGenerateSecP521R1: CryptoPrimitiveService=CRYPTO_KEY_GENERATE, CryptoPrimitiveAlgorithmFamily=CRYPTO_ALGOFAM_ECCSEC, CryptoPrimitiveAlgorithmMode=CRYPTO_ALGOMODE_CUSTOM, CryptoPrimitiveAlgorithmSecondaryFamily=CRYPTO_ALGOFAM_NOT_SET, CryptoPrimitiveAlgorithmModeCustomRef=Crypto_30_LibCv_P521r1
        KeyGenerateNistP521R1: CryptoPrimitiveService=CRYPTO_KEY_GENERATE, CryptoPrimitiveAlgorithmFamily=CRYPTO_ALGOFAM_ECCNIST, CryptoPrimitiveAlgorithmMode=CRYPTO_ALGOMODE_CUSTOM, CryptoPrimitiveAlgorithmSecondaryFamily=CRYPTO_ALGOFAM_NOT_SET, CryptoPrimitiveAlgorithmModeCustomRef=Crypto_30_LibCv_P521r1
        SlhDsaSHA2_128sVerify: CryptoPrimitiveAlgorithmFamily=CRYPTO_ALGOFAM_CUSTOM, CryptoPrimitiveAlgorithmMode=CRYPTO_ALGOMODE_CUSTOM, CryptoPrimitiveService=CRYPTO_SIGNATURE_VERIFY, CryptoPrimitiveAlgorithmSecondaryFamily=CRYPTO_ALGOFAM_NOT_SET, CryptoPrimitiveAlgorithmFamilyCustomRef=Crypto_30_LibCv_SLH_DSA, CryptoPrimitiveAlgorithmModeCustomRef=Crypto_30_LibCv_SHA2_128S
      Crypto_30_LibCv_SLH_DSA (CryptoPrimitiveAlgorithmFamilyCustom)
      Crypto_30_LibCv_SHA2_128S (CryptoPrimitiveAlgorithmModeCustom)
      Crypto_30_LibCv_SM4 (CryptoPrimitiveAlgorithmFamilyCustom)
      5 x CryptoPrimitive, all with CryptoPrimitiveAlgorithmSecondaryFamily=CRYPTO_ALGOFAM_NOT_SET:
        Sm4Encrypt: CryptoPrimitiveService=CRYPTO_ENCRYPT, CryptoPrimitiveAlgorithmMode=CRYPTO_ALGOMODE_CBC, CryptoPrimitiveAlgorithmMode=CRYPTO_ALGOMODE_ECB, CryptoPrimitiveAlgorithmFamily=CRYPTO_ALGOFAM_CUSTOM, CryptoPrimitiveAlgorithmFamilyCustomRef=Crypto_30_LibCv_SM4
        Sm4Decrypt: CryptoPrimitiveService=CRYPTO_DECRYPT, CryptoPrimitiveAlgorithmMode=CRYPTO_ALGOMODE_CBC, CryptoPrimitiveAlgorithmMode=CRYPTO_ALGOMODE_ECB, CryptoPrimitiveAlgorithmFamily=CRYPTO_ALGOFAM_CUSTOM, CryptoPrimitiveAlgorithmFamilyCustomRef=Crypto_30_LibCv_SM4
        Sm3: CryptoPrimitiveService=CRYPTO_HASH, CryptoPrimitiveAlgorithmMode=CRYPTO_ALGOMODE_NOT_SET, CryptoPrimitiveAlgorithmFamily=CRYPTO_ALGOFAM_SM3
        Sm2Generate: CryptoPrimitiveService=CRYPTO_SIGNATURE_GENERATE, CryptoPrimitiveAlgorithmFamily=CRYPTO_ALGOFAM_SM2, CryptoPrimitiveAlgorithmMode=CRYPTO_ALGOMODE_CUSTOM, CryptoPrimitiveAlgorithmModeCustomRef=Crypto_30_LibCv_Sm2P256v1
        Sm2Verify: CryptoPrimitiveService=CRYPTO_SIGNATURE_VERIFY, CryptoPrimitiveAlgorithmFamily=CRYPTO_ALGOFAM_SM2, CryptoPrimitiveAlgorithmMode=CRYPTO_ALGOMODE_CUSTOM, CryptoPrimitiveAlgorithmModeCustomRef=Crypto_30_LibCv_Sm2P256v1
      Crypto_30_LibCv_Sm2P256v1 (CryptoPrimitiveAlgorithmModeCustom)
      KeyGenerate_SM2_Sm2P256V1 (CryptoPrimitive):
        CryptoPrimitiveService = CRYPTO_KEY_GENERATE
        CryptoPrimitiveAlgorithmFamily = CRYPTO_ALGOFAM_SM2
        CryptoPrimitiveAlgorithmSecondaryFamily = CRYPTO_ALGOFAM_NOT_SET
        CryptoPrimitiveAlgorithmMode = CRYPTO_ALGOMODE_CUSTOM
        CryptoPrimitiveAlgorithmModeCustomRef = Crypto_30_LibCv_Sm2P256v1
    CryptoKeyTypes
      90 x CryptoKeyType:
        Cipher: CryptoKeyElementRef=CryptoKeyElements/Crypto_30_LibCv_Cipher_Key, CryptoKeyElementRef=CryptoKeyElements/Crypto_30_LibCv_Cipher_IV
        KeyExchange_X25519: CryptoKeyElementRef=CryptoKeyElements/Crypto_30_LibCv_KeyExchange_Algorithm_X25519, CryptoKeyElementRef=CryptoKeyElements/Crypto_30_LibCv_KeyExchange_OwnPubKey, CryptoKeyElementRef=CryptoKeyElements/Crypto_30_LibCv_KeyExchange_PrivKey, CryptoKeyElementRef=CryptoKeyElements/Crypto_30_LibCv_KeyExchange_SharedValue
        KeyGenerate: CryptoKeyElementRef=CryptoKeyElements/Crypto_30_LibCv_KeyGenerate_Algorithm, CryptoKeyElementRef=CryptoKeyElements/Crypto_30_LibCv_KeyGenerate_Seed, CryptoKeyElementRef=CryptoKeyElements/Crypto_30_LibCv_KeyGenerate_Key
        Signature: CryptoKeyElementRef=CryptoKeyElements/Crypto_30_LibCv_Signature_Key
        Mac: CryptoKeyElementRef=CryptoKeyElements/Crypto_30_LibCv_Mac_Key
        KeyDerive: CryptoKeyElementRef=CryptoKeyElements/Crypto_30_LibCv_KeyDerivation_Password, CryptoKeyElementRef=CryptoKeyElements/Crypto_30_LibCv_KeyDerive_Algorithm, CryptoKeyElementRef=CryptoKeyElements/Crypto_30_LibCv_KeyDerivation_Salt, CryptoKeyElementRef=CryptoKeyElements/Crypto_30_LibCv_KeyDerivation_Label, CryptoKeyElementRef=Crypto_30_LibCv_KeyDerivation_Iterations_PBKDF2
        Random_Fips186_Sha1: CryptoKeyElementRef=CryptoKeyElements/Crypto_30_LibCv_Random_Algorithm_Fips186_Sha1, CryptoKeyElementRef=CryptoKeyElements/Crypto_30_LibCv_Random_Seed
        Hash: CryptoKeyElementRef=CryptoKeyElements/Crypto_30_LibCv_Hash_Result
        Signature_Rsa_Pkcs1_Verify: CryptoKeyElementRef=CryptoKeyElements/Crypto_30_LibCv_Rsa_Modulus, CryptoKeyElementRef=CryptoKeyElements/Crypto_30_LibCv_Rsa_Pub_Exponent
        Signature_Rsa_Pkcs1_Generate: CryptoKeyElementRef=CryptoKeyElements/Crypto_30_LibCv_Rsa_Modulus, CryptoKeyElementRef=CryptoKeyElements/Crypto_30_LibCv_Rsa_Priv_Exponent
        Signature_Rsa_Pss_Verify: CryptoKeyElementRef=CryptoKeyElements/Crypto_30_LibCv_Rsa_Modulus, CryptoKeyElementRef=CryptoKeyElements/Crypto_30_LibCv_Rsa_Pub_Exponent, CryptoKeyElementRef=CryptoKeyElements/Crypto_30_LibCv_Rsa_SaltLength
        Signature_Rsa_Pss_Generate: CryptoKeyElementRef=CryptoKeyElements/Crypto_30_LibCv_Rsa_Modulus, CryptoKeyElementRef=CryptoKeyElements/Crypto_30_LibCv_Rsa_Priv_Exponent, CryptoKeyElementRef=CryptoKeyElements/Crypto_30_LibCv_Rsa_Salt
        Signature_Rsa_Pss_Verify_AutoSalt: CryptoKeyElementRef=CryptoKeyElements/Crypto_30_LibCv_Rsa_Modulus, CryptoKeyElementRef=CryptoKeyElements/Crypto_30_LibCv_Rsa_Pub_Exponent
        KeyExchange_ANSIP256R1: CryptoKeyElementRef=CryptoKeyElements/Crypto_30_LibCv_KeyExchange_Algorithm_ANSIP256R1, CryptoKeyElementRef=CryptoKeyElements/Crypto_30_LibCv_KeyExchange_OwnPubKey, CryptoKeyElementRef=CryptoKeyElements/Crypto_30_LibCv_KeyExchange_PrivKey, CryptoKeyElementRef=CryptoKeyElements/Crypto_30_LibCv_KeyExchange_SharedValue
        KeyDerive_NIST80056A: CryptoKeyElementRef=CryptoKeyElements/Crypto_30_LibCv_KeyDerivation_Password, CryptoKeyElementRef=CryptoKeyElements/Crypto_30_LibCv_KeyDerivation_Algorithm_NIST80056A, CryptoKeyElementRef=CryptoKeyElements/Crypto_30_LibCv_KeyExchange_PartnerPubKey, CryptoKeyElementRef=CryptoKeyElements/Crypto_30_LibCv_KeyDerivation_AdditionalInfo
        KeyDerive_ISO15118_ProvCert: CryptoKeyElementRef=CryptoKeyElements/Crypto_30_LibCv_Signature_Key, CryptoKeyElementRef=CryptoKeyElements/Crypto_30_LibCv_KeyDerivation_Algorithm_ISO15118, CryptoKeyElementRef=CryptoKeyElements/Crypto_30_LibCv_KeyExchange_OwnPubKey, CryptoKeyElementRef=CryptoKeyElements/Crypto_30_LibCv_KeyExchange_PrivKey
        KeyDerive_SYM_NIST800108: CryptoKeyElementRef=CryptoKeyElements/Crypto_30_LibCv_KeyDerivation_Password, CryptoKeyElementRef=CryptoKeyElements/Crypto_30_LibCv_KeyDerivation_Algorithm_SYM_NIST800108, CryptoKeyElementRef=CryptoKeyElements/Crypto_30_LibCv_KeyDerivation_Salt, CryptoKeyElementRef=CryptoKeyElements/Crypto_30_LibCv_KeyDerivation_Label
        KeyDerive_ASM_NISTFIPS1864: CryptoKeyElementRef=CryptoKeyElements/Crypto_30_LibCv_KeyDerivation_Password, CryptoKeyElementRef=CryptoKeyElements/Crypto_30_LibCv_KeyDerivation_Algorithm_ASM_NISTFIPS1864, CryptoKeyElementRef=CryptoKeyElements/Crypto_30_LibCv_KeyDerivation_Salt, CryptoKeyElementRef=CryptoKeyElements/Crypto_30_LibCv_KeyDerivation_Label
        KeyDerive_ISO15118_ContrCert: CryptoKeyElementRef=CryptoKeyElements/Crypto_30_LibCv_Signature_Key, CryptoKeyElementRef=CryptoKeyElements/Crypto_30_LibCv_KeyDerivation_Algorithm_ISO15118, CryptoKeyElementRef=CryptoKeyElements/Crypto_30_LibCv_KeyExchange_PartnerPubKey, CryptoKeyElementRef=CryptoKeyElements/Crypto_30_LibCv_SCC_Contract_PubKey, CryptoKeyElementRef=CryptoKeyElements/Crypto_30_LibCv_SCC_IV_And_Encrypted_PrivKey
        CipherWithoutIv: CryptoKeyElementRef=CryptoKeyElements/Crypto_30_LibCv_Cipher_Key
        CipherShe: CryptoKeyElementRef=CryptoKeyElements/Crypto_30_LibCv_Cipher_Key_She, CryptoKeyElementRef=CryptoKeyElements/Crypto_30_LibCv_Cipher_IV, CryptoKeyElementRef=CryptoKeyElements/Crypto_30_LibCv_Cipher_Proof, CryptoKeyElementRef=CryptoKeyElements/Crypto_30_LibCv_She_Counter
        MacShe: CryptoKeyElementRef=CryptoKeyElements/Crypto_30_LibCv_Mac_Key_She, CryptoKeyElementRef=CryptoKeyElements/Crypto_30_LibCv_Mac_Proof, CryptoKeyElementRef=CryptoKeyElements/Crypto_30_LibCv_She_Counter
        Random_Nist_800_90A_DRBG_AES_DF: CryptoKeyElementRef=Crypto_30_LibCv_Random_Algorithm_Nist_800_90A_DRBG_AES128_DF, CryptoKeyElementRef=CryptoKeyElements/Crypto_30_LibCv_Random_Seed_Nist_800_90A_DRBG_AES128, CryptoKeyElementRef=CryptoKeyElements/Crypto_30_LibCv_Random_PrivateString, CryptoKeyElementRef=CryptoKeyElements/Crypto_30_LibCv_Random_AdditionalInput, CryptoKeyElementRef=CryptoKeyElements/Crypto_30_LibCv_Random_Reseed_Counter, CryptoKeyElementRef=CryptoKeyElements/Crypto_30_LibCv_Random_Nonce
        Random_Nist_800_90A_DRBG_AES_NoDF: CryptoKeyElementRef=CryptoKeyElements/Crypto_30_LibCv_Random_Algorithm_Nist_800_90A_DRBG_AES128, CryptoKeyElementRef=CryptoKeyElements/Crypto_30_LibCv_Random_Seed_Nist_800_90A_DRBG_AES128, CryptoKeyElementRef=CryptoKeyElements/Crypto_30_LibCv_Random_PrivateString, CryptoKeyElementRef=CryptoKeyElements/Crypto_30_LibCv_Random_AdditionalInput, CryptoKeyElementRef=CryptoKeyElements/Crypto_30_LibCv_Random_Reseed_Counter
        Signature_RsaCrt_Pkcs1_Generate: CryptoKeyElementRef=CryptoKeyElements/Crypto_30_LibCv_Rsa_PrimeP, CryptoKeyElementRef=CryptoKeyElements/Crypto_30_LibCv_Rsa_PrimeQ, CryptoKeyElementRef=CryptoKeyElements/Crypto_30_LibCv_Rsa_ExponentDp, CryptoKeyElementRef=CryptoKeyElements/Crypto_30_LibCv_Rsa_ExponentDq, CryptoKeyElementRef=CryptoKeyElements/Crypto_30_LibCv_Rsa_InverseQi
        KeyExchange_SECP256R1: CryptoKeyElementRef=CryptoKeyElements/Crypto_30_LibCv_KeyExchange_Algorithm_SECP256R1, CryptoKeyElementRef=CryptoKeyElements/Crypto_30_LibCv_KeyExchange_OwnPubKey, CryptoKeyElementRef=CryptoKeyElements/Crypto_30_LibCv_KeyExchange_PrivKey, CryptoKeyElementRef=CryptoKeyElements/Crypto_30_LibCv_KeyExchange_SharedValue
        SheInfoKey: CryptoKeyElementRef=CryptoKeyElements/Crypto_30_LibCv_She_UId, CryptoKeyElementRef=CryptoKeyElements/Crypto_30_LibCv_She_BootProtection, CryptoKeyElementRef=CryptoKeyElements/Crypto_30_LibCv_She_DebuggerProtection
        Cipher_Rsa_Oaep_Encrypt: CryptoKeyElementRef=CryptoKeyElements/Crypto_30_LibCv_Rsa_Modulus, CryptoKeyElementRef=CryptoKeyElements/Crypto_30_LibCv_Rsa_Pub_Exponent
        Cipher_Rsa_Oaep_Decrypt: CryptoKeyElementRef=CryptoKeyElements/Crypto_30_LibCv_Rsa_Modulus, CryptoKeyElementRef=CryptoKeyElements/Crypto_30_LibCv_Rsa_Priv_Exponent
        Cipher_RsaCrt_Oaep_Decrypt: CryptoKeyElementRef=CryptoKeyElements/Crypto_30_LibCv_Rsa_PrimeP, CryptoKeyElementRef=CryptoKeyElements/Crypto_30_LibCv_Rsa_PrimeQ, CryptoKeyElementRef=CryptoKeyElements/Crypto_30_LibCv_Rsa_ExponentDp, CryptoKeyElementRef=CryptoKeyElements/Crypto_30_LibCv_Rsa_ExponentDq, CryptoKeyElementRef=CryptoKeyElements/Crypto_30_LibCv_Rsa_InverseQi
        Cipher_Rsa_Pkcs1_Encrypt: CryptoKeyElementRef=CryptoKeyElements/Crypto_30_LibCv_Rsa_Modulus, CryptoKeyElementRef=CryptoKeyElements/Crypto_30_LibCv_Rsa_Pub_Exponent
        Cipher_Rsa_Pkcs1_Decrypt: CryptoKeyElementRef=CryptoKeyElements/Crypto_30_LibCv_Rsa_Modulus, CryptoKeyElementRef=CryptoKeyElements/Crypto_30_LibCv_Rsa_Priv_Exponent
        Cipher_Rsa_Oaep_Encrypt_With_Label: CryptoKeyElementRef=CryptoKeyElements/Crypto_30_LibCv_Rsa_Modulus, CryptoKeyElementRef=CryptoKeyElements/Crypto_30_LibCv_Rsa_Pub_Exponent, CryptoKeyElementRef=Crypto_30_LibCv_Label
        Cipher_Rsa_Oaep_Decrypt_With_Label: CryptoKeyElementRef=CryptoKeyElements/Crypto_30_LibCv_Rsa_Modulus, CryptoKeyElementRef=CryptoKeyElements/Crypto_30_LibCv_Rsa_Priv_Exponent, CryptoKeyElementRef=Crypto_30_LibCv_Label
        Cipher_RsaCrt_Oaep_Decrypt_With_Label: CryptoKeyElementRef=CryptoKeyElements/Crypto_30_LibCv_Rsa_PrimeP, CryptoKeyElementRef=CryptoKeyElements/Crypto_30_LibCv_Rsa_PrimeQ, CryptoKeyElementRef=CryptoKeyElements/Crypto_30_LibCv_Rsa_ExponentDp, CryptoKeyElementRef=CryptoKeyElements/Crypto_30_LibCv_Rsa_ExponentDq, CryptoKeyElementRef=CryptoKeyElements/Crypto_30_LibCv_Rsa_InverseQi, CryptoKeyElementRef=Crypto_30_LibCv_Label
        KeyExchange_SECP384R1: CryptoKeyElementRef=Crypto_30_LibCv_KeyExchange_Algorithm_SECP384R1, CryptoKeyElementRef=CryptoKeyElements/Crypto_30_LibCv_KeyExchange_OwnPubKey, CryptoKeyElementRef=CryptoKeyElements/Crypto_30_LibCv_KeyExchange_PrivKey, CryptoKeyElementRef=CryptoKeyElements/Crypto_30_LibCv_KeyExchange_SharedValue
        Cipher_Rsa_Pkcs1_Decrypt_Pub: CryptoKeyElementRef=CryptoKeyElements/Crypto_30_LibCv_Rsa_Modulus, CryptoKeyElementRef=CryptoKeyElements/Crypto_30_LibCv_Rsa_Pub_Exponent
        KeyDerive_KDF_X963_SHA256: CryptoKeyElementRef=CryptoKeyElements/Crypto_30_LibCv_KeyDerivation_Password, CryptoKeyElementRef=CryptoKeyElements/Crypto_30_LibCv_KeyDerivation_Salt, CryptoKeyElementRef=Crypto_30_LibCv_KeyDerivation_Algorithm_KDF_X963_SHA256
        CipherSheRam: CryptoKeyElementRef=Crypto_30_LibCv_Cipher_Key_She_Ram, CryptoKeyElementRef=CryptoKeyElements/Crypto_30_LibCv_Cipher_IV, CryptoKeyElementRef=CryptoKeyElements/Crypto_30_LibCv_Cipher_Proof
        MacSheRam: CryptoKeyElementRef=Crypto_30_LibCv_Mac_Key_She_Ram, CryptoKeyElementRef=CryptoKeyElements/Crypto_30_LibCv_Mac_Proof
        MacGmac: CryptoKeyElementRef=CryptoKeyElements/Crypto_30_LibCv_Mac_Key, CryptoKeyElementRef=CryptoKeyElements/Crypto_30_LibCv_Cipher_IV
        KeyGenerate_Symmetric_Generic: CryptoKeyElementRef=CryptoKeyElements/Crypto_30_LibCv_KeyGenerate_Key, CryptoKeyElementRef=Crypto_30_LibCv_KeyGenerate_Algorithm_Symmetric_Generic
        KeyGenerate_Ansi_Nist_Sec_P256R1: CryptoKeyElementRef=CryptoKeyElements/Crypto_30_LibCv_KeyGenerate_Key, CryptoKeyElementRef=CryptoKeyElements/Crypto_30_LibCv_KeyExchange_OwnPubKey, CryptoKeyElementRef=Crypto_30_LibCv_KeyGenerate_Algorithm_Ansi_Nist_Sec_P256R1
        KeyGenerate_Nist_Sec_P384R1: CryptoKeyElementRef=CryptoKeyElements/Crypto_30_LibCv_KeyGenerate_Key, CryptoKeyElementRef=CryptoKeyElements/Crypto_30_LibCv_KeyExchange_OwnPubKey, CryptoKeyElementRef=Crypto_30_LibCv_KeyGenerate_Algorithm_Nist_Sec_P384R1
        KeyDerive_PBKDF2_HMAC_SHA1: CryptoKeyElementRef=CryptoKeyElements/Crypto_30_LibCv_KeyDerivation_Password, CryptoKeyElementRef=CryptoKeyElements/Crypto_30_LibCv_KeyDerivation_Salt, CryptoKeyElementRef=Crypto_30_LibCv_KeyDerivation_Iterations_PBKDF2, CryptoKeyElementRef=Crypto_30_LibCv_KeyDerivation_Algorithm_PBKDF2_HMAC_SHA1
        KeyDerive_PBKDF2_HMAC_SHA256: CryptoKeyElementRef=CryptoKeyElements/Crypto_30_LibCv_KeyDerivation_Password, CryptoKeyElementRef=CryptoKeyElements/Crypto_30_LibCv_KeyDerivation_Salt, CryptoKeyElementRef=Crypto_30_LibCv_KeyDerivation_Iterations_PBKDF2, CryptoKeyElementRef=Crypto_30_LibCv_KeyDerivation_Algorithm_PBKDF2_HMAC_SHA256
        KeyDerive_KDF_X963_SHA512: CryptoKeyElementRef=CryptoKeyElements/Crypto_30_LibCv_KeyDerivation_Password, CryptoKeyElementRef=CryptoKeyElements/Crypto_30_LibCv_KeyDerivation_Salt, CryptoKeyElementRef=Crypto_30_LibCv_KeyDerivation_Algorithm_KDF_X963_SHA512
        AEAD_ChaCha20_Poly1305: CryptoKeyElementRef=Crypto_30_LibCv_Aead_ChaCha_Key, CryptoKeyElementRef=Crypto_30_LibCv_Aead_ChaCha_Nonce
        Random_Nist_800_90A_DRBG_HASH_SHA2_512: CryptoKeyElementRef=Crypto_30_LibCv_Random_Algorithm_Nist_800_90A_DRBG_HASH_SHA2_512, CryptoKeyElementRef=Crypto_30_LibCv_Random_Seed_Nist_800_90A_DRBG_HASH_SHA2_512, CryptoKeyElementRef=CryptoKeyElements/Crypto_30_LibCv_Random_PrivateString, CryptoKeyElementRef=CryptoKeyElements/Crypto_30_LibCv_Random_AdditionalInput, CryptoKeyElementRef=CryptoKeyElements/Crypto_30_LibCv_Random_Reseed_Counter, CryptoKeyElementRef=CryptoKeyElements/Crypto_30_LibCv_Random_Nonce
        Random_Nist_800_90A_DRBG_AES256_NoDF: CryptoKeyElementRef=Crypto_30_LibCv_Random_Algorithm_Nist_800_90A_DRBG_AES256, CryptoKeyElementRef=Crypto_30_LibCv_Random_Seed_Nist_800_90A_DRBG_AES256, CryptoKeyElementRef=CryptoKeyElements/Crypto_30_LibCv_Random_PrivateString, CryptoKeyElementRef=CryptoKeyElements/Crypto_30_LibCv_Random_AdditionalInput, CryptoKeyElementRef=CryptoKeyElements/Crypto_30_LibCv_Random_Reseed_Counter
        Random_Nist_800_90A_DRBG_AES256_DF: CryptoKeyElementRef=Crypto_30_LibCv_Random_Algorithm_Nist_800_90A_DRBG_AES256Df, CryptoKeyElementRef=Crypto_30_LibCv_Random_Seed_Nist_800_90A_DRBG_AES256, CryptoKeyElementRef=CryptoKeyElements/Crypto_30_LibCv_Random_PrivateString, CryptoKeyElementRef=CryptoKeyElements/Crypto_30_LibCv_Random_AdditionalInput, CryptoKeyElementRef=CryptoKeyElements/Crypto_30_LibCv_Random_Reseed_Counter, CryptoKeyElementRef=CryptoKeyElements/Crypto_30_LibCv_Random_Nonce
        KeyDerive_HKDF_HMAC_SHA256: CryptoKeyElementRef=CryptoKeyElements/Crypto_30_LibCv_KeyDerivation_Password, CryptoKeyElementRef=CryptoKeyElements/Crypto_30_LibCv_KeyDerivation_Salt, CryptoKeyElementRef=Crypto_30_LibCv_KeyDerivation_Iterations_HKDF, CryptoKeyElementRef=Crypto_30_LibCv_KeyDerivation_Algorithm_HKDF_HMAC_SHA256, CryptoKeyElementRef=CryptoKeyElements/Crypto_30_LibCv_KeyDerivation_AdditionalInfo
        KeyDerive_Spake2Plus_P256R1: CryptoKeyElementRef=CryptoKeyElements/Crypto_30_LibCv_KeyDerivation_Password, CryptoKeyElementRef=Crypto_30_LibCv_KeyDerivation_Algorithm_Spake2Plus_P256R1
        KeyExchange_Spake2Plus_A_Suite8_1: CryptoKeyElementRef=Crypto_30_LibCv_KeyExchange_Algorithm_Spake2Plus_Suite8_1, CryptoKeyElementRef=Crypto_30_LibCv_W0, CryptoKeyElementRef=Crypto_30_LibCv_W1, CryptoKeyElementRef=Crypto_30_LibCv_AdditionalInfo, CryptoKeyElementRef=CryptoKeyElements/Crypto_30_LibCv_KeyExchange_SharedValue, CryptoKeyElementRef=Crypto_30_LibCv_Verification_Result, CryptoKeyElementRef=Crypto_30_LibCv_Verification
        KeyExchange_Spake2Plus_B_Suite8_1: CryptoKeyElementRef=Crypto_30_LibCv_KeyExchange_Algorithm_Spake2Plus_Suite8_1, CryptoKeyElementRef=Crypto_30_LibCv_W0, CryptoKeyElementRef=Crypto_30_LibCv_L, CryptoKeyElementRef=Crypto_30_LibCv_AdditionalInfo, CryptoKeyElementRef=CryptoKeyElements/Crypto_30_LibCv_KeyExchange_SharedValue, CryptoKeyElementRef=Crypto_30_LibCv_Verification_Result, CryptoKeyElementRef=Crypto_30_LibCv_Verification
        KeyExchange_Spake2Plus_A_Suite8: CryptoKeyElementRef=Crypto_30_LibCv_KeyExchange_Algorithm_Spake2Plus_Suite8, CryptoKeyElementRef=Crypto_30_LibCv_W0, CryptoKeyElementRef=Crypto_30_LibCv_W1, CryptoKeyElementRef=Crypto_30_LibCv_AdditionalInfo, CryptoKeyElementRef=CryptoKeyElements/Crypto_30_LibCv_KeyExchange_SharedValue, CryptoKeyElementRef=Crypto_30_LibCv_Verification_Result, CryptoKeyElementRef=Crypto_30_LibCv_Verification
        KeyExchange_Spake2Plus_B_Suite8: CryptoKeyElementRef=Crypto_30_LibCv_KeyExchange_Algorithm_Spake2Plus_Suite8, CryptoKeyElementRef=Crypto_30_LibCv_W0, CryptoKeyElementRef=Crypto_30_LibCv_L, CryptoKeyElementRef=Crypto_30_LibCv_AdditionalInfo, CryptoKeyElementRef=CryptoKeyElements/Crypto_30_LibCv_KeyExchange_SharedValue, CryptoKeyElementRef=Crypto_30_LibCv_Verification_Result, CryptoKeyElementRef=Crypto_30_LibCv_Verification
        KeyGenerate_ED25519: CryptoKeyElementRef=CryptoKeyElements/Crypto_30_LibCv_KeyGenerate_Key, CryptoKeyElementRef=CryptoKeyElements/Crypto_30_LibCv_KeyExchange_OwnPubKey, CryptoKeyElementRef=Crypto_30_LibCv_KeyGenerate_Algorithm_Ed25519
        KeyExchange_NISTP224R1_BD: CryptoKeyElementRef=Crypto_30_LibCv_KeyExchange_Algorithm_NISTP224R1_BD, CryptoKeyElementRef=CryptoKeyElements/Crypto_30_LibCv_KeyExchange_OwnPubKey, CryptoKeyElementRef=CryptoKeyElements/Crypto_30_LibCv_KeyExchange_PrivKey, CryptoKeyElementRef=CryptoKeyElements/Crypto_30_LibCv_KeyExchange_SharedValue, CryptoKeyElementRef=Crypto_30_LibCv_KeyExchange_NumEcu, CryptoKeyElementRef=Crypto_30_LibCv_KeyExchange_EcuId, CryptoKeyElementRef=Crypto_30_LibCv_KeyExchange_Intermediate, CryptoKeyElementRef=CryptoKeyElements/Crypto_30_LibCv_KeyExchange_PartnerPubKey, CryptoKeyElementRef=Crypto_30_LibCv_KeyExchange_PartnerPubKey_2
        KeyDerive_Hkdf_Option1_Sha256: CryptoKeyElementRef=CryptoKeyElements/Crypto_30_LibCv_KeyDerivation_Password, CryptoKeyElementRef=CryptoKeyElements/Crypto_30_LibCv_KeyDerivation_AdditionalInfo, CryptoKeyElementRef=Crypto_30_LibCv_KeyDerivation_Algorithm_HKDF_Option1_SHA256
        KeyExchange_SECP521R1: CryptoKeyElementRef=Crypto_30_LibCv_KeyExchange_Algorithm_SECP521R1, CryptoKeyElementRef=CryptoKeyElements/Crypto_30_LibCv_KeyExchange_OwnPubKey, CryptoKeyElementRef=CryptoKeyElements/Crypto_30_LibCv_KeyExchange_PrivKey, CryptoKeyElementRef=CryptoKeyElements/Crypto_30_LibCv_KeyExchange_SharedValue
        KeyDerive_HKDF_HMAC_SHA384: CryptoKeyElementRef=CryptoKeyElements/Crypto_30_LibCv_KeyDerivation_Password, CryptoKeyElementRef=CryptoKeyElements/Crypto_30_LibCv_KeyDerivation_Salt, CryptoKeyElementRef=Crypto_30_LibCv_KeyDerivation_Iterations_HKDF, CryptoKeyElementRef=Crypto_30_LibCv_KeyDerivation_Algorithm_HKDF_HMAC_SHA384, CryptoKeyElementRef=CryptoKeyElements/Crypto_30_LibCv_KeyDerivation_AdditionalInfo
        KeyDerive_Hkdf_Option1_Sha512: CryptoKeyElementRef=CryptoKeyElements/Crypto_30_LibCv_KeyDerivation_Password, CryptoKeyElementRef=CryptoKeyElements/Crypto_30_LibCv_KeyDerivation_AdditionalInfo, CryptoKeyElementRef=Crypto_30_LibCv_KeyDerivation_Algorithm_HKDF_Option1_SHA512
        KeyDerive_ISO15118_20_ProvCert: CryptoKeyElementRef=CryptoKeyElements/Crypto_30_LibCv_KeyDerivation_Password, CryptoKeyElementRef=Crypto_30_LibCv_KeyDerivation_Algorithm_ISO15118_20, CryptoKeyElementRef=CryptoKeyElements/Crypto_30_LibCv_KeyExchange_OwnPubKey
        KeyDerive_ISO15118_20_ContrCert: CryptoKeyElementRef=CryptoKeyElements/Crypto_30_LibCv_KeyDerivation_Password, CryptoKeyElementRef=Crypto_30_LibCv_KeyDerivation_Algorithm_ISO15118_20, CryptoKeyElementRef=CryptoKeyElements/Crypto_30_LibCv_KeyExchange_PartnerPubKey, CryptoKeyElementRef=CryptoKeyElements/Crypto_30_LibCv_SCC_Contract_PubKey, CryptoKeyElementRef=CryptoKeyElements/Crypto_30_LibCv_SCC_IV_And_Encrypted_PrivKey, CryptoKeyElementRef=CryptoKeyElements/Crypto_30_LibCv_SCC_Contract_AAD
        KeyExchange_X448: CryptoKeyElementRef=Crypto_30_LibCv_KeyExchange_Algorithm_X448, CryptoKeyElementRef=CryptoKeyElements/Crypto_30_LibCv_KeyExchange_OwnPubKey, CryptoKeyElementRef=CryptoKeyElements/Crypto_30_LibCv_KeyExchange_PrivKey, CryptoKeyElementRef=CryptoKeyElements/Crypto_30_LibCv_KeyExchange_SharedValue
        Signature_EcDsa_SECp160r1_public: CryptoKeyElementRef=Crypto_30_LibCv_Signature_EcDsa_SECp160r1_public
        Signature_EcDsa_SECp256r1_public: CryptoKeyElementRef=Crypto_30_LibCv_Signature_EcDsa_SECp256r1_public
        Signature_EcDsa_SECp384r1_public: CryptoKeyElementRef=Crypto_30_LibCv_Signature_EcDsa_SECp384r1_public
        Signature_EcDsa_SECp521r1_public: CryptoKeyElementRef=Crypto_30_LibCv_Signature_EcDsa_SECp521r1_public
        Signature_EdDsa_Ed25519_public: CryptoKeyElementRef=Crypto_30_LibCv_Signature_EdDsa_Ed25519_public
        Signature_EcDsa_SECp160r1_private: CryptoKeyElementRef=Crypto_30_LibCv_Signature_EcDsa_SECp160r1_private
        Signature_EcDsa_SECp256r1_private: CryptoKeyElementRef=Crypto_30_LibCv_Signature_EcDsa_SECp256r1_private
        Signature_EcDsa_SECp384r1_private: CryptoKeyElementRef=Crypto_30_LibCv_Signature_EcDsa_SECp384r1_private
        Signature_EcDsa_SECp521r1_private: CryptoKeyElementRef=Crypto_30_LibCv_Signature_EcDsa_SECp521r1_private
        Signature_EdDsa_Ed25519_private: CryptoKeyElementRef=Crypto_30_LibCv_Signature_EdDsa_Ed25519_private
        Signature_EdDsa_Ed448_public: CryptoKeyElementRef=Crypto_30_LibCv_Signature_EdDsa_Ed448_public
        Signature_EdDsa_Ed448_private: CryptoKeyElementRef=Crypto_30_LibCv_Signature_EdDsa_Ed448_private
        Signature_EdDsa_Ed448_public_ctx: CryptoKeyElementRef=Crypto_30_LibCv_Signature_EdDsa_Ed448_public, CryptoKeyElementRef=Crypto_30_LibCv_EdDsa_Context
        Signature_EdDsa_Ed448_private_ctx: CryptoKeyElementRef=Crypto_30_LibCv_Signature_EdDsa_Ed448_private, CryptoKeyElementRef=Crypto_30_LibCv_EdDsa_Context
        Signature_EdDsa_Ed25519_public_ctx: CryptoKeyElementRef=Crypto_30_LibCv_Signature_EdDsa_Ed25519_public, CryptoKeyElementRef=Crypto_30_LibCv_EdDsa_Context
        Signature_EdDsa_Ed25519_private_ctx: CryptoKeyElementRef=Crypto_30_LibCv_Signature_EdDsa_Ed25519_private, CryptoKeyElementRef=Crypto_30_LibCv_EdDsa_Context
        KeyExchange_P256R1_BD: CryptoKeyElementRef=Crypto_30_LibCv_KeyExchange_Algorithm_P256R1_BD, CryptoKeyElementRef=CryptoKeyElements/Crypto_30_LibCv_KeyExchange_OwnPubKey, CryptoKeyElementRef=CryptoKeyElements/Crypto_30_LibCv_KeyExchange_PrivKey, CryptoKeyElementRef=CryptoKeyElements/Crypto_30_LibCv_KeyExchange_SharedValue, CryptoKeyElementRef=Crypto_30_LibCv_KeyExchange_NumEcu, CryptoKeyElementRef=Crypto_30_LibCv_KeyExchange_EcuId, CryptoKeyElementRef=Crypto_30_LibCv_KeyExchange_Intermediate, CryptoKeyElementRef=CryptoKeyElements/Crypto_30_LibCv_KeyExchange_PartnerPubKey, CryptoKeyElementRef=Crypto_30_LibCv_KeyExchange_PartnerPubKey_2
        KeyGenerate_Nist_Sec_P521R1: CryptoKeyElementRef=CryptoKeyElements/Crypto_30_LibCv_KeyGenerate_Key, CryptoKeyElementRef=CryptoKeyElements/Crypto_30_LibCv_KeyExchange_OwnPubKey, CryptoKeyElementRef=Crypto_30_LibCv_KeyGenerate_Algorithm_Nist_Sec_P521R1
        Signature_SlhDsa_SHA2_128s_public: CryptoKeyElementRef=Crypto_30_LibCv_Signature_SlhDsa_SHA2_128s_public
        Signature_Sm2_P256Sm2_Generate_withoutID: CryptoKeyElementRef=Crypto_30_LibCv_Signature_Sm2_P256Sm2_private, CryptoKeyElementRef=Crypto_30_LibCv_Signature_Sm2Generate_P256Sm2_public
        Signature_Sm2_P256Sm2_Verify_withoutID: CryptoKeyElementRef=Crypto_30_LibCv_Signature_Sm2Verify_P256Sm2_public
        Signature_Sm2_P256Sm2_Generate: CryptoKeyElementRef=Crypto_30_LibCv_Signature_Sm2_P256Sm2_private, CryptoKeyElementRef=Crypto_30_LibCv_Signature_Sm2Generate_P256Sm2_public, CryptoKeyElementRef=Crypto_30_LibCv_Signature_Sm2_ID
        Signature_Sm2_P256Sm2_Verify: CryptoKeyElementRef=Crypto_30_LibCv_Signature_Sm2Verify_P256Sm2_public, CryptoKeyElementRef=Crypto_30_LibCv_Signature_Sm2_ID
        KeyGenerate_Sm2P256V1: CryptoKeyElementRef=CryptoKeyElements/Crypto_30_LibCv_KeyGenerate_Key, CryptoKeyElementRef=CryptoKeyElements/Crypto_30_LibCv_KeyExchange_OwnPubKey, CryptoKeyElementRef=Crypto_30_LibCv_KeyGenerate_Algorithm_Sm2P256v1
    CryptoGeneral
    CryptoKeyElements
      120 x CryptoKeyElement:
        Crypto_30_LibCv_Signature_Key: CryptoKeyElementId=1
        Crypto_30_LibCv_Random_Seed: CryptoKeyElementId=3
        Crypto_30_LibCv_KeyGenerate_Seed: CryptoKeyElementId=16
        Crypto_30_LibCv_KeyGenerate_Key: CryptoKeyElementId=1
        Crypto_30_LibCv_KeyExchange_SharedValue: CryptoKeyElementId=1
        Crypto_30_LibCv_KeyExchange_PrivKey: CryptoKeyElementId=9
        Crypto_30_LibCv_Mac_Proof: CryptoKeyElementId=2, CryptoKeyElementSize=48
        Crypto_30_LibCv_KeyDerivation_Salt: CryptoKeyElementId=13
        Crypto_30_LibCv_KeyExchange_OwnPubKey: CryptoKeyElementId=10
        Crypto_30_LibCv_KeyExchange_Base: CryptoKeyElementId=8
        Crypto_30_LibCv_KeyDerivation_Password: CryptoKeyElementId=1
        Crypto_30_LibCv_Cipher_Key: CryptoKeyElementId=1
        Crypto_30_LibCv_Cipher_IV: CryptoKeyElementId=5
        Crypto_30_LibCv_Cipher_Proof: CryptoKeyElementId=6, CryptoKeyElementSize=48
        Crypto_30_LibCv_Mac_Key: CryptoKeyElementId=1
        Crypto_30_LibCv_Hash_Result: CryptoKeyElementId=1
        Crypto_30_LibCv_KeyDerive_Algorithm: CryptoKeyElementId=15, CryptoKeyElementInitValue=0x00, CryptoKeyElementSize=1
        Crypto_30_LibCv_KeyGenerate_Algorithm: CryptoKeyElementId=17, CryptoKeyElementInitValue=0x00, CryptoKeyElementSize=1
        Crypto_30_LibCv_KeyExchange_Algorithm_X25519: CryptoKeyElementId=12, CryptoKeyElementInitValue=0x00, CryptoKeyElementSize=1
        Crypto_30_LibCv_Random_Algorithm_Fips186_Sha1: CryptoKeyElementId=4, CryptoKeyElementInitValue=0x00, CryptoKeyElementSize=1  # 4
        Crypto_30_LibCv_KeyDerivation_Label: CryptoKeyElementId=130, CryptoKeyElementSize=4
        Crypto_30_LibCv_Rsa_Modulus: CryptoKeyElementId=160
        Crypto_30_LibCv_Rsa_Pub_Exponent: CryptoKeyElementId=161
        Crypto_30_LibCv_Rsa_Priv_Exponent: CryptoKeyElementId=162
        Crypto_30_LibCv_Rsa_Salt: CryptoKeyElementId=163
        Crypto_30_LibCv_Rsa_SaltLength: CryptoKeyElementId=164, CryptoKeyElementSize=2
        Crypto_30_LibCv_KeyExchange_Algorithm_ANSIP256R1: CryptoKeyElementId=12, CryptoKeyElementInitValue=0x01, CryptoKeyElementSize=1
        Crypto_30_LibCv_KeyExchange_PartnerPubKey: CryptoKeyElementId=3003
        Crypto_30_LibCv_KeyDerivation_Algorithm_NIST80056A: CryptoKeyElementId=15, CryptoKeyElementInitValue=0x03, CryptoKeyElementSize=1
        Crypto_30_LibCv_KeyDerivation_Algorithm_ISO15118: CryptoKeyElementId=15, CryptoKeyElementInitValue=0x04, CryptoKeyElementSize=1
        Crypto_30_LibCv_KeyDerivation_Algorithm_SYM_NIST800108: CryptoKeyElementId=15, CryptoKeyElementInitValue=0x01, CryptoKeyElementSize=1
        Crypto_30_LibCv_KeyDerivation_Algorithm_ASM_NISTFIPS1864: CryptoKeyElementId=15, CryptoKeyElementInitValue=0x02, CryptoKeyElementSize=1
        Crypto_30_LibCv_KeyDerivation_AdditionalInfo: CryptoKeyElementId=131
        Crypto_30_LibCv_SCC_Contract_PubKey: CryptoKeyElementId=3013
        Crypto_30_LibCv_SCC_IV_And_Encrypted_PrivKey: CryptoKeyElementId=3014
        Crypto_30_LibCv_Random_Algorithm: CryptoKeyElementId=4, CryptoKeyElementSize=1
        Crypto_30_LibCv_Random_Algorithm_Nist_800_90A_DRBG_AES128: CryptoKeyElementId=4, CryptoKeyElementSize=1, CryptoKeyElementInitValue=0x01
        Crypto_30_LibCv_Random_AdditionalInput: CryptoKeyElementId=3016
        Crypto_30_LibCv_Random_PrivateString: CryptoKeyElementId=3015
        Crypto_30_LibCv_Random_Nonce: CryptoKeyElementId=3017
        Crypto_30_LibCv_Random_Reseed_Counter: CryptoKeyElementId=3018, CryptoKeyElementWriteAccess=WA_DENIED, CryptoKeyElementAllowPartialAccess=0, CryptoKeyElementSize=4, CryptoKeyElementInitValue=0 0 0 1
        Crypto_30_LibCv_Rsa_PrimeP: CryptoKeyElementId=3051
        Crypto_30_LibCv_Rsa_PrimeQ: CryptoKeyElementId=3052
        Crypto_30_LibCv_Rsa_ExponentDp: CryptoKeyElementId=3053
        Crypto_30_LibCv_Rsa_ExponentDq: CryptoKeyElementId=3054
        Crypto_30_LibCv_Rsa_InverseQi: CryptoKeyElementId=3055
        Crypto_30_LibCv_KeyExchange_Algorithm_SECP256R1: CryptoKeyElementId=12, CryptoKeyElementInitValue=0x02, CryptoKeyElementSize=1
        Crypto_30_LibCv_Random_Seed_Nist_800_90A_DRBG_AES128: CryptoKeyElementId=3, CryptoKeyElementAllowPartialAccess=0, CryptoKeyElementReadAccess=RA_DENIED, CryptoKeyElementSize=32
        Crypto_30_LibCv_Mac_Key_She: CryptoKeyElementId=1, CryptoKeyElementWriteAccess=WA_ENCRYPTED, CryptoKeyElementSize=16
        Crypto_30_LibCv_Cipher_Key_She: CryptoKeyElementId=1, CryptoKeyElementWriteAccess=WA_ENCRYPTED, CryptoKeyElementSize=16
        Crypto_30_LibCv_She_UId: CryptoKeyElementSize=15, CryptoKeyElementId=3021
        Crypto_30_LibCv_She_Counter: CryptoKeyElementId=3019, CryptoKeyElementSize=4, CryptoKeyElementWriteAccess=WA_DENIED
        Crypto_30_LibCv_She_BootProtection: CryptoKeyElementId=3056, CryptoKeyElementSize=1
        Crypto_30_LibCv_She_DebuggerProtection: CryptoKeyElementId=3057, CryptoKeyElementSize=1
        Crypto_30_LibCv_Label: CryptoKeyElementId=3058
        Crypto_30_LibCv_KeyExchange_Algorithm_SECP384R1: CryptoKeyElementId=12, CryptoKeyElementInitValue=0x04, CryptoKeyElementSize=1
        Crypto_30_LibCv_KeyDerivation_Algorithm_KDF_X963_SHA256: CryptoKeyElementId=15, CryptoKeyElementInitValue=0x06, CryptoKeyElementSize=1
        Crypto_30_LibCv_Mac_Key_She_Ram: CryptoKeyElementId=1, CryptoKeyElementWriteAccess=WA_ALLOWED, CryptoKeyElementSize=16, CryptoKeyElementReadAccess=RA_ENCRYPTED
        Crypto_30_LibCv_Cipher_Key_She_Ram: CryptoKeyElementId=1, CryptoKeyElementWriteAccess=WA_ALLOWED, CryptoKeyElementSize=16, CryptoKeyElementReadAccess=RA_ENCRYPTED
        Crypto_30_LibCv_Cipher_2NDKey: CryptoKeyElementId=7
        Crypto_30_LibCv_KeyGenerate_Algorithm_Symmetric_Generic: CryptoKeyElementId=17, CryptoKeyElementInitValue=0, CryptoKeyElementSize=1
        Crypto_30_LibCv_KeyGenerate_Algorithm_Ansi_Nist_Sec_P256R1: CryptoKeyElementId=17, CryptoKeyElementInitValue=1, CryptoKeyElementSize=1
        Crypto_30_LibCv_KeyGenerate_Algorithm_Nist_Sec_P384R1: CryptoKeyElementId=17, CryptoKeyElementInitValue=2, CryptoKeyElementSize=1
        Crypto_30_LibCv_KeyDerivation_Iterations_PBKDF2: CryptoKeyElementId=14, CryptoKeyElementSize=4
        Crypto_30_LibCv_KeyDerivation_Algorithm_PBKDF2_HMAC_SHA1: CryptoKeyElementId=15, CryptoKeyElementInitValue=0x09, CryptoKeyElementSize=1
        Crypto_30_LibCv_KeyDerivation_Algorithm_PBKDF2_HMAC_SHA256: CryptoKeyElementId=15, CryptoKeyElementInitValue=0x0A, CryptoKeyElementSize=1
        Crypto_30_LibCv_KeyDerivation_Algorithm_KDF_X963_SHA512: CryptoKeyElementId=15, CryptoKeyElementInitValue=0x07, CryptoKeyElementSize=1
        Crypto_30_LibCv_Aead_ChaCha_Key: CryptoKeyElementId=1, CryptoKeyElementSize=32
        Crypto_30_LibCv_Aead_ChaCha_Nonce: CryptoKeyElementId=5, CryptoKeyElementSize=12
        Crypto_30_LibCv_Random_Algorithm_Nist_800_90A_DRBG_AES128_DF: CryptoKeyElementId=4, CryptoKeyElementSize=1, CryptoKeyElementInitValue=2
        Crypto_30_LibCv_Random_Algorithm_Nist_800_90A_DRBG_HASH_SHA2_512: CryptoKeyElementId=4, CryptoKeyElementSize=1, CryptoKeyElementInitValue=3
        Crypto_30_LibCv_Random_Seed_Nist_800_90A_DRBG_HASH_SHA2_512: CryptoKeyElementId=3, CryptoKeyElementAllowPartialAccess=0, CryptoKeyElementReadAccess=RA_DENIED, CryptoKeyElementSize=222
        Crypto_30_LibCv_Random_Algorithm_Nist_800_90A_DRBG_AES256: CryptoKeyElementId=4, CryptoKeyElementSize=1, CryptoKeyElementInitValue=4
        Crypto_30_LibCv_Random_Algorithm_Nist_800_90A_DRBG_AES256Df: CryptoKeyElementId=4, CryptoKeyElementSize=1, CryptoKeyElementInitValue=5
        Crypto_30_LibCv_Random_Seed_Nist_800_90A_DRBG_AES256: CryptoKeyElementId=3, CryptoKeyElementAllowPartialAccess=0, CryptoKeyElementReadAccess=RA_DENIED, CryptoKeyElementSize=48
        Crypto_30_LibCv_KeyDerivation_Algorithm_HKDF_HMAC_SHA256: CryptoKeyElementId=15, CryptoKeyElementInitValue=0x0B, CryptoKeyElementSize=1
        Crypto_30_LibCv_KeyDerivation_Iterations_HKDF: CryptoKeyElementId=14, CryptoKeyElementSize=1
        Crypto_30_LibCv_KeyDerivation_Algorithm_Spake2Plus_P256R1: CryptoKeyElementId=15, CryptoKeyElementInitValue=0x0C, CryptoKeyElementSize=1
        Crypto_30_LibCv_KeyExchange_Algorithm_Spake2Plus_Suite8: CryptoKeyElementId=12, CryptoKeyElementSize=1, CryptoKeyElementInitValue=5
        Crypto_30_LibCv_KeyExchange_Algorithm_Spake2Plus_Suite8_1: CryptoKeyElementId=12, CryptoKeyElementSize=1, CryptoKeyElementInitValue=6
        Crypto_30_LibCv_W0: CryptoKeyElementId=3084
        Crypto_30_LibCv_W1: CryptoKeyElementId=3085
        Crypto_30_LibCv_L: CryptoKeyElementId=3086
        Crypto_30_LibCv_Verification_Result: CryptoKeyElementId=3088, CryptoKeyElementSize=1
        Crypto_30_LibCv_AdditionalInfo: CryptoKeyElementId=131
        Crypto_30_LibCv_Verification: CryptoKeyElementId=3087
        Crypto_30_LibCv_KeyGenerate_Algorithm_Ed25519: CryptoKeyElementId=17, CryptoKeyElementSize=1, CryptoKeyElementInitValue=3
        Crypto_30_LibCv_KeyExchange_PartnerPubKey_2: CryptoKeyElementId=3004
        Crypto_30_LibCv_KeyExchange_Algorithm_NISTP224R1_BD: CryptoKeyElementId=12, CryptoKeyElementInitValue=3, CryptoKeyElementSize=1
        Crypto_30_LibCv_KeyExchange_EcuId: CryptoKeyElementId=3007, CryptoKeyElementSize=1
        Crypto_30_LibCv_KeyExchange_NumEcu: CryptoKeyElementId=3006, CryptoKeyElementSize=1
        Crypto_30_LibCv_KeyExchange_Intermediate: CryptoKeyElementId=3005
        Crypto_30_LibCv_KeyDerivation_Algorithm_HKDF_Option1_SHA256: CryptoKeyElementId=15, CryptoKeyElementInitValue=0x0D, CryptoKeyElementSize=1
        Crypto_30_LibCv_KeyExchange_Algorithm_SECP521R1: CryptoKeyElementId=12, CryptoKeyElementInitValue=0x07, CryptoKeyElementSize=1
        Crypto_30_LibCv_KeyDerivation_Algorithm_HKDF_HMAC_SHA384: CryptoKeyElementId=15, CryptoKeyElementInitValue=0x0E, CryptoKeyElementSize=1
        Crypto_30_LibCv_KeyDerivation_Algorithm_HKDF_Option1_SHA512: CryptoKeyElementId=15, CryptoKeyElementInitValue=0x0F, CryptoKeyElementSize=1
        Crypto_30_LibCv_KeyDerivation_Algorithm_ISO15118_20: CryptoKeyElementId=15, CryptoKeyElementInitValue=0x10, CryptoKeyElementSize=1
        Crypto_30_LibCv_SCC_Contract_AAD: CryptoKeyElementId=3060
        Crypto_30_LibCv_KeyExchange_Algorithm_X448: CryptoKeyElementId=12, CryptoKeyElementInitValue=0x08, CryptoKeyElementSize=1
        Crypto_30_LibCv_Signature_EcDsa_SECp160r1_public: CryptoKeyElementId=1, CryptoKeyElementSize=40
        Crypto_30_LibCv_Signature_EcDsa_SECp256r1_public: CryptoKeyElementId=1, CryptoKeyElementSize=64
        Crypto_30_LibCv_Signature_EcDsa_SECp384r1_public: CryptoKeyElementId=1, CryptoKeyElementSize=96
        Crypto_30_LibCv_Signature_EcDsa_SECp521r1_public: CryptoKeyElementId=1, CryptoKeyElementSize=132
        Crypto_30_LibCv_Signature_EdDsa_Ed25519_public: CryptoKeyElementId=1, CryptoKeyElementSize=32
        Crypto_30_LibCv_Signature_EcDsa_SECp160r1_private: CryptoKeyElementId=1, CryptoKeyElementSize=20
        Crypto_30_LibCv_Signature_EcDsa_SECp256r1_private: CryptoKeyElementId=1, CryptoKeyElementSize=32
        Crypto_30_LibCv_Signature_EcDsa_SECp384r1_private: CryptoKeyElementId=1, CryptoKeyElementSize=48
        Crypto_30_LibCv_Signature_EcDsa_SECp521r1_private: CryptoKeyElementId=1, CryptoKeyElementSize=66
        Crypto_30_LibCv_Signature_EdDsa_Ed25519_private: CryptoKeyElementId=1, CryptoKeyElementSize=32
        Crypto_30_LibCv_Signature_EdDsa_Ed448_public: CryptoKeyElementId=1, CryptoKeyElementSize=57
        Crypto_30_LibCv_Signature_EdDsa_Ed448_private: CryptoKeyElementId=1, CryptoKeyElementSize=57
        Crypto_30_LibCv_EdDsa_Context: CryptoKeyElementId=3061
        Crypto_30_LibCv_KeyExchange_Algorithm_P256R1_BD: CryptoKeyElementId=12, CryptoKeyElementInitValue=9, CryptoKeyElementSize=1
        Crypto_30_LibCv_KeyGenerate_Algorithm_Nist_Sec_P521R1: CryptoKeyElementId=17, CryptoKeyElementInitValue=4, CryptoKeyElementSize=1
        Crypto_30_LibCv_Signature_SlhDsa_SHA2_128s_public: CryptoKeyElementId=1, CryptoKeyElementSize=32
        Crypto_30_LibCv_Signature_Sm2_P256Sm2_private: CryptoKeyElementId=1, CryptoKeyElementSize=32
        Crypto_30_LibCv_Signature_Sm2Verify_P256Sm2_public: CryptoKeyElementId=1, CryptoKeyElementSize=64
        Crypto_30_LibCv_Signature_Sm2_ID: CryptoKeyElementId=3092
        Crypto_30_LibCv_Signature_Sm2Generate_P256Sm2_public: CryptoKeyElementId=3093, CryptoKeyElementSize=64
        Crypto_30_LibCv_KeyGenerate_Algorithm_Sm2P256v1: CryptoKeyElementId=17, CryptoKeyElementInitValue=5, CryptoKeyElementSize=1
    CryptoNvStorage: CryptoNvManagementDataPerKey=4
  module config Crypto_Rec: definition=Crypto  # Software Crypto Driver rec-configuration
    CryptoKeyElements
      55 x CryptoKeyElement:
        Crypto_30_LibCv_Signature_Key: CryptoKeyElementSize=32
        Crypto_30_LibCv_Random_Seed: CryptoKeyElementSize=20
        Crypto_30_LibCv_KeyGenerate_Seed: CryptoKeyElementSize=16
        Crypto_30_LibCv_KeyGenerate_Key: CryptoKeyElementSize=16
        Crypto_30_LibCv_KeyExchange_SharedValue: CryptoKeyElementSize=32
        Crypto_30_LibCv_KeyExchange_PrivKey: CryptoKeyElementSize=32
        Crypto_30_LibCv_Mac_Proof: CryptoKeyElementSize=48
        Crypto_30_LibCv_KeyDerivation_Salt: CryptoKeyElementSize=16
        Crypto_30_LibCv_KeyExchange_OwnPubKey: CryptoKeyElementSize=32, CryptoKeyElementReadAccess=RA_ALLOWED
        Crypto_30_LibCv_KeyExchange_Base: CryptoKeyElementSize=16
        Crypto_30_LibCv_KeyDerivation_Password: CryptoKeyElementSize=64, CryptoKeyElementAllowPartialAccess=1
        Crypto_30_LibCv_KeyDerivation_Label
        Crypto_30_LibCv_Cipher_Key: CryptoKeyElementSize=16
        Crypto_30_LibCv_Cipher_IV: CryptoKeyElementSize=16
        Crypto_30_LibCv_Cipher_Proof: CryptoKeyElementSize=48
        Crypto_30_LibCv_Mac_Key: CryptoKeyElementSize=16
        Crypto_30_LibCv_Hash_Result: CryptoKeyElementSize=20
        Crypto_30_LibCv_KeyDerive_Algorithm
        Crypto_30_LibCv_KeyGenerate_Algorithm
        Crypto_30_LibCv_KeyExchange_Algorithm_X25519
        Crypto_30_LibCv_Random_Algorithm_Fips186_Sha1  # 4
        Crypto_30_LibCv_Rsa_Modulus: CryptoKeyElementSize=32
        Crypto_30_LibCv_Rsa_Pub_Exponent: CryptoKeyElementSize=3
        Crypto_30_LibCv_Rsa_Priv_Exponent: CryptoKeyElementSize=32
        Crypto_30_LibCv_Rsa_Salt: CryptoKeyElementSize=32
        Crypto_30_LibCv_Rsa_SaltLength
        Crypto_30_LibCv_KeyExchange_Algorithm_ANSIP256R1
        Crypto_30_LibCv_KeyExchange_PartnerPubKey: CryptoKeyElementSize=132, CryptoKeyElementAllowPartialAccess=1
        Crypto_30_LibCv_KeyDerivation_Algorithm_NIST80056A
        Crypto_30_LibCv_KeyDerivation_Algorithm_ISO15118
        Crypto_30_LibCv_KeyDerivation_Algorithm_SYM_NIST800108
        Crypto_30_LibCv_KeyDerivation_Algorithm_ASM_NISTFIPS1864
        Crypto_30_LibCv_KeyDerivation_AdditionalInfo: CryptoKeyElementSize=5
        Crypto_30_LibCv_SCC_Contract_PubKey: CryptoKeyElementSize=132, CryptoKeyElementAllowPartialAccess=1
        Crypto_30_LibCv_SCC_IV_And_Encrypted_PrivKey: CryptoKeyElementSize=128, CryptoKeyElementAllowPartialAccess=1
        Crypto_30_LibCv_Random_Algorithm
        Crypto_30_LibCv_Random_Algorithm_Nist_800_90A_DRBG_AES128
        Crypto_30_LibCv_Random_AdditionalInput: CryptoKeyElementSize=32
        Crypto_30_LibCv_Random_Nonce
        Crypto_30_LibCv_Random_PrivateString
        Crypto_30_LibCv_Random_Reseed_Counter
        Crypto_30_LibCv_Rsa_PrimeP
        Crypto_30_LibCv_Rsa_PrimeQ
        Crypto_30_LibCv_Rsa_ExponentDp
        Crypto_30_LibCv_Rsa_ExponentDq
        Crypto_30_LibCv_Rsa_InverseQi
        Crypto_30_LibCv_KeyExchange_Algorithm_SECP256R1
        Crypto_30_LibCv_Random_Seed_Nist_800_90A_DRBG_AES128
        Crypto_30_LibCv_Mac_Key_She: CryptoKeyElementReadAccess=RA_ENCRYPTED
        Crypto_30_LibCv_Cipher_Key_She: CryptoKeyElementReadAccess=RA_ENCRYPTED
        Crypto_30_LibCv_She_UId
        Crypto_30_LibCv_She_Counter: CryptoKeyElementInitValue=0 0 0 0
        Crypto_30_LibCv_She_BootProtection: CryptoKeyElementInitValue=0
        Crypto_30_LibCv_She_DebuggerProtection: CryptoKeyElementInitValue=0
        Crypto_30_LibCv_SCC_Contract_AAD: CryptoKeyElementSize=34, CryptoKeyElementAllowPartialAccess=1
    CryptoKeyTypes
    CryptoDriverObjects
      Crypto_30_LibCv (CryptoDriverObject): CryptoDriverObjectId=1, CryptoDriverObjectQueueSize=1
    CryptoGeneral: CryptoUseVStdLib=1
  module config Crypto_Pre_Class1: definition=Crypto
    CryptoKeyElements
      CryptoKeyElement: CryptoKeyElementFormat=CRYPTO_KE_FORMAT_BIN_OCTET
