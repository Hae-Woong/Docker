AUTOSAR XML (schema 4-0-3)
# COPYRIGHT
# Copyright (c) 2024 by Vector Informatik GmbH. All rights reserved.
# This software is copyright protected and proprietary to Vector Informatik GmbH.
# Vector Informatik GmbH grants to you only those rights as set out in the license conditions.
package /MICROSAR/Crypto_30_LibCv
  module config Crypto_Rec: definition=Crypto  # Software Crypto Driver rec-configuration
    CryptoGeneral: CryptoSafeBswChecks=1
