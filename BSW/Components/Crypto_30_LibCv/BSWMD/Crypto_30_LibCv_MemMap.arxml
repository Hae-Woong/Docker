AUTOSAR XML (schema 00048)
# COPYRIGHT
# Copyright (c) 2024 by Vector Informatik GmbH. All rights reserved.
# This software is copyright protected and proprietary to Vector Informatik GmbH.
# Vector Informatik GmbH grants to you only those rights as set out in the license conditions.
package /MICROSAR/Crypto_30_LibCv
  bsw implementation Crypto_Impl
    resource consumption ResourceConsumption
      12 x memory section:
        CRYPTO_30_LIBCV_CODE: sw-addrmethod=CODE, symbol=CODE
        CRYPTO_30_LIBCV_CONST_8: alignment=8, sw-addrmethod=CONST, symbol=CONST_8BIT
        CRYPTO_30_LIBCV_CONST_32: alignment=32, sw-addrmethod=CONST, symbol=CONST_32BIT
        CRYPTO_30_LIBCV_CONST_UNSPECIFIED: alignment=UNSPECIFIED, sw-addrmethod=CONST, symbol=CONST_UNSPECIFIED
        CRYPTO_30_LIBCV_VAR_NO_INIT_8: alignment=8, sw-addrmethod=VAR_NO_INIT, symbol=VAR_NOINIT_8BIT
        CRYPTO_30_LIBCV_VAR_NO_INIT_16: alignment=16, sw-addrmethod=VAR_NO_INIT, symbol=VAR_NOINIT_16BIT
        CRYPTO_30_LIBCV_VAR_NO_INIT_32: alignment=32, sw-addrmethod=VAR_NO_INIT, symbol=VAR_NOINIT_32BIT
        CRYPTO_30_LIBCV_VAR_NO_INIT_UNSPECIFIED: alignment=UNSPECIFIED, sw-addrmethod=VAR_NO_INIT, symbol=VAR_NOINIT_UNSPECIFIED
        CRYPTO_30_LIBCV_CRYPTO_SINGLE_PARTITION_VAR_NOINIT_8: alignment=8, sw-addrmethod=VAR_NO_INIT, symbol=CRYPTO_SINGLE_PARTITION_VAR_NOINIT_8BIT
        CRYPTO_30_LIBCV_CRYPTO_SINGLE_PARTITION_VAR_NOINIT_16: alignment=16, sw-addrmethod=VAR_NO_INIT, symbol=CRYPTO_SINGLE_PARTITION_VAR_NOINIT_16BIT
        CRYPTO_30_LIBCV_CRYPTO_SINGLE_PARTITION_VAR_NOINIT_32: alignment=32, sw-addrmethod=VAR_NO_INIT, symbol=CRYPTO_SINGLE_PARTITION_VAR_NOINIT_32BIT
        CRYPTO_30_LIBCV_VAR_CLEARED_8: alignment=8, sw-addrmethod=VAR_CLEARED, symbol=VAR_ZERO_INIT_8BIT
