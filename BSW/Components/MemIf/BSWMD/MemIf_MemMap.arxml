AUTOSAR XML (schema 00048)
# COPYRIGHT
# Copyright (c) 2022 by Vector Informatik GmbH. All rights reserved.
# This software is copyright protected and proprietary to Vector Informatik GmbH.
# Vector Informatik GmbH grants to you only those rights as set out in the license conditions.
package /MICROSAR
  bsw implementation MemIf_Impl
    required-artifacts:
      dependency on artifact MemIf_MemMap: category=MEMMAP, artifact-descriptor={short-label=MemIf_MemMap.h, category=SWHDR}
    resource consumption ResourceConsumption
      memory section MEMIF_CODE: sw-addrmethod=CODE, symbol=CODE
      memory section MEMIF_CONST_8: alignment=8, sw-addrmethod=CONST, symbol=CONST_8
      memory section MEMIF_CONST_32: alignment=32, sw-addrmethod=CONST, symbol=CONST_32
