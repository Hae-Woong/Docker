AUTOSAR XML (schema 4-0-3)
package /MICROSAR/Lin_Generic
  module definition Lin [0..1]: category=VENDOR_SPECIFIC_MODULE_DEFINITION, refined-module-def=Lin, variants post-build-loadable/pre-compile/post-build-selectable  # Configuration of the Lin (LIN driver) module.
    container LinGeneral  # General configuration parameters of the Lin.
      boolean LinDevErrorDetect: set at pre-compile, default-value=true  # This parameter switches the Development Error Detection ON or OFF. true: Development error detection is enabled. false: Development error detection is disabled. Note: In general, the development error detection is recommended during pre-test phase. It is not recommended to enable the development error detection in production code due to increased runtime and ROM needs.
      integer LinIndex: 0..255, set at pre-compile, default-value=0  # This value specifies the Instance Id of this module instance. If only one instance is present it shall have the Id 0.
      integer LinTimeoutDuration: 0..65535, set at pre-compile, default-value=100  # This value specifies the maximum number of loops for blocking function until a timeout is raised in short term wait loops.
      boolean LinVersionInfoApi: set at pre-compile, default-value=false  # This parameter enables/disables the function Lin_GetVersionInfo() to get major, minor and patch version information.
      string LinUserConfigFile [0..1]: set at pre-compile, origin=Vector Informatik, max-length=255, min-length=0  # Reference to an external text file that will be included during generation to Lin_Cfg.h. The content of the user configuration file will be added at the end of the generated module configuration file and allows altering or extending the generated code. Caution: User configuration files can cause the software module to malfunction and must only be used with great care!
      boolean LinDevErrorReport: set at pre-compile, origin=Vector Informatik, default-value=true  # This parameter switches the Development Error Notification ON or OFF. true: Development error notification is enabled. false: Development error notification is disabled. Note: In general, the development error detection is recommended during pre-test phase. It is not recommended to enable the development error detection in production code due to increased runtime and ROM needs.
      string LinUserConfigCode [0..1]: set at pre-compile, origin=Vector Informatik, max-length=255, min-length=0  # Reference to an external text file that will be included during generation to Lin_LCfg.c. The content of the user configuration file will be added at the end of the generated module configuration file and allows altering or extending the generated code. Caution: User configuration files can cause the software module to malfunction and must only be used with great care!
      enumeration LinNodeTypeAllowed: {Master, Slave, MasterSlave}, set at pre-compile, origin=Vector Informatik, default-value=Master  # The allowed Node Type in Post Build use case. This parameter is not use in this driver
    container LinGlobalConfig  # Global configuration parameters of the Lin.
      container LinChannel [1..*]  # Channel specific configuration parameters of the Lin.
        integer LinChannelBaudRate: 1000..20000, set at post-build in variant post-build-loadable+post-build-selectable / pre-compile in variant pre-compile, default-value=19200  # This value specifies the baud rate of the LIN channel.
        integer LinChannelId: 0..254, set at pre-compile, symbolic-name-value=true, default-value=0  # This value specifies the identifier of this LIN channel.
        boolean LinChannelWakeupSupport: set at pre-compile, default-value=false  # This parameter defines if the LIN channel supports wake up functionality.
        integer LinHWchannel: 0..255, set at pre-compile, origin=Vector Informatik, default-value=0  # Hardware channel | This value specifies which hardware channel shall be used by this LIN driver channel. Make sure that each hardware channel is only used once.
        enumeration LinNodeType: {MASTER, SLAVE}, set at pre-compile, origin=Vector Informatik  # Specifies the LIN node type of this channel.
        reference LinClockRef: set at post-build in variant post-build-loadable+post-build-selectable / pre-compile in variant pre-compile, destination=McuClockReferencePoint  # This parameter defines a reference to the LIN clock source configuration, which is set in the MCU driver configuration.
        symbolic name reference LinChannelEcuMWakeupSource [0..1]: set at pre-compile, destination=EcuMWakeupSource  # Channel EcuM Wakeup Source | This parameter defines a reference to a Wakeup Source within the EcuM configuration which is reported on detection of a wakeup on this LIN channel.
      container LinDemEventParameterRefs [0..1]  # This container has the references to DemEventParameter elements which shall be invoked using the API Dem_ReportErrorStatus API in case the corresponding error occurs. The EventId is taken from the referenced DemEventParameter's DemEventId value.
        symbolic name reference LIN_E_TIMEOUT [0..1]: set at pre-compile, destination=DemEventParameter  # This parameter references to the DemEventParameter which shall be issued when the error "Timeout caused by hardware error" has occured. If the reference is not configured the error shall be reported as DET error.
  bsw implementation Lin_Impl: programming-language=C, sw-version=5.00.00, used-code-generator=DaVinci Configurator, vendor-id=30, ar-release-version=4.00.03, behavior=LinBehavior, preconfigured-configuration=Lin_Pre, recommended-configuration=Lin_Rec, vendor-api-infix=Generic, vendor-specific-module-def=Lin
  module config Lin_Pre: definition=Lin
  module config Lin_Rec: definition=Lin
