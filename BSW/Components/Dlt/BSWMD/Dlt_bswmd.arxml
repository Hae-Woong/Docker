AUTOSAR XML (schema 00044)
package /MICROSAR
  module definition Dlt [0..1]: category=VENDOR_SPECIFIC_MODULE_DEFINITION, refined-module-def=Dlt, variants link-time/pre-compile  # "Diagnostic Log and Trace. DLT receives log information from DET, DEM, SW-Cs, or trace information of the RTE. The DLT module transmits this data either via communication busses or via XCP to make this information visible outside the ECU. #AMD #Xcp #CANoe #CANape #Monitoring #Logging #AUTOSAR #ServiceComponent"
    container DltConfigSet: multiplicity set at pre-compile  # This container lists all the global Dlt functionalities that can be enabled or disabled at pre-compile time to optimize resource consumption.
      container DltLogLevelSetting: multiplicity set at pre-compile  # Contains settings for thresholds.
        enumeration DltDefaultLogLevel: {DLT_LOG_DEBUG, DLT_LOG_ERROR, DLT_LOG_FATAL, DLT_LOG_INFO, DLT_LOG_OFF, DLT_LOG_VERBOSE, DLT_LOG_WARN}, scope=ECU, multiplicity set at pre-compile, post-build-variant-value=true, set at link in variant link-time / pre-compile in variant pre-compile, default-value=DLT_LOG_WARN  # This is the effective log level used in case no filter matches the given AppicationId and ContextId. This can be seen as a fall-through filter definition with wildcard for AppicationId and ContextId, which will be used, when no other filter matches.
        container DltLogLevelThreshold [0..*]: multiplicity set at pre-compile  # Contains settings for thresholds.
          enumeration DltThreshold: {DLT_LOG_OFF, DLT_LOG_FATAL, DLT_LOG_ERROR, DLT_LOG_WARN, DLT_LOG_INFO, DLT_LOG_DEBUG, DLT_LOG_VERBOSE}, multiplicity set at pre-compile, origin=Vector Informatik, set at pre-compile, default-value=DLT_LOG_WARN  # The actual threshold.
          reference DltLogLevelThresholdSwcContextRef: multiplicity set at pre-compile, origin=Vector Informatik, set at pre-compile, destination=DltSwcContext  # Reference to the SWC context.
      container DltLogOutput: multiplicity set at pre-compile  # Contains settings for log/trace message output
        reference DltDefaultLogChannelRef: multiplicity set at pre-compile, post-build-variant-value=true, set at link in variant link-time / pre-compile in variant pre-compile, destination=DltLogChannel  # Reference to the default log channel, which has to be used for a log/trace output, if no other match has been found.
        container DltLogChannel [1..*]: multiplicity set at pre-compile  # Contains settings for log/trace message output
          float DltLogChannelBufferOverflowTimer: 0.001..1, scope=ECU, multiplicity set at pre-compile, post-build-variant-value=true, set at link in variant link-time / pre-compile in variant pre-compile, default-value=0.1  # Specifies the cycle time in seconds for resetting the buffer overflow flag in case a buffer overflow occurred.
          integer DltLogChannelBufferSize: 0..4294967295, scope=ECU, multiplicity set at pre-compile, set at pre-compile, default-value=1024  # Buffer size in bytes for the LogChannel specific message buffer.
          string DltLogChannelId: scope=ECU, multiplicity set at pre-compile, post-build-variant-value=true, set at link in variant link-time / pre-compile in variant pre-compile, default-value=LCI0  # This is the 4 ASCII character long name of the log channel as used in the Dlt control messages as parameter name Dlt_interface
          integer DltLogChannelMaxMessageLength: 8..65535, scope=ECU, multiplicity set at pre-compile, post-build-variant-value=true, set at link in variant link-time / pre-compile in variant pre-compile, default-value=256  # The maximum length of a Dlt log or trace message.
          integer DltLogChannelMaxNumOfRetries: 0..255, scope=ECU, multiplicity set at pre-compile, post-build-variant-value=true, set at link in variant link-time / pre-compile in variant pre-compile, default-value=0  # The maximum length of a Dlt log or trace message. This parameter is not supported!
          enumeration DltLogChannelThreshold: {DLT_LOG_DEBUG, DLT_LOG_ERROR, DLT_LOG_FATAL, DLT_LOG_INFO, DLT_LOG_OFF, DLT_LOG_VERBOSE, DLT_LOG_WARN}, scope=ECU, multiplicity set at pre-compile, post-build-variant-value=true, set at link in variant link-time / pre-compile in variant pre-compile, default-value=DLT_LOG_WARN  # LogLevel Threshold
          integer DltLogChannelTrafficShapingBandwidth [0..1]: 0..18446744073709551615, multiplicity set at link in variant link-time / pre-compile in variant pre-compile, post-build-variant-multiplicity=true, post-build-variant-value=true, set at link in variant link-time / pre-compile in variant pre-compile, default-value=4294967295  # Set the maximum possible bandwith in bit/s. Notes: 1. This value is re-calculated to bytes/MainFunction to support the leaky bucket method. Example: - MainFunction cycle is 10ms, so the configured value is divided by 8 (bit/8 = byte) and by 100 (MainFunction cycle = 10ms = 0.01s) - If 1024 bytes shall be transmittable per MainFunction cycle: - 1024[byte]*8*100[1/s] = 819200[bit/s] 2. If the traffic shaping value is not used completely in a MainFunction cycle, the unused bytes are not usable in the next MainFunction cycle. So, in each MainFunction cycle only the configured TrafficShaping value is available for transmission.
          float DltLogChannelTransmitCycle: 0.001..1, scope=ECU, multiplicity set at pre-compile, post-build-variant-value=true, set at link in variant link-time / pre-compile in variant pre-compile, default-value=0.01  # Specifies the cycle time in seconds of the transmit functionality of this log channel. This parameter is not supported!
          boolean DltLogTraceStatusFlag: multiplicity set at pre-compile, post-build-variant-value=true, set at link in variant link-time / pre-compile in variant pre-compile, default-value=true  # Parameter to turn on/off on this LogChannel completely.
          enumeration DltLogChannelDebugMode: {Continuous_FirstIsBest, OnEvent_FirstIsBest}, multiplicity set at pre-compile, origin=Vector Informatik, set at pre-compile, default-value=Continuous_FirstIsBest  # Specifies the debug mode of the log channel. The debug mode can be changed during runtime via Dlt_SetDebugMode() and be requested during runtime via Dlt_GetDebugMode(). This parameter decides when buffering of Dlt log and trace messages happens and when sending happens. The debug modes: 1. Continuous_FirstIsBest: - Buffering and sending is continuous. - When buffer is overflown, new log and trace messages are rejected. 2. OnEvent_FirstIsBest: - Buffering starts on event. - When buffer is overflown, buffering is stopped and sending is performed until buffer is empty. - The event can be triggered during runtime via Dlt_TriggerDebugEvent().
          boolean DltLogChannelInitialDebugEvent: multiplicity set at pre-compile, origin=Vector Informatik, set at pre-compile, default-value=false  # This parameter is only relevant if DltLogChannelDebugMode is set to OnEvent_FirstIsBest! Defines if log and trace messages shall be gathered before initialization. This simulates a call of port "TriggerLogChannelDebugEvent" before initialization, as this port is only available after initialization.
          container DltTxPdu [0..1]: multiplicity set at pre-compile  # Contains the configuration parameters of the AUTOSAR Dlt module's Tx Pdus.
            integer DltITxPduHandleId [0..1]: 0..65535, scope=ECU, multiplicity set at link in variant link-time / pre-compile in variant pre-compile, post-build-variant-multiplicity=true, post-build-variant-value=true, set at link in variant link-time / pre-compile in variant pre-compile, symbolic-name-value=true, default-value=0  # The numerical value used as the ID of this I-PDU. | This handle Id is used for the APIs calls Dlt_TxConfirmation, Dlt_TriggerTransmit, Dlt_TriggerIPDUSend or Dlt_TriggerIPDUSendWithMetaData, Dlt_CopyTxData and Dlt_TpTxConfirmation to transmit respectively confirm transmissions of I-PDUs, as well as the PduId passed to the Tx-I-PDU-callout configured with DltIPduCallout and/or DltIPduTriggerTransmitCallout.
            boolean DltITxPduUsesTp: multiplicity set at pre-compile, post-build-variant-value=true, set at link in variant link-time / pre-compile in variant pre-compile, default-value=true  # If set to TRUE, the PDU is transmitted using the TP API. If FALSE, the IF API is used.
            reference DltTxPduIdRef: multiplicity set at pre-compile, post-build-variant-value=true, set at link in variant link-time / pre-compile in variant pre-compile, destination=Pdu  # Reference to the "global" Pdu structure to allow harmonization of handle IDs in the COM-Stack.
        container DltLogChannelAssignment [0..*]: multiplicity set at link in variant link-time / pre-compile in variant pre-compile, post-build-variant-multiplicity=true  # This container contains a preconfiguration of ApplicationId / ContextId pairs and their assigned log channel.
          reference DltLogChannelAssignmentSwcContextRef: multiplicity set at pre-compile, post-build-variant-value=true, set at link in variant link-time / pre-compile in variant pre-compile, destination=DltSwcContext  # Reference to an ApplicationId/ContextId pair that is assigned to a DltLogChannel.
          reference DltLogChannelRef: multiplicity set at pre-compile, post-build-variant-value=true, set at link in variant link-time / pre-compile in variant pre-compile, destination=DltLogChannel  # Reference to a DltLogChannel that is assigned to an ApplicationId / ContextId pair.
      container DltProtocol: multiplicity set at pre-compile  # Configuration parameters for handling the specific protocol variants.
        boolean DltHeaderUseEcuId: scope=ECU, multiplicity set at pre-compile, post-build-variant-value=true, set at link in variant link-time / pre-compile in variant pre-compile, default-value=false  # Corresponds to field WEID (With ECU ID). If set ECU ID shall be placed in the header, else not. | If the parameter DltGeneralNvRamRef is used this parameter defines the initial value for the corresponding NVRam entry. If the parameter DltGeneralNvRamRef is not set, Link-Time or Post-Build configuration shall be used.
        boolean DltHeaderUseSessionID: scope=ECU, multiplicity set at pre-compile, post-build-variant-value=true, set at link in variant link-time / pre-compile in variant pre-compile, default-value=false  # Corresponds to field WSID (with Session ID). If set the Session ID shall be placed in the header, else not. | If the parameter DltGeneralNvRamRef is used this parameter defines the initial value for the corresponding NVRam entry. If the parameter DltGeneralNvRamRef is not set, Link-Time or Post-Build configuration shall be used.
        boolean DltHeaderUseTimestamp: scope=ECU, multiplicity set at pre-compile, post-build-variant-value=true, set at link in variant link-time / pre-compile in variant pre-compile, default-value=false  # Corresponds to field WTMS (With Timestamp). If set the timestamp shall be placed in the header, else not. | If the parameter DltGeneralNvRamRef is used this parameter defines the initial value for the corresponding NVRam entry. If the parameter DltGeneralNvRamRef is not set, Link-Time or Post-Build configuration shall be used.
        boolean DltUseExtHeaderInNonVerbMode: scope=ECU, multiplicity set at pre-compile, post-build-variant-value=true, set at link in variant link-time / pre-compile in variant pre-compile, default-value=false  # Non Verbose messages (opposed to verbose messages) do not need an extended header. If this flag is set to true the extended header shall also be used for non verbose messages. | If DltGeneralNvRAMSupport is enabled this parameter is the initial value for the corresponding NVRam entry. If DltGeneralNvRAMSupport is not set, Link-Time or Post-Build configuration shall be used.
        boolean DltUseVerboseMode: scope=ECU, multiplicity set at pre-compile, post-build-variant-value=true, set at link in variant link-time / pre-compile in variant pre-compile, default-value=false  # If this flag is set to TRUE, the payload shall be transmitted in verbose mode, else the payload shall be transmitted in none-verbose mode.
        choice container DltEcuId: multiplicity set at pre-compile  # This is a choice container to choose between a EcuId value or a callout to get the EcuId.
          container DltEcuIdCalloutChoice [0..1]: multiplicity set at pre-compile  # EcuId via user defined callout. This choice is not supported!
            function name DltEcuIdCallout: scope=ECU, multiplicity set at pre-compile, set at pre-compile, default-value=DltAppl_GetEcuId  # If this choice is used the EcuId shall be fetched by calling the here configured callout function. This parameter is not supported!
          container DltEcuIdValueChoice [0..1]: multiplicity set at pre-compile  # EcuId value configuration
            string DltEcuIdValue: scope=ECU, multiplicity set at pre-compile, set at pre-compile, default-value=ECUI, max-length=4, min-length=1  # If this choice is used the EcuId shall be taken from the configured string. | This is the name of the ECU for use within the Dlt protocol. If you want to use a number representation type this as character.
      container DltRxPdu [0..*]: multiplicity set at link in variant link-time / pre-compile in variant pre-compile, post-build-variant-multiplicity=true  # Contains the Pdu IDs to be used for Dlt control messages reception.
        integer DltIRxPduHandleId [0..1]: 0..65535, scope=ECU, multiplicity set at link in variant link-time / pre-compile in variant pre-compile, post-build-variant-multiplicity=true, post-build-variant-value=true, set at link in variant link-time / pre-compile in variant pre-compile, symbolic-name-value=true, default-value=0  # The numerical value used as the ID of this I-PDU. The DltRxPduHandleId is required by the API calls Dlt_RxIndication, Dlt_TpRxIndication, Dlt_StartOfReception and Dlt_CopyRxData to receive I-PDUs from the PduR (DltIPduDirection: Receive), as well as the PduId passed to an Rx-I-PDU-callout.
        boolean DltIRxPduUsesTp: multiplicity set at pre-compile, post-build-variant-value=true, set at link in variant link-time / pre-compile in variant pre-compile, default-value=true  # If set to TRUE, the PDU is received using the TP API. If FALSE, the IF API is used.
        reference DltRxPduIdRef: multiplicity set at pre-compile, post-build-variant-value=true, set at link in variant link-time / pre-compile in variant pre-compile, destination=Pdu  # Reference to the "global" Pdu structure to allow harmonization of handle IDs in the COM-Stack.
      container DltTraceStatusSetting: multiplicity set at pre-compile  # Contains settings for trace status
        boolean DltDefaultTraceStatus: scope=ECU, multiplicity set at pre-compile, post-build-variant-value=true, set at link in variant link-time / pre-compile in variant pre-compile, default-value=true  # This is the effective trace status used in case no filter matches the given ApplicationId and ContextId. This can be seen as a fall-through filter definition with wildcard for ApplicationId and ContextId, which will be used, when no other filter matches.
        container DltTraceStatusAssignment [0..*]: multiplicity set at link in variant link-time / pre-compile in variant pre-compile, post-build-variant-multiplicity=true  # This container contains a preconfiguration of ApplicationId / ContextId pairs and their assigned trace status.
          boolean DltTraceStatus: scope=ECU, multiplicity set at pre-compile, post-build-variant-value=true, set at link in variant link-time / pre-compile in variant pre-compile, default-value=true  # Trace status for the given ApplicationId/ContextId tuple.
          reference DltTraceStatusAssignmentSwcContextRef: multiplicity set at pre-compile, post-build-variant-value=true, set at link in variant link-time / pre-compile in variant pre-compile, destination=DltSwcContext  # Reference to an ApplicationId/ContextId pair to which a DltTraceStatus is assigned.
    container DltGeneral: multiplicity set at pre-compile  # This container lists all the global Dlt functionalities that can be enabled or disabled at pre-compile time to optimize resource consumption.
      boolean DltGeneralDevErrorDetect: multiplicity set at pre-compile, set at pre-compile, default-value=true  # If the Default Error Tracer (Det) shall be used, this parameter shall be set to TRUE. Otherwise, it shall be set to FALSE.
      boolean DltGeneralInjectionSupport: multiplicity set at pre-compile, set at pre-compile, default-value=false  # Enables or disables the Dlt Injection feature.
      boolean DltGeneralRegisterContextNotification: multiplicity set at pre-compile, set at pre-compile, default-value=false  # If this parameter is set to TRUE, a Dlt Control Message is sent every time a SWC registeres and/or de-registers at/from the Dlt Module. Else, this notification is not sent. This parameter is not supported!
      boolean DltGeneralRxDataPathSupport: multiplicity set at pre-compile, set at pre-compile, default-value=true  # Enables or disables the Rx Data Path to control the Dlt module. Note: If this parameter is disabled: The used SocketConnection must know a specific Remote Address and Remote Port, otherwise the socket connection cannot be opened! If this parameter is enabled: The Remote Address and Remote Port may be undefined. Then the socket is opened with the first received message.
      float DltGeneralStartUpDelayTimer [0..1]: 0.001..10, multiplicity set at pre-compile, set at pre-compile, default-value=0.001  # Configurable delay in s of starting the transmission of Log and Trace messages after the Dlt module has been initialized. This parameter is not supported!
      boolean DltGeneralTimeStampSupport: multiplicity set at pre-compile, set at pre-compile, default-value=false  # If a Time Stamp shall be added to the Dlt messages, this configuration parameter shall be set to TRUE. | Otherwise, it shall be set to FALSE.
      boolean DltGeneralTrafficShapingSupport: multiplicity set at pre-compile, set at pre-compile, default-value=true  # Enables or disables the TrafficShaping feature to limit the maximum bandwidth for Dlt messages. If enabled, the maximum bandwidth can be configured per LogChannel. Note: The TrafficShaping is based on the leaky bucket method. This means, transmissions are allowed in each call of Dlt_MainFunction, but it is limited to the configured maximum value.
      boolean DltGeneralVersionInfoApi: multiplicity set at pre-compile, set at pre-compile, default-value=false  # Pre-processor switch for enabling Version Info API support. | * True: version information API activated * False: version information API deactivated
      enumeration DltComLayer: multiplicity set at pre-compile, origin=Vector Informatik, set at pre-compile, default-value=XCP  # Defines the communication layer to be used. - XCP: Use XCP as transport protocol - PduR: Use PduR as transport protocol
        XCP  # xcp
        PduR
      float DltMainFunctionCycleTime: 0.001..1, multiplicity set at pre-compile, origin=Vector Informatik, set at pre-compile, default-value=0.01  # Cycle time of DLT mainfunction. A value of 10 [ms] is recommended.
      string DltUserConfigFile [0..1]: multiplicity set at pre-compile, origin=Vector Informatik, set at pre-compile  # Reference to an external user configuration file that will be included during generation. The content of the user configuration file will be added at the end of the generated module configuration file and allows altering or extending the generated code. Caution: User configuration files can cause the software module to malfunction and must only be used with great care!
      boolean DltSafeBswChecks: multiplicity set at pre-compile, origin=Vector Informatik, set at pre-compile, default-value=false  # Selects if safety checks are used. These checks improve robustness as e.g. invalid parameters are checked before function is executed. This attribute has to be enabled for safety projects where this component is mapped to an ASIL partition.
      integer DltMaxNumberOfApplications: 2..65535, multiplicity set at pre-compile, origin=Vector Informatik, set at pre-compile, default-value=10  # Defines the maximum number of registered applications. Note: 1. The configured value includes all configured applications. - Therefore, if additional applications shall be able to register at runtime, this value must be greater than the configured number of applications. - The minimum value is the number of configured applications + 1 for DEM + 1 for DET (+ 1 for OS if DltOsSoftwareTracing is enabled). 2. This value affects the required RAM usage of the Dlt.
      integer DltMaxNumberOfContextsPerApplication: 1..65535, multiplicity set at pre-compile, origin=Vector Informatik, set at pre-compile, default-value=5  # Defines the maximum number of registered contexts for any application. Note: 1. The configured value includes the configured contexts. - Therefore, if additional contexts shall be able to register at runtime, this value must be greater than the configured number of contexts. - The minimum value is the maximum number of contexts any configured application has (+ 3 if DltOsSoftwareTracing is enabled). 2. This value affects the required RAM usage of the Dlt.
      boolean DltDemEventFiltering: multiplicity set at pre-compile, origin=Vector Informatik, set at pre-compile, default-value=false  # If active, forwarded DEM events are filtered if event status has not changed. If inactive, all DEM events are sent.
      boolean DltGeneralNvRAMSupport: multiplicity set at pre-compile, origin=Vector Informatik, set at pre-compile, default-value=false  # If active, part of Dlt settings are persisted in non-volatile memory. During initalization the persisted settings are restored and used for initalization instead of the configured values. If inactive, always the configured values are used for initialization.
      boolean DltSupportDefaultAPI: multiplicity set at pre-compile, origin=Vector Informatik, set at pre-compile, default-value=true  # This parameter defines if the Dlt API is generated as specified by AUTOSAR: If enabled: - The API Dlt_(Get/Set)DefaultTraceStatus has a second parameter "LogChannelName". - As specified by AUTOSAR If disabled: - The API Dlt_(Get/Set)DefaultTraceStatus has only one parameter. - Deviation from AUTOSAR
      integer DltServerPortQueueSizeForLogAndTraceMessages: 1..256, multiplicity set at pre-compile, origin=Vector Informatik, set at pre-compile, default-value=1  # Defines how many requests of SendLogMessage and SendTraceMessage can be triggered for same Server-Client Port. Values greater one only required if multiple runnables of same SWC are using the same Dlt Server-Client Port to send log and trace messages.
      boolean DltOsSoftwareTracing: multiplicity set at pre-compile, origin=Vector Informatik, set at pre-compile, default-value=false  # This parameter defines if the OS Software Tracing is enabled or not. The OS Software Tracing make use of the Vector TimingHooks: - OS_VTH_SCHEDULE - OS_VTH_SETEVENT - OS_VTH_ACTIVATION If this feature is enabled, the DltGeneralTimeStampSupport shall be enabled to provide timestamps in the OS Tracing messages. If this feature is enabled and the BSW runs on multiple cores, DltAssignedEcucCoreRef shall be set to provide the DLT on which core it is executed. If DltGeneralNvRAMSupport is enabled, this parameter increases the required Nv memory of Dlt.
      enumeration DltInitialGlobalState: {OFFLINE, ONLINE}, multiplicity set at pre-compile, origin=Vector Informatik, set at pre-compile, default-value=OFFLINE  # Defines if the DLT shall be OFFLINE after initialization or ONLINE. OFFLINE: Rejects log and trace messages after initialization. ONLINE: Accepts log and trace messages after initialization. In both cases, the state can be changed by the application with the port "SetState". OFFLINE is the default state, but if DltOsSoftwareTracing is enabled, it is recommended to set this parameter to ONLINE. Otherwise, some thread transitions are missed in the trace.
      symbolic name reference DltGeneralGptChannelRef [0..1]: multiplicity set at pre-compile, set at pre-compile, requires-symbolic-name-value=true, destination=GptChannelConfiguration  # If TimeStampSupport is used the Dlt module shall fetch the time from the Gpt module by calling Gpt_GetTimeElapsed with the here referenced GptChannel. The tick duration can be deduced from the GptChannelTickFrequency parameter of the GptChannelConfiguration container. This is necessary to calculate the microsecond resolution timestamp output in the Dlt message. | A GPT timer shall be used which starts with value 0 at ECU start-up according to the PRS Dlt Protocol Specification.
      symbolic name reference DltGeneralNvRamRef [0..1]: multiplicity set at pre-compile, set at pre-compile, requires-symbolic-name-value=true, destination=NvMBlockDescriptor  # If the Dlt module shall be able to store modified parameters during runtime persistently, this reference shall be set and shall point to the NvmBlock.
      symbolic name reference DltGeneralStbMTimeBaseRef [0..1]: multiplicity set at pre-compile, set at pre-compile, requires-symbolic-name-value=true, destination=StbMSynchronizedTimeBase  # If TimeStampSupport is used the Dlt module shall fetch the time from the StbM module by calling StbM_GetCurrentTime with the here referenced StbMSynchronizedTimeBase.
      reference DltAssignedEcucCoreRef [0..1]: multiplicity set at pre-compile, origin=Vector Informatik, set at pre-compile, destination=EcucCoreDefinition  # Optional reference to a EcuC Core. It is required that the referenced core is an AUTOSAR core. This reference is only required if the system supports multi core and DltOsSoftwareTracing is enabled. The referenced core is the only core to be traced. ATTENTION: the DLT does not support multicore, therefore all services must be called on the same core! This includes the StartOfReception, CopyRxData, CopyTxData, SendLogMessage, SendTraceMessage, RegisterContext, SetState, and (almost) all others. ATTENTION: the DLT does not check that all services are called on the given core, this shall be verified by the system integrator. The only exceptions are Dlt_DetForwardErrorTrace and Dlt_DemTriggerOnEventStatus. In these services the core is checked, therefore it is not possible to forward DETs and DEM events from other cores!
    container DltSwc [0..*]: multiplicity set at link in variant link-time / pre-compile in variant pre-compile, post-build-variant-multiplicity=true  # Contains necessary configuration parameters of the AUTOSAR Dlt module to interact with SWCs.
      integer DltSwcSessionId: 0..18446744073709551615, multiplicity set at pre-compile, set at link in variant link-time / pre-compile in variant pre-compile, default-value=0  # An ECU wide unique ID to identify the port a SWC (instance) uses.
      boolean DltSwcSupportLogLevelChangeNotification: multiplicity set at pre-compile, set at link in variant link-time / pre-compile in variant pre-compile, default-value=false  # Flag indicating, whether Dlt has to provide a R-Port for the notification of the SWC about LogLevel changes.
      integer MaxSwcLogMessageLength: 0..65535, multiplicity set at pre-compile, set at link in variant link-time / pre-compile in variant pre-compile, default-value=256  # Defines the maximum allowed length (unit16) for LogMessages. This parameter is not supported!
      integer MaxSwcTraceMessageLength: 0..65535, multiplicity set at pre-compile, set at link in variant link-time / pre-compile in variant pre-compile, default-value=256  # Defines the maximum allowed length (unit16) for TraceMessages. This parameter is not supported!
      container DltSwcContext [0..*]: multiplicity set at link in variant link-time / pre-compile in variant pre-compile, post-build-variant-multiplicity=true  # This container contains the configuration of ApplicationId / ContextId pairs which are supported by this SWC. If DltGeneralNvRAMSupport is enabled, increasing the number of this container will also increase the required Nv memory of Dlt.
        string DltSwcApplicationId: multiplicity set at pre-compile, post-build-variant-value=true, set at link in variant link-time / pre-compile in variant pre-compile, default-value=MyAI  # Abbreviation for the SWC (4 characters)
        string DltSwcContextId: multiplicity set at pre-compile, post-build-variant-value=true, set at link in variant link-time / pre-compile in variant pre-compile, default-value=MyCI  # Abbreviation for the ContextId (4 characters)
    container DltNonVerboseMessage [0..*]: multiplicity set at pre-compile  # Non-Verbose messages require a minimum bandwith as only its identifier will be transmitted over the network. The XCP tool will then resolve the identifier to the string defined as static data. To transmit a non-verbose message use the API: <Name>. Hint: Use the verbose message API to transmit a runtime defined string over the network.
      integer DltMessageId: 3..4294967295, multiplicity set at pre-compile, origin=Vector Informatik, set at pre-compile, symbolic-name-value=true, default-value=3  # Message ID is the unique ID to characterize the information, which is transported by the non-verbose message itself. The message ID will be assigned automatically. RESTRICTIONS: Message IDs used for Dem (1) and Det (2) are reserved and not usable for the application.
      string DltStaticData: multiplicity set at pre-compile, origin=Vector Informatik, set at pre-compile, symbolic-name-value=true, default-value=My static message  # Data of static information that is associated with the Message ID. This data is not transmitted with the non-verbose message but is stored in the A2L file.
  bsw implementation Dlt_Impl: programming-language=C, sw-version=7.01.00, used-code-generator=cMSR, vendor-id=30, ar-release-version=4.03.01, behavior=DltBehavior, preconfigured-configuration=Dlt_Pre, recommended-configuration=Dlt_Rec, vendor-specific-module-def=Dlt
  module config Dlt_Pre: definition=Dlt
  module config Dlt_Rec: definition=Dlt
