AUTOSAR XML (schema 4-0-3)
# COPYRIGHT
# Copyright (c) 2021 by Vector Informatik GmbH. All rights reserved.
# This software is copyright protected and proprietary to Vector Informatik GmbH.
# Vector Informatik GmbH grants to you only those rights as set out in the license conditions.
package /MICROSAR
  module definition Fee [0..1]: category=VENDOR_SPECIFIC_MODULE_DEFINITION, refined-module-def=Fee, variants pre-compile  # Flash EEPROM Emulation. Provides access to Flash EEPROM for reading and storing data persistently. #NVRAM #NVMemory #DataStorage #Flash #AUTOSAR
    container FeeBlockConfiguration [1..*]  # Block Configuration | This container includes the configuration of block specific parameters for the FEE module.
      integer FeeBlockNumber: 1..65534, set at pre-compile, symbolic-name-value=true, default-value=2  # Block Number | This value specifies the block identifier (handle). | 0x0000 and 0xFFFF shall not be used for block numbers (see FEE006). Range: min = 2^NVM_DATASET_SELECTION_BITS max = 0xFFFF -2^NVM_DATASET_SELECTION_BITS Note: Depending on the number of bits set aside for dataset selection several other block numbers shall also be left out to ease implementation.
      integer FeeBlockSize: 1..65535, set at pre-compile, default-value=1  # Block Size | This value specifies the size of a logical block.
      boolean FeeImmediateData: set at pre-compile, default-value=false  # Immediate Data | This parameter defines if this block has high priority data. | true: Block contains immediate data. false: Block does not contain immediate data.
      integer FeeNumberOfWriteCycles: 0..10000000, set at pre-compile, default-value=10000  # Number Of Write Cycles | This value specifies the number of write cycles required for this block.
      integer FeeNumberOfChunkInstances: 1..32767, set at pre-compile, origin=Vector Informatik, default-value=1  # Number Of Instances In Chunk | This value specifies the number of instances in one chunk of a certain block. Hint: The number of chunks must be a value of (2^n) - 1.
      integer FeeNumberOfDatasets: 1..255, set at pre-compile, origin=Vector Informatik, default-value=1  # Number Of Datasets | This value specifies the number of datasets/clones. This is the value how often an individual block exists.
      boolean FeeBlockIdFixed: set at pre-compile, origin=Vector Informatik, default-value=false  # Block Id Fixed | This parameter controls whether the BlockId is fixed. If fixed, the BlockId value can be (and must be) manually assigned. It remains constant, even if Block Configuration changes (add/insert new blocks, remove blocks) Hint: Make all BlockIds fixed after an initial configuration was created. For later updates they must not change in order to keep existing data.
      integer FeeBlockId: 0..65534, set at pre-compile, origin=Vector Informatik, default-value=0  # Block Id | This value specifies the BlockID which indicates the base (aka: "tag") of a Block within its associated partition. The Block can be uniquely identified using partition, FeeBlockId and block's DataIndex. Being able to uniquely identify each Block accross different configurations, is a prerequisite for supporting confiuration updates, especially: - which blocks were changed, which were not (ant thus should remain readable) - which block(s) is/are used to share information between FBL and Application FeeBlockNumber cannot serve for this purpose, because its interpretation changes, if dataset selection bit (thus the maximum number of Datasets used in NVM) changes. The ID must be unique within block's partition; blocks within different partitions may share the same value.
      boolean FeeBlockIsCritical: set at pre-compile, origin=Vector Informatik, default-value=false  # Critical Data | This parameter defines the criticality of Data, regarding data losses in exceptional situations (especially Sector Overflow). TRUE: Most recent data must never be lost FALSE: Most recent data may be lost in order to keep FEE writable Usually the criticality depends on the write frequency: The more often a block is being written, the lower its criticality. It is not recommended to check this option while "immediate data" is also set!
      boolean FeeIsLookupTableBlock: set at pre-compile, origin=Vector Informatik, default-value=false  # Is Lookup Table Block | This parameter defines, whether a block has been added by the user (if set to false) or the block has been created automatically to be used internally by Fee for lookup table storage (if set to true). Please do not edit this parameter. It will be set automatically.
      symbolic name reference FeeDeviceIndex [0..1]: set at pre-compile, destination=FlsGeneral  # Device Index | Not used! Reference to Fls driver. | Range: 0 .. 254 (0xFF reserved for broadcast call to GetStatus function).
      reference FeePartition: set at pre-compile, origin=Vector Informatik, destination=FeePartitionConfiguration  # Partition | Reference to the partition within the FEE configuration.
    container FeeGeneral  # General | General configuration parameters of the FEE.
      boolean FeeDevErrorDetect: set at pre-compile, default-value=true  # Development Error Detection | This parameter controls the Development Error Detection. true: Development error detection is enabled. false: Development error detection is disabled. If Development error detection was enabled, reporting (to DET) can be separately controlled. | true: Development error detection enabled. false: Development error detection disabled.
      integer FeeIndex: 0..254, set at pre-compile, default-value=0  # Instance Id | Not used! This value specifies the InstanceId of this module instance. If only one instance is present it shall have the Id 0. This parameter is not used by FEE, but it must have a value.
      function name FeeNvmJobEndNotification: set at pre-compile, default-value=NvM_JobEndNotification, max-length=64, min-length=1  # NvM Job End Notification | This parameter defines the job end notification routine provided by the upper layer module (normally NvM_JobEndNotification).
      function name FeeNvmJobErrorNotification: set at pre-compile, default-value=NvM_JobErrorNotification, max-length=64, min-length=1  # NvM Job Error Notification | This parameter defines the job error notification routine provided by the upper layer module (normally NvM_JobErrorNotification).
      boolean FeePollingMode: set at pre-compile, default-value=true  # Polling Mode | This parameter defines if the polling mode for this module is enabled. | true: Polling mode enabled, callback functions (provided to FLS module) disabled. false: Polling mode disabled, callback functions (provided to FLS module) enabled.
      boolean FeeSetModeSupported [0..1]: set at pre-compile, default-value=true  # Provide Fee_SetMode API | Not used! This parameter defines if the 'SetMode' functionality of the FEE module is available. Fee always provides SetMode API, it is an important control feature. | TRUE: SetMode functionality supported / code present, FALSE: SetMode functionality not supported / code not present. Note: This configuration setting has to be consistent with that of all underlying flash device drivers (configuration parameter FlsSetModeApi).
      boolean FeeVersionInfoApi: set at pre-compile, default-value=false  # Version Information Api | This parameter enables/disables the function Fee_GetVersionInfo() to get major, minor and patch version information. | true: Version info API enabled. false: Version info API disabled.
      integer FeeVirtualPageSize [0..1]: 0..1024, set at pre-compile, default-value=8  # Virtual Page Size | Not used! This value specifies the size to which logical blocks shall be aligned.
      integer FeeInternalBufferSize: 64..1024, set at pre-compile, origin=Vector Informatik, default-value=64  # Internal Buffer Size | This value specifies the size of the internal buffer. The internal buffer is used to assemble management information, to merge these management information with user data (to reduce alignment gaps), and as read buffer when copying data during sector switch processing. Note: The buffer must always be larger than write page size. It may be smaller than largest block, because FEE adapts its copy process to internal buffer size. However, the larger the buffer, the fewer read-write sequences (from Fls, to Fls) the FEE has to perform in order to copy data.
      string FeeNvmCbkIncludeFile [0..1]: set at pre-compile, origin=Vector Informatik, default-value=NvM_Cbk.h, max-length=32, min-length=1  # NvM Callback Include File | This parameter defines the name of the include file for callback functions declaration of the NvM.
      float FeeMainFunctionPeriod: 0.0001..1, set at pre-compile, origin=Vector Informatik, default-value=0.005  # Call Cycle of Fee_MainFunction | Specify fixed call cycle for Fee_MainFunction. This information affects RTE's (SchM's) settings. Fee itself does not depend on a fixed cycle time; in can be triggered at arbitrary rates. In general, Fee_MainFunction should be called as fast as possible, because it has to perform search operations in Flash, which may result in many read requests issued to FLS, at most one per MainFunction cycle. Increasing trigger rates also helps to decrease write times themselves, which results in less time the flash is intermediately in inconsistent state, vulnerable to aborts (resets). It is not necessary to trigger FEE faster than FLS Also note that large values in FeeInternalBufferSize influence maximum duration of a Fee_MainFunction call. The faster you want Fee_MainFunction being triggered, the smaller this value should be and vice versa. Also note, that notification functions may arbitrarily extend Fee_MainFunction's maximum duration.
      enumeration FeeMainFunctionTriggering: set at pre-compile, origin=Vector Informatik, default-value=FixedCycleTime  # The MainFunction can be scheduled in different ways, which allows adapting the runtime behavior - FixedCycleTime: All activities are executed in the MainFunction with the defined cycle time. - BackgroundTask: Activities that do not require a fixed cycle time run in the background task. The response time of such activities will depend on the current CPU load. Note If the system is overloaded, it may happen that the background task is no longer called.
        FixedCycleTime  # Task for Fixed Cycle Time
        BackgroundTask  # Background Task
      boolean FeeSafeBswChecks: set at pre-compile, origin=Vector Informatik, default-value=false  # Selects if safety checks are used. These checks improve robustness as e.g. invalid parameters are checked before function is executed. This attribute has to be enabled for safety projects where this component is mapped to an ASIL partition.
      container FeeFlsApi [0..*]  # Fls Api | This container includes Flash API parameters. The parameters can be used to announce Flash API's for non AUTOSAR compliant Flash drivers.
        string FeeFlsIncludeFile: set at pre-compile, origin=Vector Informatik, default-value=Fls.h  # Fls Include File | This parameter defines the name of the header File of the Flash Driver.
        function name FeeFlsSetMode: set at pre-compile, origin=Vector Informatik, default-value=Fls_SetMode  # Fls SetMode API | This parameter defines the name of the Flash SetMode API.
        function name FeeFlsRead: set at pre-compile, origin=Vector Informatik, default-value=Fls_Read  # Fls Read API | This parameter defines the name of the Flash Read API (i.e. a read operation without an implicit blank check).
        function name FeeFlsWrite: set at pre-compile, origin=Vector Informatik, default-value=Fls_Write  # Fls Write API | This parameter defines the name of the Flash Write API.
        function name FeeFlsCancel: set at pre-compile, origin=Vector Informatik, default-value=Fls_Cancel  # Fls Cancel API | This parameter defines the name of the Flash Cancel API.
        function name FeeFlsGetStatus: set at pre-compile, origin=Vector Informatik, default-value=Fls_GetStatus  # Fls GetStatus API | This parameter defines the name of the Flash GetStatus API.
        function name FeeFlsGetJobResult: set at pre-compile, origin=Vector Informatik, default-value=Fls_GetJobResult  # Fls GetJobResult API | This parameter defines the name of the Flash GetJobResult API.
        function name FeeFlsErase: set at pre-compile, origin=Vector Informatik, default-value=Fls_Erase  # Fls Erase API | This parameter defines the name of the Flash Erase API.
        function name FeeFlsCompare: set at pre-compile, origin=Vector Informatik, default-value=Fls_Compare  # Fls Compare API | This parameter defines the name of the Flash Compare API.
        function name FeeFlsReadBlank: set at pre-compile, origin=Vector Informatik, default-value=Fls_Read  # Fls Read Blank API | This parameter defines the name of the Flash Read Blank API (i.e. a read operation that contains an implicit blank check).
        symbolic name reference FeeFlsDeviceIndex: set at pre-compile, origin=Vector Informatik, destination=FlsGeneral  # Device Index | Reference to a Flash driver.
      container FeeDevErrorChecks  # Development Error Checks | This container includes additional configuration items for the development error detection.
        function name FeeDetErrorhook: set at pre-compile, origin=Vector Informatik, default-value=Det_ReportError  # Det Error Hook | This parameter defines the Errorhook function for development error reporting.
        string FeeDetIncludeFile: set at pre-compile, origin=Vector Informatik, default-value=Det.h  # Det Include File | This parameter defines the include file of the Errorhook function for development error reporting.
    container FeePublishedInformation  # Published Information | This container includes additional published parameters. | Note that these parameters do not have any configuration class setting, since they are published information.
      integer FeeBlockOverhead: 0..2, set at published-information, default-value=2  # Block Overhead | This value specifies the management overhead per logical block. | Note: If the management overhead depends on the block size or block location a formula has to be provided that allows the configurator to calculate the management overhead correctly.
      float FeeMaximumBlockingTime: 0..1, set at published-information, default-value=1  # Maximum Blocking Time | Not used! This value specifies the maximum time the FEE module's API routines shall be blocked (delayed) by internal operations. Note: Internal operations in that case means operations that are not explicitly invoked from the upper layer module but need to be handled for proper operation of this module or the underlying memory driver. | Note: Internal operations in that case means operations that are not explicitly invoked from the upper layer module but need to be handled for proper operation of this module or the underlying memory driver.
      integer FeePageOverhead: 0..0, set at published-information, default-value=0  # Page Overhead | This value specifies the management overhead per page. Note: If the management overhead depends on the block size or block location a formula has to be provided that allows the configurator to calculate the management overhead correctly. | Note: If the management overhead depends on the block size or block location a formula has to be provided that allows the configurator to calculate the management overhead correctly.
      integer FeeChunkHeader: 16..16, set at pre-compile, origin=Vector Informatik, default-value=16  # Chunk Header | This value specifies the chunk header size. This parameter is constant and can not be configured by the user.
      integer FeeChunkLink: 8..8, set at pre-compile, origin=Vector Informatik, default-value=8  # Chunk Link | This value specifies the chunk link size. This parameter is constant and can not be configured by the user.
      integer FeeSectorHeader: 8..8, set at pre-compile, origin=Vector Informatik, default-value=8  # Sector Header | This value specifies the sector header size. This parameter is constant and can not be configured by the user.
    container FeePartitionConfiguration [1..4]  # Partition Configuration | Configuration of partition specific parameters for the Flash EEPROM Emulation module.
      integer FeeBssThresholdReserved: 0..2147483648, set at pre-compile, origin=Vector Informatik, default-value=8192  # BSS Threshold Reserved | BSS = Background Sector Switch; Copying data has less priority than serving user requests (including write). SectorSwitch becomes effictive, only if Fee was set to SLOW mode (via Fee_SetMode) This values affects the threshold the FEE starts a sector switch in Background Mode. It specifies the EXTRA amount of flash that shall be remaining when BSS starts. FEE automatically reserves the whole space all blocks in a partition will occupy. This is equal to at least one copy attempt per block. The extra reserve specified here makes room for additional attempts (in case of aborts). "BSS Threshold Reserved" shall be greater than "FSS Threshold Reserved".
      integer FeeFssThresholdReserved: 0..2147483648, set at pre-compile, origin=Vector Informatik, default-value=4096  # FSS Threshold Reserved | FSS = Foreground Sector Switch; this is "last" chance handling of FFE - Sector Switch becomes urgent in order to keep Flash area writeable without using data. "Flash is almost full; clean-up is ugently necessary." Therefore it has higher priority than write jobs (directed to same partition). This values affects the threshold the FEE starts a sector switch in Background Mode. It specifies the EXTRA amount of flash that shall be remaining when BSS starts. FEE automatically reserves the whole space all blocks in a partition will occupy. This is equal to at least one copy attempt per block. The extra reserve specified here makes room for additional attempts (in case of aborts). "FSS Threshold Reserved" shall be smaller than "BSS Threshold Reserved". Note: Once the FSS Threshold was exceeded, Fee_DisableFss() (see "Enable API to allow/prohibit FSS"), would become effective - FEE inhibits any write access. Stopping write accesses this way is the only way to prevent FEE from performing Sector Switches at all.
      integer FeeLowerSectorAddress: 0..2147483648, set at pre-compile, origin=Vector Informatik, default-value=0  # Lower Sector Address | Logical start address of the lower sector.
      integer FeeLowerSectorSize: 1..2147483648, set at pre-compile, origin=Vector Informatik, default-value=1024  # Lower Sector Size | The size of the lower sector in bytes.
      integer FeeUpperSectorAddress: 1..2147483648, set at pre-compile, origin=Vector Informatik, default-value=1024  # Upper Sector Address | Logical start address of the upper sector.
      integer FeeUpperSectorSize: 1..2147483648, set at pre-compile, origin=Vector Informatik, default-value=1024  # Upper Sector Size | The size of the upper sector in bytes.
      integer FeeAddressAlignment: 8..1024, set at pre-compile, origin=Vector Informatik, default-value=16  # Address Alignment | Address Alignment influences the way FEE stores data entities in Flash memory. (Most, but not all) single Entities will start at addresses being an integral multiple of FeeAdressAlignment. This alignment itself must be equal to or greater than this partition's FeeWrite alignment. It needs to be set in a way that distinct data entities cannot influence other entities already stored in flash memory, especially if programming accesses get aborted, e.g. due to a reset. If this value is too small, a reset, aborting a programm access (e.g. writing some data related to a Block A) might cause structures related to another block B becoming unreadable. Unfortunately this is very hardware dependent; some platforms require an even stricter alignment for reading than for writing data.
      integer FeeWriteAlignment: 8..1024, set at pre-compile, origin=Vector Informatik, default-value=8  # Write Alignment | Page Size of Flash Device for write jobs in bytes. This is the alignment of Fls_Write requests the FEE issues to the FLS: As well FlsAddresses as lengths are always multiples of this value. This affects the way FEE manages the flash memory. User data buffers are _not_ affected, i.e. RAM buffers, containing actuall data do not need to obey any specific alignment. This value shall be at least the maximum page size of all fls sectors being used by this partition. Using this value, an even stricter write alignment may be chosen, if it becomes necessary, for some HW specific reason. Such reasons could be consistency limitations caused by error detecting/error correcting codes implemented in HW. E.g.: Some devices support page sizes of 4bytes (which is the smallest writeable entity), but ECC is calculated and stored for 8byte entities. Please read the Fls driver and HW manuals carefully. Note that FEE does not suppport write alignments smaller than 8bytes, even if a Fls driver allows it.
      reference FeePartitionDevice: set at pre-compile, origin=Vector Informatik, destination=FlsConfigSet  # Partition Device | Reference to the device containing the partition. In general pertitions must not refer to different ConfigSets of one device. Currently all partitions must be located in same device.
      container FeeLookUpTableConfiguration [0..1]  # LookUpTable Configuration | This container includes the configuration parameters for FEE's LookUpTable.
        boolean FeeLookUpTable: set at pre-compile, origin=Vector Informatik, default-value=true  # LookUpTable Enabled | This parameter defines whether the LookUpTable is enabled or disabled for this partition. True: LookUpTable shall be enabled. False: LookUpTable shall NOT be enabled.
        integer FeeNumberOfEntries: 16..65535, set at pre-compile, origin=Vector Informatik, default-value=32  # Number Of Entries | This value specifies the number of LookUpTable entries per LookUpTable block. This parameter defines how many entries are stored within one LookUpTable block. It might be reasonable to split the LookUpTable into several parts if many FeeBlockConfigurations are configured for the corresponding FeePartitionConfiguration.
    container FeeSpecificFeatures  # Specific Features | Container for specific features. These parameters are not specific to a block.
      function name FeeApplErrorCallbackFunction: set at pre-compile, origin=Vector Informatik, default-value=Appl_CriticalErrorCallback  # Application Error Callback Function | Name of user-defined error callback. Prototype: Fee_ErrorCallbackReturnType Fee_ErrorCallbackNotification(uint8 partitionId, Fee_SectorErrorType err)
      string FeeApplErrorCallbackIncludeFile: set at pre-compile, origin=Vector Informatik, default-value=Appl_Include.h  # Application Error Callback Include File | Include file, declaring the "Application Error Callback Function"
      boolean FeeGetEraseCycleApi: set at pre-compile, origin=Vector Informatik, default-value=false  # GetEraseCycle Api | Pre-processor switch to enable and disable the API to read out the erase cycles of a specific sector.
      boolean FeeGetWriteCycleApi: set at pre-compile, origin=Vector Informatik, default-value=false  # GetWriteCycleApi | Pre-processor switch to enable and disable the API to read out the write cycles of a specific block.
      boolean FeeUseApplErrorCallback: set at pre-compile, origin=Vector Informatik, default-value=false  # Application Error Callback | Switch to enable and disable the usage of user-defined Error Callback (named as specified in "Application Error Callback Function") It is called by FEE in case of serious error detected within a partition, such as: - no valid sector header found - formatting sector failed (erase or write sector header) - sector overflow Calback's return value decides, how to coninue: - resolve automatically (accepting the risk of losing data) - force FEE into read only mode - force FEE into reject all mode (even all subsequent reads will fail)
      boolean FeeUseJobCache: set at pre-compile, origin=Vector Informatik, default-value=false  # Use Job Cache | Not used! Switch to enable and disable the usage of the job cache functionality. This feature is currently not implemented; this switch will be ignored.
      boolean FeeForceSectorSwitchApi: set at pre-compile, origin=Vector Informatik, default-value=false  # Force Sector Switch Api | Pre-processor switch to enable and disable the API to force two sector switches.
      boolean FeeDataConversionApi: set at pre-compile, origin=Vector Informatik, default-value=false  # Data Conversion Api | Enable/Disable DataConversion API. Availability of this API is an optional feature that must be explicitly ordered. If it is not available, this parameter's setting is without any effect.
      boolean FeeFblConfig: set at pre-compile, origin=Vector Informatik, default-value=false  # Flash Bootloader Configuration | This parameter indicates, if this configuration is a block configuration for the FBL or the application. It is important to set this value correct, because with this parameter the Fee detects an incomplete configuration.
      integer FeeMaxLinkTableSize: 0..4095, configuration-class-affection=affection-kind=NO-AFFECT, set at pre-compile, origin=Vector Informatik, default-value=4095  # Maximum Number of LinkTable Entries | Limit the maximum number of LinkTable entries. The LinkTable size that will be actually used is the smaller one out of this value and the maximum Id used in Block Configuration. Any Block with a BlockId exceeding maximum Table Size will always be searched using ChunkHopping. A size-limited LinkTable saves flash, at the cost of increased search efforts (for all blocks whose IDs exceed LinkTable size). Limiting the size is only recommended when using rather small flashes (partitions) with large "Write Alignment" (>> 8Bytes), i.e. if Link-Table requires comparably much flash space.
      string FeeDbgCallbackIncludeFile [0..1]: set at pre-compile, origin=Vector Informatik  # Include File for Debug Callbacks | To aid debugging and testing FEE may be configured to invoke callbacks at certain points of operation. For more details please refer to the TechRef.
      boolean FeeFssControlApi: set at pre-compile, origin=Vector Informatik, default-value=false  # Enable API to allow/prohibit FSS | - Fee_EnableFss - Fee_DisableFss Note that if this API is used, Fee_Write requests do not affect FSS enabling.
      boolean FeeExtendedSectorHeaderCheck: set at pre-compile, origin=Vector Informatik, default-value=true  # Enable extended sector header check | This parameter defines a switch to enable and disable the usage of extended sector header check. In case this check is enabled, FEE shall perform the sector header check in order to recognize erase-aborted and therefore unreliable sectors. The sectors will be erased again. Caution: The sector header pattern cannot detect erase aborts for hardware platforms, that do not start the erase process at the sector header start address. FeeUseReliableEraseProcedure must also be enabled to do it more reliably. Note: In case this extended sector header check is used: - FeeGetEraseCycleApi shall be disabled, - And if there is still data written by older FEE versions (implementation version less than 8.05.00) this old data will be seen as invalid and erased. For further information refer to Technical Reference.
      boolean FeeUseReliableEraseProcedure: set at pre-compile, origin=Vector Informatik, default-value=true  # Use Reliable Erase Procedure | By enabling this switch Fee is able to detect erase aborts reliably. Enabling/Disabling this switch does not create any incompatibilities with older flash data as long as the Write Cycle feature was not enabled. It is highly recommended to enable this switch. Caution: Write Cycle feature must be disabled for using this option. This switch can be seen as a further addition to the FeeExtendedSectorHeaderCheck, which cannot detect erase aborts for hardware platforms that do not start the erase operations at the sector start address. This switch does not need the FeeExtendedSectorHeaderCheck to be enabled, but it is recommended to do so.
  bsw implementation Fee_Impl: programming-language=C, sw-version=10.00.04, used-code-generator=DaVinci Configurator, vendor-id=30, ar-release-version=4.00.03, behavior=FeeBehavior, preconfigured-configuration=Fee_Pre, recommended-configuration=Fee_Rec, vendor-specific-module-def=Fee
  module config Fee_Pre: definition=Fee
  module config Fee_Rec: definition=Fee
