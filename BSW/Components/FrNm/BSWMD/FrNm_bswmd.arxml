AUTOSAR XML (schema 4-0-3)
# COPYRIGHT
# Copyright (c) 2022 by Vector Informatik GmbH. All rights reserved.
# This software is copyright protected and proprietary to Vector Informatik GmbH.
# Vector Informatik GmbH grants to you only those rights as set out in the license conditions.
package /MICROSAR
  module definition FrNm [0..1]: category=VENDOR_SPECIFIC_MODULE_DEFINITION, refined-module-def=FrNm, variants post-build-loadable/pre-compile/post-build-selectable  # FlexRay Network Management. The FrNm is a hardware independent protocol that can only be used on FR. Its main purpose is to coordinate the transition between normal operation and bus-sleep mode of the network. #FR #FlexRay #ModeManagement #NetworkManagement #Shutdown #AUTOSAR
    container FrNmChannelConfig  # This container includes the configuration parameters for all FlexRay NM channels.
      container FrNmChannel [0..*]  # Channel specific configuration parameters of the FrNm.
        container FrNmChannelIdentifiers  # This container includes instance specific identifiers related to the respective FlexRay Channel.
          boolean FrNmActiveWakeupBitEnabled [0..1]: set at pre-compile in variant post-build-loadable+pre-compile / post-build in variant post-build-selectable, origin=Vector Informatik, default-value=true  # Enables/Disables the handling of the Active Wakeup Bit in the FrNm module. false: Active Wakeup Bit is always zero in the transmitted NM message true: Active Wakeup Bit is set to one in case the own ECU is the first ECU actively waking the FlexRay bus. RESTRICTIONS: This parameter is only valid if (FrNmPassiveModeEnabled == False)
          integer FrNmCarWakeUpBitPosition [0..1]: 0..7, set at pre-compile in variant post-build-loadable+pre-compile / post-build in variant post-build-selectable, default-value=0  # This parameter specifies the Bit position of the Car Wake-Up Bit within the NM-PDU. Note that this parameter has to be set to a value between 0 and 7. RESTRICTIONS: This parameter is only valid if (FrNmCarWakeUpRxEnabled == true)
          integer FrNmCarWakeUpBytePosition [0..1]: 2..253, set at pre-compile in variant post-build-loadable+pre-compile / post-build in variant post-build-selectable, default-value=2  # This parameter specifies the Byte position of the Car Wake-Up Bit within the NM-PDU. Note that this parameter has to be set to a valid byte position within the user data of the NM PDU. If this setting is set to '0', the first byte of the NM PDU (not necessarily the first user data byte) is referred. RESTRICTIONS: This parameter is only relevant if (FrNmCarWakeUpRxEnabled == true)
          boolean FrNmCarWakeUpFilterEnabled [0..1]: set at pre-compile in variant post-build-loadable+pre-compile / post-build in variant post-build-selectable, default-value=false  # This parameter defines if Car Wake-Up filtering is supported. Then only the Car Wake-Up bit within the NM message with source node identifier FrNmCarWakeUpFilterNodeId is considered as Car Wake-Up request. false: Car Wake-Up Filtering is not supported. true: Car Wake-Up Filtering is supported. RESTRICTIONS: This parameter is only relevant if (FrNmCarWakeUpRxEnabled == true)
          integer FrNmCarWakeUpFilterNodeId [0..1]: 0..255, set at pre-compile in variant post-build-loadable+pre-compile / post-build in variant post-build-selectable, default-value=0  # This value specifies the source node identifier for Car Wake-Up filtering. If Car Wake-Up filtering is supported, only the Car Wake-Up bit within the NM message with source node identifier FrNmCarWakeUpFilterNodeId is considered as Car Wake-Up request. Note that this parameter has to be set to a value between 0 and 255. RESTRICTIONS: This parameter is only relevant if (FrNmCarWakeUpFilterEnabled == true)
          boolean FrNmCarWakeUpRxEnabled: set at pre-compile in variant post-build-loadable+pre-compile / post-build in variant post-build-selectable, default-value=false  # This parameter defines the support of Car Wake-Up bit evaluation in received NM messages. false: Car Wake-Up not supported. true: Car Wake-Up supported.
          boolean FrNmControlBitVectorActive: set at pre-compile in variant post-build-loadable+pre-compile / post-build in variant post-build-selectable, default-value=false  # This parameter defines the control bit vector support for a Fr Nm Channel. RESTRICTIONS: This parameter is only relevant if (FrNmControlBitVectorEnabled == true)
          integer FrNmNodeId: 0..255, set at post-build in variant post-build-loadable+post-build-selectable / pre-compile in variant pre-compile, default-value=0  # This value specifies the NM node identifier configured for the respective FlexRay Channel. The 'NodeId' is transmitted within the network management message if 'Node Id Enabled' (FrNmNodeIdEnabled) is set. The node identifier is used for the detection of present nodes and can be read by the application at any time. Note: It must be unique for each NM node within one NM cluster. RESTRICTIONS: This parameter is only relevant if (FrNmSourceNodeIdentifierEnabled == true)
          enumeration FrNmPduScheduleVariant: {FRNM_PDU_SCHEDULE_VARIANT_1, FRNM_PDU_SCHEDULE_VARIANT_2, FRNM_PDU_SCHEDULE_VARIANT_3, FRNM_PDU_SCHEDULE_VARIANT_4, FRNM_PDU_SCHEDULE_VARIANT_5, FRNM_PDU_SCHEDULE_VARIANT_6, FRNM_PDU_SCHEDULE_VARIANT_7}, set at pre-compile in variant post-build-loadable+pre-compile / post-build in variant post-build-selectable, default-value=FRNM_PDU_SCHEDULE_VARIANT_2  # This parameter defines the PDU scheduling variant that should be used for this channel. The 'PDU Schedule Variant' defines how the NM Vote and the NM Data are transmitted (and received) within the FlexRay Cycle: 1.) NM Vote and NM Data transmitted within one PDU in static segment. 2.) NM Vote and NM-Data transmitted within one PDU in dynamic segment. 3.) NM Vote and NM-Data are transmitted in the static segment in separate PDUs. 4.) NM Vote transmitted in static and NM-Data transmitted in dynamic segment. 5.) NM Vote is transmitted in dynamic and NM-Data is transmitted in static segment. 6.) NM Vote and NM-Data are transmitted in dynamic segment in separate PDUs. 7.) NM Vote and the Control Bit Vector are transmitted in the static segment and NM-Data is transmitted in the dynamic segment. RESTRICTIONS: Must be configured equal for all nodes within all connected networks.
          boolean FrNmPnEnabled: set at post-build in variant post-build-loadable+post-build-selectable / pre-compile in variant pre-compile, default-value=false  # This parameter defines the support of partial networking. false: Partial Networking is not supported. true: Partial Networking is supported.
          boolean FrNmPnEraCalcEnabled: set at pre-compile in variant post-build-loadable+pre-compile / post-build in variant post-build-selectable, default-value=false  # This parameter defines if FrNm calculates the PN request information for external requests (ERA). false: PN request information for external requests are not calculated. true: PN request information for external requests are calculated. RESTRICTIONS: This parameter is only relevant if (FrNmPnEnabled == true)
          boolean FrNmRepeatMessageBitActive: set at pre-compile in variant post-build-loadable+pre-compile / post-build in variant post-build-selectable, default-value=false  # This parameter defines if the repeat message bit support for a Fr Nm Channel is enabled. RESTRICTIONS: This parameter is only relevant if (FrNmNodeDetectionEnabled == true).
          boolean FrNmSynchronizationPointEnabled: set at pre-compile in variant post-build-loadable+pre-compile / post-build in variant post-build-selectable, default-value=false  # This parameter defines if this channel shall provide the synchronization point indication to the NM Interface. RESTRICTIONS: This parameter shall have the same value as the corresponding NmSynchronizingNetwork value. This parameter is only relevant if (NmCoordinatorSupportEnabled == true).
          boolean FrNmSyncPduMasterEnabled [0..1]: set at pre-compile in variant post-build-loadable+pre-compile / post-build in variant post-build-selectable, origin=Vector Informatik, default-value=false  # This parameter defines whether this node realizes a 'Synchronization Master' node on this FlexRay cluster. Turn this parameter ON if this node shall send 'FrNm Sync PDUs'. RESTRICTIONS: This parameter is only valid if (FrNmPassiveModeEnabled == False) AND (FrNmDualChannelPduEnable == true)
          boolean FrNmCriBitAlwaysEnabled: set at pre-compile in variant post-build-loadable+pre-compile / post-build in variant post-build-selectable, origin=Vector Informatik, default-value=false  # When this feature is enabled, the CRI bit in the CBV byte is always enabled. Regardless of the configured Partial Network setting. Note: The CRI bit is responsible to display if the current message contains PN info bytes and is usually only set if Partial Network is enabled.
          boolean FrNmSynchronizedPncShutdownEnabled [0..1]: set at pre-compile, origin=Vector Informatik, default-value=false  # Specifies if FrNm handle PN shutdown messages to support a synchronized PNC shutdown across a PN topology. This is only used for ECUs in the role of a top-level PNC coordinator or intermediate PNC coordinator. Thus, the PNC gateway functionality is enabled and therefore ERA calculation is used. FALSE: synchronized PNC shutdown is disabled. TRUE: synchronized PNC shutdown is enabled.
          reference FrNmPnEraRxNSduRef [0..1]: set at pre-compile in variant post-build-loadable+pre-compile / post-build in variant post-build-selectable, destination=Pdu  # Reference to a Pdu in the COM-Stack. The FrNm provides the External Cluster Request Information to this PDU if this information changes. This information is reported per channel. Only one SduRef is required for FrNm because the EIRA is the aggregation over all FlexRay Channels. RESTRICTIONS: This parameter is only valid if (FrNmPnEraCalcEnabled == true)
          symbolic name reference FrNmChannelHandle: set at pre-compile in variant post-build-loadable+pre-compile / post-build in variant post-build-selectable, destination=FrIfCluster  # Reference to cluster configuration within the FRIF. The FrNmChannelHandle shall be encoded in the FrNmRxPduId parameter which is passed to FrNm_RxIndication() function called by the FrIf.
          symbolic name reference FrNmComMNetworkHandleRef: set at pre-compile in variant post-build-loadable+pre-compile / post-build in variant post-build-selectable, destination=ComMChannel  # ComM Network Handle Ref | Reference to the unique channel defined by the ComMChannel and provides access to the unique channel index value in ComMChannelId.
          container FrNmRxPdu [1..*]  # This container includes the configuration of one FlexRay NM RX PDU.
            boolean FrNmRxPduContainsData: set at post-build in variant post-build-loadable+post-build-selectable / pre-compile in variant pre-compile, default-value=false  # This parameter defines if the PDU contains NM Data information.
            boolean FrNmRxPduContainsVote: set at post-build in variant post-build-loadable+post-build-selectable / pre-compile in variant pre-compile, default-value=false  # This parameter defines if the PDU contains NM Vote information.
            integer FrNmRxPduId: 0..65535, set at pre-compile, symbolic-name-value=true, default-value=0  # This value specifies the Handle ID configured for the respective FlexRay Rx PDU. If FrNmPduScheduleVariant equals to 'FRNM_PDU_SCHEDULE_VARIANT_1' or 'FRNM_PDU_SCHEDULE_VARIANT_2', all FrNmRxPdu for one FrNm channel have the same value which is a multiple of 2. So for the first FrNm channel this value is 0, for the second FrNm channel this value is 2, ... Otherwise, all FrNmRxPdu for one FrNm channel where FrNmRxPduContainsData is true, have the same value which is a multiple of 2. So for the first FrNm channel this value is 0, for the second FrNm channel this value is 2, ... Furthermore, all FrNmRxPdu for one FrNm channel where FrNmRxPduContainsVote is true, have the same value which is an odd number. So for the first FrNm channel this value is 1, for the second FrNm channel this value is 3, ... It is used for referring to the FlexRay Interface receive function. This ID is used for the combined reception of NM Vote and NM Data or for the reception of the NM Vote/NM Data if NM Data and NM Vote are received in a separate PDU. ImplementationType: PduIdType
            reference FrNmRxPduRef: set at post-build in variant post-build-loadable+post-build-selectable / pre-compile in variant pre-compile, destination=Pdu  # Reference to a PDU in the global PDU structure described in the AUTOSAR ECU Configuration Specification. This reference will be used by the FrIf module to derive the PDU Id.
          container FrNmTxPdu [0..4]  # This container includes the configuration of one FlexRay NM TX PDU.
            integer FrNmTxConfirmationPduId: 0..65535, set at pre-compile, symbolic-name-value=true, default-value=0  # This parameter specifies the Handle ID to be used by the Lower Layer to confirm the transmission of the FrNmTxPdu to the FrNm.
            boolean FrNmTxPduContainsData: set at post-build in variant post-build-loadable+post-build-selectable / pre-compile in variant pre-compile, default-value=false  # This parameter defines if the PDU contains NM Data information.
            boolean FrNmTxPduContainsVote: set at post-build in variant post-build-loadable+post-build-selectable / pre-compile in variant pre-compile, default-value=false  # This parameter defines if the PDU contains NM Vote information.
            boolean FrNmTxPduIsSyncPdu [0..1]: set at post-build in variant post-build-loadable+post-build-selectable / pre-compile in variant pre-compile, origin=Vector Informatik, default-value=false  # This parameter defines if the PDU is a NMF-Sync-PDU used for nodes that are active on Channel A + Channel B as 'Wake-Up Master' node. This PDU is sent in order to keep the other channel awake. That is if a node votes on one of the physical channels, this PDU is sent on both physical channels in order to keep both channels awake. This PDU is sent once during each Vote Cycle. The moment in time (FlexRay cycle) whether the transmit request (call of FrIf_Transmit()) shall be issued or not can be configured in the FrNmSyncPduTxRequestCycleOffset setting. RESTRICTIONS: This parameter is only valid if (FrNmSyncPduWakeUpMasterEnabled == true).
            reference FrNmTxPduRef: set at post-build in variant post-build-loadable+post-build-selectable / pre-compile in variant pre-compile, destination=Pdu  # Reference to a PDU in the global PDU structure described in the AUTOSAR ECU Configuration Specification. This reference will be used by the FrIf module to derive the PDU Id.
          container FrNmUserDataTxPdu [0..1]  # This optional container includes the configuration of the User Nm PDU. This container is only available if FrNmComUserDataSupport is enabled.
            integer FrNmTxUserDataPduId: 0..65535, set at pre-compile, symbolic-name-value=true, default-value=0  # This value specifies the Handle ID of the NM User Data I-PDU. If NM user data has been changed, FrNm_Transmit may be called by PduR using this handle ID. RESTRICTIONS: This parameter is only relevant if (FrNmComUserDataSupport == true). ImplementationType: PduIdType
            reference FrNmTxUserDataPduRef: set at post-build in variant post-build-loadable+post-build-selectable / pre-compile in variant pre-compile, destination=Pdu  # Reference to the NM User Data I-PDU in the global PDU structure described in the AUTOSAR ECU Configuration Specification. RESTRICTIONS: This parameter is only relevant if (FrNmComUserDataSupport == true).
        container FrNmChannelTiming  # This container includes instance-specific timing related to the respective FlexRay Channel.
          enumeration FrNmDataCycle: {FRNM_CYCLE_VALUE_1, FRNM_CYCLE_VALUE_16, FRNM_CYCLE_VALUE_2, FRNM_CYCLE_VALUE_32, FRNM_CYCLE_VALUE_4, FRNM_CYCLE_VALUE_64, FRNM_CYCLE_VALUE_8}, set at pre-compile in variant post-build-loadable+pre-compile / post-build in variant post-build-selectable, default-value=FRNM_CYCLE_VALUE_1  # This parameter defines the number of FlexRay Schedule Cycles needed to transmit the NM Data of all ECUs on the FlexRay bus This parameter defines the number of data multiplexing cycles if NM Data is transmitted in the dynamic segment. Please note that this value must be a power of 2. RESTRICTIONS: This parameter is only relevant if (FrNmPassiveModeEnabled == false)
          float FrNmMainFunctionPeriod: 0.001..0.02, set at pre-compile, default-value=0.01  # This value specifies the processing cycle of the main function of FrNm module.
          float FrNmMsgTimeoutTime: 0..65.535, set at post-build in variant post-build-loadable+post-build-selectable / pre-compile in variant pre-compile, default-value=0.06  # This value specifies the timeout of an NM message. It determines how long the NM shall wait with notification of transmission failure while communication errors occur on the bus. RESTRICTIONS: This parameter is only relevant if (FrNmPassiveModeEnabled == false)
          integer FrNmReadySleepCnt: 0..65535, set at pre-compile in variant post-build-loadable+pre-compile / post-build in variant post-build-selectable, default-value=2  # FrNm switches from ready sleep to bus sleep mode at the end of the (FrNmReadySleepCnt+1)th repetition cycle without any positive NM vote. Please note that this value is given in number of NM Repetition cycles. On a value of "1", the NM-State Machine will leave the Ready Sleep State after two NM Repetitions Cycle with no "keep awake" votes.
          float FrNmRemoteSleepIndTime: 0..65.535, set at pre-compile in variant post-build-loadable+pre-compile / post-build in variant post-build-selectable, default-value=0.5  # This value specifies the timeout for Remote Sleep Indication. It defines the time how long it shall take to recognize that all other nodes are ready to sleep.
          float FrNmRepeatMessageTime: 0..65.535, set at pre-compile in variant post-build-loadable+pre-compile / post-build in variant post-build-selectable, default-value=0.4  # This value specifies the time for Repeat Message State. It defines the time how long the NM shall stay in the Repeat Message State. The value "0" denotes that no Repeat Message State is configured, which means that Repeat Message State is transient and implies that it is left immediately after entry and consequently no start-up stability is guaranteed and no node detection procedure is possible.
          enumeration FrNmRepetitionCycle: {FRNM_CYCLE_VALUE_1, FRNM_CYCLE_VALUE_16, FRNM_CYCLE_VALUE_2, FRNM_CYCLE_VALUE_32, FRNM_CYCLE_VALUE_4, FRNM_CYCLE_VALUE_64, FRNM_CYCLE_VALUE_8}, set at pre-compile in variant post-build-loadable+pre-compile / post-build in variant post-build-selectable, default-value=FRNM_CYCLE_VALUE_1  # This value specifies the number of Flexray Schedule Cycles used to repeat the transmission of the Nm vote of all ECUs on the Flexray Bus. This parameter defines the number of cycles where Votes cannot be changed and no state transition is allowed. RESTRICTIONS: Value must be an integer multiple (>= 1) of FrNmVotingCycle
          float FrNmSyncLossTimer [0..1]: 0..65.535, set at post-build in variant post-build-loadable+post-build-selectable / pre-compile in variant pre-compile, default-value=1  # Parameter not used
          boolean FrNmVoteInhibitionEnabled: set at pre-compile in variant post-build-loadable+pre-compile / post-build in variant post-build-selectable, default-value=false  # This parameter defines the inhibition of vote changes from the next-to-last repetition cycle to the last repetition cycle before the Ready Sleep Counter expires. RESTRICTIONS: This parameter is only relevant if (FrNmVotingNextToLastRepetitionCycleDisable == true)
          enumeration FrNmVotingCycle: {FRNM_CYCLE_VALUE_1, FRNM_CYCLE_VALUE_16, FRNM_CYCLE_VALUE_2, FRNM_CYCLE_VALUE_32, FRNM_CYCLE_VALUE_4, FRNM_CYCLE_VALUE_64, FRNM_CYCLE_VALUE_8}, set at pre-compile in variant post-build-loadable+pre-compile / post-build in variant post-build-selectable, default-value=FRNM_CYCLE_VALUE_1  # This parameter defines the number of FlexRay Schedule Cycles needed to transmit the Nm vote of all ECUs on the FlexRay Bus.
          integer FrNmSyncPduTxRequestCycleOffset [0..1]: 0..63, set at pre-compile in variant post-build-loadable+pre-compile / post-build in variant post-build-selectable, origin=Vector Informatik, default-value=6  # This parameter defines the cycle offset where the decision shall take place whether the 'Synchronization Master' shall send the FrNm Sync PDUs or not. Typically, this setting has the value of: - ('Cycle Offset' setting - 1), if FrNmMainAcrossFrCycle = false, - 'Cycle Offset' setting, if FrNmMainAcrossFrCycle = true, of the Frame Triggering of the Frame where the Sync PDU is located. Example: the 'Cycle Offset' of the Frame Triggering of the Frame where the Sync PDU is located is 7. FrNmMainAcrossFrCycle is false, so FrNmSyncPduTxRequestCycleOffset is typically configured to 6. RESTRICTIONS: This parameter is only valid if (FrNmSyncPduWakeUpMasterEnabled == true). This parameter needs to be configured to a value less than the FrNmVotingCycle setting.
    container FrNmGlobalConfig  # Global configuration parameters of the FRNM.
      container FrNmGlobalConstants  # This container includes module constants related to the FlexRay NM functionality.
        integer FrNmNumberOfClusters [0..1]: 1..255, set at pre-compile, default-value=1  # Parameter not used
      container FrNmGlobalFeatures  # This container includes module features related to the FlexRay NM functionality.
        boolean FrNmBusSynchronizationEnabled: set at pre-compile, default-value=false  # This parameter defines if the bus synchronization is enabled or disabled. This option allows the transmission of an asynchronous NM message at any time within Network Mode. This may be required for the synchronized shutdown of networks. Therefore this option is usually only enabled in gateways. RESTRICTIONS: Derived from NmBusSynchronizationEnabled. This parameter is only relevant if (FrNmPassiveModeEnabled == false).
        boolean FrNmComUserDataSupport: set at pre-compile, default-value=false  # This parameter defines if the user data support is enabled or disabled. If this feature is enabled the application can set the NM user data via the signal interface of the Com by setting signals of the corresponding NM I-PDU. The reference to this I-PDU has to be provided in FrNmTxUserDataPduRef. Note that this feature will disable the API FrNm_SetUserData. RESTRICTIONS: Derived from NmComUserDataSupport.
        boolean FrNmControlBitVectorEnabled: set at pre-compile, default-value=false  # This parameter defines if control bit vector support is enabled.
        boolean FrNmCoordinatorSyncSupport: set at pre-compile, default-value=false  # This parameter defines if the coordinator synchronization support is enabled.
        boolean FrNmCycleCounterEmulation: set at pre-compile, default-value=false  # This parameter defines if the cycle counter emulation is enabled. The cycle counter emulation allows the FrNm to perform state transitions even though the FlexRay bus synchronization cannot be established. The internal FlexRay cycle variable of FrNm is incremented on each main function call. It is required that the FrNm_MainFunction_X functions are continued to be called in the same period even though the FlexRay bus synchronization is not established.
        boolean FrNmDualChannelPduEnable: set at pre-compile, default-value=false  # This parameter defines if the support of dual channel transmission and reception of NM messages is enabled. This option has to be enabled when NM PDUs shall be transmitted on both FlexRay Channels in the dynamic segment. For the static segment this is automatically supported by the FlexRay Interface. RESTRICTIONS: This parameter is only relevant if (FrNmPassiveModeEnabled == false) AND (FrNmPduScheduleVariant > 1)
        boolean FrNmHwVoteEnable: set at pre-compile, default-value=false  # This parameter defines if the processing of FlexRay Hardware aggregated NM-Votes is enabled. If this option is enabled all NM Votes in the static segment are aggregated by the hardware and indicated to the NM. For PDU Schedule Variant 7 also the Control Bit Vector can be automatically aggregated by the hardware. RESTRICTIONS: This parameter is only relevant of (FrNmPduScheduleVariant != 2) AND (FrNmPduScheduleVariant != 5) AND (FrNmPduScheduleVariant != 6)
        boolean FrNmNodeDetectionEnabled: set at pre-compile, default-value=false  # This parameter defines if node detection support is enabled. If a Tester is present in the network 'FrNmNodeDetectionEnabled' offers the opportunity to detect all present network nodes. RESTRICTIONS: Derived from NmNodeDetectionEnabled. This parameter is only relevant if (FrNmPassiveModeEnabled == false). This parameter is only valid if (FrNmSourceNodeIdentifierEnabled == true).
        boolean FrNmPassiveModeEnabled: set at pre-compile, default-value=false  # This parameter defines if the Passive Mode Configuration support is enabled. If this option is enabled the node is not able to send NM messages. This option can be used for nodes that do not require to keep the bus awake. RESTRICTIONS: Derived from NmPassiveModeEnabled
        boolean FrNmPduRxIndicationEnabled: set at pre-compile, default-value=false  # This parameter defines if the PDU reception indication is enabled. If 'PduRxIndicationEnabled' option is enabled a callback function for every received Pdu will be triggered. RESTRICTIONS: Derived from NmPduRxIndicationEnabled.
        boolean FrNmPnEiraCalcEnabled: set at pre-compile in variant post-build-loadable+pre-compile / post-build in variant post-build-selectable, default-value=false  # This parameter defines if FrNm calculates the PN request information for internal and external requests. (EIRA) false: PN request information for internal and external requests are not calculated. true: PN request information for internal and external requests are calculated. RESTRICTIONS: This parameter is only relevant if (FrNmPnEnabled == true) for at least one channel.
        float FrNmPnResetTime: 0.001..65.535, set at post-build in variant post-build-loadable+post-build-selectable / pre-compile in variant pre-compile, default-value=0.2  # This value specifies the runtime of the reset timer. This reset time is valid for the reset of PN requests in the EIRA and in the ERA. The value shall be the same for every channel. Thus it is a global configuration parameter. RESTRICTIONS: This parameter is only relevant if (FrNmPnEnabled == true) for at least one channel.
        boolean FrNmRemoteSleepIndicationEnabled: set at pre-compile, default-value=false  # This parameter defines if the remote sleep indication is enabled. 'FrNmRemoteSleepIndEnabled' is used in gateways to detect when the synchronized shutdown of networks has to be carried out. It comprises Remote Sleep Indication, Remote Sleep Cancelation and checking of the Remote Sleep Indication State. Remote Sleep Indication is notified when your network node is the only one in the whole network that requests bus-communication for 'FrNmRemote SleepIndTime'. Remote Sleep Cancelation is notified if any other network node requires the communication bus while Remote Sleep Indication takes place in your network node. RESTRICTIONS: Derived from NmRemoteSleepIndEnabled. This parameter is only relevant if (FrNmPassiveModeEnabled == false).
        boolean FrNmRepeatMessageBitEnabled: set at pre-compile, default-value=false  # This parameter defines if the repeat message bit support is enabled. If this option is enabled the repeat message bit within the control bit vector is accessed and evaluated by the NM. Please note that this feature has currently no effect on the code because it is always set consistently with 'FrNmNodeDetectionEnabled'. RESTRICTIONS: (FrNmRepeatMessageBitEnabled == FrNmNodeDetectionEnabled)
        boolean FrNmSourceNodeIdentifierEnabled: set at pre-compile in variant post-build-loadable+pre-compile / post-build in variant post-build-selectable, default-value=false  # This parameter defines if the Source Node Identifier support is enabled. This option provides read access to the local node identifier and to the node identifier received in the last NM message. RESTRICTIONS: Derived from NmNodeIdEnabled.
        boolean FrNmStateChangeIndicationEnabled: set at pre-compile, default-value=false  # This parameter defines if the state change indication is enabled. This option allows tracking every change in the NM state machine by the means of a callback function triggered on every state change. RESTRICTIONS: Derived from NmStateChangeIndEnabled.
        boolean FrNmUserDataEnabled: set at pre-compile, default-value=false  # This parameter defines if the user data support is enabled. This option provides read and write access to the user data. Location of user data in the NM message depends on the message configuration. RESTRICTIONS: Derived from NmUserDataEnabled.
        boolean FrNmVotingNextToLastRepetitionCycleDisable: set at pre-compile, default-value=false  # This parameter defines if the vote change in the last two repetition cycles before the Ready Sleep Counter expires is disabled. false: vote change is allowed in the last two repetition cycles before the Ready Sleep Counter expires. true: vote change is not allowed in the last two repetition cycles before the Ready Sleep Counter expires. The setting can be configured for each channel via the FrNmVoteInhibitionEnabled setting.
        reference FrNmPnEiraRxNSduRef [0..1]: set at pre-compile in variant post-build-loadable+pre-compile / post-build in variant post-build-selectable, destination=Pdu  # Reference to a Pdu in the COM-Stack. The FrNm provides the External and Internal Cluster Request Information to this PDU if this information changes. This information is aggregated over all FlexRay channels. Only one SduRef is required for FrNm because the EIRA is the aggregation over all FlexRay Channels. RESTRICTIONS: This parameter is only relevant if (FrNmPnEiraCalcEnabled == true).
        container FrNmPnInfo [0..1]  # This container includes the PN information configuration.
          integer FrNmPnInfoLength: 0..63, set at pre-compile in variant post-build-loadable+pre-compile / post-build in variant post-build-selectable, default-value=1  # This value specifies the length of the PN request information in the NM message. Note that this parameter has to be set to a value less or equal to user data length. RESTRICTIONS: This parameter is only relevant if (FrNmPnEnabled == true). To change its value, add or remove FrNmPnFilterMaskByte containers.
          integer FrNmPnInfoOffset: 1..63, set at post-build in variant post-build-loadable+post-build-selectable / pre-compile in variant pre-compile, default-value=1  # This value specifies the offset of the PN request information in the NM message. Note that this parameter has to be set to a valid byte position within user data. RESTRICTIONS: This parameter is only relevant if (FrNmPnEnabled == true).
          container FrNmPnFilterMaskByte [0..63]  # This container includes the filter mask byte configuration.
            integer FrNmPnFilterMaskByteIndex: 0..62, set at post-build in variant post-build-loadable+post-build-selectable / pre-compile in variant pre-compile, default-value=0  # This value specifies the position within the filter mask byte array. RESTRICTIONS: This parameter is only relevant if (FrNmPnEnabled == true).
            integer FrNmPnFilterMaskByteValue: 0..255, set at post-build in variant post-build-loadable+post-build-selectable / pre-compile in variant pre-compile, default-value=0  # This value specifies the filter mask byte. RESTRICTIONS: This parameter is only relevant if (FrNmPnEnabled == true).
      container FrNmGlobalProperties  # This container includes module properties related to the FlexRay NM functionality.
        boolean FrNmDevErrorDetect: set at pre-compile, default-value=true  # This parameter switches the Development Error Detection and Notification ON or OFF. true: Development error detection is enabled. false: Development error detection is disabled. Note: In general, the development error detection is recommended during pre-test phase. It is not recommended to enable the development error detection in production code due to increased runtime and ROM needs.
        boolean FrNmMainAcrossFrCycle: set at pre-compile, default-value=false  # This parameter defines if the execution of FrNm_MainFunction() crosses the FlexRay cycle boundary or not. This feature has to be disabled if the FlexRay NM Main Function is executed shortly before the cycle end. It has to be enabled if the NM Main Function is executed shortly after cycle start. Since this parameter influences the computation of the Repetition Cycle Start and End it is essential that this parameter is set correctly according to where in the cycle the Main Function is executed.
        boolean FrNmVersionInfoApi: set at pre-compile, default-value=false  # This parameter enables/disables the function FrNm_GetVersionInfo() to get major, minor and patch version information.
        boolean FrNmSafeBswChecks: set at pre-compile, origin=Vector Informatik, default-value=false  # Selects if safety checks are used. These checks improve robustness as e.g. invalid parameters are checked before function is executed. This attribute has to be enabled for safety projects where this component is mapped to an ASIL partition.
        float FrNmPnShutdownMessageRetransmissionDuration [0..1]: 0.001..65.535, set at pre-compile, origin=Vector Informatik  # Specifies the duration in seconds of retransmission phase of a PN shutdown message. A retransmission shall be performed per affected NM channel, as long as the PN shutdown message could not be successfully sent and the retransmission timer is running. The value shall be a multiple integral of FrNmMainFunctionPeriod.
        boolean FrNmRuntimeErrorReport: set at pre-compile, origin=Vector Informatik, default-value=true  # Selects if runtime errors are reported.
      container FrNmVendorSpecific  # This container includes vendor specific module features related to the FlexRay NM functionality.
        string FrNmUserConfigFile [0..1]: set at pre-compile, origin=Vector Informatik  # Reference to an external text file that will be included during generation to FrNm_Cfg.h. The content of the user configuration file will be added at the end of the generated module configuration file and allows altering or extending the generated code. Caution: User configuration files can cause the software module to malfunction and must only be used with great care!
        boolean FrNmApiOptimization: set at pre-compile, origin=Vector Informatik, default-value=false  # This parameter defines if parts of the code can be optimized to save ROM, RAM and runtime. This is possible if the FlexRay NM just consists of a single channel and the pre-compile configuration variant is set. RESTRICTIONS: This parameter can only be enabled if (Number of FrNm Channels == 1) AND (Configuration Variant of FrNm == VARIANT-PRE-COMPILE or VARIANT-POST-BUILD-SELECTABLE).
        boolean FrNmImmediateTransmissionOnly: set at pre-compile, origin=Vector Informatik, default-value=false  # This parameter defines if the code for FrNm_TriggerTransmit can be removed to save ROM and run-time. This can only be done if all transmissions of NM messages are performed immediately within FrNm_Transmit. RESTRICTIONS: This parameter is only relevant if (FrNmPassiveModeEnabled == false).
        boolean FrNmRuntimeMeasurementSupport: set at pre-compile, origin=Vector Informatik, default-value=false  # This parameter defines if runtime measurement points are added to the BSW module code and to the module configuration of MICROSAR RTM. The available measurement points can be seen and configured in the RTM module configuration. Availability of the MICROSAR RTM module is a prerequisite to make use of the runtime measurement functionality. Runtime measurement should be disabled in production code as measurement points may inflict additional runtime.
      container FrNmGeneration  # Contains the generation configuration parameters of the module FrNm.
        boolean FrNmOutOfBoundsWriteSanitizer: set at pre-compile, origin=Vector Informatik, default-value=false  # This parameter activates/deactivates the generation of runtime checks which call a DET error notification function to find easily out of bounds write problems. FALSE: no checks are generated in the data access. TRUE: the data access is enriched with DET checks to validate indexes.
        boolean FrNmOutOfBoundsReadSanitizer: set at pre-compile, origin=Vector Informatik, default-value=false  # This parameter activates/deactivates the generation of runtime checks which call a DET error notification function to find easily out of bounds read problems. FALSE: no checks are generated in the data access. TRUE: the data access is enriched with DET checks to validate indexes.
        boolean FrNmInterfacesForDeactivatedData: set at pre-compile, origin=Vector Informatik, default-value=false  # This parameter activates/deactivates the capability to generate bsw data interfaces for deactivated data elements. This is an advantage for the BSW developer to reduce the time to market with a development environment using auto completion and to investigate potential interfaces. FALSE: data interfaces are not generated if the data element is deactivated. TRUE: data interfaces are generated as e.g. empty macros.
  bsw implementation FrNm_Impl: programming-language=C, sw-version=9.01.01, used-code-generator=DaVinci Configurator, vendor-id=30, ar-release-version=4.00.03, behavior=FrNmBehavior, preconfigured-configuration=FrNm_Pre, recommended-configuration=FrNm_Rec, vendor-specific-module-def=FrNm
  module config FrNm_Pre: definition=FrNm
  module config FrNm_Rec: definition=FrNm
