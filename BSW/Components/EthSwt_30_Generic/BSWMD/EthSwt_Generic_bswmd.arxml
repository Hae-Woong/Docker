AUTOSAR XML (schema 4-1-1)
package /MICROSAR/EthSwt_Generic
  bsw implementation EthSwt_Impl: programming-language=C, sw-version=1.00.01, used-code-generator=DaVinci Configurator, vendor-id=30, ar-release-version=4.02.01, behavior=EthSwt_30_GenericBehavior, preconfigured-configuration=EthSwt_Pre, recommended-configuration=EthSwt_Rec, vendor-api-infix=Generic, vendor-specific-module-def=EthSwt
  module definition EthSwt [0..*]: category=VENDOR_SPECIFIC_MODULE_DEFINITION, refined-module-def=EthSwt, variants pre-compile  # Configuration of the EthSwt (Ethernet Switch Driver)
    container EthSwtGeneral
      boolean EthSwtDevErrorDetect: set at pre-compile, default-value=true  # Development Error Detection | This parameter switches the Development Error Detection and Notification ON or OFF. TRUE: Development error detection is enabled. FALSE: Development error detection is disabled.
      boolean EthSwtEnableVlanApi: set at pre-compile, default-value=false  # Enable EthSwt_EnableVlan() API | This parameter enables/disables the function EthSwt_EnableVlan() to to influence the VLAN forwarding on ports during runtime.
      boolean EthSwtGetArlTableApi: set at pre-compile, default-value=false  # Enable EthSwt_GetArlTable() API | This parameter enables/disables the function EthSwt_GetArlTable() to get current L2 lookup table entries.
      boolean EthSwtGetBufferLevelApi: set at pre-compile, default-value=false  # Enable EthSwt_GetBufferLevel() API | This parameter enables/disables the function EthSwt_GetBufferLevel() to get current buffer level.
      boolean EthSwtGetDropCountApi: set at pre-compile, default-value=false  # Enable EthSwt_GetDropCount() API | This parameter enables/disables the function EthSwt_GetDropCount() to retriev the drop counts.
      boolean EthSwtGetEtherStatsApi: set at pre-compile, default-value=false  # Enable EthSwt_GetEtherStats() API | This parameter enables/disables the function EthSwt_GetEtherStats() to retriev the Ethernet statistic counters.
      boolean EthSwtGetMacLearningModeApi: set at pre-compile, default-value=false  # Enable EthSwt_GetMacLearningModel() API | This parameter enables/disables the function EthSwt_GetMacLearningMode() to get current MAC learning mode.
      boolean EthSwtGetPortMacAddrApi: set at pre-compile, default-value=false  # Enable EthSwt_GetPortMacAddr() API | This parameter enables/disables the function EthSwt_GetPortMacAddress() to get the corresponding port to a MAC address.
      boolean EthSwtGetSwitchRegApi: set at pre-compile, default-value=false  # Enable EthSwt_GetSwitchReg() API | This parameter enables/disables the function EthSwt_GetSwitchReg() to read switch registers.
      boolean EthSwtGlobalTimeSupportApi: set at pre-compile, default-value=false  # Enable Global Time Support API | This parameter enables/disables the functions related to the global time support feature. Feature not supported.
      integer EthSwtSwtIndex: 0..255, set at pre-compile, default-value=0  # Index | This parameter defines the module index.
      function name EthSwtLinkDownUser [0..1]: set at pre-compile  # Link Down User | This parameter defines the user name of the callout functions to be called if a link state changes (up/down) is detected during link state retrieval (EthSwt_GetLinkState()). ( Not supported ) Function prototypes: void <User>_LinkUp(uint8* SwitchIdxPtr, uint8* PortIdxPtr); void <User>_LinkDown(uint8* SwitchIdxPtr, uint8* PortIdxPtr); where <User> is the value of this parameter.
      function name EthSwtLinkUpUser [0..1]: set at pre-compile  # Link Up User | This parameter defines the user name of the callout functions to be called if a link state changes (up/down) is detected during link state retrieval (EthSwt_GetLinkState()). ( Not supported ) Function prototypes: void <User>_LinkUp(uint8* SwitchIdxPtr, uint8* PortIdxPtr); void <User>_LinkDown(uint8* SwitchIdxPtr, uint8* PortIdxPtr); where <User> is the value of this parameter.
      float EthSwtMainFunctionPeriod [0..1]: 0.001..1, set at pre-compile, default-value=0.02  # EthSwt_MainFunction() Period | This value specifies the period the EthSwt_MainFunction() shall be called with.
      boolean EthSwtManagementSupportApi: set at pre-compile, default-value=false  # Enable Frame Management Support API | This parameter enables/disables the functions related to the frame management support feature.
      float EthSwtMgmtInfoIndicationTimeout: 0.001..1, set at pre-compile, default-value=0.01  # Frame Management Info Indcation Timout | This parameter defines the timeout till management information for a specific frame must be provided. If the timeout is hit management information is assumed to be lost and indication is called without having the information so upper layers are able to recognize the issue and react on it.
      boolean EthSwtPersistentConfigurationResult: set at pre-compile, default-value=false  # Enable Persistent Configuration Result Callout | This parameter defines if a callout function shall be called after the asynchronous NvM job triggerd by EthSwt_StoreConfiguration() or EthSwt_ResetConfiguration() has finished. FALSE: No user callout called. TRUE: User callout configured by EthSwtPersistentConfigurationResultUser called.
      function name EthSwtPersistentConfigurationResultUser [0..1]: set at pre-compile  # Persistent Configuration Result Callout | This parameter defines the user name of the callout function to be called if EthSwtPersistentConfigurationResult is enabled. ( Not Supported ) Function prototype: void <User>_PersistentConfigurationResult( NvM_RequestResultType JobResult ); where <User> is the value of this parameter.
      string EthSwtPublicCddHeaderFile [0..*]: set at pre-compile, max-length=32, min-length=1  # Header File | This parameter defines a C/C++ header file containg the declaration of the callout defined by EthSwtPersistentConfigurationResultUser or EthSwtLinkDownUser. ( Not Supported )
      boolean EthSwtReadTrcvRegisterApi: set at pre-compile, default-value=false  # Enable EthSwt_ReadTrcvRegister() API | This parameter enables/disables the function EthSwt_ReadTrcvRegister() to read transceiver registers.
      boolean EthSwtResetConfigurationApi: set at pre-compile, default-value=false  # Enable EthSwt_ResetConfiguration() API | This parameter enables/disables the function EthSwt_ResetConfiguration() to reset the configuration stored in NV RAM.
      boolean EthSwtSetMacLearningModeApi: set at pre-compile, default-value=false  # Enable EthSwt_SetMacLearningModel() API | This parameter enables/disables the function EthSwt_SetMacLearningMode() to influenc the MAC learning mode.
      boolean EthSwtSetSwitchRegApi: set at pre-compile, default-value=false  # Enable EthSwt_SetSwitchReg() API | This parameter enables/disables the function EthSwt_SetSwitchReg() to write switch registers.
      boolean EthSwtStoreConfigurationApi: set at pre-compile, default-value=false  # Enable EthSwt_StoreConfiguration() API | This parameter enables/disables the function EthSwt_StoreConfiguration() to store the current learned L2 lookup table entries in NV RAM.
      boolean EthSwtVersionInfoApi: set at pre-compile, default-value=false  # Enable EthSwt_GetVersionInfo() API | This parameter enables/disables the function EthSwt_GetVersionInfo() to get major, minor and patch version information.
      boolean EthSwtWriteTrcvRegisterApi: set at pre-compile, default-value=false  # Enable EthSwt_WriteTrcvRegister() API | This parameter enables/disables the function EthSwt_WriteTrcvRegister() to write transceiver registers.
      string EthSwtUserConfigFile [0..1]: set at pre-compile, origin=Vector Informatik  # User Config File | Reference to an external file that will be included during generation to EthSwt_Cfg.h. The content of the user configuration file will be added at the end of the generated module configuration file and allows altering or extending the generated code. Caution: User configuration files can cause the software module to malfunction and must only be used with greate care!
      boolean EthSwtUpdateMCastPortAssignmentApi: set at pre-compile, origin=Vector Informatik, default-value=false  # Enable EthSwt_UpdateMCastPortAssignment() API | This parameter enables/disables the function EthSwt_UpdateMCastPortAssignment() to active/deactivate specific multicast addresses on ports.
      boolean EthSwtWritePortMirrorConfigurationApi: set at pre-compile, default-value=false  # Enable EthSwt_WritePortMirrorConfiguration() API | This parameter enables/disables the function EthSwt_WritePortMirrorConfiguration() to write the port mirror configuration.
      boolean EthSwtReadPortMirrorConfigurationApi: set at pre-compile, default-value=false  # Enable EthSwt_ReadPortMirrorConfiguration() API | This parameter enables/disables the function EthSwt_ReadPortMirrorConfiguration() to read the port mirror configuration.
      boolean EthSwtGetPortMirrorStateApi: set at pre-compile, default-value=false  # Enable EthSwt_GetPortMirrorState() API | This parameter enables/disables the function EthSwt_GetPortMirrorState() to get the port mirror status.
      boolean EthSwtSetPortMirrorStateApi: set at pre-compile, default-value=false  # Enable EthSwt_SetPortMirrorState() API | This parameter enables/disables the function EthSwt_SetPortMirrorState() to set the port mirror status.
      boolean EthSwtDeletePortMirrorConfigurationApi: set at pre-compile, default-value=false  # Enable EthSwt_DeletePortMirrorConfiguration() API | This parameter enables/disables the function EthSwt_DeletePortMirrorConfiguration() to set the port mirror status.
    container EthSwtConfig [1..*]  # Configuration of one Ethernet Switch.
      integer EthSwtIdx: 0..255, set at pre-compile, symbolic-name-value=true, default-value=0  # Index | This value specifies the index of an Ethernet switch.
      boolean EthSwtDropDoubleTagged: set at pre-compile, default-value=true  # Enable dropping of Double Tagged Frames | This paremeter enables/disables dropping of Double Tagged Ethernet frames.
      symbolic name reference EthSwtManagementPortRef [0..1]: set at pre-compile, destination=EthSwtPort  # Management Port | This reference defines the port where the managment entity itself (Host-CPU) or the next switch on data path to it is connected to.
      symbolic name reference EthSwtManagementEthCtrlRef [0..1]: set at pre-compile, destination=EthCtrlConfig  # Management Ethernet Controller | This reference defines the Ethernet Controller connected to the Management Port where the frames to be managed are sent to.
      reference EthSwtGenericDriverRef: set at pre-compile, origin=Vector Informatik, destination=EthSwtGenericDriver  # Generic Driver | Reference to the generic driver which is assigned to the controller instance
      container EthSwtPort [1..*]  # Configuration of one Ethernet Switch Port.
        integer EthSwtPortIdx: 0..255, set at pre-compile, symbolic-name-value=true, default-value=0  # Port Index | This parameter defines the index of this port.
        enumeration EthSwtPortSpeed [0..1]: {ETHSWT_PORT_SPEED_10, ETHSWT_PORT_SPEED_100, ETHSWT_PORT_SPEED_1000}, set at pre-compile, default-value=ETHSWT_PORT_SPEED_100  # Speed | This parameter defines the communication speed applied on this port in case there is no transceiver configured by EthSwtPortTrcvRef. Some ports do not allow to configure this parameter. ETHSWT_PORT_SPEED_10: 10 MBit/s ETHSWT_PORT_SPEED_100: 100 MBit/s ETHSWT_PORT_SPEED_1000: 1000 MBit/s
        string EthSwtPortPredefinedMacAddresses [0..*]: set at pre-compile  # Static MAC address | This parameter defines a 48-bit MAC address which shalle be applied to the address resolution table during switch initialization. ( Not Supported ) The MAC address will persistenly applied to the address resolution table and will not age out. The format of the MAC address must match xx:xx:xx:xx:xx:xx.
        enumeration EthSwtPortPhysicalLayerType: {ETHSWT_PORT_BASE_T, ETHSWT_PORT_BROAD_R_REACH, ETHSWT_PORT_RTPGE, ETHSWT_PORT_X_MII, ETHSWT_PORT_INTERNAL}, set at pre-compile, default-value=ETHSWT_PORT_BROAD_R_REACH  # Physical Layer Type | This parameter defines the type of the interface on the pin level of the switch. ETHSWT_PORT_BASE_T: 100BaseTx/1000BaseTx/... ETHSWT_PORT_BROAD_R_REACH: BroadR-Reach ETHSWT_PORT_RTPGE: Reduced Twisted Pair Gigabit Ethernet ETHSWT_PORT_X_MII: xMII Interface ETHSWT_PORT_INTERAL: Interface to the integrated CPU
        boolean EthSwtEnableLinkDownCallback: set at pre-compile, default-value=false  # Enable IEEE802.1X Link Down Callback | Enables the callback <User>_LinkDown for this EthSwtPort if an IEEE802.1X link loss is detected. (not supported)
        enumeration EthSwtXMiiPhyType [0..1]: {ETHSWT_PHY_MANAGED_BY_MCU, ETHSWT_PHY_MANAGED_BY_SWITCH, ETHSWT_NO_PHY}, set at pre-compile, origin=Vector Informatik, default-value=ETHSWT_NO_PHY  # xMII PHY Type | This parameter defines if and how a PHY is connected to the switch xMII port. ETHSWT_PHY_MANAGED_BY_MCU: The xMii interface of the port is connected to a PHY having its managment interface (MDIO/MDC) connected to a MCU. ETHSWT_PHY_MANAGED_BY_SWITCH: The xMii interface of the port is connected to a PHY having its managment interface (MDIO/MDC) connected to the switch too. ETHSWT_NO_PHY: The xMii interface of the port is directly connected to annother xMii interface without a PHY inbetween.
        enumeration EthSwtHardwarePort: {ETHSWT_PORT_0, ETHSWT_PORT_1, ETHSWT_PORT_2, ETHSWT_PORT_3, ETHSWT_PORT_4, ETHSWT_PORT_5, ETHSWT_PORT_6, ETHSWT_PORT_7, ETHSWT_PORT_8, ETHSWT_PORT_9, ETHSWT_PORT_10, ETHSWT_PORT_11, ETHSWT_PORT_12, ETHSWT_PORT_13, ETHSWT_PORT_14, ETHSWT_PORT_15, ETHSWT_PORT_16, ETHSWT_PORT_17, ETHSWT_PORT_18, ETHSWT_PORT_19, ETHSWT_PORT_20, ETHSWT_PORT_21, ETHSWT_PORT_22, ETHSWT_PORT_23, ETHSWT_PORT_24, ETHSWT_PORT_25, ETHSWT_PORT_26, ETHSWT_PORT_27, ETHSWT_PORT_28, ETHSWT_PORT_29, ETHSWT_PORT_30, ETHSWT_PORT_31}, set at pre-compile, origin=Vector Informatik, default-value=ETHSWT_PORT_0  # This parameter defines the Hardware Port represented by this configuration port.
        enumeration EthSwtXMiiType [0..1]: {ETHSWT_RVMII, ETHSWT_MII, ETHSWT_RGMII, ETHSWT_SGMII}, set at pre-compile, origin=Vector Informatik, default-value=ETHSWT_RVMII  # xMII Type | This parameter defines the type of MII-Interface used to connect to the ports counter part (MAC/PHY). ETHSWT_RVMII: Reverse MII interface allowing 10/100 MBit/s data connections. ETHSWT_MII: Common MII interface allowing 10/100 MBit/s data connections. ETHSWT_RGMII: Reduced Gigabit MII Interface allowing 10/100/1000 MBit/s data connections. ETHSWT_SGMII: Serial Gigabit MII Interface allowing 10/100/1000 MBit/s data connections.
        boolean EthSwtPortTimeStampSupport: set at pre-compile, default-value=false  # Time Stamping Support | This parameter defines if time stamping on this port is enabled/disabled.
        symbolic name reference EthSwtPortTrcvRef [0..1]: set at pre-compile, destination=EthTrcvConfig  # Transceiver | Reference to the ethernet transceiver driver this port is connected to. Some ports do not allow to configure this parameter because the PHY configuration is handled switch driver internally.
        container EthSwtPortIngress  # Configuration of the ingress behavior of a port.
          integer EthSwtPortTrafficClassAssignment [0..1]: 0..7, set at pre-compile, default-value=0  # Traffic Class Assignment | This parameter defines the default PCP which shall be applied to the VLAN-tag of untagged traffic.
          integer EthSwtPortIngressVlanModification [0..1]: 0..4094, set at pre-compile, default-value=0  # VLAN ID Modification | This parameter defines the VLAN-ID untagged traffic will be tagged with.
          container EthSwtPriorityTrafficClassAssignment [0..8]  # Tuple of PCP and traffic class used for the PCP to traffic class assignment on ingress of a VLAN tagged frame.
            integer EthSwtPriorityTrafficClassAssignmentPriority: 0..7, set at pre-compile, default-value=0  # PCP | This value specifies the PCP the traffic class specified by EthSwtPriorityTrafficClassAssignmentTrafficClass shall be assigned to.
            integer EthSwtPriorityTrafficClassAssignmentTrafficClass: 0..7, set at pre-compile, default-value=0  # Traffic Class | This value specifies the traffic class a frame with the PCP configured by EthSwtPriorityTrafficClassAssignmentPriority shall be assigned. The traffic class is used on egress side to assign the frame to a egress FIFO. Depending on the traffic class the frame is forwarded with a higher or lower priority.
          container EthSwtPriorityRegeneration [0..8]  # Tuple of PCP and regenerated PCP used for the PCP regeneration on ingress of a VLAN tagged frame. (not supported)
            integer EthSwtPriorityRegenerationIngressPriority: 0..7, set at pre-compile, default-value=0  # PCP | This value specifies the PCP which shall be modified to the PCP specified by EthSwtPriorityRegenerationRegeneratedPriority. (not supported)
            integer EthSwtPriorityRegenerationRegeneratedPriority: 0..7, set at pre-compile, default-value=0  # Regenerated PCP | This value specifies the regenerated PCP that the PCP specified by EthSwtPriorityRegenerationIngressPriority shall be changed to. (not supported)
        container EthSwtPortEgress  # Configuration of the egress behavior of a port.
          reference EthSwtPortEgressLastSchedulerRef: set at pre-compile, destination=EthSwtPortScheduler  # Last Scheduler | Reference to the port scheduler which is the last in the egress port structure.
          container EthSwtPortVlanForwarding [0..*]  # Forwarding rule used to specify the behavior that shall be applied to a VLAN tagged frame.
            integer EthSwtPortVlanForwardingId: 0..4094, set at pre-compile, default-value=1  # VLAN ID | This value specifies the VLAN ID the forwarding rule shall be applied to.
            enumeration EthSwtPortVlanForwardingType: {ETHSWT_NOT_SENT, ETHSWT_SENT_TAGGED, ETHSWT_SENT_UNTAGGED}, set at pre-compile, default-value=ETHSWT_SENT_TAGGED  # Forwarding Rule | This parameter defines the rule that shall be applied to the VLAN tagged frame. ETHSWT_NOT_SENT: Do not forward a frame with the corresponding VLAN ID on this port. ETHSWT_SENT_TAGGED: Forward a frame with the corresponding VLAN ID on this port without changing the VLAN tag. ETHSWT_SENT_UNTAGGED: Forward a frame wiht the corresponding VLAN ID on this port without the VLAN tag (tag will be removed).
            integer EthSwtPortVlanDefaultPriority: 0..7, set at pre-compile, default-value=0  # Default PCP | This value specifies the default PCP applied to a VLAN tagged frame. (not supported)
          container EthSwtPortScheduler [1..*]  # Scheduler used for scheduling the FIFOs, Shapers and Schedulers on egress port.
            enumeration EthSwtPortSchedulerAlgorithm: {ETHSWT_SCHEDULER_DEFICIT_ROUND_ROBIN, ETHSWT_SCHEDULER_WEIGHTED_ROUND_ROBIN, ETHSWT_SCHEDULER_STRICT_PRIORITY}, set at pre-compile, default-value=ETHSWT_SCHEDULER_STRICT_PRIORITY  # Scheduling Algorithm | This parameter defines the scheduling algorithm used to schedule the predecessor elements configured by EthSwtPortSchedulerPredecessor. ETHSWT_SCHEDULER_WEIGHTED_ROUND_ROBING: Weighted round robin algorithm. ETHSWT_SCHEDULER_STRICT_PRIORITY: Strict priority algorithm. ETHSWT_SCHEDULER_DEFICIT_ROUND_ROBIN: Deficit round robin algorithm. (not supported)
            container EthSwtPortSchedulerPredecessor [1..*]  # Predecessor of the scheduler.
              integer EthSwtPortSchedulerPredecessorOrder: 0..255, set at pre-compile, default-value=0  # Order Index | This value specifes the index in the order of predecessors applied to the scheduler.
              integer EthSwtPredecessorWeight [0..1]: 1..255, set at pre-compile, origin=Vector Informatik, default-value=1  # WRR Scheduling Weigth | This parameter defines the weight assigned to the predecessor element in case weighted round robin is used as scheduling algorithm.
              choice reference EthSwtPortEgressPredecessorRef: set at pre-compile, destination=[EthSwtPortScheduler, EthSwtPortShaper, EthSwtPortFifo]  # Predecessor | Reference to the predecessor of the scheduler. Predecessors can be FIFOs, Shapers or other schedulers.
          container EthSwtPortShaper [0..*]  # Shaper used to shape the traffic of its predecessor.
            integer EthSwtPortShaperIdleSlope [0..1]: 64000..2147483647, set at pre-compile, default-value=64000  # Idle Slope | This value specifies the increase of credits per second for the AVB shaper.
            enumeration EthSwtHardwareShaper: {ETHSWT_SHAPER_0, ETHSWT_SHAPER_1, ETHSWT_SHAPER_2, ETHSWT_SHAPER_3, ETHSWT_SHAPER_4, ETHSWT_SHAPER_5, ETHSWT_SHAPER_6, ETHSWT_SHAPER_7}, set at pre-compile, origin=Vector Informatik, default-value=ETHSWT_SHAPER_0  # This parameter defines the hardware shaper representet by this configuration shaper.
            reference EthSwtPortEgressPredecessorFifoRef: set at pre-compile, destination=EthSwtPortFifo  # FIFO | Reference to the FIFO which is the predecessor of the shaper.
          container EthSwtPortFifo [1..*]  # FIFO the frames are directed to depending on the traffic class assignment.
            integer EthSwtPortFifoTrafficClassAssignment [0..8]: 0..7, set at pre-compile, default-value=0  # Traffic Class Assignment | This value specifies the traffic class assigned to the FIFO.
            enumeration EthSwtHardwareFifo: {ETHSWT_QUEUE_0, ETHSWT_QUEUE_1, ETHSWT_QUEUE_2, ETHSWT_QUEUE_3, ETHSWT_QUEUE_4, ETHSWT_QUEUE_5, ETHSWT_QUEUE_6, ETHSWT_QUEUE_7}, set at pre-compile, origin=Vector Informatik, default-value=ETHSWT_QUEUE_0  # Hardware Queue | This parameter defines the hardware queue representet by this configuration FIFO.
      container EthSwtSpi [0..1]  # Configuration of the Ethernet Switch SPI access.
        container EthSwtSpiSequence [1..*]  # SPI sequence configuration.
          boolean EthSwtSpiAccessSynchronous [0..1]: set at pre-compile, default-value=true  # Enable Synchronous Access | This parameter defines the access method to the SPI. false: SPI will be accessed asynchronous. true: SPI will be accessed synchronous.
          symbolic name reference EthSwtSpiSequenceName [0..1]: set at pre-compile, destination=SpiSequence  # SPI Sequence | Reference to the SPI sequence used for SPI access.
      container EthSwtNvm [0..1]  # Configuration of the NvM interface.
        symbolic name reference EthSwtTableNvmBlockDescriptorRef: set at pre-compile, destination=NvMBlockDescriptor  # NvM Block | Reference to the Nvm block description in the Nvm module configuration to store e.g. the learned ARL table
        symbolic name reference EthSwtConfigurationNvmBlockDescriptorRef: set at pre-compile, destination=NvMBlockDescriptor  # Mirroring NvM Block | Reference to the Nvm block description in the Nvm module configuration to store e.g. the port mirror configurations
      container EthSwtDemEventParameterRefs [0..1]  # Configuration of the DEM events.
        symbolic name reference ETHSWT_E_ACCESS [0..1]: set at pre-compile, destination=DemEventParameter  # E_ACCESS | Reference to the DEM event issued if an configuration interface access issue occurs.
        symbolic name reference ETHSWT_E_BUFFEROVERRUN [0..1]: set at pre-compile, origin=Vector Informatik, destination=DemEventParameter  # E_BUFFEROVERRUN | Reference to the DEM event issued if a buffer overrun is detected.
        symbolic name reference ETHSWT_E_CRC [0..1]: set at pre-compile, origin=Vector Informatik, destination=DemEventParameter  # E_CRC | Reference to the DEM event issued if a CRC error is detected.
        symbolic name reference ETHSWT_E_UNDERSIZEPCKT [0..1]: set at pre-compile, origin=Vector Informatik, destination=DemEventParameter  # E_UNDERSIZEPCKT | Reference to the DEM event issued if an undersited frame is detected.
        symbolic name reference ETHSWT_E_OVERSIZEPCKT [0..1]: set at pre-compile, origin=Vector Informatik, destination=DemEventParameter  # E_OVERSIZEPCKT | Reference to the DEM event issued if an oversited frame is detected.
        symbolic name reference ETHSWT_E_ALIGNMENT [0..1]: set at pre-compile, origin=Vector Informatik, destination=DemEventParameter  # E_ALIGNMENT | Reference to the DEM event issued if an alignment error is detected.
        symbolic name reference ETHSWT_E_SQETEST [0..1]: set at pre-compile, origin=Vector Informatik, destination=DemEventParameter  # E_SQETEST | Reference to the DEM event issued if a SQE test error is detected.
        symbolic name reference ETHSWT_E_INDISCARD [0..1]: set at pre-compile, origin=Vector Informatik, destination=DemEventParameter  # E_INDISCARD | Reference to the DEM event issued if a non errornous frame is discarded on ingress side.
        symbolic name reference ETHSWT_E_INERROR [0..1]: set at pre-compile, origin=Vector Informatik, destination=DemEventParameter  # E_INERROR | Reference to the DEM event issued if a errournous frame on ingress side is detected.
        symbolic name reference ETHSWT_E_OUTDISCARD [0..1]: set at pre-compile, origin=Vector Informatik, destination=DemEventParameter  # E_OUTDISCARD | Reference to the DEM event issued if a non errornous frame is discarded on egress side.
        symbolic name reference ETHSWT_E_OUTERROR [0..1]: set at pre-compile, origin=Vector Informatik, destination=DemEventParameter  # E_OUTERROR | Reference to the DEM event issued if a errournous frame on egress side is detected.
        symbolic name reference ETHSWT_E_SINGLECOLLISION [0..1]: set at pre-compile, origin=Vector Informatik, destination=DemEventParameter  # E_SINGLECOLLISION | Reference to the DEM event issued if a single collision is detected.
        symbolic name reference ETHSWT_E_MULTIPLECOLLISION [0..1]: set at pre-compile, origin=Vector Informatik, destination=DemEventParameter  # E_MULTIPLECOLLISION | Reference to the DEM event issued if a multiple collision is detected.
        symbolic name reference ETHSWT_E_DEFFEREDTRANSMISSION [0..1]: set at pre-compile, origin=Vector Informatik, destination=DemEventParameter  # E_DEFFEREDTRANSMISSION | Reference to the DEM event issued if a deffered transmission is detected.
        symbolic name reference ETHSWT_E_LATECOLLISION [0..1]: set at pre-compile, origin=Vector Informatik, destination=DemEventParameter  # E_LATECOLLISION | Reference to the DEM event issued if a late collision is detected.
    container EthSwtGenericDriver [1..*]  # This container represents one Generic Ethernet Switch Driver.
      linker symbol EthSwtGenericDriverName: set at pre-compile, origin=Vector Informatik  # Driver Name | This value specifies the identifier used for the API infixing of the drivers AUTOSAR API. Example: The EthSwt_Init() API will be generated as EthSwt_<Vendor ID>_<Driver Name>_Init().
      integer EthSwtGenericDriverVendorId: 0..65535, set at pre-compile, origin=Vector Informatik  # Vendor ID | This value specifies the vendor ID used for the API infixing of the drivers AUTOSAR API. Example: The EthSwt_Init() API will be generated as EthSwt_<Vendor ID<_<Driver Name>_Init().
  module config EthSwt_Pre: definition=EthSwt
  module config EthSwt_Rec: definition=EthSwt
