AUTOSAR XML (schema 4-0-3)
package /MICROSAR/Cdd_AsrCdd
  bsw implementation Cdd_Impl: programming-language=C, used-code-generator=DaVinci Configurator, vendor-id=30, ar-release-version=4.00.03, behavior=Cdd_AsrCddBehavior, preconfigured-configuration=Cdd_Pre, recommended-configuration=Cdd_Rec, vendor-specific-module-def=Cdd
  module definition Cdd [0..*]: category=VENDOR_SPECIFIC_MODULE_DEFINITION, refined-module-def=Cdd, variants pre-compile/post-build-selectable  # The Complex Device Driver module describes the minimal requirements that are necessary for the configuration of one or more Complex Device Drivers with access to the MICROSAR communication stack.
    container CddComStackContribution  # Contribution of COM Stack modules.
      container CddComIfUpperLayerContribution [0..1]  # This container collects parameters for the configuration of a Complex Driver that serves as the UpperLayer of a Com Interface module (e.g. CanIf, FrIf).
        container CddComIfUpperLayerRxPdu [0..*]  # This container specifies Rx PDUs that are received by the CDD through communication stack.
          integer CddComIfHandleId: 0..65535, set at pre-compile, symbolic-name-value=true, default-value=0  # ECU wide unique, symbolic handle for the Pdu.
          reference CddComIfPduRef: set at pre-compile, destination=Pdu  # Reference to the "global" Pdu structure to allow harmonization of handle IDs in the COM-Stack.
        container CddComIfUpperLayerTxPdu [0..*]  # This container specifies Tx PDUs that are transmitted by the CDD through communication stack.
          integer CddComIfHandleId: 0..65535, set at pre-compile, symbolic-name-value=true, default-value=0  # ECU wide unique, symbolic handle for the Pdu.
          reference CddComIfPduRef: set at pre-compile, destination=Pdu  # Reference to the "global" Pdu structure to allow harmonization of handle IDs in the COM-Stack.
      container CddComMLowerLayerContribution [0..0]  # ComM Lower Layer Contribution | Parameters that are necessary for the configuration of a Complex Device Driver that serves as the LowerLayer of the Communication Manager module.
        container CddComMLowerLayerChannel [1..*]  # ComM Lower Layer Channel | This container contains the network specific parameters.
          reference CddComMLowerLayerChannelRef: set at pre-compile, destination=ComMChannel  # ComM Lower Layer Channel Ref | Unique handle to identify one certain network. Reference to one of the network handles configured for the ComM.
      container CddGenericNmLowerLayerContribution [0..0]  # Parameters that are necessary for the configuration of a Complex Device Driver that serves as the LowerLayer of the Generic NM module.
        container CddGenericNmLowerLayerChannel [1..*]  # NM Channel specific configuration parameters.
          reference CddGenericNmComMNetworkHandleRef: set at pre-compile, destination=ComMChannel  # Generic Nm ComM Network Handle Ref | This reference points to the unique channel defined by the ComMChannel and provides access to the unique channel index value in ComMChannelId.
      container CddPduRLowerLayerContribution [0..1]  # PduR Lower Layer Contribution | Parameters that are necessary for the configuration of a Complex Driver that serves as the LowerLayer of the Pdu Router module.
        container CddPduRLowerLayerRxPdu [0..*]  # PduR Lower Layer Rx Pdu | Rx PDU that is received by the Complex Driver and forwarded to the PduR.
          integer CddPduRLowerLayerHandleId: 0..65535, set at pre-compile, symbolic-name-value=true, default-value=0  # PduR Lower Layer Handle Id | ECU wide unique, symbolic handle for the Pdu.
          reference CddPduRLowerLayerPduRef: set at pre-compile, destination=Pdu  # PduR Lower Layer Pdu Ref | Reference to the "global" Pdu structure to allow harmonization of handle IDs in the COM-Stack.
        container CddPduRLowerLayerTxPdu [0..*]  # PduR Lower Layer Tx Pdu | Tx PDU that is received by the Complex Driver from the PduR.
          integer CddPduRLowerLayerHandleId: 0..65535, set at pre-compile, symbolic-name-value=true, default-value=0  # PduR Lower Layer Handle Id | ECU wide unique, symbolic handle for the Pdu.
          reference CddPduRLowerLayerPduRef: set at pre-compile, destination=Pdu  # PduR Lower Layer Pdu Ref | Reference to the "global" Pdu structure to allow harmonization of handle IDs in the COM-Stack.
      container CddPduRUpperLayerContribution [0..1]  # PduR Upper Layer Contribution | Parameters that are necessary for the configuration of a Complex Driver that serves as the UpperLayer of the Pdu Router module.
        container CddPduRUpperLayerRxPdu [0..*]  # PduR Upper Layer Rx Pdu | This container specifies Rx PDUs that are received by the Complex Driver from the PduR.
          integer CddPduRUpperLayerHandleId: 0..65535, set at pre-compile, symbolic-name-value=true, default-value=0  # PduR Upper Layer Handle Id | ECU wide unique, symbolic handle for the Pdu.
          reference CddPduRUpperLayerPduRef: set at pre-compile, destination=Pdu  # PduR Upper Layer Pdu Ref | Reference to the "global" Pdu structure to allow harmonization of handle IDs in the COM-Stack.
        container CddPduRUpperLayerTxPdu [0..*]  # PduR Upper Layer Tx Pdu | This container specifies Tx PDUs that are transmitted from the Complex Driver to the PduR.
          integer CddPduRUpperLayerHandleId: 0..65535, set at pre-compile, symbolic-name-value=true, default-value=0  # PduR Upper Layer Handle Id | ECU wide unique, symbolic handle for the Pdu.
          reference CddPduRUpperLayerPduRef: set at pre-compile, destination=Pdu  # PduR Upper Layer Pdu Ref | Reference to the "global" Pdu structure to allow harmonization of handle IDs in the COM-Stack.
      container CddJ1939RmContribution [0..1]  # This container collects parameters for the configuration of a Complex Driver that serves as UpperLayer of the J1939Rm module.
        boolean CddJ1939RmRequestIndication: set at pre-compile, origin=Vector Informatik, default-value=false  # Enables the J1939Rm RequestIndication for this CDD. The RequestIndication provides information about a received J1939 RQST message which affects a J1939Rm user that references this CDD. Prototype of the RequestIndication: void <Cdd>_RequestIndication(uint8 node, NetworkHandleType channel, uint32 requestedPgn, uint8 sourceAddress, uint8 destAddress, uint8 priority)
        boolean CddJ1939RmAckIndication: set at pre-compile, origin=Vector Informatik, default-value=false  # Enables the J1939Rm AckIndication for this CDD. The AckIndication provides information about a received J1939 ACKM message which affects a J1939Rm user that references this CDD. Prototype of the AckIndication: void <Cdd>_AckIndication(uint8 node, NetworkHandleType channel, uint32 ackPgn, uint8 ackCode, uint8 ackAddress, uint8 sourceAddress, uint8 priority)
        boolean CddJ1939RmRequestTimeoutIndication: set at pre-compile, origin=Vector Informatik, default-value=false  # Enables the J1939Rm RequestTimeoutIndication for this CDD. The RequestTimeoutIndication is called after time out of a transmitted J1939 RQST message. Prototype of the AckIndication: void <Cdd>_RequestTimeoutIndication(uint8 node, NetworkHandleType channel, uint32 requestedPgn, uint8 destAddress)
      container CddSoAdUpperLayerContribution [0..1]  # SoAd Upper Layer Contribution | Parameters that are necessary for the configuration of a Complex Driver that serves as the UpperLayer of the SoAd module.
        container CddSoAdUpperLayerRxPdu [0..*]  # SoAd Upper Layer Rx Pdu | This container specifies Rx PDUs that are exchanged between the CDD and the standardized BSW module.
          enumeration CddPduRApiType: {IF, TP}, set at pre-compile, origin=Vector Informatik  # Api Type | This parameter configures the type of the CDD interface (IF/TP)
          integer CddSoAdUpperLayerHandleId: 0..65535, set at pre-compile, origin=Vector Informatik, symbolic-name-value=true, default-value=0  # SoAd Upper Layer Handle Id | ECU wide unique, symbolic handle for the Pdu.
          reference CddSoAdUpperLayerPduRef: set at pre-compile, origin=Vector Informatik, destination=Pdu  # SoAd Upper Layer Pdu Ref | Reference to the "global" Pdu structure to allow harmonization of handle IDs in the COM-Stack.
        container CddSoAdUpperLayerTxPdu [0..*]  # SoAd Upper Layer Tx Pdu | This container specifies Tx PDUs that are exchanged between the CDD and the standardized BSW module.
          enumeration CddPduRApiType: {IF, TP}, set at pre-compile, origin=Vector Informatik  # Api Type | This parameter configures the type of the CDD interface (IF/TP)
          integer CddSoAdUpperLayerHandleId: 0..65535, set at pre-compile, origin=Vector Informatik, symbolic-name-value=true, default-value=0  # SoAd Upper Layer Handle Id | ECU wide unique, symbolic handle for the Pdu.
          reference CddSoAdUpperLayerPduRef: set at pre-compile, origin=Vector Informatik, destination=Pdu  # SoAd Upper Layer Pdu Ref | Reference to the "global" Pdu structure to allow harmonization of handle IDs in the COM-Stack.
    container CddEcucPartitionInteraction [0..0]  # This optional container holds the partition interaction configuration.
      function name CddPartitionStoppedFunctionName: set at pre-compile  # Function name to be called when the partition which is triggering the complex driver is stopped.
      reference CddEcucPartitionRef: set at pre-compile, destination=EcucPartition  # Reference to the "EcucPartition" which executes the software which triggers the CDD.
  module config Cdd_Pre: definition=Cdd
  module config Cdd_Rec: definition=Cdd
