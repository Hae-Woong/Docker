AUTOSAR XML (schema 4-0-3)
# COPYRIGHT
# Copyright (c) 2016 by Vector Informatik GmbH. All rights reserved.
# This software is copyright protected and proprietary to Vector Informatik GmbH.
# Vector Informatik GmbH grants to you only those rights as set out in the license conditions.
package /MICROSAR  # /MICROSAR
  bsw implementation Ccp_Impl: programming-language=C, sw-version=1.00.00, used-code-generator=cMSR, vendor-id=30, ar-release-version=4.02.01, behavior=CcpBehavior, preconfigured-configuration=Ccp_Pre, recommended-configuration=Ccp_Rec, vendor-specific-module-def=Ccp
  module definition Ccp [0..1]: category=VENDOR_SPECIFIC_MODULE_DEFINITION, variants pre-compile/link-time/post-build-loadable/post-build-selectable  # /MICROSAR/Ccp | Configuration of the CCP module
    container CcpGeneral  # This container contains the general configuration parameters of the CCP.
      string CcpUserConfigFile [0..1]: set at pre-compile, origin=Vector Informatik  # A configuration file (Ccp_cfg.h) is generated by Cfg5. If you want to overwrite settings in the generated configuration file, you can specify a path to a user defined configuration file. The user defined configuration file will be included at the end of the generated file. Therefore definitions in the user defined configuration file can overwrite definitions in the generated configuration file.
      boolean CcpMemProtection: set at pre-compile, origin=Vector Informatik, default-value=false  # The option 'Memory Protection' enables read and write access check to memory areas. I.e. prior to carrying out access to RAM an application callback function is called and the memory address is passed as parameter. The application has to either grant or deny the memory access.
      boolean CcpDevErrorDetect: set at pre-compile, origin=Vector Informatik, default-value=true  # Switches the Development Error Detection and Notification on or off. true: Development Error Detection and Notificiation on false: Development Error Detection and Notification off
      boolean CcpVersionInfoApi: set at pre-compile, origin=Vector Informatik, default-value=false  # Enables/disables the existence of the Ccp_GetVersionInfo() API service true: Ccp_GetVersionInfo() API service exists false: Ccp_GetVersionInfo() API service does not exist
      integer CcpBroadcastStationAddress [0..1]: 0..65535, set at pre-compile, origin=Vector Informatik  # If there is more than one ECU connected to the same CAN Bus and they are both using the same CAN identifiers for communication with the application system, the broadcast station address can be used to address all of these devices simultaneously.
      boolean CcpControl: set at pre-compile, origin=Vector Informatik, default-value=false  # If enabled the CCP functionality can be enabled/disabled during runtime. The feature may be used to prevent unintended CCP activity by disabling the functionality on a special trigger. If this option is disabled CCP will always stay activate in the ECU.
      string CcpStationId: set at pre-compile, origin=Vector Informatik, max-length=255, min-length=1  # The 'ECU Name' is an identification of the electronic control unit (ECU) that is used for automatic session configuration. This might include automatic assignment of a data acquisition setup file depending on the slave's returned ID.
      float CcpMainFunctionPeriod: 0.., set at pre-compile, origin=Vector Informatik, default-value=0.005  # The CCP does not require this information but the BSW scheduler, which invokes the main function, needs it in order to plan its tasks.
      container CcpDaq [0..1]  # Data acquisition (DAQ) is the definition of a procedure and messages sent from the slave device to the master device for fast data acquisition from an ECU. The synchronous data acquisition gives the ability to sample data according to events in the ECU, e.g. timer events for firing point or cyclic events.
        integer CcpTransmitQueueSize: 0..255, set at pre-compile, origin=Vector Informatik, default-value=0  # The size of the transmit queue should be large enough to store at least the amount of data required for one DAQ list.
        boolean CcpOverrunDetection: set at pre-compile, origin=Vector Informatik, default-value=true  # If the option 'Overrun Detection' is enabled a Transmit Queue overrun is signaled to the master device. This option is proprietary and not included in the ASAP CCP specification.
        integer CcpMaxOdt: 1..254, set at pre-compile, origin=Vector Informatik  # The Object Desription Table (ODT) describes the mapping between the synchronous data transfer objects and the slave's memory. I.e. 'Max ODT' configures the number of data bytes for each DAQ list. The data bytes that can be measured are calculated using the following formula: DataBytes = Max_DAQ * Max_ODT * 7
        integer CcpMaxDaq: 1..254, set at pre-compile, origin=Vector Informatik  # The maximum number of DAQ-lists defines the maximum number of events that can be used for triggering a measurement.
    container CcpConfig  # Configuration of the CCP. This container is a MultipleConfigurationContainer, i.e. this container and its sub-containers exist once per configuration set.
      integer CcpStationAddress: 0..65535, set at link in variant link-time / post-build in variant post-build-loadable+post-build-selectable / pre-compile in variant pre-compile, origin=Vector Informatik  # If there is more than one ECU connected to the same CAN Bus and they are both using the same CAN identifiers for communication with the application system, the station address can be used as distinction of these devices.
      container CcpChannel [1..*]: post-build-changeable=true  # Description of the Rx and Tx PDUs used for CCP communication.
        container CcpRxPdu: post-build-changeable=true  # Rx PDU description.
          integer CcpRxPduId: 0.., set at pre-compile, origin=Vector Informatik, symbolic-name-value=true, default-value=0  # ID of the PDU that will be received by the CCP module via a Ccp_RxIndication.
          reference CcpRxPduRef: set at link in variant link-time / post-build in variant post-build-loadable+post-build-selectable / pre-compile in variant pre-compile, origin=Vector Informatik, destination=Pdu  # Reference to the external PDU definition.
        container CcpTxPdu: post-build-changeable=true  # Tx PDU description.
          integer CcpTxPduId: 0.., set at pre-compile, origin=Vector Informatik, symbolic-name-value=true, default-value=0  # The PDU identifier, which has to be used by the lower layer to identify the PDU during TxConfirmation or TriggerTransmit calls to the XCP module.
          reference CcpTxPduRef: set at link in variant link-time / post-build in variant post-build-loadable+post-build-selectable / pre-compile in variant pre-compile, origin=Vector Informatik, destination=Pdu  # Reference to the external PDU definition.
  module config Ccp_Rec: definition=Ccp
  module config Ccp_Pre: definition=Ccp
