AUTOSAR XML (schema 4-0-3)
package /MICROSAR
  module config FrSM_Rec: definition=FrSM
    FrSMGeneral: FrSMSafeBswChecks=1
