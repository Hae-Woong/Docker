AUTOSAR XML (schema 4-0-3)
# COPYRIGHT
# Copyright (c) 2020 by Vector Informatik GmbH. All rights reserved.
# This software is copyright protected and proprietary to Vector Informatik GmbH.
# Vector Informatik GmbH grants to you only those rights as set out in the license conditions.
package /MICROSAR
  bsw implementation FrSM_Impl: programming-language=C, sw-version=4.00.00, used-code-generator=DaVinci Configurator, vendor-id=30, ar-release-version=4.00.03, behavior=FrSMBehavior, preconfigured-configuration=FrSM_Pre, recommended-configuration=FrSM_Rec, vendor-specific-module-def=FrSM
  module definition FrSM [0..1]: category=VENDOR_SPECIFIC_MODULE_DEFINITION, refined-module-def=FrSM, variants pre-compile/post-build-selectable  # Configuration of the FrSM (FlexRay State Manager) module.
    container FrSMConfig  # This container includes the cluster specific configuration of the FlexRay State Manager.
      container FrSMCluster [0..*]  # This container includes a FlexRay cluster and all related data. A FlexRay cluster may consist of more than one controller per ECU.
        boolean FrSMCheckWakeupReason: set at pre-compile, default-value=false  # This parameter defines if the FrSM will check the wakeup reason in order to skip the wakeup in case of wakeup by bus. If FrSMCheckWakeupReason is false, the FrSM will always try to perform a wakeup.
        boolean FrSMDelayStartupWithoutWakeup: set at post-build in variant post-build-selectable / pre-compile in variant pre-compile, default-value=false  # This parameter defines if timer t1 shall be started instead of immediately calling FrIf_AllowColdstart in case of a startup without wakeup.
        float FrSMDurationT1: 0..65.534, set at post-build in variant post-build-selectable / pre-compile in variant pre-compile, default-value=0.005  # This value specifies the duration of timer t1. The timer t1 models the delay of clearing the coldstart inhibit mode (i.e. calling FrIf_AllowColdstart). | A value of 0 shall imply that the timer is not used.
        float FrSMDurationT2: 0..65.534, set at post-build in variant post-build-selectable / pre-compile in variant pre-compile, default-value=0.05  # This value specifies the duration of timer t2. The timer t2 models the time difference after which the FrSM will repeat the startup of the FlexRay cluster. Restriction: The value of this parameter shall be larger than the value of FrSMDurationT1 parameter. | A value of 0 shall imply that the timer is not used. The value of this parameter shall be larger than the value of FrSMDurationT1 parameter.
        float FrSMDurationT3: 0..65.534, set at post-build in variant post-build-selectable / pre-compile in variant pre-compile, default-value=0.5  # This value specifies the duration of timer t3. The timer t3 supervises the transition to FullCom. If the timer elapses the FrSM reports the production error FRSM_E_CLUSTER_STARTUP as failed. Restriction: The value of this parameter should be larger than the value of FrSMDurationT1 and FrSMDurationT2 parameter. | A value of 0 shall imply that the timer is not used. It shall only be possible to configure a value 0 if no FrNm is used.
        boolean FrSMIsColdstartEcu: set at post-build in variant post-build-selectable / pre-compile in variant pre-compile, default-value=false  # This parameter defines if the ECU is a coldstart node for this FlexRay cluster. | False: The ECU is no coldstart node for this FlexRay cluster.
        boolean FrSMIsWakeupEcu: set at post-build in variant post-build-selectable / pre-compile in variant pre-compile, default-value=false  # This parameter defines if the FrSM shall perform a wakeup for this cluster. | False: FrSM shall never perform a wakeup for this FlexRay cluster.
        float FrSMMainFunctionCycleTime: 0.001..65.534, set at pre-compile, default-value=0.005  # This parameter specifies the cycle time of the periodic calling of FrSM main function.
        integer FrSMMinNumberOfColdstarter [0..0]: 0..255, set at pre-compile, default-value=2  # Not supported! This value specifies the number of coldstarter that should not be underrun. If this parameter is not configured the mainfunction shall not check the number of startup frames.
        integer FrSMNumWakeupPatterns: 0..65535, set at post-build in variant post-build-selectable / pre-compile in variant pre-compile, default-value=1  # This value specifies the maximum number of Wakeup Patterns the node may send before going to FRSM_STARTUP. Restriction: A value of zero is not possible, because one Wakeup Pattern will be sent when the node enters FRSM_WAKEUP. In case the node is no WakeupEcu or has been woken by bus no Wakeup Pattern will be sent anyway independent of this value.
        integer FrSMStartupRepetitions [0..1]: 0..65535, set at post-build in variant post-build-selectable / pre-compile in variant pre-compile, default-value=10  # This value specifies the number of times an ECU may repeat the startup procedure for a FlexRay cluster.
        boolean FrSMStartupRepetitionsUnlimited: set at post-build in variant post-build-selectable / pre-compile in variant pre-compile, origin=Vector Informatik, default-value=false  # This parameter defines if the configuration item is enabled then the FrSM performs the start up sequence until: - the FlexRay controller is in state sync OR - the state request for FULL communication is rejected. The value of this attribute has some influence of the visibility and/or value of the following attributes: - FrSMDurationT1 - FrSMDurationT2 - FrSMStartupRepetitions - FrSMWakeupRepetitions Please refer to the FrSM Technical Reference for details.
        integer FrSMStartupRepetitionsWithWakeup [0..1]: 0..65535, set at post-build in variant post-build-selectable / pre-compile in variant pre-compile, default-value=0  # This value specifies the number of times an ECU may repeat the startup procedure including a wakeup for a FlexRay cluster.
        boolean FrSMStartupRepetitionsWithWakeupUnlimited: set at post-build in variant post-build-selectable / pre-compile in variant pre-compile, origin=Vector Informatik, default-value=false  # This parameter defines if the FrSM performs the start up sequence including a wakeup until: - the FlexRay controller is in state sync OR - the state request for FULL communication is rejected. The value of this attribute has some influence of the visibility and/or value of the following attributes: - FrSMDurationT1 - FrSMDurationT2 - FrSMStartupRepetitions - FrSMWakeupRepetitions - FrSMUnlimitedStartupRepetitions Please refer to the FrSM Technical Reference for details.
        float FrSMTrcvStdbyDelay [0..1]: 0..65.534, set at post-build in variant post-build-selectable / pre-compile in variant pre-compile, origin=Vector Informatik, default-value=0  # The transceiver will be set to STANDBY mode during shutdown. This action can be delayed by the value of this timer, to prevent unnecessary wake up in case a ECU has a delayed shutdown and the own transceiver generates wake up for all frame types. The value of this attribute has some influence of the visibility of the following attribute: FrSmEnableDelayedTrcvModeStandby The timer is a multiple of the FrSM cycle time. | A value of 0 shall imply that the timer is not used. It shall only be possible to configure a value 0 if no FrNm is used.
        float FrSMDurationT4 [0..1]: 0..65.534, set at post-build in variant post-build-selectable / pre-compile in variant pre-compile, origin=Vector Informatik, default-value=0.25  # This value specifies the duration of timer t4. The timer t4 provides the delay of clearing the coldstart inhibit mode (i.e. calling FrIf_AllowColdstart), in case of a DualChannelWakeup (i.e. FrSMIsDualChannelNode and NO_WU_BY_BUS). (The timer is only used if the ECU is a coldstart, a wake up and a dual channel node). Note: Usually the node which initiates the wake up should not initiate the cold start too. So the timer t4 should be seen as a fallback system. The timer t4 should be big enough that the other nodes are able to perform the cold start. Also there should be the chance to perform the coldstart sequence before the timer t2 elapse. Pay attention that the timer t4 is still running while the node performs the configured number of wake up attempts (FrSMNumWakeupPatterns) whereas the timer t2 is started after the wake up attempts are finished (transition to STARTED).
        symbolic name reference FrSMComMNetworkHandleRef: set at post-build in variant post-build-selectable / pre-compile in variant pre-compile, destination=ComMChannel  # ComM Network Handle Ref | Reference to the unique handle to identify one certain FlexRay network correspond to one of the network handles of the ComM configuration.
        symbolic name reference FrSMFrIfClusterRef: set at post-build in variant post-build-selectable / pre-compile in variant pre-compile, destination=FrIfCluster  # FrIf Cluster Ref | References the cluster configuration in the FlexRay Interface configuration. | Note that the assigned controllers and transceivers are defined in the FrIf configuration and can be accessed via this reference.
        container FrSMClusterDemEventParameterRefs [0..1]  # This container includes the references to DemEventParameter elements which shall be invoked using the API Dem_ReportErrorStatus in case the corresponding error occurs. The EventId is taken from the referenced DemEventParameter's DemEventId value. | The standardized errors are provided in this container and can be extended by vendor specific error references.
          symbolic name reference FRSM_E_CLUSTER_STARTUP [0..1]: set at pre-compile, destination=DemEventParameter  # Reference to the DemEventParameter which shall be issued when the error "FRSM_E_CLUSTER_STARTUP" has occured. If the reference is not configured the error is reported as DET error.
          symbolic name reference FRSM_E_CLUSTER_SYNC_LOSS [0..1]: set at pre-compile, destination=DemEventParameter  # Reference to the DemEventParameter which shall be issued when the error "FRSM_E_CLUSTER_SYNC_LOSS" has occurred. If the reference is not configured the error is reported as DET error.
    container FrSMGeneral  # General configuration parameters of the FrSM.
      boolean FrSMDevErrorDetect: set at pre-compile, default-value=true  # This parameter switches the Development Error Detection and Notification ON or OFF. true: Development error detection is enabled. false: Development error detection is disabled. Note: In general, the development error detection is recommended during pre-test phase. It is not recommended to enable the development error detection in production code due to increased runtime and ROM needs. | notification mechanism.
      function name FrSMSyncLossErrorIndicationName [0..1]: set at pre-compile, default-value=FrNm_StartupError  # This parameter defines the name of <Cdd>_SyncLossErrorIndication function that shall be called on loss of synchronization. If this parameter is omitted no indication shall take place.
      boolean FrSMVersionInfoApi: set at pre-compile, default-value=false  # This parameter enables/disables the function FrSM_GetVersionInfo() to get major, minor and patch version information.
      string FrSMUserConfigurationFile [0..1]: set at pre-compile, origin=Vector Informatik  # User Config File | Reference to an external user configuration file that will be included during generation. The content of the user configuration file will be added at the end of the generated module configuration file and allows altering or extending the generated code. Caution: User configuration files can cause the software module to malfunction and must only be used with great care!
      boolean FrSMEcuPassiveMode [0..1]: set at pre-compile, origin=Vector Informatik, default-value=false  # En-/ disable the ECU Passive Mode handling. In passive mode the FrSM sets the transceiver mode to RECEIVEONLY instead of setting it to NORMAL.
      boolean FrSMWakeupOnBothChannelsAllowed [0..1]: set at pre-compile, origin=Vector Informatik, default-value=false  # En-/disable Wake up on Both Channels If an ECU currently performing an "initial dual channel wake up" was not able to transmit a wakeup or it receives a wakeup frame from another node; the ECU changes the wake up channel to FR_CHANNEL_B and begins with the "wake up forwarding". If there is still a coldstart node missing, the "initial dual channel wake up ECU", waits the remaining Duration T4 and starts or joins the coldstart.
      boolean FrSMSafeBswChecks: set at pre-compile, origin=Vector Informatik, default-value=false  # Selects if safety checks are used. These checks improve robustness as e.g. invalid parameters are checked before function is executed. This attribute has to be enabled for safety projects where this component is mapped to an ASIL partition.
      container FrSMGeneration  # Contains the generation configuration parameters of the module FrSM.
        boolean FrSMOutOfBoundsWriteSanitizer: set at pre-compile, origin=Vector Informatik, default-value=false  # This parameter activates/deactivates the generation of runtime checks which call a DET error notification function to find easily out of bounds write problems. FALSE: no checks are generated in the data access. TRUE: the data access is enriched with DET checks to validate indexes.
        boolean FrSMOutOfBoundsReadSanitizer: set at pre-compile, origin=Vector Informatik, default-value=false  # This parameter activates/deactivates the generation of runtime checks which call a DET error notification function to find easily out of bounds read problems. FALSE: no checks are generated in the data access. TRUE: the data access is enriched with DET checks to validate indexes.
  module config FrSM_Pre: definition=FrSM
  module config FrSM_Rec: definition=FrSM
