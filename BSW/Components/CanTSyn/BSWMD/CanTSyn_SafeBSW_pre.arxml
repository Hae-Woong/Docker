AUTOSAR XML (schema 4-3-1)
package /MICROSAR
  module config CanTSyn_Rec: definition=CanTSyn
    CanTSynGeneral: CanTSynSafeBswChecks=1
