AUTOSAR XML (schema 4-3-1)
package /MICROSAR
  module definition CanTSyn [0..1]: category=VENDOR_SPECIFIC_MODULE_DEFINITION, post-build-variant-support=true, refined-module-def=CanTSyn, variants pre-compile  # The CAN Time Synchronization module (CanTSyn) handles the distribution of time information over CAN buses. #TimeSync #CAN #AUTOSAR
    container CanTSynGeneral: multiplicity set at pre-compile  # This container holds the general parameters of the CAN-specific Synchronized Time-base Manager
      boolean CanTSynDevErrorDetect: multiplicity set at pre-compile, set at pre-compile, default-value=true  # Switches the development error detection and notification on or off. | * true: detection and notification is enabled. * false: detection and notification is disabled.
      float CanTSynMainFunctionPeriod: 0..1, multiplicity set at pre-compile, set at pre-compile, default-value=0.01  # Schedule period of the main function CanTSyn_MainFunction.
      boolean CanTSynVersionInfoApi: multiplicity set at pre-compile, set at pre-compile, default-value=false  # Activate/Deactivate the version information API (CanTSyn_GetVersionInfo). True: version information API activated False: version information API deactivated.
      enumeration CanTSynMessageCompatibility: multiplicity set at pre-compile, origin=Vector Informatik, set at pre-compile, default-value=AR_4_3_X  # Switch between different message types. AR_4_2_X: Use message type as specified in Autosar 4.2.2 and below. AR_4_3_X: Use message type as specified in Autosar 4.3.0 and above.
        AR_4_2_X  # 4.2.x
        AR_4_3_X  # 4.3.x
      boolean CanTSynSafeBswChecks: multiplicity set at pre-compile, origin=Vector Informatik, set at pre-compile, default-value=false  # Selects if safety checks are used. These checks improve robustness as e.g. invalid parameters are checked before function is executed. This attribute has to be enabled for safety projects where this component is mapped to an ASIL partition.
    container CanTSynGlobalTimeDomain [1..*]: multiplicity set at pre-compile  # This represents the existence of a global time domain on CAN. The CanTSyn module can administrate several global time domains at the same time that in itself form a hierarchy of domains and sub-domains. | If the CanTSyn exists it is assumed that at least one global time domain exists.
      integer CanTSynGlobalTimeDomainId: 0..31, multiplicity set at pre-compile, set at pre-compile, default-value=0  # The global time domain ID.
      boolean CanTSynUseExtendedMsgFormat: multiplicity set at pre-compile, set at pre-compile, default-value=false  # Switches support for 16 Byte Timesync messages on or off (for CAN FD only) | * true: use 16 byte Timesync message formats (for CAN FD only). * false: use 8 byte Timesync message formats.
      symbolic name reference CanTSynSynchronizedTimeBaseRef: multiplicity set at pre-compile, set at pre-compile, requires-symbolic-name-value=true, destination=StbMSynchronizedTimeBase  # Mandatory reference to the required synchronized time-base.
      container CanTSynGlobalTimeFupDataIDList [0..1]: multiplicity set at pre-compile, post-build-variant-multiplicity=true  # The DataIDList for FUP messages ensures the identification of data elements due to CRC calculation process.
        container CanTSynGlobalTimeFupDataIDListElement [16..16]: multiplicity set at pre-compile  # Element of the DataIDList for FUP messages ensures the identification of data elements due to CRC calculation process.
          integer CanTSynGlobalTimeFupDataIDListIndex: 0..15, multiplicity set at pre-compile, post-build-variant-value=true, set at pre-compile, default-value=0  # Index of the DataIDList for FUP messages ensures the identification of data elements due to CRC calculation process.
          integer CanTSynGlobalTimeFupDataIDListValue: 0..255, multiplicity set at pre-compile, post-build-variant-value=true, set at pre-compile, default-value=0  # Value of the DataIDList for FUP messages ensures the identification of data elements due to CRC calculation process.
      container CanTSynGlobalTimeMaster [0..*]: multiplicity set at pre-compile, post-build-variant-multiplicity=true  # Configuration of the global time master. Each global time domain is required to have exactly one global time master. This master may or may not exist on the configured ECU.
        float CanTSynCyclicMsgResumeTime [0..1]: 0..4294967, multiplicity set at pre-compile, post-build-variant-value=true, set at pre-compile, default-value=0.01  # Defines the time where the 1st regular cycle time based message transmission takes place, after an immediate transmission before.
        float CanTSynGlobalTimeDebounceTime: 0..4294967, multiplicity set at pre-compile, post-build-variant-value=true, set at pre-compile, default-value=0.01  # This represents the configuration of a TX debounce time for SYNC, FUP, OFS and OFNS messages compared to a message before with the same PDU.
        enumeration CanTSynGlobalTimeTxCrcSecured: {CRC_NOT_SUPPORTED, CRC_SUPPORTED}, multiplicity set at pre-compile, post-build-variant-value=true, set at pre-compile, default-value=CRC_NOT_SUPPORTED  # This represents the configuration of whether or not CRC is supported.
        float CanTSynGlobalTimeTxPeriod: 0..4294967, multiplicity set at pre-compile, post-build-variant-value=true, set at pre-compile, default-value=0.01  # This represents configuration of the TX period.
        boolean CanTSynImmediateTimeSync: multiplicity set at pre-compile, post-build-variant-value=true, set at pre-compile, default-value=false  # Enables/Disables the cyclic polling of StbM_GetTimeBaseUpdateCounter() within CanTSyn_MainFunction().
        float CanTSynMasterConfirmationTimeout: 0..4294967, multiplicity set at pre-compile, post-build-variant-value=true, set at pre-compile, default-value=1  # This represents the confirmation timeout after transmission of a message.
        container CanTSynGlobalTimeMasterPdu: multiplicity set at pre-compile  # This container encloses the configuration of the PDU that is supposed to contain the global time information.
          integer CanTSynGlobalTimeMasterConfirmationHandleId: 0..65535, multiplicity set at pre-compile, set at pre-compile, symbolic-name-value=true, default-value=0  # This represents the handle ID of the PDU that contains the global time information.
          reference CanTSynGlobalTimePduRef: multiplicity set at pre-compile, post-build-variant-value=true, set at pre-compile, destination=Pdu  # This represents the reference to the Pdu taken to transmit the global time information. The global time master of a global time domain acts as the sender of the Pdu while all the time slaves are supposed to receive the Pdu.
      container CanTSynGlobalTimeOfnsDataIDList [0..1]: multiplicity set at pre-compile, post-build-variant-multiplicity=true  # The DataIDList for OFNS messages ensures the identification of data elements due to CRC calculation process.
        container CanTSynGlobalTimeOfnsDataIDListElement [16..16]: multiplicity set at pre-compile  # Element of the DataIDList for OFNS messages ensures the identification of data elements due to CRC calculation process.
          integer CanTSynGlobalTimeOfnsDataIDListIndex: 0..15, multiplicity set at pre-compile, post-build-variant-value=true, set at pre-compile, default-value=0  # Index of the DataIDList for OFNS messages ensures the identification of data elements due to CRC calculation process.
          integer CanTSynGlobalTimeOfnsDataIDListValue: 0..255, multiplicity set at pre-compile, post-build-variant-value=true, set at pre-compile, default-value=0  # Value of the DataIDList for OFNS messages ensures the identification of data elements due to CRC calculation process.
      container CanTSynGlobalTimeOfsDataIDList [0..1]: multiplicity set at pre-compile, post-build-variant-multiplicity=true  # The DataIDList for OFS messages ensures the identification of data elements due to CRC calculation process.
        container CanTSynGlobalTimeOfsDataIDListElement [16..16]: multiplicity set at pre-compile  # Element of the DataIDList for OFS messages ensures the identification of data elements due to CRC calculation process.
          integer CanTSynGlobalTimeOfsDataIDListIndex: 0..15, multiplicity set at pre-compile, post-build-variant-value=true, set at pre-compile, default-value=0  # Index of the DataIDList for OFS messages ensures the identification of data elements due to CRC calculation process.
          integer CanTSynGlobalTimeOfsDataIDListValue: 0..255, multiplicity set at pre-compile, post-build-variant-value=true, set at pre-compile, default-value=0  # Value of the DataIDList for OFS messages ensures the identification of data elements due to CRC calculation process.
      container CanTSynGlobalTimeSlave [0..1]: multiplicity set at pre-compile, post-build-variant-multiplicity=true  # Configuration of a global time slave. Each global time domain is required to have at least one time slave. The configured ECU may or may not represent a time slave.
        float CanTSynGlobalTimeFollowUpTimeout: 0..4294967, multiplicity set at pre-compile, post-build-variant-value=true, set at pre-compile, default-value=1  # Rx timeout for the follow-up message. This is only relevant for selected bus systems.
        integer CanTSynGlobalTimeSequenceCounterJumpWidth: 1..15, multiplicity set at pre-compile, post-build-variant-value=true, set at pre-compile, default-value=1  # The SequenceCounterJumpWidth specifies the maximum allowed gap of the Sequence Counter between two SYNC resp. two OFS messages.
        enumeration CanTSynRxCrcValidated: {CRC_IGNORED, CRC_NOT_VALIDATED, CRC_OPTIONAL, CRC_VALIDATED}, multiplicity set at pre-compile, post-build-variant-value=true, set at pre-compile, default-value=CRC_IGNORED  # Definition of whether or not validation of the CRC is supported.
        container CanTSynGlobalTimeSlavePdu: multiplicity set at pre-compile  # This container encloses the configuration of the PDU that is supposed to contain the global time information.
          integer CanTSynGlobalTimeSlaveHandleId: 0..65535, multiplicity set at pre-compile, set at pre-compile, symbolic-name-value=true, default-value=0  # This represents the handle ID of the PDU that contains the global time information.
          reference CanTSynGlobalTimePduRef: multiplicity set at pre-compile, post-build-variant-value=true, set at pre-compile, destination=Pdu  # This represents the reference to the Pdu taken to transmit the global time information. The global time master of a global time domain acts as the sender of the Pdu while all the time slaves are supposed to receive the Pdu.
      container CanTSynGlobalTimeSyncDataIDList [0..1]: multiplicity set at pre-compile, post-build-variant-multiplicity=true  # The DataIDList for SYNC messages ensures the identification of data elements due to CRC calculation process.
        container CanTSynGlobalTimeSyncDataIDListElement [16..16]: multiplicity set at pre-compile  # Element of the DataIDList for SYNC messages ensures the identification of data elements due to CRC calculation process.
          integer CanTSynGlobalTimeSyncDataIDListIndex: 0..15, multiplicity set at pre-compile, post-build-variant-value=true, set at pre-compile, default-value=0  # Index for the DataIDList for SYNC messages ensures the identification of data elements due to CRC calculation process.
          integer CanTSynGlobalTimeSyncDataIDListValue: 0..255, multiplicity set at pre-compile, post-build-variant-value=true, set at pre-compile, default-value=0  # Value of the DataIDList for SYNC messages ensures the identification of data elements due to CRC calculation process.
  bsw implementation CanTSyn_Impl: programming-language=C, sw-version=6.04.00, used-code-generator=DaVinci Configurator, vendor-id=30, ar-release-version=4.04.00, behavior=CanTSynBehavior, preconfigured-configuration=CanTSyn_Pre, recommended-configuration=CanTSyn_Rec, vendor-specific-module-def=CanTSyn
  module config CanTSyn_Pre: definition=CanTSyn
  module config CanTSyn_Rec: definition=CanTSyn
