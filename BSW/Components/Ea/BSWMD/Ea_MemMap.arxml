AUTOSAR XML (schema 00048)
# COPYRIGHT
# Copyright (c) 2022 by Vector Informatik GmbH. All rights reserved.
# This software is copyright protected and proprietary to Vector Informatik GmbH.
# Vector Informatik GmbH grants to you only those rights as set out in the license conditions.
package /MICROSAR
  bsw implementation Ea_Impl
    required-artifacts:
      dependency on artifact Ea_MemMap: category=MEMMAP, artifact-descriptor={short-label=Ea_MemMap.h, category=SWHDR}
    resource consumption ResourceConsumption
      7 x memory section:
        EA_CODE: sw-addrmethod=CODE, symbol=CODE
        EA_CONST_8: alignment=8, sw-addrmethod=CONST, symbol=CONST_8
        EA_CONST_UNSPECIFIED: alignment=UNSPECIFIED, sw-addrmethod=CONST, symbol=CONST_UNSPECIFIED
        EA_VAR_NO_INIT_INTERNAL_READ_BUFFER: alignment=32, sw-addrmethod=VAR_NO_INIT, symbol=VAR_NO_INIT_INTERNAL_READ_BUFFER
        EA_VAR_NO_INIT_INTERNAL_WRITE_BUFFER: alignment=32, sw-addrmethod=VAR_NO_INIT, symbol=VAR_NO_INIT_INTERNAL_WRITE_BUFFER
        EA_VAR_NO_INIT_UNSPECIFIED: alignment=UNSPECIFIED, sw-addrmethod=VAR_NO_INIT, symbol=VAR_NO_INIT_UNSPECIFIED
        EA_VAR_FAST_INIT_UNSPECIFIED: alignment=UNSPECIFIED, sw-addrmethod=VAR_FAST_INIT, symbol=VAR_FAST_INIT_UNSPECIFIED
