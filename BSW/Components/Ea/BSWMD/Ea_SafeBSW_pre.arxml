AUTOSAR XML (schema 4-0-3)
package /MICROSAR
  module config Ea_Rec: definition=Ea
    EaGeneral: EaSafeBswChecks=1
