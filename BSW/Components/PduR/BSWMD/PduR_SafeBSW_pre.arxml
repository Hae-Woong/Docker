AUTOSAR XML (schema 4-0-3)
package /MICROSAR
  module config PduR_Rec: definition=PduR
    PduRGeneral: PduRSafeBswChecks=1
