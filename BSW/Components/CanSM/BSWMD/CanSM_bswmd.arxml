AUTOSAR XML (schema 4-0-3)
# COPYRIGHT
# Copyright (c) 2024  by Vector Informatik GmbH. All rights reserved.
# This software is copyright protected and proprietary to Vector Informatik GmbH.
# Vector Informatik GmbH grants to you only those rights as set out in the license conditions.
package /MICROSAR
  bsw implementation CanSM_Impl: programming-language=C, sw-version=7.00.00, used-code-generator=DaVinci Configurator, vendor-id=30, ar-release-version=4.00.03, behavior=CanSMBehavior, preconfigured-configuration=CanSM_Pre, recommended-configuration=CanSM_Rec, vendor-specific-module-def=CanSM
  module definition CanSM [0..1]: category=VENDOR_SPECIFIC_MODULE_DEFINITION, refined-module-def=CanSM, variants pre-compile/post-build-selectable  # The CAN State Manager (CanSM) realizes a software layer between the Communication Manager (ComM) and the CAN Interface (CanIf). CanSM changes the communication modes of the configured CAN networks according to requests from the ComM module and and perfomes a bus-specific error handling (BusOff). #CAN #StateManager #ModeManagement #Startup #Shutdown #Wakeup #BusOff #AUTOSAR
    container CanSMConfiguration  # This container includes the global parameters of the CanSM and sub containers, which are for the CAN network specific configuration.
      integer CanSMModeRequestRepetitionMax: 0..255, set at post-build in variant post-build-selectable / pre-compile in variant pre-compile, default-value=10  # This value specifies the maximum amount of mode request repetitions without a respective mode indication from the CanIf module until the CanSM module reports a development error to the DET and tries to go back to No Communication.
      float CanSMModeRequestRepetitionTime: 0..65.535, set at post-build in variant post-build-selectable / pre-compile in variant pre-compile, default-value=0.1  # This value specifies the duration the CanSM module shall repeat mode change requests by using the API of the CanIf module.
      container CanSMManagerNetwork [0..*]  # This container includes the CAN network specific parameters of each CAN network
        integer CanSMBorCounterL1ToL2: 0..255, set at post-build in variant post-build-selectable / pre-compile in variant pre-compile, default-value=5  # This value specifies the number of bus-off events the bus-off recovery switches from level 1 (short recovery time) to level 2 (long recovery time).
        float CanSMBorTimeL1: 0..65.535, set at post-build in variant post-build-selectable / pre-compile in variant pre-compile, default-value=1  # This value specifies the duration of the bus-off recovery time in level 1 (short recovery time).
        float CanSMBorTimeL2: 0..65.535, configuration-class-affection=affection-kind=LT-AFFECTS-PB, set at post-build in variant post-build-selectable / pre-compile in variant pre-compile, default-value=3  # This value specifies the duration of the bus-off recovery time in level 2 (long recovery time).
        float CanSMBorTimeTxEnsured: 0..65.535, set at post-build in variant post-build-selectable / pre-compile in variant pre-compile, default-value=5  # This value specifies the duration of the bus-off event check. This check assesses, if the recovery has been successful after the recovery reenables the transmit path. If a new bus-off occurs during this time period, the CanSM assesses this bus-off as sequential bus-off without successful recovery. Because a bus-off only can be detected, when PDUs are transmitted, the time has to be great enough to ensure that PDUs are transmitted again (e. g. time period of the fastest cyclic transmitted PDU of the COM module / ComTxModeTimePeriodFactor).
        boolean CanSMBorTxConfirmationPolling: set at pre-compile, default-value=false  # This parameter defines if the CanSM polls the CanIf_GetTxConfirmationState API to decide on the bus-off state to be recovered instead of using the CanSMBorTimeTxEnsured parameter for this decision.
        symbolic name reference CanSMComMNetworkHandleRef: set at post-build in variant post-build-selectable / pre-compile in variant pre-compile, destination=ComMChannel  # ComM Network Handle Ref | Reference to one of the network handles configured in the ComM.
        symbolic name reference CanSMTransceiverId [0..1]: set at post-build in variant post-build-selectable / pre-compile in variant pre-compile, destination=CanIfTrcvCfg  # Reference to one of the transceivers managed by the CanIf module. Note: Pay attention that the Trcv has to be activated (/ActiveEcuC/CanTrcv/CanTrcvConfigSet/CanTrcvChannel[CanTrcvChannelUsed])
        container CanSMController [1..*]  # This container includes references to CAN controllers in the CanIf.
          symbolic name reference CanSMControllerId: set at post-build in variant post-build-selectable / pre-compile in variant pre-compile, destination=CanIfCtrlCfg  # Reference to one of the CAN controllers managed by the CanIf module.
        container CanSMDemEventParameterRefs [0..1]  # This container includes references to DemEventParameter elements which shall be invoked using the API Dem_ReportErrorStatus API in case the corresponding error occurs. The EventId is taken from the referenced DemEventParameter's DemEventId value. The standardized errors are provided in the container and can be extended by vendor specific error references.
          symbolic name reference CANSM_E_BUS_OFF [0..1]: set at post-build in variant post-build-selectable / pre-compile in variant pre-compile, destination=DemEventParameter  # Reference to configured DEM event to report bus off errors for this CAN network.
          symbolic name reference CANSM_E_MODE_REQUEST_TIMEOUT [0..1]: set at post-build in variant post-build-selectable / pre-compile in variant pre-compile, origin=Vector Informatik, destination=DemEventParameter  # Reference to configured DEM event to report mode request timeout errors for this CAN network. The error is triggered if the CanSM module has triggered the CanIf API calls more often than configured without getting the supposed mode indication callbacks. The DEM indication will substitute the DET. The CanSM does not clear the event (DEM_EVENT_STATUS_PASSED).
    container CanSMGeneral  # General configuration parameters of the CanSM.
      boolean CanSMDevErrorDetect: set at pre-compile, default-value=true  # This parameter switches the Development Error Detection and Notification ON or OFF. true: Development error detection is enabled. false: Development error detection is disabled. Note: In general, the development error detection is recommended during pre-test phase. It is not recommended to enable the development error detection in production code due to increased runtime and ROM needs.
      float CanSMMainFunctionTimePeriod: 0.001..65.535, set at pre-compile, default-value=0.010  # This value specifies the cycle time of the function CanSM_MainFunction.
      boolean CanSMVersionInfoApi: set at pre-compile, default-value=false  # This parameter enables/disables the function CanSM_GetVersionInfo() to get major, minor and patch version information. | true: version information API activated false: version information API deactivated
      boolean CanSmChangeBaudrateApi [0..1]: set at pre-compile, origin=Vector Informatik, default-value=false  # This parameter defines if the Can_ChangeBaudrate API is available. This Parameter must not be active if Can_SetBaudrate is used. Please note that the ChangeBaudrate API and this parameter are deprecated and will be removed in future releases (replaced with CanSMSetBaudrateApi) | If this parameter is set to true the Can_ChangeBaudrate API shall be supported. Otherwise the API is not supported.
      string CanSMUserConfigurationFile [0..1]: set at pre-compile, origin=Vector Informatik  # User Config File | Reference to an external user configuration file that will be included during generation. The content of the user configuration file will be added at the end of the generated module configuration file and allows altering or extending the generated code. Caution: User configuration files can cause the software module to malfunction and must only be used with great care!
      boolean CanSMBorCheckLevel: set at pre-compile, origin=Vector Informatik, default-value=false  # This parameter defines if the CanSM_CheckBorLevel API is available. The API provides information to the internal bus-off recovery level.
      boolean CanSMEcuPassiveMode [0..1]: set at pre-compile, origin=Vector Informatik, default-value=false  # This parameter enables/disables the ECU Passive Mode handling. In passive mode the CanSM sets the Tx PDU mode to OFFLINE_ACTIVE instead to ONLINE.
      boolean CanSMPreventBusSleepAtStartUp [0..1]: set at pre-compile, origin=Vector Informatik, default-value=false  # This parameter enables/disables the "Prevent Bus Sleep At Start Up" API. The API dispose the CanSM to skip the initial transition of the according CAN channel.
      boolean CanSMSetBaudrateApi [0..1]: set at pre-compile, origin=Vector Informatik, default-value=false  # This parameter enables/disables SetBaudrate functionality which allows changing the baud rate during runtime. The support of the Can_SetBaudrate API is optional. Must not be active if Can_ChangeBaudrate is used.
      function name CanSMGetBusOffDelayFunction [0..1]: set at pre-compile, origin=Vector Informatik, default-value=J1939Nm_GetBusOffDelay  # Function is called within the call context of the CanSM_ControllerBusOff indication. The second parameter can be used to substitute the TxOffline duration, If the parameter is of value 255 (0xFF) then the parameter's value is ignored and the TxOffline duration is set to the configured BorTime L1/L2. The second parameter value is in terms of number of CanSM MainFunction cycles. API: void FunctionName( NetworkHandleType NetworkHandle, uint8* OnlineDelayCyclesPtr ); Default: void J1939Nm_GetBusOffDelay( NetworkHandleType NetworkHandle, uint8* OnlineDelayCyclesPtr ); Note: If multiple modules are interested in this notification (e.g. J1939Nm, NmOsek or vCanIdps), the application shall provide a dispatcher function that forwards the function call to the corresponding module. Example: Configure the parameter to 'Appl_CanSM_GetBusOffDelay'. Then implement the following function in a C file of the Application: void Appl_CanSM_GetBusOffDelay( NetworkHandleType NetworkHandle, uint8* OnlineDelayCyclesPtr ) { if (NetworkHandle == 0u) { J1939Nm_GetBusOffDelay(NetworkHandle, OnlineDelayCyclesPtr); } else { NmOsek_CanSM_GetBusOffDelay(NetworkHandle, OnlineDelayCyclesPtr); } }
      function name CanSMBusOffEnd [0..1]: set at pre-compile, origin=Vector Informatik, default-value=J1939Nm_BusOffEnd  # Function is called when the PduMode is set to online after a bus-off recovers. API: void FunctionName( NetworkHandleType NetworkHandle ); Default: void J1939Nm_BusOffEnd( NetworkHandleType NetworkHandle ); Note: If multiple modules are interested in this notification (e.g. J1939Nm and NmOsek), the application shall provide a dispatcher function that forwards the function call to the corresponding module. Example: Configure the parameter to 'Appl_CanSM_BusOffEnd'. Then implement the following function in a C file of the Application: void Appl_CanSM_BusOffEnd( NetworkHandleType NetworkHandle ) { if (NetworkHandle == 0u) { J1939Nm_BusOffEnd(NetworkHandle); } else { NmOsek_CanSM_BusOffEnd(NetworkHandle); } }
      boolean CanSMSwiftTxTimeoutRecovery [0..1]: set at pre-compile, origin=Vector Informatik, default-value=true  # This parameter enables/disables alternativ mechanism for the Tx time out exception recovery. Only the controller is set in stop mode and back to started (instead of the entire shut down and re-start).
      boolean CanSMExtendedRamCheck [0..1]: set at pre-compile, origin=Vector Informatik, default-value=false  # This parameter enables/disables extended RAM check of the CAN registers and MsgBoxes. The RAM check is performed during shutdown. Potential errors are forwarded to the application. Further modifications of the CAN hardware will be stopped while an error of a CAN register is present.
      function name CanSMTxTimeoutEnd [0..1]: set at pre-compile, origin=Vector Informatik, default-value=Appl_TxTimeoutExceptionEnd  # Function is called at the end of the timeout exception handling. If a valid function name is configured the CanSM activates the "expanded" time out exception handling. The "expanded" time out exception handling is equal to the CanSMSwiftTxTimeoutRecovery followed by the configured end indication. In addition the CanSM executes the handling also if the Tx timeout exception is indicated in the states "SILENTCOM" or "BUS_OFF_CHECK". Default function prototype: void Appl_TxTimeoutExceptionEnd( NetworkHandleType NetworkHandle );
      boolean CanSMSafeBswChecks: set at pre-compile, origin=Vector Informatik, default-value=false  # Selects if safety checks are used. These checks improve robustness as e.g. invalid parameters are checked before function is executed. This attribute has to be enabled for safety projects where this component is mapped to an ASIL partition.
      container CanSMGeneration  # Contains the generation configuration parameters of the module CanSM.
        boolean CanSMOutOfBoundsWriteSanitizer: set at pre-compile, origin=Vector Informatik, default-value=false  # This parameter activates/deactivates the generation of runtime checks which call a DET error notification function to find easily out of bounds write problems. FALSE: no checks are generated in the data access. TRUE: the data access is enriched with DET checks to validate indexes.
        boolean CanSMOutOfBoundsReadSanitizer: set at pre-compile, origin=Vector Informatik, default-value=false  # This parameter activates/deactivates the generation of runtime checks which call a DET error notification function to find easily out of bounds read problems. FALSE: no checks are generated in the data access. TRUE: the data access is enriched with DET checks to validate indexes.
  module config CanSM_Pre: definition=CanSM
  module config CanSM_Rec: definition=CanSM
