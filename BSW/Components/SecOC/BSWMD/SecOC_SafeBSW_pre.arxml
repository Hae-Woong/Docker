AUTOSAR XML (schema 4-3-0)
package /MICROSAR
  module config SecOC_Rec: definition=SecOC
    SecOCGeneral: SecOCSafeBswChecks=1
