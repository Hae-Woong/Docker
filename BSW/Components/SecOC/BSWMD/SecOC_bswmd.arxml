AUTOSAR XML (schema 4-3-0)
package /MICROSAR
  module definition SecOC [0..1]: category=VENDOR_SPECIFIC_MODULE_DEFINITION, post-build-variant-support=true, refined-module-def=SecOC, variants post-build/pre-compile  # Secure Onboard Communication | The Secure Onboard Communication module provides a mechanism to authenticate and verify I-PDUs.
    container SecOCGeneral: multiplicity set at pre-compile  # Contains the general configuration parameters of the SecOC module.
      boolean SecOCDevErrorDetect: multiplicity set at pre-compile, set at pre-compile, default-value=true  # Pre-processor switch for enabling development error detection support. | * true: detection and notification is enabled. * false: detection and notification is disabled.
      boolean SecOCEnableForcedPassOverride: multiplicity set at pre-compile, set at pre-compile, default-value=false  # If SecOCEnableForcedPassOverride is set to true the API SecOC_VerifyStatusOverride accepts the overrideStatus Pass.
      boolean SecOcIgnoreVerificationResult: multiplicity set at pre-compile, set at pre-compile, default-value=false  # If set to true the result of the authentication process (e.g. MAC Verify) is ignored after the first try and the SecOC proceeds like the result was a success. The calculation of the authenticator is still done, only its result will be ignored. | - true: enabled (verification result is ignored). - false: disabled (verification result is NOT ignored).
      string SecOCMaxAlignScalarType: multiplicity set at pre-compile, set at pre-compile  # The scalar type which has the maximum alignment restrictions on the given platform. This type can be e.g. uint8, uint16 or uint32. This parameter is NOT used by the generator.
      enumeration SecOCQueryFreshnessValue: {CFUNC, RTE}, multiplicity set at pre-compile, set at pre-compile, default-value=CFUNC  # This parameter specifies if the freshness value shall be determined through a C-function (CDD) or a software component (SW-C). RTE The SecOC queries the freshness for every PDU to process using the Rte service port FreshnessManagement CFUNC The SecOC queries the freshness for every PDU to process using C function.
      function name SecOCVerificationStatusCallout [0..*]: multiplicity set at pre-compile, set at pre-compile  # Entry address of the customer specific call out routine which shall be invoked in case of a verification attempt.
      boolean SecOCVersionInfoApi: multiplicity set at pre-compile, set at pre-compile, default-value=false  # If true the SecOC_GetVersionInfo API is available.
      string SecOCUserConfigFile [0..1]: multiplicity set at pre-compile, origin=Vector Informatik, set at pre-compile  # Reference to an external user configuration file that will be included during generation. The content of the user configuration file will be added at the end of the generated module configuration file and allows altering or extending the generated code. Caution: User configuration files can cause the software module to malfunction and must only be used with great care!
      integer SecOCMaxMessageLinkerSizeOfRxPdus: 0..65535, multiplicity set at pre-compile, origin=Vector Informatik, set at pre-compile, default-value=0  # Max byte size of Message Linker used with Rx Secured Collection Pdus.
      boolean SecOCSafeBswChecks: multiplicity set at pre-compile, origin=Vector Informatik, set at pre-compile, default-value=false  # Selects if safety checks are used. These checks improve robustness as e.g. invalid parameters are checked before function is executed. This attribute has to be enabled for safety projects where this component is mapped to an ASIL partition.
      boolean SecOCPropagateOnlyFinalVerificationStatus: multiplicity set at pre-compile, origin=Vector Informatik, set at pre-compile, default-value=false  # This parameter Is used to specify if the verification status shall be reported only after the final determination of the verification status (TRUE) or on every verification attempt (FALSE).
      boolean SecOCEnableDevelopmentMode: multiplicity set at pre-compile, origin=Vector Informatik, set at pre-compile, default-value=false  # If the Development Mode is enabled the API SecOC_SetDevelopmentMode(True/False) is available. If the Development Mode is started with the API SecOC_SetDevelopmentMode(True) all received Pdus will be forwared to the Upper Layer, even if the verifcation fails.
      boolean SecOCUseGetRxFreshness: multiplicity set at pre-compile, origin=Vector Informatik, set at pre-compile, default-value=false  # This parameter enables the useage of the GetRxFreshness API.
      boolean SecOCUseGetRxFreshnessAuthData: multiplicity set at pre-compile, origin=Vector Informatik, set at pre-compile, default-value=false  # This parameter enables the useage of the GetRxFreshnessAuthData API.
      boolean SecOCUseGetTxFreshness: multiplicity set at pre-compile, origin=Vector Informatik, set at pre-compile, default-value=false  # This parameter enables the useage of the GetTxFreshness API.
      boolean SecOCUseGetTxFreshnessTruncData: multiplicity set at pre-compile, origin=Vector Informatik, set at pre-compile, default-value=false  # This parameter enables the useage of the GetTxFreshnessTruncData API.
      boolean SecOCUseSPduTxConfirmation: multiplicity set at pre-compile, origin=Vector Informatik, set at pre-compile, default-value=false  # This parameter enables the useage of the SPduTxConfirmation API.
      function name SecOCVerificationStatusCalloutWithSecuredPdu [0..*]: multiplicity set at pre-compile, origin=Vector Informatik, set at pre-compile  # Entry address of the customer specific call out routine which shall be invoked in case of a verification attempt. Compared to the SecOCVerificationStatusCallout this callout contains more detailed information about the received secured PDU and the freshness value.
      integer SecOCDefaultAuthenticationInformationPattern [0..1]: 0..255, multiplicity set at pre-compile, origin=Vector Informatik, post-build-variant-value=true, set at pre-compile  # Defines the key pattern which is used in case the fvm or csm returns a non-recoverrable error and development mode is enabled.
      boolean SecOCEnableCustomAuthenticationAPI: multiplicity set at pre-compile, origin=Vector Informatik, set at pre-compile, default-value=false  # Enable to do the authentication and verification in a customer callout. The authentication info must be calculated by the user in this callout and must be written to the corresponding pointer.
      boolean SecOCCanFdPadding: multiplicity set at pre-compile, origin=Vector Informatik, set at pre-compile, default-value=false  # Adds padding bytes after the MAC generation of a container PDU to prevent that the CAN driver adds padding bytes and removes the padding bytes before verification if TRUE.
      boolean SecOCRetryFailedTransmitRequest: multiplicity set at pre-compile, origin=Vector Informatik, set at pre-compile, default-value=true  # Retry transmit if lower layer reports an error
      boolean SecOCUseMSBAlignedTruncatedFreshnessValueInFvM: multiplicity set at pre-compile, origin=Vector Informatik, set at pre-compile, default-value=false  # This Parameter defines if the truncated freshness value that is passed to the FvM is MSB aligned or if it is passed byte array is LSB aligned. true: The truncated freshness value is MSB aligend false: The truncated freshness value is LSB aligned/value aligned
      boolean SecOCEnableAsyncCSMJobTimeout: multiplicity set at pre-compile, origin=Vector Informatik, set at pre-compile, default-value=false  # Enables the Timeout for asynchronous CSM Job calls.
      container SecOCSecurityEventRefs [0..1]: multiplicity set at pre-compile  # Container for the references to IdsMEvent elements representing the security events that the SecOC module shall report to the IdsM in case the coresponding security related event occurs (and if SecOCEnableSecurityEventReporting is set to "true"). The standardized security events in this container can be extended by vendor-specific security events.
        reference SECOC_SEV_FRESHNESS_NOT_AVAILABLE [0..1]: multiplicity set at pre-compile, origin=Vector Informatik, set at pre-compile, destination=IdsMEvent  # Failed to get freshness value from FvM.
        reference SECOC_SEV_MAC_VERIFICATION_FAILED [0..1]: multiplicity set at pre-compile, origin=Vector Informatik, set at pre-compile, destination=IdsMEvent  # MAC verification of a received PDU failed.
    container SecOCGeneration: multiplicity set at pre-compile  # Contains the generation configuration parameters of the module SecOC.
      enumeration SecOCOutOfBoundsWriteProtectionStrategy: multiplicity set at pre-compile, origin=Vector Informatik, set at pre-compile, default-value=NONE  # This parameter is used to configure a strategy to protect the code to write out of bounds. NONE: no protection strategy is generated in the data access. INDEX_SATURATION: arrays are blown up and the data access index is saturated by an appropriate mask. The advantage is the speed of the data access, but own data elements at other indexes of the same variable can be overridden. INDEX_CHECKING: the data access index is validated by a runtime check. The advantage is that values are never written to incorrect indexes of the data access.
        NONE  # none
        INDEX_SATURATION  # index saturation
        INDEX_CHECKING  # index checking
      boolean SecOCOutOfBoundsWriteSanitizer: multiplicity set at pre-compile, origin=Vector Informatik, set at pre-compile, default-value=false  # This parameter activates/deactivates the generation of runtime checks which call a DET error notification function to find easily out of bounds write problems. FALSE: no checks are generated in the data access. TRUE: the data access is enriched with DET checks to validate indexes.
      boolean SecOCOutOfBoundsReadSanitizer: multiplicity set at pre-compile, origin=Vector Informatik, set at pre-compile, default-value=false  # This parameter activates/deactivates the generation of runtime checks which call a DET error notification function to find easily out of bounds read problems. FALSE: no checks are generated in the data access. TRUE: the data access is enriched with DET checks to validate indexes.
      boolean SecOCShortSymbols: multiplicity set at pre-compile, origin=Vector Informatik, set at pre-compile, default-value=false  # This parameter activates/deactivates the capability to generate shortened symbol names. FALSE: symbol names are generated in a human readable style based on the MIP, tags and variant names. TRUE: symbol names are generated based on the MIP and a CRC32.
      boolean SecOCInterfacesForDeactivatedData: multiplicity set at pre-compile, origin=Vector Informatik, set at pre-compile, default-value=false  # This parameter activates/deactivates the capability to generate bsw data interfaces for deactivated data elements. This is an advantage for the BSW developer to reduce the time to market with a development environment using auto completition and to investigate potential interfaces. FALSE: data interfaces are not generated if the data elementis deactivated. TRUE: data interfaces are generated as e.g. emty macros.
      boolean SecOCReferringKeysInComments: multiplicity set at pre-compile, origin=Vector Informatik, set at pre-compile, default-value=false  # This parameter activates/deactivates the capability to generate referring keys in comments. This is an advantage for the developer to investigate indirections, but this feature reduces the overall readability of the generated data. FALSE: referring keys are not generated in comments. TRUE: referring keys are generated in comments.
    container SecOCRxPduProcessing [0..*]: multiplicity set at post-build in variant post-build / pre-compile in variant pre-compile, post-build-variant-multiplicity=true  # Contains the parameters to configure the RxPdus to be verified by the SecOC module.
      integer SecOCAuthDataFreshnessLen [0..1]: 0..65535, scope=ECU, multiplicity set at post-build in variant post-build / pre-compile in variant pre-compile, set at post-build in variant post-build / pre-compile in variant pre-compile  # The length of the external authentic PDU data in bits (uint16).
      integer SecOCAuthDataFreshnessStartPosition [0..1]: 0..65535, scope=ECU, multiplicity set at post-build in variant post-build / pre-compile in variant pre-compile, set at post-build in variant post-build / pre-compile in variant pre-compile  # This value determines the start position in bits (uint16) of the Authentic PDU that shall be passed on to the Freshness SWC. The bit position starts counting from the MSB of the first byte of the PDU.
      integer SecOCAuthenticationBuildAttempts: 0..65535, multiplicity set at pre-compile, set at post-build in variant post-build / pre-compile in variant pre-compile, default-value=1  # This parameter specifies the number of authentication build attempts.
      integer SecOCAuthenticationVerifyAttempts: 0..65535, multiplicity set at pre-compile, set at post-build in variant post-build / pre-compile in variant pre-compile, default-value=1  # This parameter specifies the number of authentication verify attempts that are to be carried out when the verification of the authentication information failed for a given Secured I-PDU. If zero is set, then only one authentication verification attempt is done.
      integer SecOCAuthInfoTxLength: 1..65535, multiplicity set at pre-compile, post-build-variant-value=true, set at post-build in variant post-build / pre-compile in variant pre-compile  # This parameter defines the length in bits of the authentication code to be included in the payload of the Secured I-PDU.
      integer SecOCDataId: 0..65535, multiplicity set at pre-compile, post-build-variant-value=true, set at post-build in variant post-build / pre-compile in variant pre-compile  # This parameter defines a unique numerical identifier for the Secured I-PDU.
      integer SecOCFreshnessValueId: 0..65535, multiplicity set at pre-compile, post-build-variant-value=true, set at post-build in variant post-build / pre-compile in variant pre-compile, default-value=0  # This parameter defines the Id of the Freshness Value. | The Freshness Value might be a normal counter or a time value.
      integer SecOCFreshnessValueLength: 0..256, multiplicity set at pre-compile, post-build-variant-value=true, set at post-build in variant post-build / pre-compile in variant pre-compile  # This parameter defines the complete length in bits of the Freshness Value. As long as the key doesn't change the counter shall not overflow. The length of the counter shall be determined based on the expected life time of the corresponding key and frequency of usage of the counter.
      integer SecOCFreshnessValueTxLength: 0..256, multiplicity set at pre-compile, post-build-variant-value=true, set at post-build in variant post-build / pre-compile in variant pre-compile  # This parameter defines the length in bits of the Freshness Value to be included in the payload of the Secured I-PDU. This length is specific to the least significant bits of the complete Freshness Counter. If the parameter is 0 no Freshness Value is included in the Secured I-PDU.
      enumeration SecOCReceptionOverflowStrategy: {REJECT, QUEUE}, multiplicity set at pre-compile, set at pre-compile, default-value=REJECT  # This parameter defines the overflow strategy for receiving PDUs
      integer SecOCReceptionQueueSize [0..1]: 0..65535, multiplicity set at pre-compile, set at pre-compile, default-value=0  # This parameter defines the queue size in case the overflow strategy for receiving PDUs is set to QUEUE.
      boolean SecOCUseAuthDataFreshness: scope=ECU, multiplicity set at pre-compile, set at post-build in variant post-build / pre-compile in variant pre-compile, default-value=false  # A Boolean value that indicates if a part of the Authentic-PDU shall be passed on to the SWC that verifies and generates the Freshness. If it is set to TRUE, the values SecOCAuthDataFreshnessStartPosition and SecOCAuthDataFreshnessLen must be set to specify the bit position and length within the Authentic-PDU.
      enumeration SecOCVerificationStatusPropagationMode: {BOTH, FAILURE_ONLY, NONE}, multiplicity set at pre-compile, post-build-variant-value=true, set at post-build in variant post-build / pre-compile in variant pre-compile, default-value=NONE  # This parameter is used to describe the propagation of the status of each verification attempt from the SecOC module to SWCs. BOTH: 'True' and 'False' verification status will be propagated. FAILURE_ONLY: Only 'False' verification status will be propagated, NONE: No verification status will be propagated.
      enumeration SecOCVerificationStatusWithSecuredPduPropagationMode: {BOTH, FAILURE_ONLY, NONE}, multiplicity set at pre-compile, origin=Vector Informatik, post-build-variant-value=true, set at post-build in variant post-build / pre-compile in variant pre-compile, default-value=NONE  # This parameter is used to describe the propagation of the status of each verification attempt from the SecOC module to SWCs. BOTH: 'True' and 'False' verification status will be propagated. FAILURE_ONLY: Only 'False' verification status will be propagated, NONE: No verification status will be propagated.
      boolean SecOCImmediateProcessingOfCsmCallback: multiplicity set at pre-compile, origin=Vector Informatik, set at pre-compile, default-value=false  # Enable, if the result of MACVerify/ MACGenerate shall be processed immediately in the context of the callback. This parameter is only relevant if CsmMacVerifyProcessing/ CsmMacGenerateProcessing is set to CSM_ASYNCHRONOUS. If disabled, the result of the callback will be processed in the context of the respective main function.
      enumeration SecOCPduProcessing: {DEFERRED, IMMEDIATE}, multiplicity set at pre-compile, origin=Vector Informatik, set at post-build in variant post-build / pre-compile in variant pre-compile, default-value=DEFERRED  # Processing type which determines if the request shall be processed within the interrupt context of the SecOC_RxIndication or within the task level of SecOC_MainFunctionRx. Set to - DEFERRED: Pdu is processed within the task context of the SecOC_MainFunctionRx API - IMMEDIATE: Pdu is processed within the interrupt context of the SecOC_RxIndication API
      float SecOCAsyncCSMJobTimeout [0..1]: 0..10, multiplicity set at post-build in variant post-build / pre-compile in variant pre-compile, origin=Vector Informatik, post-build-variant-multiplicity=true, post-build-variant-value=true, set at post-build in variant post-build / pre-compile in variant pre-compile, default-value=0  # Defines the maximum time the SecOC waits for an asynchronous CSM job to finish. If the timeout occurs the SecOC will cancel the CSM job and release the buffers inside the SecOC. If not configured or configured to 0 the SecOC waits infinit.
      enumeration SecOCClientServerVerificationStatusPropagationMode: {BOTH, FAILURE_ONLY, NONE}, multiplicity set at pre-compile, origin=Vector Informatik, set at pre-compile, default-value=NONE  # This parameter is used to determine the propagation of the verification status through the client/server interface to an SW-C. BOTH Both "TRUE" and "FALSE" AuthenticationStatus is propagated to SW-C FAILURE_ONLY Only "FALSE" Authentication Status is propagated to SW-C NONE No Authentication Status for this PDU is provided to SW-C
      symbolic name reference SecOCRxAuthServiceConfigRef: multiplicity set at pre-compile, set at post-build in variant post-build / pre-compile in variant pre-compile, requires-symbolic-name-value=true, destination=CsmJob  # This reference is used to define which crypto service function is called for authentication.
      reference SecOCSameBufferPduRef [0..1]: multiplicity set at pre-compile, set at pre-compile, destination=SecOCSameBufferPduCollection  # This reference is used to collect Pdus that are using the same SecOC buffer.
      reference SecOCRxPduMainFunctionRef [0..1]: multiplicity set at pre-compile, origin=Vector Informatik, set at pre-compile, destination=SecOCMainFunctionRx  # Reference to the SecOC_MainFunctionRx this PDU belongs to. Mandatory, if multiple main functions are defined.
      container SecOCRxAuthenticPduLayer: multiplicity set at pre-compile  # This container specifies the Pdu that is transmitted by the SecOC module to the PduR after the Mac was verified.
        enumeration SecOCPduType: {SECOC_IFPDU, SECOC_TPPDU}, multiplicity set at pre-compile, set at pre-compile, default-value=SECOC_IFPDU  # This parameter defines API Type to use for communication with PduR.
        reference SecOCRxAuthenticLayerPduRef: multiplicity set at pre-compile, post-build-variant-value=true, set at post-build in variant post-build / pre-compile in variant pre-compile, destination=Pdu  # Reference to the global Pdu.
      choice container SecOCRxSecuredPduLayer: multiplicity set at pre-compile  # Choice between normal Secured I-PDUs and Secured PDU Collections.
        container SecOCRxSecuredPdu [0..1]: multiplicity set at pre-compile  # This container specifies the Pdu that is received by the SecOC module from the PduR. For this Pdu the Mac verification is provided.
          integer SecOCRxSecuredLayerPduId: 0..65535, multiplicity set at pre-compile, set at pre-compile, symbolic-name-value=true, default-value=0  # PDU identifier assigned by SecOC module. Used by PduR for SecOC_PduRRxIndication.
          boolean SecOCSecuredRxPduVerification: multiplicity set at pre-compile, origin=Vector Informatik, post-build-variant-value=true, set at post-build in variant post-build / pre-compile in variant pre-compile, default-value=true  # If this parameter is set to FALSE no authentication of received secured PDU will be performed. - true: enabled (verification result is NOT ignored). - false: disabled (verification result is ignored).
          integer SecOCAuthPduHeaderLength [0..1]: 0..4, multiplicity set at pre-compile, origin=Vector Informatik, set at pre-compile, default-value=0  # This parameter indicates the length (in bytes) of the Secured I-PDU Header in the Secured I-PDU. The length of zero means there's no header in the PDU.
          reference SecOCRxSecuredLayerPduRef: multiplicity set at pre-compile, post-build-variant-value=true, set at post-build in variant post-build / pre-compile in variant pre-compile, destination=Pdu  # Reference to the global Pdu.
        container SecOCRxSecuredPduCollection [0..1]: multiplicity set at post-build in variant post-build / pre-compile in variant pre-compile  # This container specifies two Pdus that are received by the SecOC module from the PduR and a message linking between them. | SecOCRxAuthenticPdu contains the original Authentic I-PDU, i.e. the secured data, and the SecOCRxCryptographicPdu contains the Authenticator, i.e. the actual Authentication Information.
          boolean SecOCSecuredRxPduVerification: multiplicity set at pre-compile, origin=Vector Informatik, post-build-variant-value=true, set at post-build in variant post-build / pre-compile in variant pre-compile, default-value=true  # If this parameter is set to FALSE no authentication of received secured PDU will be performed. - true: enabled (verification result is NOT ignored). - false: disabled (verification result is ignored).
          container SecOCRxAuthenticPdu: multiplicity set at pre-compile  # This container specifies the Authentic Pdu that is received by the SecOC module from the PduR.
            integer SecOCRxAuthenticPduId: 0..65535, multiplicity set at pre-compile, set at pre-compile, symbolic-name-value=true, default-value=0  # PDU identifier of the Authentic I-PDU assigned by SecOC module. Used by PduR for SecOC_PduRRxIndication.
            integer SecOCAuthPduHeaderLength [0..1]: 0..4, multiplicity set at pre-compile, origin=Vector Informatik, set at pre-compile, default-value=0  # This parameter indicates the length (in bytes) of the Secured I-PDU Header in the Secured I-PDU. The length of zero means there's no header in the PDU.
            reference SecOCRxAuthenticPduRef: multiplicity set at pre-compile, post-build-variant-value=true, set at post-build in variant post-build / pre-compile in variant pre-compile, destination=Pdu  # Reference to the global Pdu.
          container SecOCRxCryptographicPdu: multiplicity set at pre-compile  # This container specifies the Cryptographic Pdu that is received by the SecOC module from the PduR.
            integer SecOCRxCryptographicPduId: 0..65535, multiplicity set at pre-compile, set at pre-compile, symbolic-name-value=true, default-value=0  # PDU identifier of the Cryptographic I-PDU assigned by SecOC module. Used by PduR for SecOC_PduRRxIndication.
            reference SecOCRxCryptographicPduRef: multiplicity set at pre-compile, post-build-variant-value=true, set at post-build in variant post-build / pre-compile in variant pre-compile, destination=Pdu  # Reference to the global Pdu.
          container SecOCUseMessageLink [0..1]: multiplicity set at post-build in variant post-build / pre-compile in variant pre-compile  # SecOC links an Authentic I-PDU and Cryptographic I-PDU together by repeating a specific part (Message Linker) of the Authentic I-PDU in the Cryptographic I-PDU.
            integer SecOCMessageLinkLen: 0..65535, multiplicity set at pre-compile, set at post-build in variant post-build / pre-compile in variant pre-compile, default-value=0  # Length of the Message Linker inside the Authentic I-PDU in bits.
            integer SecOCMessageLinkPos: 0..65535, multiplicity set at pre-compile, set at post-build in variant post-build / pre-compile in variant pre-compile, default-value=0  # The position of the Message Linker inside the Authentic I-PDU in bits.
      container SecOCRxPduSecuredArea [0..1]: multiplicity set at post-build in variant post-build / pre-compile in variant pre-compile  # This container specifies an area in the Authentic I-Pdu that will be the input to the Authenticator verification algorithm. If this container does not exist in the configuration the complete Authentic I-Pdu will be the input to the Authenticator verification algorithm.
        integer SecOCSecuredRxPduLength: 0..4294967294, multiplicity set at pre-compile, origin=Vector Informatik, post-build-variant-value=true, set at post-build in variant post-build / pre-compile in variant pre-compile  # This parameter defines the length (in bytes) of the area within the Pdu which is secured
        integer SecOCSecuredRxPduOffset: 0..4294967294, multiplicity set at pre-compile, origin=Vector Informatik, post-build-variant-value=true, set at post-build in variant post-build / pre-compile in variant pre-compile  # This parameter defines the start position (offset in bytes) of the area within the Pdu which is secured
    container SecOCSameBufferPduCollection [0..0]: multiplicity set at pre-compile  # SecOCBuffer configuration that may be used by a collection of Pdus. Note: This container is not used by the generator.
      integer SecOCBufferLength: 0..4294967295, multiplicity set at pre-compile, set at pre-compile  # This parameter defines the Buffer in bytes that is used by the SecOC module. Note: This parameter is not used by the generator.
    container SecOCTxPduProcessing [0..*]: multiplicity set at post-build in variant post-build / pre-compile in variant pre-compile, post-build-variant-multiplicity=true  # Contains the parameters to configure the TxPdus to be secured by the SecOC module.
      integer SecOCAuthenticationBuildAttempts: 1..65535, multiplicity set at pre-compile, set at post-build in variant post-build / pre-compile in variant pre-compile, default-value=1  # This parameter specifies the number of authentication build attempts.
      integer SecOCAuthInfoTxLength: 1..65535, multiplicity set at pre-compile, post-build-variant-value=true, set at post-build in variant post-build / pre-compile in variant pre-compile  # This parameter defines the length in bits of the authentication code to be included in the payload of the Secured I-PDU.
      integer SecOCDataId: 0..65535, multiplicity set at pre-compile, post-build-variant-value=true, set at post-build in variant post-build / pre-compile in variant pre-compile  # This parameter defines a unique numerical identifier for the Secured I-PDU.
      integer SecOCFreshnessValueId: 0..65535, multiplicity set at pre-compile, post-build-variant-value=true, set at post-build in variant post-build / pre-compile in variant pre-compile, default-value=0  # This parameter defines the Id of the Freshness Value. | The Freshness Value might be a normal counter or a time value.
      integer SecOCFreshnessValueLength: 0..256, multiplicity set at pre-compile, post-build-variant-value=true, set at post-build in variant post-build / pre-compile in variant pre-compile  # This parameter defines the complete length in bits of the Freshness Value. As long as the key doesn't change the counter shall not overflow. The length of the counter shall be determined based on the expected life time of the corresponding key and frequency of usage of the counter.
      integer SecOCFreshnessValueTxLength: 0..256, multiplicity set at pre-compile, post-build-variant-value=true, set at post-build in variant post-build / pre-compile in variant pre-compile  # This parameter defines the length in bits of the Freshness Value to be included in the payload of the Secured I-PDU. This length is specific to the least significant bits of the complete Freshness Counter. If the parameter is 0 no Freshness Value is included in the Secured I-PDU.
      boolean SecOCProvideTxTruncatedFreshnessValue: multiplicity set at pre-compile, set at post-build in variant post-build / pre-compile in variant pre-compile, default-value=false  # This parameter specifies if the Tx query freshness function provides the truncated freshness info instead of generating this by SecOC In this case, SecOC shall add this data to the Authentic PDU instead of truncating the freshness value.
      boolean SecOCUseTxConfirmation: multiplicity set at pre-compile, set at post-build in variant post-build / pre-compile in variant pre-compile, default-value=false  # A Boolean value that indicates if the function SecOC_SPduTxConfirmation shall be called for this PDU.
      boolean SecOCAddCANFDContainerPduPadding: multiplicity set at pre-compile, origin=Vector Informatik, set at post-build in variant post-build / pre-compile in variant pre-compile, default-value=false  # If enabled the SecOC adds the CAN FD padding after the Pdu was authenticated. Pdu Layout: Authentic Pdu | Padding | Truncated Freshness Value | Truncated Authenticater
      boolean SecOCImmediateProcessingOfCsmCallback: multiplicity set at pre-compile, origin=Vector Informatik, set at pre-compile, default-value=false  # Enable, if the result of MACVerify/ MACGenerate shall be processed immediately in the context of the callback. This parameter is only relevant if CsmMacVerifyProcessing/ CsmMacGenerateProcessing is set to CSM_ASYNCHRONOUS. If disabled, the result of the callback will be processed in the context of the respective main function.
      enumeration SecOCPduProcessing: {DEFERRED, IMMEDIATE}, multiplicity set at pre-compile, origin=Vector Informatik, set at post-build in variant post-build / pre-compile in variant pre-compile, default-value=DEFERRED  # Processing type which determines if the request shall be processed within the context of SecOC_Transmit or within the task level of SecOC_MainFunctionTx. Set to - DEFERRED: Pdu is processed within the task context of the SecOC_MainFunctionTx API - IMMEDIATE: Pdu is processed within the interrupt context of the SecOC_Transmit API
      float SecOCAsyncCSMJobTimeout [0..1]: 0..10, multiplicity set at post-build in variant post-build / pre-compile in variant pre-compile, origin=Vector Informatik, post-build-variant-multiplicity=true, post-build-variant-value=true, set at post-build in variant post-build / pre-compile in variant pre-compile, default-value=0  # Defines the maximum time the SecOC waits for an asynchronous CSM job to finish. If the timeout occurs the SecOC will cancel the CSM job and release the buffers inside the SecOC. If not configured or configured to 0 the SecOC waits infinit.
      reference SecOCSameBufferPduRef [0..1]: multiplicity set at pre-compile, set at pre-compile, destination=SecOCSameBufferPduCollection  # This reference is used to collect Pdus that are using the same SecOC buffer.
      symbolic name reference SecOCTxAuthServiceConfigRef: multiplicity set at pre-compile, set at post-build in variant post-build / pre-compile in variant pre-compile, requires-symbolic-name-value=true, destination=CsmJob  # This reference is used to define which crypto service function is called for authentication.
      reference SecOCTxPduMainFunctionRef [0..1]: multiplicity set at pre-compile, origin=Vector Informatik, set at pre-compile, destination=SecOCMainFunctionTx  # Reference to the SecOC_MainFunctionTx this PDU belongs to. Mandatory, if multiple main functions are defined.
      container SecOCTxAuthenticPduLayer: multiplicity set at pre-compile  # This container specifies the Pdu that is received by the SecOC module from the PduR. For this Pdu the Mac generation is provided.
        enumeration SecOCPduType: {SECOC_IFPDU, SECOC_TPPDU}, multiplicity set at pre-compile, set at pre-compile, default-value=SECOC_IFPDU  # This parameter defines API Type to use for communication with PduR.
        integer SecOCTxAuthenticLayerPduId: 0..65535, multiplicity set at pre-compile, set at pre-compile, symbolic-name-value=true, default-value=0  # PDU identifier assigned by SecOC module. Used by PduR for SecOC_PduRTransmit.
        reference SecOCTxAuthenticLayerPduRef: multiplicity set at pre-compile, post-build-variant-value=true, set at post-build in variant post-build / pre-compile in variant pre-compile, destination=Pdu  # Reference to the global Pdu.
      choice container SecOCTxSecuredPduLayer: multiplicity set at pre-compile  # This container specifies the Pdu that is transmitted by the SecOC module to the PduR after the Mac was generated.
        container SecOCTxSecuredPdu [0..1]: multiplicity set at pre-compile  # This container specifies one Pdu that is transmitted by the SecOC module to the PduR after the Mac was generated. This Pdu contains the cryptographic information.
          integer SecOCTxSecuredLayerPduId: 0..65535, multiplicity set at pre-compile, set at pre-compile, symbolic-name-value=true, default-value=0  # PDU identifier assigned by SecOC module. Used by PduR for confirmation (SecOC_PduRTxConfirmation) and for TriggerTransmit.
          enumeration SecOCPduType: {SECOC_IFPDU, SECOC_TPPDU}, multiplicity set at pre-compile, origin=Vector Informatik, set at pre-compile, default-value=SECOC_IFPDU  # This parameter defines API Type to use for communication with PduR.
          integer SecOCAuthPduHeaderLength [0..1]: 0..4, multiplicity set at pre-compile, origin=Vector Informatik, set at pre-compile, default-value=0  # This parameter indicates the length (in bytes) of the Secured I-PDU Header in the Secured I-PDU. The length of zero means there's no header in the PDU.
          reference SecOCTxSecuredLayerPduRef: multiplicity set at pre-compile, post-build-variant-value=true, set at post-build in variant post-build / pre-compile in variant pre-compile, destination=Pdu  # Reference to the global Pdu.
        container SecOCTxSecuredPduCollection [0..1]: multiplicity set at pre-compile  # This container specifies the Pdu that is transmitted by the SecOC module to the PduR after the Mac was generated. Two separate Pdus are transmitted to the PduR: | Authentic I-PDU and Cryptographic I-PDU.
          container SecOCTxAuthenticPdu: multiplicity set at pre-compile  # This container specifies the Authetic Pdu that is transmitted by the SecOC module to the PduR after the Mac was generated.
            integer SecOCTxAuthenticPduId: 0..65535, multiplicity set at pre-compile, set at pre-compile, symbolic-name-value=true, default-value=0  # PDU identifier of the Authentic I-PDU assigned by SecOC module. Used by PduR for confirmation (SecOC_PduRTxConfirmation) and for TriggerTransmit.
            integer SecOCAuthPduHeaderLength [0..1]: 0..4, multiplicity set at pre-compile, origin=Vector Informatik, set at pre-compile, default-value=0  # This parameter indicates the length (in bytes) of the Secured I-PDU Header in the Secured I-PDU. The length of zero means there's no header in the PDU.
            reference SecOCTxAuthenticPduRef: multiplicity set at pre-compile, post-build-variant-value=true, set at post-build in variant post-build / pre-compile in variant pre-compile, destination=Pdu  # Reference to the global Pdu.
          container SecOCTxCryptographicPdu: multiplicity set at pre-compile  # This container specifies the Cryptographic Pdu that is transmitted by the SecOC module to the PduR after the Mac was generated.
            integer SecOCTxCryptographicPduId: 0..65535, multiplicity set at pre-compile, set at pre-compile, symbolic-name-value=true, default-value=0  # PDU identifier of the Cryptographic I-PDU assigned by SecOC module. Used by PduR for confirmation (SecOC_PduRTxConfirmation) and for TriggerTransmit.
            reference SecOCTxCryptographicPduRef: multiplicity set at pre-compile, post-build-variant-value=true, set at post-build in variant post-build / pre-compile in variant pre-compile, destination=Pdu  # Reference to the global Pdu.
          container SecOCUseMessageLink [0..1]: multiplicity set at post-build in variant post-build / pre-compile in variant pre-compile  # SecOC links an Authentic I-PDU and Cryptographic I-PDU together by repeating a specific part (Message Linker) of the Authentic I-PDU in the Cryptographic I-PDU.
            integer SecOCMessageLinkLen: 0..65535, multiplicity set at pre-compile, set at post-build in variant post-build / pre-compile in variant pre-compile, default-value=0  # Length of the Message Linker inside the Authentic I-PDU in bits.
            integer SecOCMessageLinkPos: 0..65535, multiplicity set at pre-compile, set at post-build in variant post-build / pre-compile in variant pre-compile, default-value=0  # The position of the Message Linker inside the Authentic I-PDU in bits.
      container SecOCTxPduSecuredArea [0..1]: multiplicity set at post-build in variant post-build / pre-compile in variant pre-compile  # This container specifies an area in the Authentic I-Pdu that will be the input to the Authenticator generation algorithm. If this container does not exist in the configuration the complete Authentic I-Pdu will be the input to the Authenticator generation algorithm.
        integer SecOCSecuredTxPduLength: 0..4294967294, multiplicity set at pre-compile, origin=Vector Informatik, post-build-variant-value=true, set at post-build in variant post-build / pre-compile in variant pre-compile  # This parameter defines the length (in bytes) of the area within the Pdu which shall be secured
        integer SecOCSecuredTxPduOffset: 0..4294967294, multiplicity set at pre-compile, origin=Vector Informatik, post-build-variant-value=true, set at post-build in variant post-build / pre-compile in variant pre-compile  # This parameter defines the start position (offset in bytes) of the area within the Pdu which shall be secured
    container SecOCMainFunctionRx [0..*]: multiplicity set at pre-compile  # Each element of this container defines one instance of SecOC_MainFunctionRx.
      float SecOCMainFunctionPeriodRx: 0..3600, multiplicity set at pre-compile, origin=Vector Informatik, set at pre-compile, default-value=0.01  # Allows to configure the time for the respective MainFunction instance of the Rx path (as float in seconds).
      integer SecOCMainFunctionRxHandleId: 0..65535, multiplicity set at pre-compile, origin=Vector Informatik, set at pre-compile, symbolic-name-value=true, default-value=0  # The numerical value used as the ID of this MainFunctionRx.
      reference SecOCMainFunctionRxPartitionRef: multiplicity set at pre-compile, origin=Vector Informatik, set at pre-compile, destination=EcucPartition  # Reference to EcucPartition, where the according SecOC_MainFunction instance is assigned to.
    container SecOCMainFunctionTx [0..*]: multiplicity set at pre-compile  # Each element of this container defines one instance of SecOC_MainFunctionTx.
      float SecOCMainFunctionPeriodTx: 0..3600, multiplicity set at pre-compile, origin=Vector Informatik, set at pre-compile, default-value=0.01  # Allows to configure the time for the respective MainFunction instance of the Tx path (as float in seconds).
      integer SecOCMainFunctionTxHandleId: 0..65535, multiplicity set at pre-compile, origin=Vector Informatik, set at pre-compile, symbolic-name-value=true, default-value=0  # The numerical value used as the ID of this MainFunctionTx.
      reference SecOCMainFunctionTxPartitionRef: multiplicity set at pre-compile, origin=Vector Informatik, set at pre-compile, destination=EcucPartition  # Reference to EcucPartition, where the according SecOC_MainFunction instance is assigned to.
  bsw implementation SecOC_Impl: programming-language=C, sw-version=13.01.00, used-code-generator=DaVinci Configurator, vendor-id=30, ar-release-version=4.03.00, behavior=SecOCBehavior, preconfigured-configuration=SecOC_Pre, recommended-configuration=SecOC_Rec, vendor-specific-module-def=SecOC
  module config SecOC_Pre: definition=SecOC
  module config SecOC_Rec: definition=SecOC
