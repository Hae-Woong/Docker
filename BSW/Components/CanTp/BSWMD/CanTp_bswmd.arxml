AUTOSAR XML (schema 4-0-3)
package /MICROSAR
  module definition CanTp [0..1]: category=VENDOR_SPECIFIC_MODULE_DEFINITION, refined-module-def=CanTp, variants post-build-loadable/pre-compile/post-build-selectable  # CAN Transport Protocol. Provides segmentation(TX) and reassembly(RX) of data according ISO15765-2 for transferring large data objects via CAN bus. #ISO15765-2 #AUTOSAR
    container CanTpConfig  # This container includes the configuration parameters and sub containers of the AUTOSAR CanTp module. This container is a MultipleConfigurationContainer, i.e. this container and its sub-containers exist once per configuration set.
      float CanTpMainFunctionPeriod: 0..0.255, set at pre-compile, default-value=0.01  # This value specifies the call cycle for the CanTp MainFunction.
      container CanTpChannel [1..*]: post-build-changeable=true  # This container includes the configuration parameters of one CanTp channel.
        enumeration CanTpChannelMode: {CANTP_MODE_FULL_DUPLEX, CANTP_MODE_HALF_DUPLEX}, set at pre-compile, default-value=CANTP_MODE_FULL_DUPLEX  # This parameter defines whether this channel is half or full duplex. CANTP_MODE_FULL_DUPLEX: on one channel, reception and transmission can be performed simultaneously CANTP_MODE_HALF_DUPLEX: starting a new connection is only possible if on the same channel, the opposite direction is not active.
        enumeration CanTpChannelLowerLayer [0..1]: {CANTP_LOWER_LAYER_CANIF, CANTP_LOWER_LAYER_PDUR}, set at pre-compile, origin=Vector Informatik, default-value=CANTP_LOWER_LAYER_CANIF  # This parameter defines the lower layer of the N-SDUs grouped under this channel. The CanTp will use the functions provided by the selected lower layer.
        reference CanTpChannelEcucPartitionRef [0..1]: set at pre-compile, origin=Vector Informatik, destination=EcucPartition  # This parameter must not be changed manually. It is calculated automatically by the CanTp validation. The EcucPartition this Channel is assigned to. To change this value, assign all global Pdus referred by the Sdus of this channel (/EcucPduCollection/Pdu) to a (different) EcucPartition. This value is copied from 'Pdu/EcucPduDefaultPartitionRef' or 'Pdu/EcucPduDedicatedPartition/EcucPduDedicatedPartitionRef'.
        container CanTpRxNSdu [0..1]  # This container includes the configuration (parameters) needed for each CAN N-SDU that the CanTp module receives via this CanTpChannel.
          integer CanTpBs [0..1]: 0..255, set at post-build in variant post-build-loadable+post-build-selectable / pre-compile in variant pre-compile, default-value=8  # Block Size | This value specifies the maximum number of consecutive frames the CanTp receiver allows the sender to transmit before waiting for the next flow control frame.
          float CanTpNar [0..1]: 0..65.535, set at post-build in variant post-build-loadable+post-build-selectable / pre-compile in variant pre-compile, default-value=0.1  # N_Ar | This value specifies the N_Ar timeout. N_Ar is the time for transmission of a CAN frame on the receiver side.
          float CanTpNbr: 0..65.535, set at post-build in variant post-build-loadable+post-build-selectable / pre-compile in variant pre-compile, default-value=0.1  # N_Br | This value specifies the performance parameter N_Br. If wait frames have to be transmitted, the value of N_Br is used as delay between two FC.WAIT in order to prevent the transmitter side from running into an N_Bs timeout.
          float CanTpNcr [0..1]: 0..65.535, set at post-build in variant post-build-loadable+post-build-selectable / pre-compile in variant pre-compile, default-value=0.5  # N_Cr | This value specifies the N_Cr timeout. N_Cr is the time until reception of the next consecutive frame N-PDU. It must be larger than (N_As + N_Cs) of the transmission side.
          enumeration CanTpRxAddressingFormat: {CANTP_EXTENDED, CANTP_MIXED, CANTP_STANDARD, CANTP_MIXED29BIT, CANTP_NORMALFIXED, CANTP_CUSTOM}, set at pre-compile, default-value=CANTP_STANDARD  # This parameter defines the addressing format used by this Rx N-SDU. CANTP_STANDARD: Normal addressing format CANTP_EXTENDED: Extended addressing format CANTP_MIXED: Mixed 11 bit addressing format CANTP_MIXED29BIT: Mixed 29 bit addressing format CANTP_NORMALFIXED: Normal fixed addressing format CANTP_CUSTOM: Addressing format is individual and fully handled by an upper layer callout given in attribute CanTpSduCustomAddressingCallout of this Sdu.
          integer CanTpRxDl [0..1]: 0..65535, set at pre-compile, default-value=1  # Data Length | This AUTOSAR parameter is deprecated and no longer used by the CanTp. For CAN FD, the data length is set by the PduLength parameter of the referenced global N-PDU.
          integer CanTpRxNSduId: 0..65535, set at pre-compile, symbolic-name-value=true, default-value=0  # This value specifies the unique identifier used by the upper layer to call CanTp_CancelReceive, CanTp_ChangeParameter and CanTp_ReadParameter.
          enumeration CanTpRxPaddingActivation: {CANTP_OFF, CANTP_ON}, set at post-build in variant post-build-loadable+post-build-selectable / pre-compile in variant pre-compile, default-value=CANTP_ON  # This parameter defines if the Rx N-SDU uses padding or not. If padding is enabled, all received SFs, FFs and CFs are checked to have a DLC of 8. FCs to be transmitted are filled up to a length of 8 bytes.
          enumeration CanTpRxTaType: {CANTP_FUNCTIONAL, CANTP_PHYSICAL, CANTP_CANFD_FUNCTIONAL, CANTP_CANFD_PHYSICAL}, set at pre-compile, default-value=CANTP_FUNCTIONAL  # Declares the communication type of this Rx N-SDU. CANTP_FUNCTIONAL: Functional request type (CAN2.0) CANTP_PHYSICAL: Physical request type (CAN 2.0) CANTP_CANFD_FUNCTIONAL: Functional request type (CAN-FD) CANTP_CANFD_PHYSICAL: Physical request type (CAN-FD)
          integer CanTpRxWftMax [0..1]: 0..65535, set at post-build in variant post-build-loadable+post-build-selectable / pre-compile in variant pre-compile, default-value=15  # This value specifies how many flow control with status WAIT can be consecutively transmitted by the receiver. This value is local to the node and is not transmitted inside the flow control.
          float CanTpSTmin [0..1]: 0..3.402823E+38, set at post-build in variant post-build-loadable+post-build-selectable / pre-compile in variant pre-compile, default-value=0.02  # This value specifies the duration of the minimum time the CanTp sender shall wait between the transmissions of two consecutive frames. This value is transmitted by the receiver as part of FC.CTS
          string CanTpCustomAddressingCallout [0..1]: set at pre-compile, origin=Vector Informatik  # Callout to an upper layer enabling it to implement a fully custom addressing format in case CanTpRxAddressingFormat of this Sdu is CANTP_CUSTOM.
          reference CanTpRxNSduRef: set at pre-compile, destination=Pdu  # Reference to a Pdu in the COM-Stack to establish the communication with the upper layer communictaion module (CanTp to PduR).
          container CanTpNAe [0..1]  # Address Extension | This container includes the Address Extension parameter needed to configure each Rx N-SDU with CanTpAddressingFormat set to CanTpMixed.
            integer CanTpNAe: 0..255, set at post-build in variant post-build-loadable+post-build-selectable / pre-compile in variant pre-compile, default-value=0  # Address Extension | This value specifies the address extension value. It is only configured for mixed addressing.
          container CanTpNSa [0..1]  # Source Address | This container includes the parameters needed to configure each Rx N-SDU with CanTpAddressingFormat set to CanTpExtended.
            integer CanTpNSa: 0..255, set at post-build in variant post-build-loadable+post-build-selectable / pre-compile in variant pre-compile, default-value=0  # Source Address | This value specifies the transport protocol source address's value. It is only configured for extended addressing format.
          container CanTpNTa [0..1]  # Target Address | This container includes the parameters needed to configure each Rx N-SDU with CanTpAddressingFormat set to CanTpExtended.
            integer CanTpNTa: 0..255, set at post-build in variant post-build-loadable+post-build-selectable / pre-compile in variant pre-compile, default-value=0  # Target Address | This value specifies the transport protocol target address's value. It is only configured for extended addressing format.
          container CanTpRxNPdu  # This container includes the configuration for Rx N-PDU values and references.
            integer CanTpRxNPduId: 0..65535, set at pre-compile, symbolic-name-value=true, default-value=0  # This value specifies the Rx N-PDU identifier attached to the Rx N-SDU. It is used by the CanIf to report the reception of data CAN frames.
            reference CanTpRxNPduRef: set at pre-compile, destination=Pdu  # Reference to a Pdu in the COM-Stack to establish the communication with the lower layer communictaion module (CanIf to CanTp).
          container CanTpTxFcNPdu [0..1]  # This container includes the configuration for flow control N-PDU values and references.
            integer CanTpTxFcNPduConfirmationPduId: 0..65535, set at pre-compile, symbolic-name-value=true, default-value=0  # This value specifies the Tx N-PDU identifier attached to the Rx N-SDU. It is used by the CanIf to report the transmission of flow control CAN frames.
            reference CanTpTxFcNPduRef: set at pre-compile, destination=Pdu  # Reference to a Pdu in the COM-Stack to establish the communication with the lower layer communictaion module (CanTp to CanIf).
        container CanTpTxNSdu [0..1]  # This container includes the configuration (parameters) needed for each CAN N-SDU that the CanTp module transmits via this CanTpChannel.
          float CanTpNas: 0..65.535, set at post-build in variant post-build-loadable+post-build-selectable / pre-compile in variant pre-compile, default-value=0.1  # N_As | This value specifies the N_As timeout. N_As is the time for transmission of a CAN frame on the part of the sender.
          float CanTpNbs [0..1]: 0..65.535, set at post-build in variant post-build-loadable+post-build-selectable / pre-compile in variant pre-compile, default-value=0.5  # N_Bs | This value specifies the N_Bs timeout. N_Bs is the time until reception of the next flow control N-PDU. It must be larger than (N_Ar + N_Br) of the reception side
          float CanTpNcs: 0..65.535, set at post-build in variant post-build-loadable+post-build-selectable / pre-compile in variant pre-compile, default-value=0.2  # N_Cs | This value specifies the performance parameter N_Cs. N_Cs is defined as the maximum time between the transmission of two consecutive frames, which must be kept to avoid that the receiver side runs into an N_Cr timeout. This value is used as timeout if temporarily no buffer is available (not only between CFs, but also before SF and FF transmission).
          boolean CanTpTc: set at pre-compile, default-value=false  # Transmit Cancellation | This parameter defines if transmit cancellation is enabled or disabled for this Tx N-SDU. Note: to be able to activate the transmit cancellation individually for an Tx N-SDU, transmit cancellation must also be activated globally in CanTpGeneral.
          enumeration CanTpTxAddressingFormat: {CANTP_EXTENDED, CANTP_MIXED, CANTP_STANDARD, CANTP_MIXED29BIT, CANTP_NORMALFIXED, CANTP_CUSTOM}, set at pre-compile, default-value=CANTP_STANDARD  # This parameter defines the addressing format used by this Tx N-SDU. CANTP_STANDARD: Normal addressing format CANTP_EXTENDED: Extended addressing format CANTP_MIXED: Mixed 11 bit addressing format CANTP_MIXED29BIT: Mixed 29 bit addressing format CANTP_NORMALFIXED: Normal fixed addressing format CANTP_CUSTOM: Addressing format is individual and fully handled by an upper layer callout given in attribute CanTpSduCustomAddressingCallout of this Sdu.
          integer CanTpTxDl [0..1]: 0..65535, set at pre-compile, default-value=1  # Data Length | This AUTOSAR parameter is deprecated and no longer used by the CanTp. For CAN FD, the data length is set by the PduLength parameter of the referenced global N-PDU.
          integer CanTpTxNSduId: 0..65535, set at pre-compile, symbolic-name-value=true, default-value=0  # This value specifies the the unique identifier used by the upper layer to call CanTp_Transmit and CanTp_CancelTransmit.
          enumeration CanTpTxPaddingActivation: {CANTP_OFF, CANTP_ON}, set at post-build in variant post-build-loadable+post-build-selectable / pre-compile in variant pre-compile, default-value=CANTP_ON  # This parameter defines if the Tx N-SDU uses padding or not. If padding is enabled, all SFs, FFs and CFs to be transmitted are filled up to a length of 8 bytes. Received FCs are checked to have a DLC of 8.
          enumeration CanTpTxTaType: {CANTP_FUNCTIONAL, CANTP_PHYSICAL, CANTP_CANFD_FUNCTIONAL, CANTP_CANFD_PHYSICAL}, set at pre-compile, default-value=CANTP_FUNCTIONAL  # Declares the communication type of this Tx N-SDU. CANTP_FUNCTIONAL: Functional request type (CAN2.0) CANTP_PHYSICAL: Physical request type (CAN 2.0) CANTP_CANFD_FUNCTIONAL: Functional request type (CAN-FD) CANTP_CANFD_PHYSICAL: Physical request type (CAN-FD)
          string CanTpCustomAddressingCallout [0..1]: set at pre-compile, origin=Vector Informatik  # Callout to an upper layer enabling it to implement a fully custom addressing format in case CanTpTxAddressingFormat of this Sdu is CANTP_CUSTOM.
          reference CanTpTxNSduRef: set at pre-compile, destination=Pdu  # Reference to a Pdu in the COM-Stack to establish the communication with the upper layer communictaion module (PduR to CanTp).
          container CanTpNAe [0..1]  # Address Extension | This container includes the parameters needed to configure each Tx N-SDU with CanTpAddressingFormat set to CanTpMixed.
            integer CanTpNAe: 0..255, set at post-build in variant post-build-loadable+post-build-selectable / pre-compile in variant pre-compile, default-value=0  # Address Extension | This value specifies the address extension value. It is only configured for mixed addressing.
          container CanTpNSa [0..1]  # Source Address | This container includes the parameters needed to configure each Tx N-SDU with CanTpAddressingFormat set to CanTpExtended.
            integer CanTpNSa: 0..255, set at post-build in variant post-build-loadable+post-build-selectable / pre-compile in variant pre-compile, default-value=0  # Source Address | This value specifies the transport protocol source address's value. It is only configured for extended addressing format.
          container CanTpNTa [0..1]  # Target Address | This container includes the parameters needed to configure each Tx N-SDU with CanTpAddressingFormat set to CanTpExtended.
            integer CanTpNTa: 0..255, set at post-build in variant post-build-loadable+post-build-selectable / pre-compile in variant pre-compile, default-value=0  # Target Address | This value specifies the transport protocol target address's value. It is only configured for extended addressing format.
          container CanTpRxFcNPdu [0..1]  # This container includes the configuration for flow control N-PDU values and references.
            integer CanTpRxFcNPduId: 0..65535, set at pre-compile, symbolic-name-value=true, default-value=0  # This value specifies the Rx N-PDU identifier attached to the Tx N-SDU. It is used by the CanIf to report the reception of flow control CAN frames.
            reference CanTpRxFcNPduRef: set at pre-compile, destination=Pdu  # Reference to a Pdu in the COM-Stack to establish the communication with the lower layer communictaion module (CanIf to CanTp).
          container CanTpTxNPdu  # This container includes the configuration for Tx N-PDU values and references.
            integer CanTpTxNPduConfirmationPduId: 0..65535, set at pre-compile, symbolic-name-value=true, default-value=0  # This value specifies the Tx N-PDU identifier attached to the Tx N-SDU. It is used by the CanIf to report the transmission of data CAN frames.
            reference CanTpTxNPduRef: set at pre-compile, destination=Pdu  # Reference to a Pdu in the COM-Stack to establish the communication with the lower layer communictaion module (CanTp to CanIf).
      container CanTpEcucPartition [0..*]: post-build-changeable=true  # EcucPartition specific configuration parameters of the CanTp.
        integer CanTpNumRxChannels: set at post-build in variant post-build-loadable / pre-compile in variant post-build-selectable+pre-compile, default-value=1  # This value specifies the maximum number of Rx channels that can be active simultaneously. RESTRICTIONS: This setting only has an effect if "CanTpDynamicChannelAssignment" is enabled.
        integer CanTpNumTxChannels: set at post-build in variant post-build-loadable / pre-compile in variant post-build-selectable+pre-compile, default-value=1  # This value specifies the maximum number of Tx channels that can be active simultaneously. RESTRICTIONS: This setting only has an effect if "CanTpDynamicChannelAssignment" is enabled.
        reference CanTpEcucPartitionRef [0..1]: set at pre-compile, origin=Vector Informatik, destination=EcucPartition  # The EcucPartition this CanTpEcucPartition is assigned to.
    container CanTpGeneral  # General configuration parameters of the CanTp.
      boolean CanTpChangeParameterApi: set at pre-compile, default-value=false  # This parameter specifices if the API CanTp_ChangeParameterRequest is available.
      boolean CanTpDevErrorDetect: set at pre-compile, default-value=true  # Dev Error Detect | This parameter switches the Development Error Detection and Notification ON or OFF. true: Development error detection is enabled. false: Development error detection is disabled. Note: In general, the development error detection is recommended during pre-test phase. It is not recommended to enable the development error detection in production code due to increased runtime and ROM needs.
      integer CanTpPaddingByte: 0..255, set at pre-compile, default-value=204  # Padding Pattern | This value specifies the byte value used for the initialization of unused bytes. The default value specified by ISO 15765-2 is 0xCC.
      boolean CanTpReadParameterApi: set at pre-compile, default-value=false  # This parameter specifices if the API CanTp_ReadParameter is available.
      boolean CanTpVersionInfoApi: set at pre-compile, default-value=false  # This parameter enables/disables the function CanTp_GetVersionInfo() to get major, minor and patch version information.
      boolean CanTpSupportMultiPartition [0..1]: set at pre-compile, origin=Vector Informatik, default-value=false  # Enable, if multipartition capabilities are required.
      boolean CanTpPaddingActive: configuration-class-affection=affection-kind=PC-AFFECTS-LT-AND-PB, set at pre-compile, origin=Vector Informatik, default-value=true  # Padding Activation | This parameter defines if padding is globally enabled or disabled. By enabling this switch, each Rx/Tx N-SDU can be configured separately with or without padding. If this switch is disabled, then no padding can be used for any Rx/Tx N-SDU.
      boolean CanTpHavePaddingByte: configuration-class-affection=affection-kind=PC-AFFECTS-LT-AND-PB, set at pre-compile, origin=Vector Informatik, default-value=false  # Padding Byte Usage | This parameter defines if usage of the "Padding Pattern" is enabled or disabled. With this switch it can be specified if the unused bytes of a frame to be transmitted are filled up with the value specified as "CanTpPaddingPattern" (switch is ON) or if they are just filled up with random content (switch is OFF). Padding bytes are needed for CAN-FD frames, or if padding is activated for CAN2.0 frames and less then 8 bytes are required.
      boolean CanTpDynamicChannelAssignment [0..1]: configuration-class-affection=affection-kind=PC-AFFECTS-LT-AND-PB, set at pre-compile, origin=Vector Informatik, default-value=false  # This parameter defines if the restriction of the maximum number of simultaneously active Rx and Tx connections is enabled or disabled. If this switch is active, the maximum number of simultaneously active Rx and Tx connections will be restricted. Each connection will be dynamically assigned to a channel during runtime. This reduces memory consumption in configurations with a high number of connection. If this switch is disabled, all CanTp N-SDUs are statically assigned to a channel. All configured connections can be active at the same time.
      boolean CanTpEnableSplitMainFunction: configuration-class-affection=affection-kind=PC-AFFECTS-LT-AND-PB, set at pre-compile, origin=Vector Informatik, default-value=false  # Split Main Function | This parameter defines the usage of two separate tasks CanTp_MainFunctionTx and CanTp_MainFunctionRx instead of one single task. If enabled, the CanTp_MainFunction is split into two seperate tasks named CanTp_MainFunctionTx and CanTp_MainFunctionRx. Instead of calling one main function it can be more efficient to call the Rx and Tx side of the CanTp separately to accomplish an optimal task call sequence. The CanTp_MainFunction can still be used. It calls both separate tasks successively.
      string CanTpUserConfigFile [0..1]: configuration-class-affection=affection-kind=PC-AFFECTS-LT-AND-PB, set at pre-compile, origin=Vector Informatik, default-value=CanTp.ucf  # Reference to an external text file that will be included during generation to CanTp_Cfg.h. The content of the user configuration file will be added at the end of the generated module configuration file and allows altering or extending the generated code. Caution: User configuration files can cause the software module to malfunction and must only be used with great care!
      boolean CanTpOptimizeSingleRxBuffer [0..1]: configuration-class-affection=affection-kind=PC-AFFECTS-LT-AND-PB, set at pre-compile, origin=Vector Informatik, default-value=false  # Single Rx Buffer Optimization | This parameter activates or disables optimization for non-segmented Rx buffers. At the beginning of a reception, the CanTp requests the application to provide a buffer where to store the received data. If this buffer is always large enough to store the complete message, this option can be enabled to remove the code that handles segmented buffers. This will reduce memory and runtime consumption. If this option is disabled, the CanTp will support segmented buffers as required by AUTOSAR.
      boolean CanTpSupportStandardAddressing: configuration-class-affection=affection-kind=PC-AFFECTS-LT-AND-PB, set at pre-compile, origin=Vector Informatik, default-value=true  # Support Addressing Format 'Standard' | This parameter defines the support for Standard Addressing. For optimization purposes, the support can be disabled. For full AUTOSAR compatibility, this switch must be enabled.
      boolean CanTpSupportExtendedAddressing: configuration-class-affection=affection-kind=PC-AFFECTS-LT-AND-PB, set at pre-compile, origin=Vector Informatik, default-value=true  # Support Addressing Format 'Extended' | This parameter defines the support for Extended Addressing For optimization purposes, the support can be disabled. For full AUTOSAR compatibility, this switch must be enabled.
      boolean CanTpSupportMixed11Addressing: configuration-class-affection=affection-kind=PC-AFFECTS-LT-AND-PB, set at pre-compile, origin=Vector Informatik, default-value=true  # Support Addressing Format 'Mixed11' | This parameter defines the support for Mixed11 Addressing. For optimization purposes, the support can be disabled. For full AUTOSAR compatibility, this switch must be enabled.
      boolean CanTpSupportMixed29Addressing: configuration-class-affection=affection-kind=PC-AFFECTS-LT-AND-PB, set at pre-compile, origin=Vector Informatik, default-value=true  # Support Addressing Format 'Mixed29' | This parameter defines the support for Mixed29 Addressing. For optimization purposes, the support can be disabled. For full AUTOSAR compatibility, this switch must be enabled.
      boolean CanTpSupportNormalFixedAddressing: configuration-class-affection=affection-kind=PC-AFFECTS-LT-AND-PB, set at pre-compile, origin=Vector Informatik, default-value=true  # Support Addressing Format 'Normal Fixed' | This parameter defines the support for Normal Fixed Addressing. For optimization purposes, the support can be disabled. For full AUTOSAR compatibility, this switch must be enabled.
      boolean CanTpSupportCustomAddressing: configuration-class-affection=affection-kind=PC-AFFECTS-LT-AND-PB, set at pre-compile, origin=Vector Informatik, default-value=false  # Support Addressing Format 'Custom' | This parameter defines the support for Custom Addressing. For optimization purposes, the support can be disabled. For full AUTOSAR compatibility, this switch must be disabled.
      boolean CanTpOnlyNotifyInformedAppl: configuration-class-affection=affection-kind=PC-AFFECTS-LT-AND-PB, set at pre-compile, origin=Vector Informatik, default-value=true  # This parameter defines that the reception sequence will always be kept independent of the buffer provision return value, i.e. the PduR_CanTpRxIndication will always be called during a reception, even if the application has already returned that no buffer is available (BUFREQ_E_NOT_OK). This is the default behavior for AUTOSAR 4.0.3 or lower. When switched on, the RxIndication function will only be called if the corresponding buffer provision had returned a value different from BUFREQ_E_NOT_OK. This is the default behavior since AUTOSAR 4.1
      boolean CanTpRc: configuration-class-affection=affection-kind=PC-AFFECTS-LT-AND-PB, set at pre-compile, origin=Vector Informatik, default-value=false  # Receive Cancellation | This parameter defines whether Receive Cancellation is enabled or disabled. If this switch is disabled, the API 'CanTp_CancelReceiveRequest' is not available, reducing resource consumption.
      boolean CanTpTc: configuration-class-affection=affection-kind=PC-AFFECTS-LT-AND-PB, set at pre-compile, origin=Vector Informatik, default-value=false  # Transmit Cancellation | This parameter defines whether Transmit Cancellation is globally enabled or disabled. By enabling this switch, each Tx N-SDU can be configured separately with or without transmit cancellation. If this switch is disabled, the API 'CanTp_CancelTransmitRequest' is not available, reducing resource consumption.
      boolean CanTpEnableSynchronousTransmit [0..1]: configuration-class-affection=affection-kind=PC-AFFECTS-LT-AND-PB, set at pre-compile, origin=Vector Informatik, default-value=false  # Synchronous Transmission | If this option is enabled, the CanTp will try to get a buffer and to transmit the FF or SF directly from the context of CanTp_Transmit. Otherwise, buffer request and transmission will be done during the next CanTp_MainFunction call.
      boolean CanTpEnableConstantBS [0..1]: set at pre-compile, origin=Vector Informatik, default-value=true  # Constant Block Size | This parameter defines if the block size remains constant throughout a reception, or if it may be adjusted for each flow control transmission. In older version of the ISO15765-2, the flow control parameters of the first FC had to be constant throughout a reception. Since ISO 15765-2:2015, both behaviors are allowed. If this switch is enabled, the CanTp calculates the BS only once at the beginning of the reception. Otherwise, the BS is re-calculated for each flow control frame, based on the available buffer. Please note: If the communication partner sends different BS values during a transmission, by default they will be evaluated and used by the CanTp. (See also 'CanTpUseOnlyFirstFC')
      boolean CanTpUseOnlyFirstFc [0..1]: set at pre-compile, origin=Vector Informatik, default-value=false  # This parameter defines if during a transmission BS and STmin of all or only of the first FC.CTS are evaluated. In older version of the ISO15765-2, the parameters of the first FC had to be used throughout the transmission. Since ISO 15765-2:2015, both behaviors are allowed. If enabled, any valid flow control frame other than the first will only used for synchronizaton and trigger the transmission of the next block of data. Its BS and STMin value have no effect. If disabled, every flow control frame will be fully evaluated, i.e. changes to STmin and BS within one transmission will immediately have an effect.
      boolean CanTpEnableTransmitQueue [0..1]: set at pre-compile, origin=Vector Informatik, default-value=false  # Transmit Queue | This parameter enables or disables the use of a transmission queue to resolve conflicts when a Tx N-PDU is used by multiple connections. If this option is disabled, a connection will retry each task cycle to transmit a TxPdu that is already in use. If this option is enabled, the transmission request for a Tx N-PDU already in use will be stored in a queue. The queue entries are transmitted as soon as the ongoing transmission is completed. Note: this feature is mainly needed for extended or mixed11 addressing, when multiple connections use the same Tx N-PDU.
      boolean CanTpSupportLongFirstFrames [0..1]: set at pre-compile, origin=Vector Informatik, default-value=false  # This switch enables the support of an extended first frame definition, which have been introduced to the ISO15765-2 together with CAN-FD. If disabled, the default limitation of 4095 byte for CanTp messages applies. If enabled, the length of CanTp messages can be up to 4GB. Note: This feature does not depend on CAN-FD and works also with 8 byte CAN frames.
      boolean CanTpFlexibleDataRateSupport [0..1]: set at pre-compile, origin=Vector Informatik, default-value=false  # Support CAN-FD | If enabled, the CanTp supports CAN FD frames with more than 8 byte. The maximum length allowed for an N-PDU is configured by the PduLength parameter of the referenced global PDUs
      function name CanTpApplSTminStartFunction [0..1]: set at pre-compile, origin=Vector Informatik, default-value=Appl_StartSeparationTime  # STmin by Application callout | This parameter specifies a function which is called by the CanTp when separation time measurement between two CFs need to be started. The application has then the possibility to setup a timer and trigger transmission of the next CF by calling the API CanTp_StopSeparationTime(). Alternatively the application can reject the request to handle the separation time and leave it all to the CanTp. If this parameter is omitted, the separation time will always be handled internally by the CanTp.
      boolean CanTpRejectFcWithReservedStMin [0..1]: set at pre-compile, origin=Vector Informatik, default-value=false  # Reject FC.CTS with reserved STmin | According to ISO, flow control - ClearToSend frames with invalid STmin values (0x80-0xF0 and 0xFA-0xFF) are interpreted as STmin 0x7F (127ms). If this option is enabled, FC.CTS with invalid STmin values will lead to the termination of the currently ongoing transmission.
      boolean CanTpEnableDcmRequestDetect [0..1]: set at pre-compile, origin=Vector Informatik, default-value=false  # If this option is enabled, the Tp will call a function 'Dcm_OnRequestDetection' each time a mixed addressed first- or single frame is received, even if no valid RxSDU is addressed.
      boolean CanTpSafeBswChecks: set at pre-compile, origin=Vector Informatik, default-value=false  # Selects if safety checks are used. These checks improve robustness as e.g. invalid parameters are checked before function is executed. This attribute has to be enabled for safety projects where this component is mapped to an ASIL partition.
      enumeration CanTpSupportedLowerLayers [0..1]: {CANTP_LOWER_LAYER_CANIF, CANTP_LOWER_LAYER_PDUR, CANTP_LOWER_LAYER_CANIF_AND_PDUR}, configuration-class-affection=affection-kind=PC-AFFECTS-LT-AND-PB, set at pre-compile, origin=Vector Informatik, default-value=CANTP_LOWER_LAYER_CANIF  # This parameter defines which lower layers can be configured on each CanTpChannel during the pre-compile and post-build configuration phases.
      boolean CanTpGenericConnectionSupport [0..1]: set at pre-compile, default-value=false  # Enable support for the handling of generic connections using N-SDUs with MetaData. Requires CanTpDynIdSupport.
      boolean CanTpDynIdSupport [0..1]: set at pre-compile, default-value=false  # Enable support for dynamic ID handling via N-PDU MetaData. Supported only in combination with CanTpGenericConnectionSupport.
      string CanTpCustomAddressingCalloutHeaderFile [0..*]: set at pre-compile, origin=Vector Informatik, default-value=Appl_Cbk.h  # Defines header files for callback functions which shall be included in case upper layers implement a fully custom addressing format. Range of characters is 1.. 32. A CanTpCustomAddressingCalloutHeaderFile should be present only if at least one CanTpRxSdu or CanTpTxPdu is configured with CanTp[Rx|Tx]AddressingFormat CANTP_CUSTOM and a non-empty CanTpCustomAddressingCallout.
      boolean CanTpEnableNonStrictLengthCheck [0..1]: configuration-class-affection=affection-kind=PC-AFFECTS-LT-AND-PB, set at pre-compile, origin=Vector Informatik, default-value=false  # Non-Strict Length Check | If this option is enabled, the CanTp will accept reception of SF and last CF frames where the given CAN_DL has at least the minimum value, instead of enforcing CAN_DL matches exactly the value stated in ISO 15765-2:2016.
  bsw implementation CanTp_Impl: programming-language=C, sw-version=6.00.00, used-code-generator=DaVinci Configurator, vendor-id=30, ar-release-version=4.00.03, behavior=CanTpBehavior, preconfigured-configuration=CanTp_Pre, recommended-configuration=CanTp_Rec, vendor-specific-module-def=CanTp
  module config CanTp_Rec: definition=CanTp
  module config CanTp_Pre: definition=CanTp
