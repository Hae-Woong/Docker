AUTOSAR XML (schema 4-2-1)
package /MICROSAR
  module config E2EXf_Rec: definition=E2EXf
    XfrmGeneral: XfrmSafeBswChecks=1
