AUTOSAR XML (schema 4-2-1)
package /MICROSAR
  module definition E2EXf [0..1]: category=VENDOR_SPECIFIC_MODULE_DEFINITION, refined-module-def=Xfrm, variants pre-compile  # End to End Transformer (E2EXF) is used by the Runtime Environment (RTE) to ensure correct communication of safety related signals. It works by appending and checking an additional end to end header to bytestreams that are either sent directly or created by other transformers. #Transformer #Safety #RuntimeEnvironment #Communication #AUTOSAR
    container XfrmGeneral: multiplicity set at pre-compile  # Contains the general configuration parameters of the module.
      boolean XfrmDevErrorDetect: multiplicity set at pre-compile, set at pre-compile, default-value=true  # Switches the Development Error Detection and Notification ON or OFF. | true: Enabled false: Disabled
      boolean XfrmVersionInfoApi: multiplicity set at pre-compile, origin=Vector Informatik, set at pre-compile, default-value=false  # Activate/Deactivate the version information API. | True: version information API activated False: version information API deactivated
      boolean XfrmSafeBswChecks: multiplicity set at pre-compile, origin=Vector Informatik, set at pre-compile, default-value=false  # Selects if safety checks are used. These checks improve robustness as e.g. invalid parameters are checked before function is executed. This attribute has to be enabled for safety projects where this component is mapped to an ASIL partition.
      boolean XfrmLegacyStateMachine [0..1]: multiplicity set at pre-compile, origin=Vector Informatik, set at pre-compile, default-value=false  # If this parameter is set to true, E2E_SMConfigType is generated according to AUTOSAR 4.4 with only a single WindowSize field. Otherwise, E2E_SMConfigType is generated according to AUTOSAR 22-11 with additional fields for WindowSizeInit, WindowSizeInvalid, WindowSizeValid, ClearToInvalid and TransitToInvalid.
    container XfrmImplementationMapping [0..*]: multiplicity set at pre-compile  # For each transformer (TransformationTechnology) in a transformer chain (DataTransformation) which is applied to an ISignal it is necessary to specify the BswModuleEntry which implements it. This is the container to hold these mappings.
      foreign reference XfrmTransformerBswModuleEntryRef [0..1]: multiplicity set at pre-compile, set at pre-compile, destination-type=BSW-MODULE-ENTRY  # Reference to the BswModuleEntry which implements the referenced transformer on the sending/calling side.
      foreign reference XfrmInvTransformerBswModuleEntryRef [0..1]: multiplicity set at pre-compile, set at pre-compile, destination-type=BSW-MODULE-ENTRY  # Reference to the BswModuleEntry which implements the referenced inverse transformer on the receiving/called side.
      foreign reference XfrmTransformationTechnologyRef: multiplicity set at pre-compile, set at pre-compile, destination-type=TRANSFORMATION-TECHNOLOGY  # Reference to the TransformationTechnology in the DataTransformation of the system description for which the implementation (BswModuleEntry) shall be mapped.
      instance reference XfrmVariableDataPrototypeInstanceRef [0..1]: multiplicity set at pre-compile, set at pre-compile, destination-context=SW-COMPONENT-PROTOTYPE PORT-PROTOTYPE, destination-type=VARIABLE-DATA-PROTOTYPE  # Instance Reference to a VariableDataPrototype in case a dedicated transformer BswModuleEntry is required per VariableDataPrototype access.
      container XfrmDemEventParameterRefs [0..1]: multiplicity set at pre-compile  # Container for the references to DemEventParameter elements which shall be invoked using the API Dem_ReportErrorStatus API in case the corresponding error occurs. The EventId is taken from the referenced DemEventParameter's DemEventId value. The standardized errors are provided in the container and can be extended by vendor specific error references.
        symbolic name reference XFRM_E_MALFORMED_MESSAGE [0..1]: multiplicity set at pre-compile, set at pre-compile, destination=DemEventParameter  # Reference to configured DEM event to report if malformed messages were received by the transformer.
      container XfrmSignal: multiplicity set at pre-compile  # Reference to the signal in the system description that transports the transformed data.
        choice container XfrmSignalChoice: multiplicity set at pre-compile  # Choice whether an ISignal or an ISignalGroup shall be referenced.
          container XfrmISignalGroupRefChoice [0..1]: multiplicity set at pre-compile  # Reference to the ISignalGroup in the system description that transports the transformed data.
            foreign reference XfrmISignalGroupRef: multiplicity set at pre-compile, set at pre-compile, destination-type=I-SIGNAL-GROUP  # Reference to the ISignalGroup in the system description that transports the transformed data.
          container XfrmISignalRefChoice [0..1]: multiplicity set at pre-compile  # Reference to the ISignal in the system description that transports the transformed data.
            foreign reference XfrmISignalRef: multiplicity set at pre-compile, set at pre-compile, destination-type=I-SIGNAL  # Reference to the ISignal in the system description that transports the transformed data.
  bsw implementation E2EXf_Impl: programming-language=C, sw-version=4.37.00, used-code-generator=DaVinci Configurator, vendor-id=30, ar-release-version=4.03.01, behavior=E2EXfBehavior, preconfigured-configuration=E2EXf_Pre, recommended-configuration=E2EXf_Rec, vendor-specific-module-def=E2EXf
  module config E2EXf_Pre: definition=E2EXf
  module config E2EXf_Rec: definition=E2EXf
