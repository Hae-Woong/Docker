[part 2 of 2: package /MICROSAR]
AUTOSAR XML (schema 4-1-2)
package /MICROSAR  (continued)
  module definition Dem [0..1]: category=VENDOR_SPECIFIC_MODULE_DEFINITION, refined-module-def=Dem, variants pre-compile/post-build-loadable/post-build-selectable  (continued)
    container DemGeneral  # This container groups the constant configuration options, e.g. options that can not have different values in multiple configurations.
      enumeration DemAgingCycleCounterProcessing: {DEM_PROCESS_AGINGCTR_EXTERN, DEM_PROCESS_AGINGCTR_INTERN}, scope=ECU, set at pre-compile, default-value=DEM_PROCESS_AGINGCTR_INTERN  # AgingCycle Counter Processing | This parameter is obsolete and ignored, since no DemAgingCycle is supported. The same functionality can be achieved with operation cycles.
      boolean DemAgingRequieresTestedCycle: scope=ECU, set at pre-compile, default-value=false  # Defines if the aging cycle counter is processed every aging cycles or if only tested aging cycle are considered. (Not supported, please use DemGeneral/DemAgingBehavior instead)
      enumeration DemAvailabilitySupport: {DEM_EVENT_AVAILABILITY, DEM_NO_AVAILABILITY}, set at pre-compile, default-value=DEM_NO_AVAILABILITY  # This configuration switch defines, whether support for runtime configuration of the availability of events is enabled or not. If enabled, a corresponding API for switching availability of events at runtime is provided.
      boolean DemAvailabilityStorage: set at pre-compile, origin=Vector Informatik, default-value=false  # This configuration switch defines, whether runtime changes of the event's availability are persisted in NVRAM. If this option is disabled, changing the event availability is not persisted and API Dem_SetEventAvailable() will work as described in the AUTOSAR SWS. When activating this feature, the configuration needs an additional NV-RAM block with DemNvRamBlockIdType "DEM_NVBLOCK_AVAILABILITY". The referenced NV block must be configured to hold the configured number of DemEventParameter containers + 1, divided by 8, fraction rounded up to integer. Enabling this option will prevent API Dem_SetEventAvailable() from working before Dem_Init(), as the NV data must be restored first. If this option is enabled, you also need DemGeneral/DemAvailabilitySupport == TRUE - otherwise the availability is not persisted in NVRAM.
      integer DemBswErrorBufferSize: 0..255, scope=ECU, set at pre-compile, default-value=0  # BswError Buffer Size | Dem processing queue size. (This parameter is no longer supported. The number of events, which can be queued, is not limited to this parameter value.) The Dem will process qualified events (Failed/Passed) during the next task cycle. This value specifies how many events can be queued. When this queue overflows you will not lose reports, but the surplus events are not processed in reporting order. Also run-time is greately increased as surplus events need to be searched for the pending event change. A sufficient queue size can not be deduced from the Dem configuration, you need to analyze how your system reports events: set the size to the maximum amount of monitors that may report a qualified result (e.g. finish debouncing) during a single task cycle of the Dem. With queue overflow the run time of the Dem_MainFunction can spike, so you need to verify its run-time does not exceed your system limit (e.g. causes a task overflow) when the maximum amount of your monitors qualify at the same time.
      enumeration DemClearDTCBehavior: {DEM_CLRRESP_NONVOLATILE_FINISH, DEM_CLRRESP_NONVOLATILE_TRIGGER, DEM_CLRRESP_VOLATILE}, scope=ECU, set at pre-compile, default-value=DEM_CLRRESP_VOLATILE  # ClearDTC Behavior | Select the point in time a clear DTC request will result in a positive response from the Dcm. VOLATILE: The Dem will clear all DTCs in RAM before the API Dem_ClearDTC returns a final result to the Dcm. If power is cut right after that and your ECU does not allow for a controlled shut down in that case, DTCs will still be visible after the ECU restarts. NONVOLATILE_TRIGGER: ClearDTC will return a final result after the NvM has been informed about the modification. This setting is not supported by this implementation. NONVOLATILE_FINISH: ClearDTC will return a final result only after the NvM has finished persisting the cleared state of DTCs. Depending on your NV system this can result in several seconds of NRC $78 - response pending. On the upside, if power is cut after the positive response, all DTCs remain cleared.
      enumeration DemClearDTCLimitation: {DEM_ALL_SUPPORTED_DTCS, DEM_ONLY_CLEAR_ALL_DTCS, DEM_ONLY_CLEAR_OBDII_AND_ALL_DTCS, DEM_ONLY_CLEAR_SINGLE_AND_ALL_DTCS, DEM_ONLY_CLEAR_EMISSIONS_SYSTEM_GROUP_AND_ALL_DTCS}, scope=ECU, set at pre-compile, default-value=DEM_ALL_SUPPORTED_DTCS  # Defines the supported Dem_{...}ClearDTC API scope. ALL_SUPPORTED_DTCS: The API accepts all supported DTC values, as well as all DTC values which are configured in DemGroupDTCs and DEM_DTC_GROUP_ALL_DTCS (default). ONLY_CLEAR_ALL_DTCS: The API accepts ClearAllDTCs only (DTC Group 0xFFFFFF). ONLY_CLEAR_OBDII_AND_ALL_DTCS: The API accepts ClearAllDTCs only (DTC Groups 0x000000, 0xFFFFFF) in OBDII configuration variants. ONLY_CLEAR_SINGLE_AND_ALL_DTCS: The API accepts DTC numbers and ClearAllDTCs (DTC Group, 0xFFFFFF). ONLY_CLEAR_EMISSIONS_SYSTEM_GROUP_AND_ALL_DTCS: The API accepts ClearAllDTCs only (DTC Groups 0xFFFF33, 0xFFFFFF) in WWHOBD, OBD on UDS and ZEV on UDS configuration variants.
      enumeration DemDataElementDefaultEndianness: {BIG_ENDIAN, LITTLE_ENDIAN, OPAQUE}, set at pre-compile, default-value=LITTLE_ENDIAN  # Defines the default endianness of the data belonging to a data element which is applicable if the DemExternalSRDataElementClass does not define a endianness. (not supported)
      boolean DemDebounceCounterBasedSupport: scope=ECU, set at pre-compile, default-value=true  # Debounce CounterBased Support | This configuration switch defines, whether support for counter based debouncing is enabled or not (see DemConfigSet/DemEventParameter/DemDebounceAlgorithmClass/DemDebounceCounterBased/DemDebounceCounterBasedClassRef). If events are configured to use counter based debouncing, this option must be enabled.
      boolean DemDebounceTimeBasedSupport: scope=ECU, set at pre-compile, default-value=false  # Debounce TimeBased Support | This configuration switch defines, whether support for time based debouncing is enabled or not (see DemConfigSet/DemEventParameter/DemDebounceAlgorithmClass/DemDebounceTimeBased/DemDebounceTimeBasedClassRef). If events are configured to use timer based debouncing, this option must be enabled.
      boolean DemDevErrorDetect: set at pre-compile, default-value=true  # Development Error Detect | Activate/Deactivate the Development Error Detection and Notification. If this option is enabled, integration errors are reported to the DET module (e.g. calling APIs with invalid arguments that would cause a malfunction of the Dem module). In a production system this option can be disabled as all code should be tested to correctly use the Dem API.
      integer DemDtcStatusAvailabilityMask: 0..255, scope=ECU, set at pre-compile in variant post-build-loadable+pre-compile / post-build in variant post-build-selectable, default-value=255  # DTC StatusAvailabilityMask | Mask for the supported DTC status bits of the Dem. This mask is used by UDS service 0x19. Internally, all status bits are supported as required by the Dem specification. This internal status byte is used e.g. for internal event notification callout functions. Externally, all status bits are ANDed with this mask, e.g. for diagnostic services like 0x19 or DTC status change notifications. This mask is also reported as status availability mask in the respective 0x19 subfunctions.
      boolean DemEnableConditionSupport: scope=ECU, set at pre-compile, default-value=false  # EnableCondition Support | This configuration switch defines, whether support for enable conditions is enabled or not. If enable conditions are set up for events (DemConfigSet/DemEventParameter/DemEventClass/DemEnableConditionGroupRef) this option must be enabled.
      enumeration DemEventCombinationSupport: {DEM_EVCOMB_DISABLED, DEM_EVCOMB_TYPE1, DEM_EVCOMB_TYPE2, DEM_EVCOMB_TYPE3}, scope=ECU, set at pre-compile, default-value=DEM_EVCOMB_DISABLED  # Merge several events to one specific DTC and a combined UDS DTC status byte. DISABLED: No event combination is supported. TYPE1: Multiple events can be combined to a single DTC. The events are combined on storage as specified in AUTOSAR. TYPE2: Multiple events can be combined to a single DTC. The events are combined on retrieval as specified in AUTOSAR. TYPE3: This type of event combination is only relevant if OBDonUDS is supported in at least one configuration variant. For configuration variants without OBDonUDS support: - The behavior of all DTCs corresponds to event combination TYPE1. For configuration variants with OBDonUDS support: - The calculation of the DTC status of OBD relevant DTCs deviates from TYPE1. It corresponds to the behavior specified in the Digital Annex of SAE J1979. - The behavior of DTCs that are not OBD relevant still corresponds to TYPE1.
      enumeration DemEventDisplacementStrategy: {DEM_DISPLACEMENT_FULL, DEM_DISPLACEMENT_NONE, DEM_DISPLACEMENT_PRIO_OCC, DEM_DISPLACEMENT_LEGACY_403}, scope=ECU, set at pre-compile, default-value=DEM_DISPLACEMENT_LEGACY_403  # This configuration switch is back-ported from AR4.1.1 and specifies the event displacement when the event memory is currently filled completely. It replaces the AR4.0.3 parameter DemEventDisplacementSupport. Please note, the DTC selected by the displacement algorithm is only displaced if it is a better match than the new DTC that has to be entered into the memory. If the new DTC is the better match, or no matching DTCs are found in the event memory, the fall-back strategy DemEventDisplacementFallbackStrategy is implemented. NONE: No displacement. If the event memory is filled, a new event will always be displaced immediately. Please note, the only supported fall-back strategy for this case is DISCARD_NEW_EVENT. PRIO_OCC: Displacement is active. If the event memory is filled, the DTC(s) with lowest priority are selected. If multiple DTCs share this lowest priority, the oldest is selected. FULL: Displacement is active. If the event memory is filled, the DTC(s) with the lowest priority are selected. If multiple DTCs share this lowest priority, the oldest passive DTC is selected. If no passive DTCs are among the lowest priority list, the oldest active, but untested DTC is selected. LEGACY_403: Vector extension that corresponds to the displacement behavior defined in Autosar 4.0.3. If the event memory is filled, the DTC(s) with the lowest priority are selected. If multiple DTCs share this lowest priority, the oldest passive DTC is selected.
      enumeration DemExtendedDataCapture [0..1]: {DEM_TRIGGER_EVENT_MEMORY_STORAGE, DEM_TRIGGER_TESTFAILED}, scope=ECU, set at pre-compile, default-value=DEM_TRIGGER_EVENT_MEMORY_STORAGE  # ExtendedData Capture | This parameter defines the point in time, when the extended data collection is done. TESTFAILED: The data is collected directly in the context of the SetEventStatus call. This option is not supported. MEMORY_STORAGE: The data is collected during the next Dem task cycle, in case a memory entry can be created for the DTC (see DemEventDisplacementSupport)
      enumeration DemExtendedDataVisibility [0..1]: {DEM_VISIBILITY_ALL_DTC, DEM_VISIBILITY_STOREDONLY}, set at pre-compile, origin=Vector Informatik, default-value=DEM_VISIBILITY_ALL_DTC  # ExtendedData Visibility | This parameter defines the point in time when extended data will be reported in diagnostic response messages. This parameter affects extended data records that consist solely of statistical data which is by its nature at any time available, see DemInternalDataElement. Using this parameter allows to reduce visibility of such extended data records until the DTC is actually stored. ALL_DTC: The data is reported independent of an existing memory entry. STOREDONLY: The data is reported only if a memory entry exists for the reported DTC. Example: The current fault detection counter exists at any time for all DTCs. If this parameter is set to ALL_DTC, service 19 06 will report the value of the FDC for DTCs that are not currently stored. If this parameter is set to STOREDONLY, Dcm will instead send a positive response without any content for those DTCs.
      enumeration DemFreezeFrameCapture [0..1]: {DEM_TRIGGER_EVENT_MEMORY_STORAGE, DEM_TRIGGER_TESTFAILED}, scope=ECU, set at pre-compile, default-value=DEM_TRIGGER_EVENT_MEMORY_STORAGE  # FreezeFrame Capture | This parameter defines the point in time, when the freeze frame data collection is done. TESTFAILED: The data is collected directly in the context of the SetEventStatus call. This option is not supported. MEMORY_STORAGE: The data is collected during the next Dem task cycle, in case a memory entry can be created for the DTC (see DemEventDisplacementSupport).
      boolean DemGeneralInterfaceSupport: scope=ECU, set at pre-compile, default-value=false  # The interfaces GeneralEvtInfo, GeneralCallbackEventDataChanged and GeneralCallbackEventStatusChange are provided if DemGeneralInterfaceSupport is equal to true. (Not supported, please use - DemGeneral/DemGeneralDiagnosticInfoSupport, - DemGeneral/DemTriggerGlobalEventDataChangedCallback, - DemGeneral/DemTriggerGlobalEventStatusChangedCallback instead.)
      string DemHeaderFileInclusion [0..*]: scope=ECU, set at pre-compile  # HeaderFile Inclusion | Name of the header file(s) to be included by the Dem module containing the used C-callback declarations. The different callout configurations allow to specify a C-Callback instead of a port interface. If you choose so, you need to add a header file here with the appropriate declaration of the function. see DemConfigSet/DemDTCClass/DemCallbackInitMForF/DemCallbackInitMForFFnc, see DemConfigSet/DemEventParameter/DemCallbackClearEventAllowed/DemCallbackClearEventAllowedFnc, see DemConfigSet/DemEventParameter/DemCallbackEventDataChanged/DemCallbackEventDataChangedFnc, see DemConfigSet/DemEventParameter/DemCallbackEventStatusChanged/DemCallbackEventStatusChangedFnc, see DemConfigSet/DemEventParameter/DemCallbackInitMForE/DemCallbackInitMForEFnc, see DemConfigSet/DemEventParameter/DemDebounceAlgorithmClass/DemDebounceMonitorInternal/DemCallbackGetFDC/DemCallbackGetFDCFnc, see DemGeneral/DemCallbackDTCStatusChanged/DemCallbackDTCStatusChangedFnc, see DemGeneral/DemDataClass/DemDataElementReadFnc, see DemGeneral/DemEventMemorySet/DemClearDTCNotification/DemClearDtcNotificationFnc.
      integer DemImmediateNvStorageLimit [0..1]: 1..255, scope=ECU, set at pre-compile  # ImmediateNvStorage Limit | This parameter defines a limit for the number of immediate write accesses to the non-volatile memory. This option is only relevant if immediate NV storage is used for DTCs (see DemGeneral/DemImmediateNvStorageSupport and DemConfigSet/DemDTCClass/DemImmediateNvStorage). If configured the non-volatile immediate storage for a DTC is only triggered until the OccurenceCounter reaches the configured value. Note that the number of immediate write accesses for a DTC can be higher than the configured value (for detailed description see Technical Reference).
      integer DemMaxNumberEventEntryMirror: 0..255, scope=ECU, set at pre-compile, default-value=0  # Maximum number of events which can be stored in the mirror memory. The mirror memory is currently not supported, so this value should be set to 0.
      integer DemMaxNumberEventEntryOBDFreezeFrame: 0..255, set at pre-compile in variant post-build-loadable+pre-compile / post-build in variant post-build-selectable, origin=Vector Informatik, default-value=0  # Max Number Event Entry OBD FreezeFrame | Maximum number of events which can concurrently store an OBD II or OBDonUDS Freeze Frame. With WWH OBD each memory entry stores an OBD Freeze Frame, so this parameter is ignored. OBD Freeze Frame memory is only available if OBD II or OBDonUDS is supported.
      integer DemMaxNumberEventEntryPermanent: 0..255, scope=ECU, set at pre-compile, default-value=0  # Maximum number of events which can be stored in the permanent memory. Permanent memory is available in case that MIL is supported and either OBD II or OBD on UDS or Permanent for WWH-OBD is supported (see DemOBDSupport, DemOBDLegislation, DemMILIndicatorRef and DemOBDPermanentForWWHOBD).
      integer DemMaxNumberPrestoredFF: 0..255, scope=ECU, set at pre-compile, default-value=0  # Defines the maximum number for prestored freeze frames.
      enumeration DemOBDSupport: {DEM_OBD_DEP_SEC_ECU, DEM_OBD_MASTER_ECU, DEM_OBD_NO_OBD_SUPPORT, DEM_OBD_PRIMARY_ECU}, scope=ECU, set at pre-compile in variant post-build-loadable+pre-compile / post-build in variant post-build-selectable, default-value=DEM_OBD_NO_OBD_SUPPORT  # DEM_OBD_NO_OBD_SUPPORT: OBD support is disabled, the DEM operates in UDS mode. DEP_SEC_ECU: OBD support is enabled, the DEM operates in secondary/dependent ECU mode. (not supported) PRIMARY_ECU: OBD support is enabled, the DEM operates in primary ECU mode. MASTER_ECU: OBD support is enabled, the DEM operates in master ECU mode. (not supported) If OBD support is NOT disabled, use parameter Dem/DemGeneral/DemGeneralOBD/DemOBDLegislation to choose either OBD II or WWH-OBD or OBDonUDS or ZEVonUDS support. If OBD support is disabled, all configured OBD relevant parameters (e.g. the parameters in Dem/DemGeneral/DemGeneralOBD) are ignored.
      enumeration DemOccurrenceCounterProcessing: {DEM_PROCESS_OCCCTR_CDTC, DEM_PROCESS_OCCCTR_TF}, scope=ECU, set at pre-compile, default-value=DEM_PROCESS_OCCCTR_TF  # OccurrenceCounter Processing | The occurrence counter is incremented each time the event status transitions from 'passed' to 'failed'. TF (TestFailed) : The counter is incremented each time. CDTC (Confirmed): The counter is incremented only after the event is confirmed - Effectively the counter starts incrementing after N cycles (see DemConfigSet/DemEventParameter/DemEventClass/DemEventFailureCycleCounterThreshold).
      enumeration DemOperationCycleProcessing [0..1]: {DEM_PROCESS_OPCYC_COUNTER, DEM_PROCESS_OPCYC_STATE}, scope=ECU, set at pre-compile, default-value=DEM_PROCESS_OPCYC_STATE  # OperationCycle Processing | This parameter is obsolete since the option DEM_PROCESS_OPCYC_COUNTER is not longer supported by AUTOSAR. OPCYC_STATE: Cycles are reported by SetOperationCycleState(Start/Stop) and the Dem counts the cycles internally. OPCYC_COUNTER: Cycles are counted externally. The current count is reported to the Dem by SetOperationCycleCounter. Only OPCYC_STATE is supported at the moment.
      boolean DemOperationCycleStatusStorage: scope=ECU, set at pre-compile, default-value=false  # OperationCycle Status Storage | Defines if the operation cycle state is available over the power cycle (stored non-volatile) or not. If this value is disabled, operation cycles are considered 'stopped' at the time of Dem_Init. Cycles must be started first to allow monitor reports to be processed, but starting a cycle involves event status changes. So if you have operation cycles that are longer than the power cycle of your ECU, you need to enable this option. This parameter is only valid if DemOperationCycleProcessing is set to OPCYC_STATE.
      boolean DemPTOSupport: scope=ECU, set at pre-compile, default-value=false  # This configuration switch defines, whether PTO support (and therefore PID $1E support) is enabled or not. This parameter is not supported. Use parameter /Dem/DemConfigSet/DemEventParameter/DemEventClass/DemConsiderPtoStatus to configure an event as affected by PTO and activate the Dem PTO handling.
      boolean DemResetConfirmedBitOnOverflow: set at pre-compile, default-value=true  # Status Bit ConfirmedDTC Reset on Overflow | This configuration switch defines, whether the ConfirmedDTC UDS status bit is reset or not when an event memory entry will be displaced. If enabled, a DTC will immediately 'age', i.e. lose its ConfirmedDTC bit if it is displaced. If disabled, a DTC will stop aging on displacement. Its ConfirmedDTC status bit will stay active until the DTC can allocate a new aging counter, at which point the aging process will start from the beginning. Alternatively, ClearDTC will also clear such a DTC.
      enumeration DemStatusBitHandlingTestFailedSinceLastClear: {DEM_STATUS_BIT_AGING_AND_DISPLACEMENT, DEM_STATUS_BIT_NORMAL, DEM_STATUS_BIT_AGING}, scope=ECU, set at pre-compile, default-value=DEM_STATUS_BIT_NORMAL  # Status Bit TestFailedSinceLastClear Handling | This configuration switch defines whether the aging and displacement mechanism shall be applied to the "TestFailedSinceLastClear" status bits. AGING_AND_DISPLACEMENT: The status bit 'TestFailedSinceLastClear' is only set if an event can be enteren into its event memory. (In case the event is not mapped to any destination it is never set!) The status bit is reset due to aging, clearing and displacement of the memory entry. NORMAL: The status bit 'TestFailedSinceLastClear' set for all events, irrespective of successful allocation of an event memory entry. It is reset to 0 only when the event is cleared. AGING: The status bit 'TestFailedSinceLastClear' set for all events, irrespective of successful allocation of an event memory entry. It is reset to 0 when the event ages, or is cleared.
      boolean DemStatusBitStorageTestFailed: scope=ECU, set at pre-compile, default-value=true  # Status Bit TestFailed Storage | Activate/Deactivate the permanent storage of the "TestFailed" status bits. If disabled, the TestFailed bit is reset during initilization. Please note that this does not suffice to start aging of the event.
      boolean DemStorageConditionSupport: scope=ECU, set at pre-compile, default-value=false  # StorageCondition Support | This configuration switch defines, whether support for storage conditions is enabled or not. If storage conditions are set up for events (DemConfigSet/DemEventParameter/DemEventClass/DemStorageConditionGroupRef) this option must be enabled.
      enumeration DemSuppressionSupport: {DEM_DTC_SUPPRESSION, DEM_EVENT_AND_DTC_SUPPRESSION, DEM_EVENT_SUPPRESSION, DEM_NO_SUPPRESSION}, set at pre-compile, default-value=DEM_NO_SUPPRESSION  # This configuration switch defines, whether support for suppression is enabled or not. According AUTOSAR 4.3, this DEM implementation only supports the suppression by DTC, not the suppression by Event. DTC_SUPPRESSION: Support suppression by DTC. EVENT_AND_DTC_SUPPRESSION: Support suppression by Event and DTC. Equivalent to DTC_SUPPRESSION, as suppression by Event is not supported. EVENT_SUPPRESSION: Support suppression by Event. Equivalent to NO_SUPPRESSION, as suppression by Event is not supported. NO_SUPPRESSION: Suppression is not supported.
      float DemTaskTime: 0.001..0.1, scope=ECU, set at pre-compile, default-value=0.01  # Allow to configure the time for the periodic cyclic task. This value is used to set up the Dem Service-Description and BSW scheduler. This time is also used as time base in case time based debouncing is supported (see DemDebounceTimeBasedSupport, DemConfigSet/DemEventParameter/DemDebounceAlgorithmClass/DemDebounceTimeBased/DemDebounceTimeBasedClassRef). The AUTOSAR configuration standard is to use SI units, so in the EcuC file this parameter is stored as float value in seconds - the DaVinci Configurator 5 GUI will convert the value when using a diffenent unit.
      boolean DemTriggerDcmReports: scope=ECU, set at pre-compile, default-value=false  # If enabled, the Dcm module is notified about DTC status changes in primary memory. Status changes caused by Dem_<...>ClearDTC do not trigger this callback. Notifications must be enabled using API Dem_DcmControlDTCStatusChangedNotification. For ASR4.0.3 compatible behavior, disable this option, and configure the Dcm trigger function in parameter 'DemCallbackDTCStatusChangedFnc'. This is required to implement RoE - OnDTCChange supervision, please refer to the Dcm configuration for details.
      boolean DemTriggerDltReports: scope=ECU, set at pre-compile, default-value=false  # Activate/Deactivate the notification to the Diagnostic Log and Trace.
      boolean DemTriggerFiMReports: scope=ECU, set at pre-compile, default-value=false  # Trigger FiM Reports | Activate/Deactivate the notification to the Function Inhibition Manager. This option must be enabled if the FiM requires monitor status change notification (see FiM/FiMGeneral/FiMEventUpdateTriggeredByDem). It enables MonitorStatusChange and FiM_DemInit according AR4.3.0.
      boolean DemTriggerFiMReportsExtended: scope=ECU, set at pre-compile, origin=Vector Informatik, default-value=false  # Trigger FiM Reports (Extended) | Activate/Deactivate the notification to the Function Inhibition Manager. This option must be enabled if the FiM requires event status change notification. It is used for Vector FiM's OBD extension, and also provides backward compatibility for older FiM version (ASR 4.2 and older)
      boolean DemTriggerMonitorInitBeforeClearOk: scope=ECU, set at pre-compile, default-value=true  # Trigger MonitorInit Before Clear Ok | Defines if the monitor re-initialization has to be triggered before or after the Dem module returns DEM_CLEAR_OK. This option is not supported. InitMonitor callbacks are always triggered during the clear operation, and have completed before the final result is returned to the Dcm.
      boolean DemTriggerMonitorInitForEnableConditions: scope=ECU, set at pre-compile, origin=Vector Informatik, default-value=false  # Trigger MonitorInit For Enable Conditions | Defines if the monitor re-initialization is triggered when enable conditions re-activate a disabled monitor This option requires AR4.1.2 API compatibility.
      enumeration DemTypeOfDTCSupported: {DEM_DTC_TRANSLATION_ISO11992_4, DEM_DTC_TRANSLATION_ISO14229_1, DEM_DTC_TRANSLATION_ISO15031_6, DEM_DTC_TRANSLATION_SAEJ1939_73, DEM_DTC_TRANSLATION_J2012DA_FORMAT_04}, scope=ECU, set at pre-compile, default-value=DEM_DTC_TRANSLATION_ISO14229_1  # This parameter defines the format returned by Dem_GetTranslationType and does not relate to/influence the supported Dem functionality. Its value is returned by some of the $19 services. ISO11992_4: ISO11992-4 DTC format. ISO14229_1: ISO14229-1 DTC format. ISO15031_6: ISO15031-6 DTC format/SAE J2012-DA_DTCFormat_00 DTC format. SAEJ1939_73: SAEJ1939-73 DTC format. J2012DA_FORMAT_04: SAE_J2012-DA_DTCFormat_04 DTC format.
      boolean DemVersionInfoApi: set at pre-compile, default-value=false  # Activate/Deactivate the version information API.
      enumeration DemBswApiVersion: {DEM_BSW_API_4_XX_XX, DEM_BSW_API_3_XX_XX}, set at pre-compile, origin=Vector Informatik, default-value=DEM_BSW_API_4_XX_XX  # Specifies the AUTOSAR version of the integrated BSW stack API that Dem shall be able to interact with. This setting will modify the symbolic names, that are offered by the DEM and used by other BSW modules. See the additional parameters for the reverse (the DEM uses a symbolic name that is offered by another module): DemGeneral/DemBswApiVersionNvM, DemGeneral/DemBswApiVersionFiM. API_4_XX_XX: The DEM offers only symbolic names according the definition of AUTOSAR 4 for interaction with other BSW modules. API_3_XX_XX: The DEM creates additional symbolic names according the definition of AUTOSAR 3 for interaction with other BSW modules: The DEM itself will offer additional symbolic names (that may be used by AUTOSAR 3 BSW modules) for: - DemAgingCycle identifier - DemEnableConditionId - DemEventId - DemGroupDTCs - DemIndicatorID - DemMILGroup identifier - DemOperationCycle identifier - DemStorageConditionId
      enumeration DemBswApiVersionNvM: {DEM_BSW_API_4_XX_XX, DEM_BSW_API_3_XX_XX}, set at pre-compile, origin=Vector Informatik, default-value=DEM_BSW_API_4_XX_XX  # Bsw Api Version NvM | Specifies the AUTOSAR version of the integrated NvM API that Dem shall be able to interact with. Switches Dem interaction to the corresponding AUTOSAR version of NvM (DemNvRamBlockIdRef->NvMBlockDescriptor). API_4_XX_XX: The DEM uses symbolic names according the definition of AUTOSAR 4 for interaction with the NvM module. This is the default. API_3_XX_XX: The DEM uses symbolic names according the definition of AUTOSAR 3 for interaction with the NvM module. Use this setting when the NvM offers its symbolic names only according the AUTOSAR 3 naming convention (for example AUTOSAR 3 "NvM_DemAdminDataBlock" vs. AUTOSAR 4 "NvMConf_NvMBlockDescriptor_DemAdminDataBlock").
      enumeration DemBswApiVersionFiM: {DEM_BSW_API_4_XX_XX, DEM_BSW_API_3_XX_XX}, set at pre-compile, origin=Vector Informatik, default-value=DEM_BSW_API_4_XX_XX  # Bsw Api Version FiM | Specifies the AUTOSAR version of the integrated FiM API that Dem shall be able to interact with. Switches Dem interaction to the corresponding AUTOSAR version of FiM (DemFunctionIdRef->FiMFID, DemSecondaryFunctionIdRef->FiMFID, DemIgnitionCycleFunctionIdRef->FiMFID). API_4_XX_XX: The DEM uses symbolic names according the definition of AUTOSAR 4 for interaction with the FiM module. This is the default. API_3_XX_XX: The DEM uses symbolic names according the definition of AUTOSAR 3 for interaction with the FiM module. Use this setting when the FiM offers its symbolic names only according the AUTOSAR 3 naming convention (for example AUTOSAR 3 "FiM_FiMFID_001" vs. AUTOSAR 4 "FiMConf_FiMFID_FiMFID_001").
      enumeration DemAgingAfterHealing: {DEM_AGING_WHILE_HEALING, DEM_AGING_AFTER_HEALING, DEM_AGING_AFTER_HEALING_ALL_DTC}, set at pre-compile, origin=Vector Informatik, default-value=DEM_AGING_WHILE_HEALING  # This parameter selects how aging and healing interact. DEM_AGING_WHILE_HEALING will allow events that meet the configured aging criteria (DemAgingBehavior) to start aging. In theory, this could mean that events can age while they still request an indicator. Use well defined operation cycles to avoid this effect, i.e. aging cycles should not complete faster than operation cycles. DEM_AGING_AFTER_HEALING will allow aging only after the event has finished healing, i.e. after resetting the warningIndicatorRequested status bit. This setting only has an effect on events with an indicators. This is the behavior defined by the AUTOSAR standard. DEM_AGING_AFTER_HEALING_ALL_DTC behaves like DEM_AGING_AFTER_HEALING, but extends the healing process to events without indicator. I.e. even though the events do not set the WIR bit, they will only start aging after they would have reset it. This way, both events with and without indicators age after the same amount of cycles. Events configured to use the MIL will always behave according to DEM_AGING_AFTER_HEALING.
      enumeration DemAgingBehavior: {DEM_AGING_TYPE_1, DEM_AGING_TYPE_2, DEM_AGING_TYPE_3, DEM_AGING_TYPE_4, DEM_AGING_TYPE_5, DEM_AGING_TYPE_6}, set at pre-compile, origin=Vector Informatik, default-value=DEM_AGING_TYPE_1  # This parameter selects the algorithm for the aging of the events. AGING_TYPE_1: Initial trigger to start the aging is the test result PASSED. The aging counter is incremented at the end of the aging cycle. Events with DemAgingCycleCounterThreshold == 0 will age with the PASSED test result. AGING_TYPE_2: Initial trigger to start the aging is the end of operation cycle if the event was tested PASSED and was never tested FAILED in this cycle. The aging counter is incremented at the end of the aging cycle. Events with DemAgingCycleCounterThreshold == 0 will age at the end of the operation cycle if the event was tested PASSED and was not tested FAILED in this cycle. AGING_TYPE_3: Initial trigger to start the aging is the end of operation cycle if the event was tested PASSED and was never tested FAILED in this cycle. The aging counter is incremented at the end of the aging cycle if the event was tested PASSED and was never tested FAILED in this cycle. Events with DemAgingCycleCounterThreshold == 0 will age at the end of the operation cycle if the event was tested PASSED and was not tested FAILED in this cycle. AGING_TYPE_4: Initial trigger to start the aging is the test result PASSED. The aging counter is incremented at the end of the aging cycle if the event was tested PASSED. Events with DemAgingCycleCounterThreshold == 0 will age with the PASSED test result. AGING_TYPE_5: Initial trigger to start the aging is the end of operation cycle if the event was tested PASSED and was never tested FAILED in this cycle. The aging counter is incremented at the end of the aging cycle if the event was tested PASSED and was never tested FAILED in this cycle. Events with DemAgingCycleCounterThreshold == 0 will age with the PASSED test result, if the event was not tested FAILED in this cycle. AGING_TYPE_6: Initial trigger to start the aging is the test result PASSED, if the event was never tested FAILED in this cycle. The aging counter is incremented at the end of the aging cycle if the event was tested PASSED and was never tested FAILED in this cycle. Events with DemAgingCycleCounterThreshold == 0 will age with the PASSED test result.
      enumeration DemAgingCounterBehavior: {DEM_AGING_COUNT_ALWAYS, DEM_AGING_COUNT_ONLY_AGEABLE}, set at pre-compile, origin=Vector Informatik, default-value=DEM_AGING_COUNT_ALWAYS  # Control whether an aging counter is incremented / decremented for events that do not support aging (refer to DemAgingAllowed). DEM_AGING_COUNT_ALWAYS: The aging counter is incremented/decremented for every event. If an event does not support aging (DemAgingAllowed is set to false), its incrementing aging counter latches at aging cycle counter threshold and decrementing aging counters stops at 0. DEM_AGING_COUNT_ONLY_AGEABLE: The aging counter is incremented/decremented only for events supporting aging. If an event does not support aging, incrementing aging counters remain at 0, decrementing aging counters remain at the aging cycle counter threshold value.
      enumeration DemAgingCounterReporting: {DEM_AGING_NORMAL_REPORTING, DEM_AGING_ZERO_AS_ONE_REPORTING}, set at pre-compile, origin=Vector Informatik, default-value=DEM_AGING_NORMAL_REPORTING  # This parameter changes how the aging counter is reported in an extended record. AGING_NORMAL_REPORTING: The counter is reported as defined by the internal data element (UPCOUNT/DOWNCOUNT) AGING_ZERO_AS_ONE_REPORTING: For upward counting, the counter value 0x00 is reported as value 0x01 in the cycle where aging is started. This has no effect on downward counting and on events with aging cycle counter threshold 0.
      boolean DemAgingRetainEnvironmentalData: set at pre-compile, origin=Vector Informatik, default-value=false  # If this option is enabled, environmental data stored with a DTC is not deleted on aging. This includes snapshot data and extended data records. The data is reported for UDS services as if the DTC was still confirmed, although Bit3 is not set anymore in the DTC status byte. Aged event entries will be treated as empty as far as displacment is concerned, even if DTC displacement is deactivated by DemEventDisplacementStategy. If this option is disabled, event memory entries including all stored data are cleared on aging. This setting corresponds to the behavior defined by AUTOSAR.
      integer DemClearDTCRuntimeLimit [0..1]: 1..255, set at pre-compile, origin=Vector Informatik  # ClearDTC Runtime Limit | If this parameter exists, ClearDTC will not clear more than this amount of DTCs at once. This parameter can be used to reduce the run time of the Dem_MainFunction during ClearDTC.
      integer DemCompiledConfigId [0..1]: 0..65535, set at post-build in variant post-build-loadable+post-build-selectable / pre-compile in variant pre-compile, origin=Vector Informatik, default-value=0  # Change this value to force the Dem to clear all NV data on next initialization (startup). This is useful if the flash eeprom emulation is not cleared during flashing of a new software version. When this parameter is missing, the value 0 is assumed.
      integer DemCompiledPostbuildCrc: 0..4294967295, set at post-build in variant post-build-loadable+post-build-selectable / pre-compile in variant pre-compile, origin=Vector Informatik, default-value=0  # This parameter contains a variant specific checksum (CRC) over all postbuiild-changeable configuration items. This value is internally used to detect changes in the configuration. The non-volatile stored data is always configuration specific. Reading the NvData with a different configuration will give a new interpretation to that binary data, that is usually wrong. So with configuration changes the DEM shall typically discard the previous NvData. In mode AUTOMATIC (see parameter DemCompiledPostbuildCrcMode) the DaVinci Configurator5 will automatically evaluate a checksum over the relevant data, that will differ between incompatible configurations. In mode MANUAL the user himself is responsible to use different values for incompatible configurations. Generally: a value here, that is different from the previous value (that was used when storing the non-volatile data) will cause the DEM to discard the previously stored NvData.
      enumeration DemCompiledPostbuildCrcMode: {DEM_POSTBUILD_CRC_AUTOMATIC, DEM_POSTBUILD_CRC_MANUAL}, set at post-build in variant post-build-loadable+post-build-selectable / pre-compile in variant pre-compile, origin=Vector Informatik, default-value=DEM_POSTBUILD_CRC_AUTOMATIC  # Switch the mode for the calculation of the variant specific checksum (CRC) over all postbuiild-changeable configuration items. See parameter DemCompiledPostbuildCrc. AUTOMATIC: the DaVinci Configurator5 calculates the checksum value MANUAL: the user defines the checksum - use this setting only when the NvData shall not be cleared with a configuration change. Take care to manually change the checksum when the stored non-volatile data becomes incompatible to the current configuration.
      boolean DemDcmSupport [0..1]: set at pre-compile, origin=Vector Informatik, default-value=true  # When this parameter is missing, the Dem assumes the Dcm being configured (that means you use a standard AUTOSAR stack). If the parameter exists with value FALSE there is no Dcm module in the system: the Dem doesn't offer the APIs defined in file "Dem_Dcm.h" any more, and it does not offer the Dcm port interfaces. Use this setting when your ECU doesn't implement UDS diagnostic services. A J1939Dcm in system will then still offer J1939 diagnostic services. If the parameter exists with value TRUE (or is missing) the standard Dem behaviour and APIs are available.
      float DemDebounceTimeLowResThreshold [0..1]: 0.15..3600, set at pre-compile, origin=Vector Informatik, default-value=5  # TimeBased Debouncing - LowRes Timer Threshold | Largest time duration (excl.) for using the high resolution timer. To reduce CPU load and reduce configuration code size, the feature Time Base Debounce can use 2 different timers: the high resolution timer will tick with the configured DemTaskTime (typ. 10ms), the additional low resolution timer will tick with 150ms. This configuration value defines the min. debounce time for an event to be handled by the low-res timer. Default: 5s Refer to configuration values DemDebounceTimeFailedThreshold and DemDebounceTimePassedThreshold of each event: - if both time values of an event are lower than the threshold (typ. 5s), the event's debounce is using the high-res timer with a jitter of DemTaskTime (typ. 10ms); - otherwise the debounce algorithms are using the low-res timer (with a jitter of 150ms) and a reduced CPU load. The AUTOSAR configuration standard is to use SI units, so in the EcuC file this parameter is stored as float value in seconds - the GUI will convert the value when using a diffenent unit.
      boolean DemEvMemOverflowIndicationSupport [0..1]: set at pre-compile, origin=Vector Informatik, default-value=true  # EventMemory Overflow Indication Support | Provide the Port-Interface EvMemOverflowIndication. If this parameter is disabled, the Dem will not provide the port interface or the C functions to read the overflow status of the event memories.
      enumeration DemEventDisplacementFallbackStrategy: {DEM_FALLBACK_DISCARD_NEW_EVENT, DEM_FALLBACK_DISPLACE_OLDEST_EVENT}, configuration-class-affection=affection-kind=PC-AFFECTS-LT-AND-PB, set at pre-compile, origin=Vector Informatik, default-value=DEM_FALLBACK_DISCARD_NEW_EVENT  # Fallback strategy for event displacement: DISCARD_NEW_EVENT: Standard behavior defined by AUTOSAR. In case no candidate for displacement is found, a new event is silently discarded. DISPLACE_OLDEST_EVENT: In case no better candidate for displacement can be found, the oldest event is displaced unconditionally. Note: Active OBD DTCs are not affected from this configuration.
      function name DemGeneralCallbackMonitorStatusChangedFnc [0..1]: scope=ECU, set at pre-compile, origin=Vector Informatik  # General Callback MonitorStatus Changed Fnc | Function name of prototype "<Module>_DemTriggerOnMonitorStatus". If configured, the DEM will call this function with each MonitorStatus change of an event. The function's signature is: void NN_DemTriggerOnMonitorStatus( Dem_EventIdType EventId ); For FiM monitor status notification, use the configuration parameter DemGeneral/DemTriggerFiMReports.
      boolean DemGeneralDiagnosticInfoSupport: set at pre-compile, origin=Vector Informatik, default-value=true  # General DiagnosticInfo Support | Provide the Port-Interface GeneralDiagnosticInfo.
      boolean DemImmediateNvStorageSupport [0..1]: set at pre-compile, origin=Vector Informatik, default-value=false  # ImmediateNvStorage Support | TRUE: For all DTCs for which DemConfigSet/DemDTCClass/DemImmediateNvStorage parameter is enabled, environmental data is stored immediately in NvRam. Independent of the value of DemConfigSet/DemDTCClass/DemImmediateNvStorage OBD relevant data (OBD freeze frames and permanent DTCs) is always synchronized to NvRAM immediately. FALSE or when this parameter is missing: If at least one of the following conditions is fulfilled, the feature will be switched on (same behavior as TRUE): - at least one of the DemConfigSet/DemDTCClass/DemImmediateNvStorage parameters is enabled - DemGeneral/DemNvSynchronizeSupport is set to TRUE - DemGeneral/DemClearDTCBehavior is set to DEM_CLRRESP_NONVOLATILE_FINISH Otherwise the feature is disabled. Note: Immediate storage of other data (e.g., event status, IUMPR, DTR) than environmental data is not triggered by enabling this option. For more details regarding NvRAM synchronization see chapters 'NVRAM Write Frequency' in Technical Reference and Addendum for OBD.
      boolean DemJ1939Support: set at pre-compile, origin=Vector Informatik, default-value=false  # Globally activate the support for J1939. If this feature is active, the configuration of J1939 in container DemGeneral/DemGeneralJ1939 is mandatory.
      integer DemMemoryBlockDistribution [0..1]: 1..255, set at pre-compile, origin=Vector Informatik, default-value=1  # This parameter has no effect
      boolean DemMultipleTripSupport [0..1]: set at pre-compile, origin=Vector Informatik, default-value=false  # FALSE: Multitrip behavior is not allowed for any event. DemConfigSet/DemEventParameter/DemEventClass/DemEventFailureCycleCounterThreshold has to be 0 or 1. TRUE: Multitrip behavior is possible, but not mandatory, i.e. confirmation handling is still according to the settings of DemConfigSet/DemEventParameter/DemEventClass/DemEventFailureCycleCounterThreshold. Trip counter information is available for all events. Example: If all events have a single trip behavior, enabling MultipleTripSupport may be useful for configuration variants, e.g. to calibrate a different value for DemEventFailureCycleCounterThreshold later. When this parameter is missing, the Dem will select the confirmation handling according to the settings of DemConfigSet/DemEventParameter/DemEventClass/DemEventFailureCycleCounterThreshold or DemConfigSet/DemEventParameter/DemEventClass/DemIndicatorAttribute/DemIndicatorHealingCycleCounterThreshold.
      boolean DemNvSynchronizeSupport: set at pre-compile, origin=Vector Informatik, default-value=false  # Provides API Dem_RequestNvSynchronization. If this option is enabled, API Dem_RequestNvSynchronization is provided which can be used to request full NV synchronization. For SWC, the API is available as operation SynchronizeNvData in port interface DemServices. Use this API in case the AUTOSAR defined synchronization points do not suffice for your project.
      enumeration DemPendingDtcProcessing: {DEM_PROCESS_PDTC_STOREDONLY, DEM_PROCESS_PDTC_ALL_DTC}, set at pre-compile, origin=Vector Informatik, default-value=DEM_PROCESS_PDTC_STOREDONLY  # Status Bit PendingDTC Processing | Select behavior of PendingDTC status bit. STOREDONLY: Set the status bit2 (PendingDTC) only if a memory entry could be allocated successfully. With this setting the status bit PendingDTC is also reset when the event is displaced from memory. ALL_DTC: Set the status bit2 (PendingDTC) independently from successful event storage. With this setting the status bit PendingDTC is not modified in case the DTC is displaced from memory.
      enumeration DemResetDebounceBehavior: {DEM_RESET_DEBOUNCE_ON_ENABLE_ENABLE_CONDITIONS, DEM_RESET_DEBOUNCE_ON_DISABLE_ENABLE_CONDITIONS}, set at pre-compile, origin=Vector Informatik, default-value=DEM_RESET_DEBOUNCE_ON_DISABLE_ENABLE_CONDITIONS  # Controls which enable condition group transition leads to a reset/freeze of the debouncing behaviour, either with the state trasition to enabled or disabled. DEM_RESET_DEBOUNCE_ON_DISABLE_ENABLE_CONDITIONS Reset/freeze the debouncing values when the events preconditions are no longer fulfilled. DEM_RESET_DEBOUNCE_ON_ENABLE_ENABLE_CONDITIONS Reset/freeze the debouncing values when the events preconditions return to fulfilled state, after they had been unfulfilled. However, if /Dem/DemConfigSet/DemDebounceTimeBasedClass/DemDebounceContinuous == FALSE, then the debounce value is frozen, when the events preconditions are no longer fulfilled.
      boolean DemResetTestFailedOnOperationCycleStart: set at pre-compile, origin=Vector Informatik, default-value=false  # Reset TestFailed on OperationCycle Start | If this option is enabled, (re)starting an operation cycle also resets the TestFailed bit of events using the cycle as operation cycle. This is not counted as a qualified test result.
      boolean DemRetryStorageSupport: set at pre-compile, origin=Vector Informatik, default-value=false  # When enabled, the Dem will retry to store events that could not be stored; e.g. due to missing storage conditions, or filled up event memory. An attempt to store is triggered for FAILED DTCs (Bit0 set) with every PRE_FAILED report (while the FDC is at 128) or FAILED report.
      boolean DemSafeBswChecks: set at pre-compile, origin=Vector Informatik, default-value=true  # SafeBSW Checks | Selects if safety checks are used. These checks improve robustness as e.g. invalid parameters are checked before function is executed. By default, this parameter is enabled. For projects where this component is not mapped to an ASIL partition, this parameter could be disabled.
      boolean DemTriggerControlDTCSetting [0..1]: set at pre-compile, origin=Vector Informatik, default-value=false  # Trigger ControlDTCSetting | The application is triggered if diagnostic service 0x85 - ControlDtcSetting is processed in DEM. In case the ECU does not support an RTE (DemUseRte == False), the Dem calls function Appl_Dem_CBControlDTCSetting_ControlDTCSettingChanged, which must be supplied by the application
      boolean DemTriggerDtcStatusChangedCallback [0..1]: set at pre-compile, origin=Vector Informatik, default-value=true  # Trigger DtcStatusChanged Callback | Globally disable DTC status notifications. You can use this parameter to suppress all dtc status notification callbacks, usually because none are used in the first place. You can also use this parameter as a temporary measure to allow compilation until all notification callouts are actually available. If you want notifications, it is recommended to remove the parameter completely.
      boolean DemTriggerEventDataChangedCallback [0..1]: set at pre-compile, origin=Vector Informatik, default-value=true  # Trigger EventDataChanged Callback | Globally disable DTC data change notifications. You can use this parameter to suppress all data change notification callbacks, usually because none are used in the first place. You can also use this parameter as a temporary measure to allow compilation until all notification callouts are actually available. If you want notifications, it is recommended to remove the parameter completely.
      boolean DemTriggerEventStatusChangedCallback [0..1]: set at pre-compile, origin=Vector Informatik, default-value=true  # Trigger EventStatusChanged Callback | Globally disable event status notifications. You can use this parameter to suppress all event status notification callbacks, usually because none are used in the first place. You can also use this parameter as a temporary measure to allow compilation until all notification callouts are actually available. If you want notifications, it is recommended to remove the parameter completely.
      boolean DemTriggerGlobalEventDataChangedCallback [0..1]: set at pre-compile, origin=Vector Informatik, default-value=false  # Trigger GlobalEventDataChanged Callback | If this parameter exists, you can explicitly control if the Dem requires the port interface 'GlobalEventDataChanged' (set: True) or not (set: False). It is used as a 'one for all' callout in case event data changes. If this parameter is missing (not set), the global interface is always required in addition to any DemConfigSet/DemEventParameter/DemCallbackEventDataChanged callout as demanded by AUTOSAR. This parameter here is irrelevant, if parameter DemGeneral/DemTriggerEventDataChangedCallback exists and has value False. In case the ECU does not support an RTE (DemUseRte == False), the Dem calls function Appl_Dem_GeneralCBDataEvt_EventDataChanged, which must be supplied by the application.
      boolean DemTriggerGlobalEventStatusChangedCallback [0..1]: set at pre-compile, origin=Vector Informatik, default-value=false  # Trigger GlobalEventStatusChanged Callback | If this parameter exists, you can explicitly control if the port interface 'GlobalEventStatusChanged' will be required (set: True) or not (set: False) by the Dem. It is used as a 'one for all' callout in case event status changes. If this parameter is missing (not set), the global interface is always required in addition to any DemConfigSet/DemEventParameter/DemCallbackEventStatusChanged callout as demanded by AUTOSAR. This parameter here is irrelevant, if parameter DemGeneral/DemTriggerEventStatusChangedCallback exists and has value False. In case the ECU does not support an RTE (DemUseRte == False), the Dem calls function Appl_Dem_GeneralCBStatusEvt_EventStatusChanged, which must be supplied by the application.
      boolean DemUseMemcopyMacros: set at pre-compile, origin=Vector Informatik, default-value=false  # Control use of VStdLib. If this switch is enabled, the Dem implementation uses macro implementations for memcopy and memset routines. These macros can be defined within a user config file (see DemUserConfigFile) if so desired: #define Dem_MemCpy_Macro(dst, src, len) /* some implementation */ #define Dem_MemSet_Macro(dst, val, len) /* some implementation */ If no definition is given by user config file, the Dem automatically uses a default implementation. If the switch is disabled, VStdLib is used.
      boolean DemUseNvm [0..1]: set at pre-compile, origin=Vector Informatik, default-value=true  # When this parameter is missing, the Dem will determine if it uses nonvolatile memory blocks based on the configuration of DemNvRamBlockId containers. If the configuration of the containers is incorrect, NvM usage will be deactivated which is also indicated by a warning during generation. If the configuration of the containers is correct, NvM usage will be active. If NvM usage is deactivated, the Dem will not report modified blocks to the NvM and will run completely from RAM mirrors without persistence. All features concerning NV memory will not be available. If the parameter exists, you can control manually if NvM usage is active. This can be useful in early integration phases where you have not yet completely set up the NvM but still need the Dem for production error reporting of the communication stack. Creating and manually setting this parameter is discouraged in production ECUs, i.e., the parameter should not exist in production ECUs. It is expected that the NvM shall be set up completely for production and the configuration of DemNvRamBlockId containers is correct.
      boolean DemUseRte: set at pre-compile, origin=Vector Informatik, default-value=true  # Set to FALSE to disable the usage of RTE callbacks. If disabled, all callouts are replaced by direct function calls. This is supported only for ECUs with neither RTE nor BRE. If the ECU uses an RTE or BRE, this option must be enabled.
      string DemUserConfigFile [0..1]: set at pre-compile, origin=Vector Informatik  # User Configuration File | Path to an external user configuration file used by the DaVinci Configurator 5 generation tool. If you want to overwrite some of the settings in the generated configuration file (Dem_Cfg.h), you can specify a path to a user defined configuration file. The user defined configuration file will be included at the end of the generated preprocessor switches. Definitions in the user defined configuration file can overwrite definitions in the generated configuration file. To specify the file name, you can use "$(var)" sequence(s) in the specified path. Each such sequence is replaced by the content of the related environment variable "var". Additionally you can use following predefined sequences: $(DpaProjectFolder) Absolute directory of the loaded *.dpa file. $(EcuProjectName) Name of the project defined in the loaded *.dpa file. $(EcucFile) Absolute directory "ECUC", defined by the loaded *.dpa file, containing files $(EcuProjectName).ecuc.arxml and $(EcuProjectName).ecuc.Initial.arxml . $(EcucFolder) Parent directory of $(EcucFile). $(SipRootPath) Absolute directory "SIP", defined by the loaded *.dpa file. $(OutputFolder) (Relative) directory "GenData", defined by the loaded *.dpa file. See setting "Root Target Folder" of Configurator 5. $(ServiceSwcFolder) Absolute directory "ServiceComponents", defined by the loaded *.dpa file. $(cwd) Current working directory when starting Configurator 5. RESTRICTIONS: Not all of the settings can be overwritten simply by triggering the preprocessor switch. Some of the options are complex and the code generator generates less or more code depending on the setting. USE SUCH A FILE ONLY AFTER DISCUSSION WITH VECTOR.
      string DemUserConfigFilePost [0..1]: set at pre-compile, origin=Vector Informatik  # User Configuration File - Late Inclusion | Path to an external user configuration file used by the DaVinci Configurator 5 generation tool. If you want to overwrite some of the settings in the generated configuration file (Dem_LCfg.h), you can specify a path to a user defined configuration file. The user defined configuration file will be included at the end of the file. Definitions in the user defined configuration file can overwrite definitions in the generated configuration file. To specify the file name, you can use "$(var)" sequence(s) in the specified path. Each such sequence is replaced by the content of the related environment variable "var". Additionally you can use following predefined sequences: $(DpaProjectFolder) Absolute directory of the loaded *.dpa file. $(EcuProjectName) Name of the project defined in the loaded *.dpa file. $(EcucFile) Absolute directory "ECUC", defined by the loaded *.dpa file, containing files $(EcuProjectName).ecuc.arxml and $(EcuProjectName).ecuc.Initial.arxml . $(EcucFolder) Parent directory of $(EcucFile). $(SipRootPath) Absolute directory "SIP", defined by the loaded *.dpa file. $(OutputFolder) (Relative) directory "GenData", defined by the loaded *.dpa file. See setting "Root Target Folder" of Configurator 5. $(ServiceSwcFolder) Absolute directory "ServiceComponents", defined by the loaded *.dpa file. $(cwd) Current working directory when starting Configurator 5. RESTRICTIONS: Usually it is sufficient to use only the DemUserConfigFile. This option should be only used with extreme caution. USE SUCH A FILE ONLY AFTER DISCUSSION WITH VECTOR.
      enumeration DemUserControlledWirBehavior: {DEM_DISABLED_DURING_CONTROLDTCSETTING, DEM_ENABLED_DURING_CONTROLDTCSETTING}, set at pre-compile, origin=Vector Informatik, default-value=DEM_ENABLED_DURING_CONTROLDTCSETTING  # Status Bit WarningIndicatorRequest User Controlled Behavior | This setting has effect only when DemUserControlledWirSupport == True. (Status Bit WarningIndicatorRequest User Controlled == True) DISABLED_DURING_CONTROLDTCSETTING: The API Dem_SetWIRStatus will return E_NOT_OK while ControlDTCSetting has disabled DTC storage. ENABLED_DURING_CONTROLDTCSETTING Dem_SetWIRStatus will process changes while ControlDTCSetting has disabled DTC storage.
      boolean DemUserDefinedCompareAndSwap: set at pre-compile, origin=Vector Informatik, default-value=false  # Implement and use a hardware optimized ApplDem_SyncCompareAndSwap() function. The API ApplDem_SyncCompareAndSwap(uint32* AddressPtr, uint32 OldValue, uint32 NewValue) performs an atomic compare and swap of memory contents. If disabled, the DEM uses an internal implementation, that needs the critical section 'CrossCoreComm'. If enabled, the DEM uses an external implementation.
      boolean DemUserControlledWirSupport [0..1]: set at pre-compile, origin=Vector Informatik, default-value=false  # Status Bit WarningIndicatorRequest User Controlled | Activate the external modifiability of the WarningIndicatorRequest Status Bit. If this option is enabled, the API Dem_SetWIRStatus is provided, which allows the user to override the current WarningIndicatorRequest Bit of the DTC status. Additionally, the API Dem_GetWIRStatus can be used the read the current override status (WIR controlled / not controlled by user). If this option is disabled, overriding the WarningIndicatorRequest Bit is deactivated, and the APIs Dem_SetWIRStatus and Dem_GetWIRStatus are not available.
      enumeration DemWarningIndicatorRequestedProcessing: {DEM_PROCESS_WIR_STOREDONLY, DEM_PROCESS_WIR_ALL_DTC}, set at pre-compile, origin=Vector Informatik, default-value=DEM_PROCESS_WIR_STOREDONLY  # Status Bit WarningIndicatorRequested Processing | Select behavior of WarningIndicatorRequested status bit. STOREDONLY: Set the status bit7 (WarningIndicatorRequested) only if a memory entry could be allocated successfully. ALL_DTC: Set the status bit7 (WarningIndicatorRequested) independently from successful event storage. Independent of the selected behavior the status bit 7 is not cleared due to displacement.
      boolean DemUseMultiPartitionFiM: set at pre-compile, origin=Vector Informatik, default-value=false  # Use Multi Partition FiM | This configuration switch defines, whether a Multi Partition FiM is used. If this parameter is enabled, the Dem calls the APIs FiM_DemInitMaster and FiM_DemInitSatellite instead of FiM_DemInit during initialization. This parameter is only relevant, if the FiM is notified about monitor status changes (see Dem/DemGeneral/DemTriggerFiMReports).
      boolean DemReportSuppressedDTCsInService19x0A: set at pre-compile, origin=Vector Informatik, default-value=false  # Report Suppressed DTCs In Service 19x0A | If this parameter is enabled, suppressed DTCs are reported in UDS service $19 0A. If this parameter is disabled, suppressed DTCs are not reported in UDS service $19 0A.
      boolean DemSupportAgingForAllDTCs: set at pre-compile, origin=Vector Informatik, default-value=false  # Support Aging For All DTCs | If this parameter is enabled, all DTCs can age independently of a memory entry. If this parameter is disabled, only DTCs with a memory entry can age.
      boolean DemSupportStorageIndependentCycleCounters [0..1]: set at pre-compile, origin=Vector Informatik, default-value=false  # Event Storage Independent Cycle Counters | If this parameter is enabled, Dem internal data elements FAILED_CYCLES and FAULT_PENDING_COUNTER are calculated and reported independently of an event memory entry (if configured for event). When activating this feature, the configuration needs an additional NV-RAM block with DemNvRamBlockIdType "DEM_NVBLOCK_CYCLECOUNTER". Additional two bytes per DTC are required for NVRAM. If this parameter is disabled or does not exist, the counters are only tracked and reported if the event has a memory entry. Set Dem/DemGeneral/DemExtendedDataVisibility to 'ALL_DTC' for full benefit of this feature.
      enumeration DemLatchTestFailedBehavior: {DEM_LATCH_TF_CONFIRMED_AND_THIS_CYCLE, DEM_LATCH_TF_ONLY_THIS_CYCLE}, set at pre-compile, origin=Vector Informatik, symbolic-name-value=true, default-value=DEM_LATCH_TF_CONFIRMED_AND_THIS_CYCLE  # Defines the behavior of events that have DemConfigSet/DemEventParameter/DemEventLatchTestFailed enabled. DEM_LATCH_TF_ONLY_THIS_CYCLE: After a qualified FAILED result, a PASSED result for the event is ignored during the current operation cycle. DEM_LATCH_TF_CONFIRMED_AND_THIS_CYCLE: After a qualified FAILED result, a PASSED result for the event is ignored during the current operation cycle. Additionally if the event is confirmed, no PASSED result is processed for that event until it is cleared. As a consequence, the event cannot age.
      boolean DemSupportService19x16 [0..1]: set at pre-compile, origin=Vector Informatik, default-value=false  # Support Service 19x16 | If this parameter is enabled, subfunction 0x16 (reportDTCExtDataRecordByRecordNumber) of UDS service 0x19 (ReadDTCInformation) is supported.
      boolean DemSupportService19x56 [0..1]: set at pre-compile, origin=Vector Informatik, default-value=false  # Support Service 19x56 | If this parameter is enabled, subfunction 0x56 (reportDTCInformationByDTCReadinessGroupIdentifier) of UDS service 0x19 (ReadDTCInformation) is supported. Subfunction 0x56 provides a list of OBD relevant DTCs and their UDS status information for a requested readiness group.
      boolean DemSupportService19x1A [0..1]: set at pre-compile, origin=Vector Informatik, default-value=false  # Support Service 19x1A | If this parameter is enabled, subfunction 0x1A (reportSupportedDTCExtDataRecord) of UDS service 0x19 (ReadDTCInformation) is supported. Subfunction 0x1A provides a list of all DTCs and their UDS status that are configured for a requested Extended Data Record.
      boolean DemSupportService19x04DIDLength: set at pre-compile, origin=Vector Informatik, default-value=false  # Support Service 19x04 DID Length | If this parameter is enabled, in the service 19x04 response an additional byte is added for each data identifier (DID) containing the size of the DID. This additional size byte is located between the DID and the DID data.
      boolean DemCalibrationSupport [0..1]: set at pre-compile, origin=Vector Informatik, default-value=false  # Calibration Support | If this parameter is set to true, the Dem supports calibration. The calibratable parameters can be specified via Dem/DemGeneral/DemGeneralCalibration. If this parameter is set to false, all configuration options under Dem/DemGeneral/DemCalibrationGeneral will be ignored.
      boolean DemSupportStorageIndependentMaxFDCSinceLastClear [0..1]: set at pre-compile, origin=Vector Informatik, default-value=false  # Event Storage Independent Max FDC Since Last Clear | If this parameter is enabled, the Dem internal data element MAX_FDC_SINCE_LAST_CLEAR (if configured for the event) is calculated and stored independently of an event memory entry. In order for the data element to be reported for all DTCs independent of an existing memory entry, Dem/DemGeneral/DemExtendedDataVisibility must be set to ALL_DTC. If this parameter is enabled, the data element is stored in the Admin data block instead of in the memory entry and one additional byte per DTC is required for NVRAM. If this parameter is disabled or does not exist, MAX_FDC_SINCE_LAST_CLEAR is only tracked and reported if the event has a memory entry.
      reference DemMILIndicatorRef [0..1]: scope=ECU, set at pre-compile, destination=DemIndicator  # This parameter defines the indicator representing the MIL. If no indicator is selected, the MIL is not supported by this ECU. When J1939 is supported, the MIL indicator must differ from the J1939 indicators.
      symbolic name reference DemIgnitionCycleFunctionIdRef [0..1]: set at pre-compile, origin=Vector Informatik, destination=FiMFID  # IgnitionCycle FunctionId Ref | Define a FID that is disabled when the input signals to calculate the ignition cycle are defective. This FID is required if RatioIDs are used in OBD configurations. Otherwise it is not supported.
      reference DemMasterOsApplicationRef [0..1]: set at pre-compile, origin=Vector Informatik, destination=OsApplication  # OsApplication Ref for Master | The central partition for a multi partition DEM, see chapter "Multi-Partition support" in the TechnicalReference. This partition is used as DEM Master partition. When this configuration value is missing, the pseudo partition "INVALID_OSAPPLICATION" is substituted. See also configuration parameter /Dem/DemConfigSet/DemEventParameter/DemEventOsApplicationRef for the mapping of events to the DEM satellite's partition. This value DemMasterOsApplicationRef here acts as a default for not configured DemEventOsApplicationRef values.
      reference DemOsApplicationRef [0..*]: set at pre-compile, origin=Vector Informatik, destination=OsApplication  # OsApplication Ref | List of references to partitions, the DEM is running at. The Dem directly supports multi partition architectures, i.e. ECUs using multiple cores or memory protection for safety reasons. See chapter "Multi-Partition support" in the TechnicalReference for details. This list here implicitly contains all configured /Dem/DemConfigSet/DemEventParameter/DemEventOsApplicationRef references as well as the configured /Dem/DemGeneral/DemMasterOsApplicationRef reference - even if they are not configured here explicitly.
      reference DemRestartCycleOnInitRef [0..1]: set at pre-compile, origin=Vector Informatik, destination=DemOperationCycle  # Automatically start the referenced cycle with Dem_PreInit(). BSW events need a started cycle (typically the power cycle) to not be discarded. Event changes will not be notified (Callbacks OnStatusChange, FiM, etc) since the RTE is not necessarily available at this point in time. Make sure dependent modules (e.g. FiM) are set up accordingly.
      choice reference DemClearEventsWithoutDTCEventMemoryRef [0..1]: set at pre-compile, destination=[DemPrimaryMemory, DemUserDefinedMemory]  # Indicating the event memory used as trigger to clear events without assigned DTCs.
      container DemAgingCycle [0..0]  # AgingCycle | Aging cycles are not supported. Use OperationCycles instead.
      container DemCallbackDTCStatusChanged [0..*]  # Callback DTCStatusChanged | The presence of this container sets up a callout function 'DTCStatusChanged' for this DTC. The Dem will call this function each time a DTC status changes. This function is usually called through a RTE port interface. This behavior can be changed by creating the sub-parameter 'DemCallbackDTCStatusChangedFnc'.
        function name DemCallbackDTCStatusChangedFnc [0..1]: scope=ECU, set at pre-compile  # Callback DTCStatusChanged Function | Function name of a 'DTCStatusChanged' callout. If this parameter exists, it must give a valid C-Function which is called instead of using an RTE port interface. See DemGeneral/DemHeaderFileInclusion to specify a header file which declares this function.
      container DemClient [1..255]  # This container contains possible clients that are using the Dem APIs.
        integer DemClientId: 0..254, scope=ECU, set at pre-compile, origin=Vector Informatik, symbolic-name-value=true, default-value=254  # Defines a unique identifier for a Dem client. This number is used by this client in the ClientID parameter in all API with this parameter.
      container DemDataClass [0..65534]  # This container groups the configuration (parameters) of a data element. Data elements are used to build DIDs, PIDs and ExtendedDataRecords
        integer DemDataElementDataSize: 1..4096, scope=ECU, set at pre-compile, origin=Vector Informatik  # DataElement Data Size | Defines the size of the data element in bytes. For Dem-internal data elements, the size shall be predefined according to the selected internal data element (see Dem/DemGeneral/DemDataClass/DemDataElementInternalData). For Dem-external data elements, the size depends on the data type and number of elements which needs to be stored. For array data classes, this field must contain the total size of the array in bytes. An example is provided below. BOOLEAN is a 8 bit data type and therefore needs 1 byte. UINT8, SINT8, UINT8_N and SINT8_N are 8 bit data types and therefore need 1 bytes per element. UINT16, SINT16, UINT16_N and SINT16_N are 16 bit data types and therefore need 2 bytes per element. UINT32, SINT32, UINT32_N and SINT32_N are 32 bit data types and therefore need 4 bytes per element. FLOAT and FLOAT_N entries are 32 bit data types and therefore need 4 bytes per element. Example: For example if an UINT16_N array data type is selected, of which 4 entries need to be stored, than a data size of 8 bytes needs to be allocated.
        enumeration DemDataElementDataType [0..1]: {BOOLEAN, SINT16, SINT32, SINT8, SINT8_N, UINT16, UINT32, UINT8, UINT8_N, UINT16_N, SINT16_N, UINT32_N, SINT32_N, FLOAT, FLOAT_N}, set at pre-compile, origin=Vector Informatik  # Provide the implementation data type of data belonging to a external data. For DemDataElementDataSize > 1 the configured data type UINT8/SINT8 is treated as UINT8_N/SINT8_N to establish compatibility with the DCM.
        enumeration DemDataElementEndianness [0..1]: {BIG_ENDIAN, LITTLE_ENDIAN, OPAQUE}, set at pre-compile, origin=Vector Informatik  # Defines the endianness of the data belonging to an external data.
        enumeration DemDataElementInternalData [0..1]: {DEM_AGINGCTR, DEM_AGINGCTR_UPCNT, DEM_AGINGCTR_INVERTED, DEM_AGINGCTR_DOWNCNT, DEM_OCCCTR, DEM_OCCCTR_2BYTE, DEM_OVFLIND, DEM_SIGNIFICANCE, DEM_PRIORITY, DEM_CURRENT_FDC, DEM_MAX_FDC_SINCE_LAST_CLEAR, DEM_MAX_FDC_DURING_CURRENT_CYCLE, DEM_CYCLES_SINCE_FIRST_FAILED, DEM_CYCLES_SINCE_LAST_FAILED, DEM_FAILED_CYCLES, DEM_CONSECUTIVE_FAILED_CYCLES, DEM_CYCLES_TESTED_SINCE_FIRST_FAILED, DEM_CYCLES_TESTED_SINCE_LAST_FAILED, DEM_HEALINGCTR_DOWNCNT, DEM_ROOTCAUSE_EVENTID, DEM_OBDDTC, DEM_OBDDTC_3BYTE, DEM_OBD_RATIO, DEM_FAULT_PENDING_COUNTER, DEM_AGED_COUNTER, DEM_WUC_SINCE_LAST_FAILED, DEM_IUMPR, DEM_DTR, DEM_MONITOR_ACTIVITY_DATA}, scope=ECU, set at pre-compile, origin=Vector Informatik  # Internal DataElement | Select the Dem-internal data value, which is mapped to the data element. AGINGCTR / AGINGCTR_UPCNT: (1 Byte) Current value of the aging counter, counting from 1...DemAgingCycleCounterThreshold. The value latches at aging counter threshold (refer to DemGeneral/DemAgingCounterBehavior). If DemGeneral/DemSupportAgingForAllDTCs is disabled, this value is processed and readable only for currently stored events. If DemGeneral/DemSupportAgingForAllDTCs is enabled, depending on the configuration, this value is always readable (refer to Dem/DemGeneral/DemExtendedDataVisibility). AGINGCTR_INVERTED / AGINGCTR_DOWNCNT: (1 Byte) Current value of the aging counter, counting backwards from the configured aging cycle counter threshold value down to 0. If DemGeneral/DemSupportAgingForAllDTCs is disabled, this value is processed and readable only for currently stored events. If DemGeneral/DemSupportAgingForAllDTCs is enabled, depending on the configuration, this value is always readable (refer to Dem/DemGeneral/DemExtendedDataVisibility). OCCCTR: (1 Byte) Current value of the occurrence counter, counting from 1...255. The value is incremented on each transition of the TestFailed Bit from 0 to 1 and latches at 255. This value is processed and readable only for currently stored events. OCCCTR_2BYTE: (2 Byte) Current value of the occurrence counter, counting from 1...65535. The value is incremented on each transition of the TestFailed Bit from 0 to 1 and latches at 65535. This value is processed and readable only for currently stored events. OVFLIND: (1 Byte) Value 1 if the primary memory has overflown, 0 otherwise. Will be reset on ClearAllDTC request. This value is always available. SIGNIFICANCE: (1 Byte) Value 0 if the event is configured as OCCURRENCE, 1 if the event is configured as FAILURE. This value is always available. PRIORITY: (1 Byte) The DTC priority which is mapped into the environmental data. This value is always available. CURRENT_FDC: (1 Byte) Current value of the DTC fault detection counter. This value is always available. MAX_FDC_SINCE_LAST_CLEAR: (1 Byte) Maximum value of the DTC fault detection counter reached since last clear. 0 is the minimum value reported. If Dem/DemGeneral/DemSupportStorageIndependentMaxFDCSinceLastClear is not enabled the data element is processed and readable only for currently stored events. Otherwise it is processed and readable at all times (see also Dem/DemGeneral/DemExtendedDataVisibility). MAX_FDC_DURING_CURRENT_CYCLE: (1 Byte) Maximum value of the DTC fault detection counter reached in the current operation cycle. 0 is the minimum value reported. This value is always available. CYCLES_SINCE_FIRST_FAILED: (1 Byte) Number of completed operation cycles, since the cycle of the first transition of the TestFailed Bit from 0 to 1 of the DTC. The value latches at 255. The counter is processed and readable only for currently stored events. CYCLES_SINCE_LAST_FAILED: (1 Byte) Number of completed operation cycles, since the last transition of the TestFailed Bit from 0 to 1 of the DTC. The value is reset at the first failed result in the operation cycle, latches at 255. The counter is processed and readable only for currently stored events. FAILED_CYCLES: (1 Byte) Number of operation cycles, since last DTC clear in which the DTC was tested 'failed', including the current cycle. The value is incremented at the first failed result in the operation cycle, latches at 255. If Dem/DemGeneral/DemSupportStorageIndependentCycleCounters is not enabled the counter is processed and readable only for currently stored events. Otherwise the counter is processed and readable at all times (see also Dem/DemGeneral/DemExtendedDataVisibility). CONSECUTIVE_FAILED_CYCLES: (1 Byte): Number of consecutive operation cycles in which the DTC was tested 'failed', including the current cycle. The value is incremented at the first failed result in the operation cycle and reset at the end of an operation cycle that was tested and not tested 'failed'.The value latches at 255. The counter is processed and readable only for currently stored events. CYCLES_TESTED_SINCE_FIRST_FAILED: (1 Byte) Number of completed and tested operation cycles since the cycle of the first transition of the TestFailed Bit from 0 to 1 of the DTC. The value latches at 255. The counter is processed and readable only for currently stored events. CYCLES_TESTED_SINCE_LAST_FAILED: (1 Byte) Number of completed and tested operation cycles, since the last transition of the TestFailed Bit from 0 to 1 of the DTC (Healing Counter). The value is reset at the first failed result in the operation cycle, latches at 255. The value is always available. HEALINGCTR_DOWNCNT: (1 Byte) Number of complete and tested operation cycles until WIR bit will be cleared (independently of whether Dem/DemConfigSet/DemEventParameter/DemEventClass/DemIndicatorAttribute/DemIndicatorRef is set or not). If healing has not started yet, Dem/DemConfigSet/DemEventParameter/DemEventClass/DemIndicatorAttribute/DemIndicatorHealingCycleCounterThreshold is reported. If healing is completed, 0 is reported. The value is always available. ROOTCAUSE_EVENTID: (2 Byte) The event id that caused the storage/update of the environmental data. Can be used in context of the feature 'combined event' to store the root cause DemEventId value. The value is processed and readable only for currently stored events OBDDTC: (2 Byte) The corresponding OBD II DTC for the requested UDS DTC. If no OBD II DTC is configured, the returned value will be 0. This value is always available. OBDDTC_3BYTE: (3 Byte) In OBDII configurations: The corresponding OBD II DTC for the requested UDS DTC in format [0x00 LoByte HiByte]. In OBD on UDS configurations: The corresponding 3 byte OBD DTC for the requested UDS DTC, if DemGeneral/DemGeneralOBD/DemSupportedObdUdsDtcSeparation == true. If no OBD II DTC resp. 3 byte OBD DTC is configured, the returned value will be 0. This value is always available. OBD_RATIO: (4 Byte) If the DTC has a ratio attached, the numerator and denominator are returned in the following format: [NumHiByte NumLoByte DenomHiByte DenomLoByte]. If the DTC does not have a ratio attached, the returned value is [0x00 0x00 0x00 0x00]. This value is always available. FAULT_PENDING_COUNTER: (1 Byte) Number of consecutive operation cycles in which the DTC was tested 'failed', including the current cycle. The value is incremented at the first failed result in the operation cycle and reset at the end of an operation cycle that was tested and not tested 'failed'. In contrast to the 'Consecutive Failed Cycle Counter' the value latches at DemEventFailureCycleCounterThreshold + 1. If Dem/DemGeneral/DemSupportStorageIndependentCycleCounters is not enabled the counter is processed and readable only for currently stored events. Otherwise the counter is processed and readable at all times (see also Dem/DemGeneral/DemExtendedDataVisibility). AGED_COUNTER: (1 Byte) Current value of the aged counter. The value is incremented, if the DTC is aged and reset, if the DTC is cleared. The value latches at 255 and is always available. WUC_SINCE_LAST_FAILED: (1 Byte) Number of completed warm up cycles, since the last transition of the TestFailed Bit from 0 to 1 of the DTC. The value latches at 255. The counter is processed and readable only for currently stored events. IUMPR: (4 Byte) The numerator and denominator of the ratio of a DTC are returned in the following format: [NumHiByte NumLoByte DenomHiByte DenomLoByte]. This value can be used to configure extended data record number 0x91 according to SAE J1979-2. The value is only available, if OBD on UDS is supported (see Dem/DemGeneral/DemGeneralOBD/DemOBDLegislation). DTR: (1 Byte for the number of test results, 8 Byte for each test result) The Diagnostic Test Results (DTRs) of a DTC are returned in the following format: [NumberOfTestResults] and for each test result: [UaSIdHiByte UaSIdLoByte TestValueHiByte TestValueLoByte MinTestLimitHiByte MinTestLimitLoByte MaxTestLimitHiByte MaxTestLimitLoByte]. The DTRs are returned in ascending order by Monitor Identifier (MID) and Test Identifier (TID). The size of this internal data element varies for each DTC based on the number of DTRs referencing the corresponding event. Due to this variability, size must be configured to the maximum supported value of 249 bytes (Dem supports a maximum of 31 DTRs with 8 byte each plus 1 byte for the number of test results, see Dem/DemGeneral/DemDataClass/DemDataElementDataSize). The actual size is calculated at runtime. This value can be used to configure extended data record number 0x92 according to SAE J1979-2. The value is only available, if OBD on UDS is supported (see Dem/DemGeneral/DemGeneralOBD/DemOBDLegislation). MONITOR_ACTIVITY_DATA: (2 Byte) The monitor activity numerator (MAN) and stored monitor activity ratio (SMAR) of a DTC are returned in the following format: [MAN SMAR]. This value can be used to configure extended data record number 0x93 according to SAE J1979-2. The value is only available, if OBD on UDS is supported (see Dem/DemGeneral/DemGeneralOBD/DemOBDLegislation).
        function name DemDataElementReadFnc [0..1]: scope=ECU, set at pre-compile, origin=Vector Informatik  # In case of DemDataElementUsePort is USE_DATA_FUNCTION_CALL, USE_DATA_FUNCTION_CALL_WITH_EVENTID, USE_DATA_FUNCTION_CALL_WITH_EVENTID_BUFFERLENGTH or USE_DATA_FUNCTION_CALL_WITH_PROXY, this parameter defines the prototype of the C function "ReadDataElement" used to get the according value.
        boolean DemDataElementStoreNonVolatile: set at pre-compile, origin=Vector Informatik, default-value=true  # Select if the data element needs to be stored in NVRam. Ususally, snapshots of a system value (like temperature, voltage...) need to be stored in NVRam. If the data element is stored, the Dem will collect the current value into NVRam at the DTC storage time. Reading access will return the stored data (e.g. for diagnostic service $19) Disabling NV storage for this data element will cause the Dem to fetch the data with each read access. This is useful if this data element is something that will not change over time, or is already stored outside the Dem.
        enumeration DemDataElementUsePort: {USE_DATA_CLIENT_SERVER_PORT, USE_DATA_CLIENT_SERVER_PORT_WITH_EVENTID, USE_DATA_FUNCTION_CALL, USE_DATA_FUNCTION_CALL_WITH_EVENTID, USE_DATA_SENDER_RECEIVER, USE_DATA_INTERNAL, USE_DATA_FUNCTION_CALL_WITH_EVENTID_BUFFERLENGTH, USE_DATA_FUNCTION_CALL_WITH_PROXY}, scope=ECU, set at pre-compile, origin=Vector Informatik, default-value=USE_DATA_CLIENT_SERVER_PORT  # Defines which interface shall be used to access the data. For data calculated internally by the Dem, use USE_DATA_INTERNAL For data provided by the application through a client/server port, use USE_DATA_CLIENT_SERVER_PORT USE_DATA_CLIENT_SERVER_PORT_WITH_EVENTID For data provided by the application through a C function-callback, use USE_DATA_FUNCTION_CALL USE_DATA_FUNCTION_CALL_WITH_EVENTID USE_DATA_FUNCTION_CALL_WITH_EVENTID_BUFFERLENGTH USE_DATA_FUNCTION_CALL_WITH_PROXY For data provided by the application through a sender/receiver port, use USE_DATA_SENDER_RECEIVER
        foreign reference DemDataElementSystemTemplateDiagnosticDataElementRef [0..1]: set at pre-compile, origin=Vector Informatik, destination-type=DIAGNOSTIC-DATA-ELEMENT  # DataElement System Template Diagnostic DataElement Ref | Reference to the DiagnosticDataElement which is represented by this DemDataClass.
        choice container DemDiagnosisScaling [0..1]  # This container contains the configuration (parameters) of an alternative Diagnosis Representation. Out if this the scaling between Diagnosis and ECU internal representation and vice versa can be calculated. (not supported)
          container DemAlternativeDataInterface [0..1]  # This container contains the configuration (parameters) of an alternative Diagnosis Representation by the means of a VariableDataPrototoype in a DataInterface. (not supported)
            foreign reference DemDataElement: set at pre-compile, origin=Vector Informatik, destination-type=VARIABLE-DATA-PROTOTYPE  # Alternative Diagnosis Representation for the data defined by the means of a VariableDataPrototoype in a DataInterface. (not supported)
            foreign reference DemPortInterfaceMapping [0..1]: set at pre-compile, origin=Vector Informatik, destination-type=PORT-INTERFACE-MAPPING  # Optional reference to PortInterfaceMapping which defines the mapping rules. (not supported)
          container DemAlternativeDataProps [0..1]  # This container contains the configuration (parameters) of an alternative Diagnosis Representation by the means of ECU configuration parameters. (not supported)
            enumeration DemDataTypeCategory: {SCALE_LINEAR_AND_TEXTTABLE, TEXTTABLE}, scope=ECU, set at pre-compile, origin=Vector Informatik  # Data category of the alternative Diagnosis Representation. (not supported)
            container DemLinearScale [0..1]  # This container contains the configuration (parameters) of an linear scale of the alternative Diagnosis Representation. (not supported)
              float DemDiagnosisRepresentationDataLowerRange: -1.7976931348623157E+308..1.7976931348623157E+308, scope=ECU, set at pre-compile, origin=Vector Informatik  # Lower Range for this scale of the data in the alternative Diagnosis Representation. (not supported)
              float DemDiagnosisRepresentationDataOffset: 0..1.7976931348623157E+308, scope=ECU, set at pre-compile, origin=Vector Informatik, default-value=0  # Data offset of the alternative Diagnosis Representation for this scale. (not supported)
              float DemDiagnosisRepresentationDataResolution: 0..1.7976931348623157E+308, scope=ECU, set at pre-compile, origin=Vector Informatik  # Data resolution of the alternative Diagnosis Representation for this scale. (not supported)
              float DemDiagnosisRepresentationDataUpperRange: 0..1.7976931348623157E+308, scope=ECU, set at pre-compile, origin=Vector Informatik  # Upper Range for this scale of the data in the alternative Diagnosis Representation. (not supported)
            container DemTextTableMapping [0..*]  # This container contains the configuration (parameters) of the mapping a DataPrototype typed by AutosarDataType that refer to a CompuMethods of category TEXTTABLE or SCALE_LINEAR_AND_TEXTTABLE. (not supported)
              integer DemDiagnosisRepresentationDataValue: 0..18446744073709551615, scope=ECU, set at pre-compile, origin=Vector Informatik  # The data value in the diagnosis representation. (not supported)
              integer DemInternalDataValue: 0..18446744073709551615, scope=ECU, set at pre-compile, origin=Vector Informatik  # The ECU internal data value. (not supported)
          container DemAlternativeDataType [0..1]  # This container contains the configuration (parameters) of an alternative Diagnosis Representation by the means of an ApplicationDataType. (not supported)
            foreign reference DemApplicationDataType: set at pre-compile, origin=Vector Informatik, destination-type=APPLICATION-PRIMITIVE-DATA-TYPE  # Alternative Diagnosis Representation for the data defined by the means of a ApplicationPrimitiveDataType of category VALUE or BOOLEAN. (not supported)
            container DemTextTableMapping [0..*]  # This container contains the configuration (parameters) of the mapping a DataPrototype typed by AutosarDataType that refer to a CompuMethods of category TEXTTABLE or SCALE_LINEAR_AND_TEXTTABLE. (not supported)
              integer DemDiagnosisRepresentationDataValue: 0..18446744073709551615, scope=ECU, set at pre-compile, origin=Vector Informatik  # The data value in the diagnosis representation. (not supported)
              integer DemInternalDataValue: 0..18446744073709551615, scope=ECU, set at pre-compile, origin=Vector Informatik  # The ECU internal data value. (not supported)
        choice container DemSRDataElementClass [0..1]  # This container defines the source of data in a provided port which shall be read for a external data element. (not supported)
          container DemDataElementInstance [0..1]  # Instance Reference to the primitive data in a port where the data element is typed with an ApplicationPrimitveDataType or an ImplementationDataType. (not supported)
            instance reference DemDataElementInstanceRef: set at pre-compile, origin=Vector Informatik, destination-context=ROOT-SW-COMPOSITION-PROTOTYPE SW-COMPONENT-PROTOTYPE PORT-PROTOTYPE, destination-type=AUTOSAR-DATA-PROTOTYPE  # Instance Reference to the primitive data which shall be read or written. (not supported)
          container DemSubElementInDataElementInstance [0..1]  # Instance Reference to the primitve sub-element (at any level) of composite data in a port where the data element is typed with an ApplicationCompositeDataType. (not supported)
            instance reference DemSubElementInDataElementInstanceRef: set at pre-compile, origin=Vector Informatik, destination-context=ROOT-SW-COMPOSITION-PROTOTYPE SW-COMPONENT-PROTOTYPE PORT-PROTOTYPE AUTOSAR-DATA-PROTOTYPE APPLICATION-COMPOSITE-ELEMENT-DATA-PROTOTYPE*, destination-type=AUTOSAR-DATA-PROTOTYPE  # Instance Reference to the primitve sub-element (at any level) of composite data in a port which shall be read or written. (not supported)
          container DemSubElementInImplDataElementInstance [0..1]  # Instance Reference to the primitve sub-element (at any level) of composite data in a port where the data element is typed with an ImplementationDataType of category STRUCTURE or ARRAY. (not supported)
            instance reference DemSubElementInImplDataElementInstanceRef: set at pre-compile, origin=Vector Informatik, destination-context=ROOT-SW-COMPOSITION-PROTOTYPE SW-COMPONENT-PROTOTYPE PORT-PROTOTYPE AUTOSAR-DATA-PROTOTYPE IMPLEMENTATION-DATA-TYPE-ELEMENT*, destination-type=IMPLEMENTATION-DATA-TYPE-ELEMENT  # Instance Reference to the primitve sub-element (at any level) of composite data in a port which shall be read or written. (not supported)
      container DemDidClass [0..65025]  # This container represents a Data Identifier (DID) as defined by the UDS protocol. Each DID is assembled out of one or several data elements.
        integer DemDidIdentifier: 0..65535, set at post-build in variant post-build-loadable+post-build-selectable / pre-compile in variant pre-compile  # Identifier of the Data ID as returned e.g. in $19 04.
        reference DemDidDataClassRef [1..255]: scope=ECU, set at pre-compile, origin=Vector Informatik, requires-index=true, destination=DemDataClass  # Did Data Class Ref | These references select the data elements contained in the DID. The data elements are ordered as in the XML file.
        foreign reference DemDidSystemTemplateDiagnosticDataIdentifierRef [0..1]: set at pre-compile, origin=Vector Informatik, destination-type=DIAGNOSTIC-DATA-IDENTIFIER  # Reference to the DiagnosticDataIdentifier which is represented by this DemDidClass.
      container DemEnableCondition [0..254]  # EnableCondition | This container represents a single enable condition. Please note: enable conditions can not be used directly but must be grouped (see DemEnableConditionGroup).
        integer DemEnableConditionId: 1..255, scope=ECU, set at pre-compile, symbolic-name-value=true, default-value=255  # EnableCondition Id | Internal identifier of the enable condition. This number is calculated internally and shall not be configured manually. This parameter is only available to publish the result of this calculation. Applications using Dem APIs must not rely on the value of this parameter. Instead, they must use the symbolic constant (SymbolicNameValue) DemConf_DemEnableCondition_{SHORT-NAME}. The ID value 0 is reserved for internal purpose.
        boolean DemEnableConditionStatus: scope=ECU, set at pre-compile, default-value=true  # EnableCondition Status | Defines the status of this enable condition after full initialization, i.e. when Dem_MasterInit() or Dem_Init() finished. After pre-initialization, but before the full intialization (between Dem_(Master)PreInit() and Dem_(Master)Init()) the status is always 'true'. Changes to the enable condition status during runtime are not persisted non-volatile. The status of this enable condition will always be reset to this configuration value during Dem_MasterInit() or Dem_Init().
      container DemEnableConditionGroup [0..255]: post-build-changeable=true  # EnableCondition Group | This container groups several enable conditions. EventParameters only reference one of these groups, not individual enable conditions.
        reference DemEnableConditionRef [1..254]: scope=ECU, set at post-build in variant post-build-loadable+post-build-selectable / pre-compile in variant pre-compile, origin=AUTOSAR_ECUC V1.0.0, destination=DemEnableCondition  # EnableCondition Ref | References an enable condition.
      container DemEventMemorySet  # This container is a collection of referenced event memories and related information for a Dem client.
        container DemClearDTCNotification [0..255]  # Contains callback function definition which are called during clear DTC operations.
          function name DemClearDtcNotificationFnc [0..1]: set at pre-compile, origin=Vector Informatik  # Notification callback function name which is called on a clear DTC operation (refer to <Module>_ClearDtcNotification). If this parameter exists, it must give a valid C-Function which is called instead of using an RTE port interface. See DemGeneral/DemHeaderFileInclusion to specify a header file which declares this function.
          enumeration DemClearDtcNotificationTime: {FINISH, START}, set at pre-compile, origin=Vector Informatik  # Configure, whether the callback shall be called on start of a clear or after finishing a clear DTC operation (refer to <Module>_ClearDtcNotification)
        container DemPrimaryMemory  # This container contains the primary event memory specific parameters of the Dem module.
          integer DemMaxNumberEventEntryPrimary: 1..255, set at pre-compile, default-value=8  # Maximum number of events which can be stored in the primary memory
          enumeration DemTypeOfFreezeFrameRecordNumeration: {DEM_FF_RECNUM_CALCULATED, DEM_FF_RECNUM_CONFIGURED, DEM_FF_RECNUM_CALCULATED_FIFO}, scope=ECU, set at pre-compile, default-value=DEM_FF_RECNUM_CALCULATED  # Type Of FreezeFrameRecord Numeration | This parameter defines the type of assigning snapshot record numbers. CALCULATED: The snapshot records are enumerated from one (1) up to DemConfigSet/DemEventParameter/DemMaxNumberFreezeFrameRecords for each event. Once an event memory entry is created a snapshot is stored at each FAILED transition. After DemMaxNumberFreezeFrameRecords have been stored for the event, the last snapshot is updated with each FAILED transition. CALCULATED_FIFO: The snapshot records are enumerated from one (1) up to DemConfigSet/DemEventParameter/DemMaxNumberFreezeFrameRecords for each event. Once an event memory entry is created, a snapshot is stored at each FAILED transition of the event. After DemMaxNumberFreezeFrameRecords have been stored for the event, the oldest snapshot is overwritten during the next trigger. When a snapshot is overwritten, all snapshot records are renumbered in ascending order from oldest to newest snapshot record. CONFIGURED: The snapshot record numbers are taken from DemConfigSet/DemEventParameter/DemFreezeFrameRecNumClassRef. Storage triggers and update conditions can be configured.
          enumeration DemEventMemoryEntryStorageTrigger: {DEM_STORAGE_ON_CONFIRMED, DEM_STORAGE_ON_FDC_THRESHOLD, DEM_STORAGE_ON_PENDING, DEM_STORAGE_ON_TEST_FAILED}, set at pre-compile, default-value=DEM_STORAGE_ON_TEST_FAILED  # Event Memory Entry Storage Trigger | This parameter describes the trigger for the allocation of an event memory entry, i.e. the point of time when the corresponding DTC is initially stored in the referenced event memory. CONFIRMED: An event entry is allocated once its corresponding DTC confirms (bit3 transitions 0->1). FDC_THRESHOLD: An event entry is allocated once the fault detection counter of its corresponding DTC exceeds its storage threshold. PENDING: An event entry is allocated once its corresponding DTC gets pending (bit2 transitions 0->1). TEST_FAILED: An event entry is allocated once its corresponding DTC fails (bit0 transitions 0->1). Restriction: If FDC_THRESHOLD is selected, monitor internal debouncing cannot be used to store event data at pre-failed.
          integer DemMaxNumberTimeSeriesSnapshots: 0..32, set at pre-compile, origin=Vector Informatik, default-value=0  # Max Number Time Series Entries | This parameter defines the maximum number of events for which time series snapshot records (also known as multi-sample development snapshot records) can be stored at the same time for this event memory.
          integer DemMaxNumberTimeSeriesSnapshotSets [0..1]: 1..16, set at pre-compile, origin=Vector Informatik, default-value=1  # Max Number Time Series Sets | The maximum number of time series snapshot record sets that can be stored for an event assigned to this memory. If the parameter is missing, only one set will be stored. A set of time series snapshot records consists of all past and future samples that are stored for an event after the freeze frame storage trigger has occurred. With each re-occurrence of the trigger, a new set can be stored. When the maximum number of time series snapshot record sets has been stored, the new set may overwrite the oldest set depending on the value of DemTimeSeriesSnapshotFifoSupport. For more information on how the time series snapshot records of the different sets are numbered, refer to DemTimeSeriesSnapshotRecordNumberOffset.
          boolean DemTimeSeriesSnapshotFifoSupport: set at pre-compile, origin=Vector Informatik, default-value=false  # Time Series Fifo Support | This configuration switch defines if the time series snapshot record sets of events assigned to this memory are stored in a circular buffer. If the switch is enabled and the configured maximum number of time series snapshot record sets (see DemMaxNumberTimeSeriesSnapshotSets) is stored for an event, the oldest set of time series snapshot records will be overwritten with each new storage trigger occurrence. Correspondingly, all time series snapshot records of the event will be renumbered in ascending order from oldest to newest.
          integer DemTimeSeriesSnapshotRecordNumberOffset [0..1]: 1..32, set at pre-compile, origin=Vector Informatik, default-value=8  # Time Series Sets Record Number Offset | This offset is used to calculate the first record number of all subsequent sets of time series snapshots that are stored for an event (see DemMaxNumberTimeSeriesSnapshotSets). This parameter only has an effect if DemMaxNumberTimeSeriesSnapshotSets is greater than 1. The first set of time series snapshot record numbers starts at the freeze frame recod number (see DemFreezeFrameRecordNumber) configured for the time series snapshot record (see DemFreezeFrameRecordIsTimeSeries). If DemMaxNumberTimeSeriesSnapshotSets is greater than 1, the records numbers of the subsequent sets will start at: - DemFreezeFrameRecordNumber + (1 * DemTimeSeriesSnapshotOffset), - DemFreezeFrameRecordNumber + (2 * DemTimeSeriesSnapshotOffset), ... - DemFreezeFrameRecordNumber + (n* DemTimeSeriesSnapshotOffset), where n equals (DemMaxNumberTimeSeriesSnapshotSets -1). Example: - DemFreezeFrameRecordNumber is set to 0x80, - DemTimeSeriesSnapshotOffset is set to 0x08 and - DemMaxNumberTimeSeriesSnapshotSets equals 3, the different sets of time series snapshot records stored for an event will start at record number - 0x80, - 0x88 and - 0x90.
          integer DemMaxNumberCustomTriggeredSnapshots: 0..255, set at pre-compile, origin=Vector Informatik, default-value=0  # This parameter defines the maximum number of events for which custom triggered snapshot records and/or custom triggered time series snapshot records can be stored at the same time for this event memory. A snapshot record or time series snapshot record is custom triggered if the corresponding DemFreezeFrameRecordTrigger is configured to DEM_TRIGGER_ON_CUSTOM.
        container DemUserDefinedMemory [0..256]  # This container contains the user defined event memory specific parameters of the Dem module.
          integer DemMaxNumberEventEntryUserDefined: 1..255, set at pre-compile  # Maximum number of events which can be stored in the user defined memory.
          integer DemUserDefinedMemoryIdentifier: 0..255, set at pre-compile  # Identifier used by external tester to identify the User defined event memory
          enumeration DemTypeOfFreezeFrameRecordNumeration: {DEM_FF_RECNUM_CALCULATED, DEM_FF_RECNUM_CONFIGURED, DEM_FF_RECNUM_CALCULATED_FIFO}, scope=ECU, set at pre-compile, default-value=DEM_FF_RECNUM_CALCULATED  # Type Of FreezeFrameRecord Numeration | This parameter defines the type of assigning snapshot record numbers. CALCULATED: The snapshot records are enumerated from one (1) up to DemConfigSet/DemEventParameter/DemMaxNumberFreezeFrameRecords for each event. Once an event memory entry is created a snapshot is stored at each FAILED transition. After DemMaxNumberFreezeFrameRecords have been stored for the event, the last snapshot is updated with each FAILED transition. CALCULATED_FIFO: The snapshot records are enumerated from one (1) up to DemConfigSet/DemEventParameter/DemMaxNumberFreezeFrameRecords for each event. Once an event memory entry is created, a snapshot is stored at each FAILED transition of the event. After DemMaxNumberFreezeFrameRecords have been stored for the event, the oldest snapshot is overwritten during the next trigger. When a snapshot is overwritten, all snapshot records are renumbered in ascending order from oldest to newest snapshot record. CONFIGURED: The snapshot record numbers are taken from DemConfigSet/DemEventParameter/DemFreezeFrameRecNumClassRef. Storage triggers and update conditions can be configured.
          enumeration DemEventMemoryEntryStorageTrigger: {DEM_STORAGE_ON_CONFIRMED, DEM_STORAGE_ON_FDC_THRESHOLD, DEM_STORAGE_ON_PENDING, DEM_STORAGE_ON_TEST_FAILED}, set at pre-compile, default-value=DEM_STORAGE_ON_TEST_FAILED  # Event Memory Entry Storage Trigger | This parameter describes the trigger for the allocation of an event memory entry, i.e. the point of time when the corresponding DTC is initially stored in the referenced event memory. CONFIRMED: An event entry is allocated once its corresponding DTC confirms (bit3 transitions 0->1). FDC_THRESHOLD: An event entry is allocated once the fault detection counter of its corresponding DTC exceeds its storage threshold. PENDING: An event entry is allocated once its corresponding DTC gets pending (bit2 transitions 0->1). TEST_FAILED: An event entry is allocated once its corresponding DTC fails (bit0 transitions 0->1). Restriction: If FDC_THRESHOLD is selected, monitor internal debouncing cannot be used to store event data at pre-failed.
          integer DemMaxNumberTimeSeriesSnapshots: 0..32, set at pre-compile, origin=Vector Informatik, default-value=0  # Max Number Time Series Entries | This parameter defines the maximum number of events for which time series snapshot records (also known as multi-sample development snapshot records) can be stored at the same time for this event memory.
          integer DemMaxNumberTimeSeriesSnapshotSets [0..1]: 1..16, set at pre-compile, origin=Vector Informatik, default-value=1  # Max Number Time Series Sets | The maximum number of time series snapshot record sets that can be stored for an event assigned to this memory. If the parameter is missing, only one set will be stored. A set of time series snapshot records consists of all past and future samples that are stored for an event after the freeze frame storage trigger has occurred. With each re-occurrence of the trigger, a new set can be stored. When the maximum number of time series snapshot record sets has been stored, the new set may overwrite the oldest set depending on the value of DemTimeSeriesSnapshotFifoSupport. For more information on how the time series snapshot records of the different sets are numbered, refer to DemTimeSeriesSnapshotRecordNumberOffset.
          boolean DemTimeSeriesSnapshotFifoSupport: set at pre-compile, origin=Vector Informatik, default-value=false  # Time Series Fifo Support | This configuration switch defines if the time series snapshot record sets of events assigned to this memory are stored in a circular buffer. If the switch is enabled and the configured maximum number of time series snapshot record sets (see DemMaxNumberTimeSeriesSnapshotSets) is stored for an event, the oldest set of time series snapshot records will be overwritten with each new storage trigger occurrence. Correspondingly, all time series snapshot records of the event will be renumbered in ascending order from oldest to newest.
          integer DemTimeSeriesSnapshotRecordNumberOffset [0..1]: 1..32, set at pre-compile, origin=Vector Informatik, default-value=8  # Time Series Sets Record Number Offset | This offset is used to calculate the first record number of all subsequent sets of time series snapshots that are stored for an event (see DemMaxNumberTimeSeriesSnapshotSets). This parameter only has an effect if DemMaxNumberTimeSeriesSnapshotSets is greater than 1. The first set of time series snapshot record numbers starts at the freeze frame recod number (see DemFreezeFrameRecordNumber) configured for the time series snapshot record (see DemFreezeFrameRecordIsTimeSeries). If DemMaxNumberTimeSeriesSnapshotSets is greater than 1, the records numbers of the subsequent sets will start at: - DemFreezeFrameRecordNumber + (1 * DemTimeSeriesSnapshotOffset), - DemFreezeFrameRecordNumber + (2 * DemTimeSeriesSnapshotOffset), ... - DemFreezeFrameRecordNumber + (n* DemTimeSeriesSnapshotOffset), where n equals (DemMaxNumberTimeSeriesSnapshotSets -1). Example: - DemFreezeFrameRecordNumber is set to 0x80, - DemTimeSeriesSnapshotOffset is set to 0x08 and - DemMaxNumberTimeSeriesSnapshotSets equals 3, the different sets of time series snapshot records stored for an event will start at record number - 0x80, - 0x88 and - 0x90.
          integer DemMaxNumberCustomTriggeredSnapshots: 0..255, set at pre-compile, origin=Vector Informatik, default-value=0  # This parameter defines the maximum number of events for which custom triggered snapshot records and/or custom triggered time series snapshot records can be stored at the same time for this event memory. A snapshot record or time series snapshot record is custom triggered if the corresponding DemFreezeFrameRecordTrigger is configured to DEM_TRIGGER_ON_CUSTOM.
      container DemExtendedDataClass [0..*]  # ExtendedData Class | This class groups several extended data records. EventParameters only reference these groups, not individual extended data records.
        reference DemExtendedDataRecordClassRef [1..253]: set at pre-compile, destination=DemExtendedDataRecordClass  # ExtendedDataRecord Class Ref | This reference contains the link to an extended data class record.
      container DemExtendedDataRecordClass [0..253]  # ExtendedDataRecord Class | This container represents a single extended data record. Each extended data record is assembled out of one or several data elements.
        integer DemExtendedDataRecordNumber: 1..253, scope=ECU, set at pre-compile  # ExtendedDataRecord Number | The unique identifier of the extended data record as requested and reported by $19 06. Please note that extended data records are unique per ECU, e.g. the number references a defined set of data independent of the DTC it is related to.
        enumeration DemExtendedDataRecordTrigger [0..1]: {DEM_TRIGGER_ON_TEST_FAILED, DEM_TRIGGER_ON_FDC_FIRST_IN_CYCLE, DEM_TRIGGER_ON_CONFIRMED, DEM_TRIGGER_ON_PASSED}, set at pre-compile, default-value=DEM_TRIGGER_ON_TEST_FAILED  # This parameter defines the trigger to store and update ExtendedDataRecords, if configured. FDC_FIRST_IN_CYCLE: The extended data record capture/ update is triggered by the event's fault detection counter exceeding the configured storage threshold. This trigger is only processed once per operationcycle. TEST_FAILED: The extended data record capture/ update is triggered by the TestFailed bit transition from 0 to 1. CONFIRMED: The extended data record capture is triggered by the Confirmed bit transition from 0 to 1. PASSED: The extended data record capture/ update is triggered by a qualified 'Passed' report that resets the TestFailed bit from 1 to 0.
        enumeration DemExtendedDataRecordUpdate [0..1]: {DEM_UPDATE_RECORD_NO, DEM_UPDATE_RECORD_YES}, scope=ECU, set at pre-compile  # ExtendedDataRecord Update | This parameter defines if this record is captured only once (UPDATE_RECORD_NO) or updated with each following trigger ((UPDATE_RECORD_YES). Please note that internal data elements are updated continuously and can not be frozen to their value at the time of confirmation.
        reference DemDataClassRef [1..255]: set at pre-compile, origin=Vector Informatik, requires-index=true, destination=DemDataClass  # Data Class Ref | These references select the data elements contained in the extended data record. The data elements are ordered as in the XML file.
      container DemFreezeFrameClass [0..65534]  # FreezeFrame Class | This container groups DIDs into a snapshot record. These records are sampled at different points in time, and each of these samples is identified by the snapshot record number.
        reference DemDidClassRef [1..21844]: scope=ECU, set at post-build in variant post-build-loadable+post-build-selectable / pre-compile in variant pre-compile, requires-index=true, destination=DemDidClass  # These references select the DIDs contained in the snapshot record. The DIDs are ordered as in the XML file.
      container DemFreezeFrameRecNumClass [0..255]  # FreezeFrameRecNum Class | This container contains a list of dedicated, different snapshot record numbers assigned to an event. These containers are relevant in case snapshot record numbers are CONFIGURED for an event (see DemTypeOfFreezeFrameRecordNumeration of DemPrimaryMemory or DemUserDefinedMemory referenced by the event) and in case that an event uses time series snapshot records (See Dem/DemGeneral/DemFreezeFrameRecordClass/DemFreezeFrameRecordIsTimeSeries).
        reference DemFreezeFrameRecordClassRef [1..254]: scope=ECU, set at pre-compile, requires-index=true, destination=DemFreezeFrameRecordClass  # FreezeFrameRecord Class Ref | This parameter references record number(s) for a freeze frame record. Currently only up to 8 freeze frame records with configured record numbers, not counting freeze frame with trigger CUSTOM and time series freeze frames, can be referenced.
      container DemFreezeFrameRecordClass [0..65535]  # FreezeFrameRecord Class | This container contains a list of dedicated, different freeze frame record numbers.
        integer DemFreezeFrameRecordNumber: 1..254, scope=ECU, set at pre-compile  # FreezeFrameRecord Number | This parameter defines a record number for a freeze frame record. This record number is unique per freeze frame record number class. In case that DemFreezeFrameRecordIsTimeSeries is enabled, this parameter represents the first record number of the time series snapshot records.
        enumeration DemFreezeFrameRecordTrigger: {DEM_TRIGGER_ON_FDC_THRESHOLD, DEM_TRIGGER_ON_CONFIRMED, DEM_TRIGGER_ON_PENDING, DEM_TRIGGER_ON_TEST_FAILED, DEM_TRIGGER_ON_TEST_FAILED_FIRST_IN_CYCLE, DEM_TRIGGER_ON_FDC_FIRST_IN_CYCLE, DEM_TRIGGER_ON_PASSED, DEM_TRIGGER_ON_CUSTOM}, set at pre-compile  # FreezeFrameRecord Trigger | Defines the trigger to store the FreezeFrameRecord. FDC_THRESHOLD: The snapshot data capture is triggered by a fault detection counter passing a storage threshold. CONFIRMED: The snapshot data capture is triggered by the ConfirmedDTC transition 0 -> 1. PENDING: The snapshot data capture is triggered by the PendingDTC transition 0 -> 1. TEST_FAILED: The snapshot data capture is triggered by the TestFailed transition 0 -> 1. TEST_FAILED_FIRST_IN_CYCLE: The snapshot data capture is triggered by the first TestFailed transition 0 -> 1 in an operation cycle (i.e TestFailedThisOperationCycle transition 0 -> 1). FDC_FIRST_IN_CYCLE: The snapshot data capture is triggered by the first DTC fault detection counter reaching the storage threshold in an operation cycle. PASSED: The snapshot data capture is triggered by the TestFailed transition 1 -> 0. CUSTOM: The snapshot data capture is triggered by API Dem_StoreCustomTriggeredFreezeFrame(). An event can only use this snapshot trigger, when the corresponding event memory has DemMaxNumberCustomTriggeredSnapshots > 0 Please note: For all triggers except CUSTOM, snapshot trigger occuring before an event memory entry is allocated are postponed until the event memory entry gets allocated. Snapshot trigger CUSTOM can capture snapshot data even before an event memory entry is allocated to the event.
        enumeration DemFreezeFrameRecordUpdate: {DEM_UPDATE_RECORD_NO, DEM_UPDATE_RECORD_YES}, scope=ECU, set at pre-compile  # FreezeFrameRecord Update | This parameter defines the case, when the freeze frame record is stored/updated. DEM_UPDATE_RECORD_NO - The snapshot record is captured only once. DEM_UPDATE_RECORD_YES - The snapshot is captured with each trigger, overwriting a previously captured snapshot. If option DEM_UPDATE_RECORD_YES is chosen for a snapshot record with DemFreezeFrameRecordTrigger CONFIRMED the snapshot record is initally stored on ConfirmedDTC transition 0 -> 1 and updated with each following TestFailed transition 0 -> 1. If option DEM_UPDATE_RECORD_YES is chosen for a time series snapshot record (see DemFreezeFrameRecordIsTimeSeries) all past samples are overwritten and future samples are collected anew with each trigger.
        boolean DemFreezeFrameRecordIsTimeSeries [0..1]: set at pre-compile, origin=Vector Informatik, default-value=false  # FreezeFrameRecord Is TimeSeries | Defines whether the record is used as a time series snapshot record. If this parameter is enabled, DemTimeSeriesSnapshotClassRef must contain a valid reference. If this parameter is disabled or not configured, the record is used as a configured freeze frame record and DemTimeSeriesSnapshotClassRef is ignored.
        reference DemTimeSeriesSnapshotClassRef [0..1]: set at pre-compile, origin=Vector Informatik, destination=DemTimeSeriesSnapshotClass  # TimeSeriesSnapshot Class Ref | This parameter must only exist, if parameter DemFreezeFrameRecordIsTimeSeries is enabled and must contain a reference to a DemTimeSeriesSnapshotClass
      container DemGeneralJ1939 [0..1]  # This container contains the general J1939-specific configuration (parameters) of the Dem module.
        boolean DemJ1939ClearDtcSupport: set at pre-compile, default-value=false  # This configuration switch defines whether clearing J1939 DTCs is supported or not. If enabled, the following DMs are supported: - Clearing all active / previously Active DTCs (DM03 and DM11) - Clearing single active / previously Active DTC (DM22)
        boolean DemJ1939Dm31Support: set at pre-compile, default-value=false  # This configuration switch defines whether J1939 DM31 is supported or not.
        boolean DemJ1939ExpandedFreezeFrameSupport: set at pre-compile, default-value=false  # J1939 Expanded FreezeFrame Support | This configuration switch defines whether J1939 expanded freeze frames are supported or not.
        boolean DemJ1939FreezeFrameSupport: set at pre-compile, default-value=false  # J1939 FreezeFrame Support | This configuration switch defines whether J1939 freeze frames are supported or not.
        boolean DemJ1939RatioSupport: set at pre-compile, default-value=false  # This configuration switch defines whether J1939 performance ratios are supported or not.
        boolean DemJ1939Readiness1Support: set at pre-compile, default-value=false  # This configuration switch defines whether J1939 diagnostic readiness 1 is supported or not. This switches on and off the API Dem_J1939DcmReadDiagnosticReadiness1.
        boolean DemJ1939Readiness2Support: set at pre-compile, default-value=false  # This configuration switch defines whether J1939 diagnostic readiness 2 is supported or not. This switches on and off the API Dem_J1939DcmReadDiagnosticReadiness2.
        boolean DemJ1939Readiness3Support: set at pre-compile, default-value=false  # This configuration switch defines whether J1939 diagnostic readiness 3 is supported or not. This switches on and off the API Dem_J1939DcmReadDiagnosticReadiness3.
        boolean DemJ1939ReadingDtcSupport: set at pre-compile, default-value=false  # This configuration switch defines whether J1939 DTC readout is supported or not.
        boolean DemTriggerJ1939DcmReports: set at pre-compile, origin=Vector Informatik, default-value=false  # If enabled, the J1939Dcm module is notified about DTC status changes in primary memory.
        integer DemJ1939ReadingDTCRuntimeLimit [0..1]: 1..65534, set at pre-compile, origin=Vector Informatik  # If this parameter exists, Dem_J1939DcmGetNextFilteredDTC will test at most this amount of DTCs for matching the filter before returning DEM_PENDING. This parameter can be used to reduce the run time of the J1939Dcm_MainFunction when filtering for DTCs.
        reference DemAmberWarningLampIndicatorRef [0..1]: set at pre-compile, destination=DemIndicator  # This parameter defines the indicator representing the AmberWarningLamp. This parameter is used for ECUs supporting J1939. For DemAmberWarningLampIndicatorRef, DemProtectLampIndicatorRef and DemRedStopLampIndicatorRef you must use different indicators. When OBD is supported, the MIL indicator must in addition differ from these indicators.
        reference DemProtectLampIndicatorRef [0..1]: set at pre-compile, destination=DemIndicator  # This parameter defines the indicator representing the ProtectLamp. This parameter is used for ECUs supporting J1939. For DemAmberWarningLampIndicatorRef, DemProtectLampIndicatorRef and DemRedStopLampIndicatorRef you must use different indicators. When OBD is supported, the MIL indicator must in addition differ from these indicators.
        reference DemRedStopLampIndicatorRef [0..1]: set at pre-compile, destination=DemIndicator  # This parameter defines the indicator representing the RedStopLamp. This parameter is used for ECUs supporting J1939. For DemAmberWarningLampIndicatorRef, DemProtectLampIndicatorRef and DemRedStopLampIndicatorRef you must use different indicators. When OBD is supported, the MIL indicator must in addition differ from these indicators.
        container DemCallbackJ1939DTCStatusChanged [0..*]  # The presence of this container indicates, that the Dem has access to a "DTCStatusChanged" callback, which the Dem will call to notify other components about the change in the status of a DTC.
          function name DemCallbackDTCStatusChangedFnc [0..1]: scope=ECU, set at pre-compile  # Function name of prototype "DTCStatusChanged".
        container DemJ1939FreezeFrameClass [0..2]  # J1939 FreezeFrame Class | This container contains the combinations of SPNs s for a J1939 relevant freeze frame. Your configuration must use one (1) common definition for all J1939 freeze frames and one (1) common definition for all J1939 expanded freeze frames (use the event parameters DemJ1939FreezeFrameClassRef and DemJ1939ExpandedFreezeFrameClassRef to use this definitions). Therefore the multiplicity of this parameter is limited to 2.
          reference DemSPNClassRef [1..255]: scope=ECU, set at pre-compile, requires-index=true, destination=DemSPNClass  # Reference to an SPN. This reference defines requiresIndex = true since it represents a ordered list of references where the order describes the order of single SPNs in the J1939 Freeze Frame.
        container DemSPNClass [0..*]  # This container contains the configuration (parameters) for a SPN.
          integer DemSPNId: 0..524287, set at pre-compile  # Suspect parameter number.
          reference DemSPNDataClassRef: scope=ECU, set at pre-compile, origin=Vector Informatik, destination=DemDataClass  # This reference contains the link to a data element class.
      container DemGeneralOBD [0..1]  # This container will be used only, if the OBD support (for either OBD II or WWH-OBD or OBD on UDS or ZEV on UDS) is activated (see DemGeneral/DemOBDSupport and DemGeneral/DemGeneralOBD/DemOBDLegislation).
        boolean DemOBDCentralizedPID21Handling: scope=ECU, set at pre-compile, default-value=false  # Switch to enable the centralized handling of PID $21. (not supported, please use DemGeneral/DemPidConfiguration/DemSupportPid21 instead)
        boolean DemOBDCentralizedPID31Handling: scope=ECU, set at pre-compile, default-value=false  # Switch to enable the centralized handling of PID $31. (Not supported, please use DemGeneral/DemPidConfiguration/DemSupportPid31 instead)
        integer DemOBDCompliancy: 0..255, scope=ECU, set at post-build in variant post-build-loadable+post-build-selectable / pre-compile in variant pre-compile, default-value=1  # Configuration value to define the appropriate value to PID$1C "OBD requirements to which vehicle or engine is certified." according to the respective standards, e.g. OBD I, OBD II, JOBD etc.
        enumeration DemOBDEngineType [0..1]: {DEM_IGNITION_COMPRESSION, DEM_IGNITION_SPARK}, scope=ECU, set at pre-compile, origin=Vector Informatik  # Switch to provide either Gasoline or Diesel parameters. Used for PID $01, PID $F501 and J1939 diagnostic readiness 1 if Major Monitors are supported.
        enumeration DemOBDDestinationOfEvents: {DEM_DTC_ORIGIN_PRIMARY_MEMORY, DEM_DTC_ORIGIN_SECONDARY_MEMORY}, scope=ECU, set at pre-compile, default-value=DEM_DTC_ORIGIN_PRIMARY_MEMORY  # The destination of events assigns where the OBD events shall be stored. (not supported)
        boolean DemOBDEventDisplacement: set at pre-compile, default-value=true  # Activate/Deactivate a different displacement behavior for OBD events. (not supported)
        boolean DemDelayWarmUpCycleToDcyEnd: set at pre-compile, origin=Vector Informatik, default-value=false  # Delay WarmUp Cycle To Driving Cycle End | If enabled the DEM can only be triggered for the start of warm-Up cycle and it will ignore the trigger for the end of warm-up cycle. It will automatically restart the warm-up cycle at the end of a (qualified) driving cycle. Therefore the DTCs that have configured the warm-up cycle as their aging cycle will age at the end of the driving cycle.
        float DemEngineRuntimePolling [0..1]: 0.001..2678400, scope=ECU, set at pre-compile, origin=Vector Informatik, default-value=60  # Engine Runtime Minutes Polling | Allow to configure the time for the periodic polling of the engine runtime in minutes. The value must be a multiple of the DemGeneral/DemTaskTime. Otherwise it is rounded down to the next multiple value of DemTaskTime. This value is mandatory, when parameter DemOBDTimeSinceEngineStart is required. If missing, it defaults to the DemTaskTime. The AUTOSAR configuration standard is to use SI units, so in the EcuC file this parameter is stored as float value in seconds - the DaVinci Configurator 5 GUI will convert the value when using a diffenent unit.
        enumeration DemOBDFreezeFrameBehavior [0..1]: {DEM_OBDII_FREEZE_FRAME_BEHAVIOR_TYPE1, DEM_OBDII_FREEZE_FRAME_BEHAVIOR_TYPE2, DEM_OBDII_FREEZE_FRAME_BEHAVIOR_TYPE3, DEM_OBDII_FREEZE_FRAME_BEHAVIOR_TYPE4, DEM_OBDII_FREEZE_FRAME_BEHAVIOR_TYPE5, DEM_WWHOBD_FREEZE_FRAME_BEHAVIOR_TYPE1, DEM_WWHOBD_FREEZE_FRAME_BEHAVIOR_TYPE2, DEM_COMBINED_FREEZE_FRAME_BEHAVIOR_TYPE1, DEM_COMBINED_FREEZE_FRAME_BEHAVIOR_TYPE2}, set at pre-compile, origin=Vector Informatik  # OBD Freeze Frame Behavior | This configuration value defines, when the OBD II resp. WWH-OBD Freeze Frame is taken, stored and updated and when/how it is visible for diagnostic requests. DemOBDFreezeFrameBehavior has no effect on OBDonUDS Freeze Frame storage.The OBDonUDS FF is always stored when trigger conditions are met. OBD II, TYPE 1: OBD II Freeze Frame data capture is triggered by the initial PendingDTC transition from 0 to 1. If PendingDTC is healed without being ConfirmedDTC, the Freeze Frame will be cleared. The Freeze Frame is immediately visible in Mode02. OBD II, TYPE 2: OBD II Freeze Frame data capture is triggered by the initial PendingDTC transition from 0 to 1. If PendingDTC is healed without being ConfirmedDTC, the Freeze Frame will be cleared. The Freeze Frame is visible as soon as the ConfirmedDTC status bit of the DTC is visible. The visibility depends on parameter /DemEventParameter/DemEventClass/DemOBDVisibilityDelayedUntilDcyQualification. If this parameter is enabled, visibility is delayed until the OBD driving cycle is qualified. This option allows multiple Freeze Frames (see parameter /DemGeneral/DemMaxNumberEventEntryOBDFreezeFrame). OBD II, TYPE 3: OBD II Freeze Frame data capture is triggered by the initial PendingDTC transition from 0 to 1. The Pending Freeze Frame will be displaced if another DTC becomes a ConfirmedDTC. If PendingDTC is healed without being ConfirmedDTC the Freeze Frame will be cleared. The Freeze Frame is immediately visible in Mode02. OBD II, TYPE 4: OBD II Freeze Frame data capture is triggered by the initial PendingDTC transition from 0 to 1. The Pending Freeze Frame will be updated if the DTC becomes a ConfirmedDTC. If PendingDTC is healed without being ConfirmedDTC the Freeze Frame will be cleared. The Freeze Frame is immediately visible in Mode02. OBD II, TYPE 5: OBD II Freeze Frame data capture is triggered when the trip condition is fulfilled. The Freeze Frame is visible as soon as the ConfirmedDTC status bit of the DTC is visible. The visibility depends on parameter /DemEventParameter/DemEventClass/DemOBDVisibilityDelayedUntilDcyQualification. If this parameter is enabled, visibility is delayed until the OBD driving cycle is qualified. For DTCs related to misfire or fuel system monitoring (DemEventOBDReadinessGroup = DEM_OBD_RDY_MISF or DEM_OBD_RDY_FLSYS or DEM_OBD_RDY_FLSYS_NONCONT) the Freeze Frame can also become visible without the need for a qualified driving cycle in some edge cases. A stored but not yet visible freeze frame will be displaced by the freeze frame of an event with parameter DemOBDVisibilityDelayedUntilDcyQualification disabled, if the invisible freeze frame is not related to a misfire and fuel system monitor. For more information refer to chapter "Reporting of Freeze Frame with Mode $02" in the OBD Technical Reference. WWH-OBD, TYPE 1: WWH-OBD Freeze Frame data capture is triggered by the initial PendingDTC transition from 0 to 1. The Freeze Frame is immediately visible WWH-OBD, TYPE 2: WWH-OBD Freeze Frame data capture is triggered by the initial PendingDTC transition from 0 to 1. If DTC becomes a ConfirmedDTC the Freeze Frame data will be updated. The Freeze Frame is immediately visible. COMBINED, TYPE1: This behavior corresponds to 'Type 1' for OBDII and 'Type 1' for WWH-OBD. COMBINED, TYPE2: This behavior corresponds to 'Type 4' for OBDII and 'Type 2' for WWH-OBD. Use COMBINED values if and only if using OBDII and WWH-OBD in different PBS variants within one configuration.
        boolean DemOBDFreezeFrameInService19: set at pre-compile, origin=Vector Informatik, default-value=false  # OBD II FreezeFrame In Service 19 | Only relevant for OBD II legislation. Report the OBD II freeze frame in UDS Service $19 04 (with record number 0x00 or wildcard 0xFF). If enabled the OBD II Freeze Frame can be accessed in diagnostic service $19 04 and in Mode 02 otherwise only in Mode 02.
        boolean DemOBDHideOccurrences: set at pre-compile, origin=Vector Informatik, default-value=false  # OBD Hide Occurrences | Only relevant for OBD II and OBD on UDS legislation. Dependent OBD DTCs shall not appear in some UDS $19 sub-services. If enabled, the Dem hides dependent OBD DTCs from reporting. Also, operation 'HideOccurrences' in service 'DemOBDServices' is provided to change this behavior at run-time. Dependent OBD DTCs are identified via the parameter 'DemEventSignificance'. A setting of 'OCCURRENCE' marks a dependent DTC. Note: Non-OBD DTCs are not affected by this feature.
        enumeration DemOBDLegislation: {DEM_OBD_LEGISLATION_OBDII, DEM_OBD_LEGISLATION_WWHOBD, DEM_OBD_LEGISLATION_OBD_ON_UDS, DEM_OBD_LEGISLATION_ZEV_ON_UDS}, set at pre-compile in variant post-build-loadable+pre-compile / post-build in variant post-build-selectable, origin=Vector Informatik, default-value=DEM_OBD_LEGISLATION_OBDII  # The OBD legislation that shall be supported. OBDII: Support of OBD II. WWHOBD: Support of WWH-OBD. OBD_ON_UDS: Support of OBDonUDS. ZEV_ON_UDS: Support of ZEVonUDS. If OBD support is disabled (Dem/DemGeneral/DemOBDSupport == DEM_OBD_NO_OBD_SUPPORT), this parameter is ignored.
        integer DemOBDPermanentDtcActivationDistance [0..1]: 0..4294967295, set at pre-compile, origin=Vector Informatik, default-value=1  # OBD PermanentDtc Activation Distance | Only relevant for OBD II and OBD on UDS legislation. Distance after first valid Odometer value was provided after which permanent DTC storage is activated. The resolution is the same as for PID$21 and PID$31 (see parameter DemOBDInputDistanceInformation). Providing this parameter will also enable an API to activate permanent DTC storage before the configured distance is reached. If this parameter is missing, permanent DTC storage is always active and can't be suppressed.
        boolean DemOBDPermanentEraseConditionDcy: set at pre-compile, origin=Vector Informatik, default-value=false  # OBD Permanent Erase Condition Dcy | Only relevant for OBD II and OBD on UDS legislation. This parameter controls the behavior of a permanent fault after a clear DTC command issued while the OBD driving cycle (DCY) is not yet qualified. If enabled, the Dem checks the DCY qualification state during a Clear DTC request. - DCY not qualified: The permanent fault code can be removed from permanent memory in the same DCY as the clear DTC request was issued. - DCY qualified: The permanent fault code cannot be removed from permanent memory in the same DCY as the clear DTC request was issued. If disabled, the DCY qualification state has no effect. Note: To remove a DTC from permanent memory the PFC condition must be fulfilled and the DTC must be tested as passed and not failed.
        boolean DemOBDPermanentMandatoryPfcAfterClear: set at pre-compile, origin=Vector Informatik, default-value=false  # OBD Permanent Mandatory Pfc After Clear | Only relevant for OBD II and OBD on UDS legislation. This configuration switch specifies, when a DTC will be removed from the permanent memory after the fault memory was cleared (e.g. Mode $04) and the DTC illuminates the MIL again. If this option is enabled, the DTC will be removed from permanent memory only if PFC cycle was active and MIL becomes inactive for this DTC. If this option is disabled, the DTC will be removed from permanent memory after the MIL becomes inactive for this event.
        boolean DemOBDRestartDcyOnClearDTC: set at pre-compile, origin=Vector Informatik, default-value=false  # OBD Restart Dcy On ClearDTC | With ClearDTC (Mode $04 or Service $14FFFFFF) the DEM may restart the OBD driving cycle independent of its current qualification state. If enabled, the DEM restarts the OBD driving cycle (configured as DemOperationCycleType==DEM_OPCYC_OBD_DCY) with Mode $04 or Service $14 FFFFFF requests. If disabled, no cycle is restarted with Mode $04 or Service $14 FFFFFF requests.
        enumeration DemClearPermanentDtcBehavior: {DEM_CLR_PERM_DTC_TYPE_1, DEM_CLR_PERM_DTC_TYPE_2}, set at pre-compile, origin=Vector Informatik, default-value=DEM_CLR_PERM_DTC_TYPE_1  # OBD Clear Permanent Dtc Behavior | Only relevant for OBD II and OBD on UDS legislation. DEM_CLR_PERM_DTC_TYPE_1 (default): Permanent DTC is erased if only tested passed (and not tested failed) during the driving cycle and if permanent fault code condition is fulfilled. DEM_CLR_PERM_DTC_TYPE_2: Permanent DTC with IUMPR monitoring is erased if only tested passed (and not tested failed) during the driving cycle. Permanent DTC without IUMPR monitoring is erased if only tested passed (and not tested failed) during the driving cycle and if permanent fault code condition is fulfilled.
        boolean DemOBDSimilarConditionsSupport: set at pre-compile, origin=Vector Informatik, default-value=false  # This configuraton switch defines, whether support for similar conditions is enabled or not.
        boolean DemOBDRdyThisDcyComprehensiveComponentsAlwaysComplete: set at pre-compile, origin=Vector Informatik, default-value=false  # OBD Readiness This Driving Cycle Comprehensive Components Always Complete | Switch to control if Comprehensive Components Monitoring is always reported as complete or calculated based on current DTC status in PID $41 and J1939 diagnostic readiness 3.
        boolean DemOBDSupportMajorMonitors: set at pre-compile, origin=Vector Informatik, default-value=false  # Allows to configure the event readiness group to something different to Comprehensive Components Monitoring.
        boolean DemReportBlinkingMilAsActive: set at pre-compile, origin=Vector Informatik, default-value=true  # Report Blinking Mil As Active | If enabled, the DEM reports the MIL as 'activated' if its current state is BLINKING and/or CONTINUOUS. If disabled, the DEM reports the MIL as 'activated' only if its current state is CONTINUOUS (see parameter Dem/DemConfigSet/DemEventParameter/DemEventClass/DemIndicatorAttribute/DemIndicatorBehaviour). This influences the behavior of PID $01, PID $F501, PID $21 and PID $4D.
        integer DemOBDPermanentChronologyMaxNumberEvents: 1..65534, set at pre-compile, origin=Vector Informatik  # OBD Permanent Chronology Max Number Events | Maximum number of events which can be stored in the chronology of confirmed events. This chronology is used to identify the next DTC to be stored in the permanent memory, if the permanent memory was full and an entry gets freed. Each event in the chronology adds two more bytes to the Dem's status NvRAM block. It is recommended to configure a value that corresponds to the maximum number of DTCs fulfilling the criteria for permanent storage at the same time in a (realistic) worst case scenario. To ensure that always the oldest confirmed DTC is stored in the permanent memory or if NvRam consumption is not a critical restriction, set the value to the maximum number of DTCs having the MIL attached (OBDII or OBDonUDS) or the maximum number of class A and B1 DTCs (WWHOBD).
        boolean DemOBDFuelSystemAlwaysComplete: set at pre-compile, origin=Vector Informatik, default-value=false  # OBD PID Fuel System Always Complete | This switch describes whether the completeness status for fuel system monitors is calculated or always indicated as complete in: - PID $01, - PID $41, - PID $F501. - J1939 diagnostic readiness 1 and - J1939 diagnostic readiness 3. True: Fuel system monitoring is always reported as complete. False: Completeness of fuel system monitoring is calculated based on non-continuous fuel system monitor status.
        boolean DemOBDCompressionMisfireAlwaysComplete: set at pre-compile, origin=Vector Informatik, default-value=false  # OBD PID Compression Misfire Always Complete | This switch describes whether the completeness status for misfire monitors is calculated or always indicated as complete for compression ignition engines (DemGeneralOBD/DemOBDEngineType == DEM_IGNITION_COMPRESSION) in - PID $01, - PID $41, - J1939 diagnostic readiness 1 and - J1939 diagnostic readiness 3. In the data contexts above, misfire monitors will always indicate completed for spark ignition engines independently of this parameter value. For PID $F501, the completion of readiness group Misfire is always calculated. True: Misfire monitoring is always reported as complete. False: Completeness of misfire monitors is calculated.
        boolean DemOBDPermanentDtcImmediateReport [0..1]: set at pre-compile, origin=Vector Informatik, default-value=false  # OBD PermanentDtc Immediate Report | Only relevant for OBD II and OBD on UDS legislation. TRUE: All Permanent Dtcs are available via OBD mode 0A immediately after WIR bit is visible FALSE: Only DTCs for which /DemEventParameter/DemEventClass/DemOBDVisibilityDelayedUntilDcyQualification is disabled and the /DemEventParameter/DemEventClass/DemEventFailureCycleCounterThreshold is configured to 0 are visible in mode 0A immediately, all other DTCs only after OBD driving cycle is restarted.
        boolean DemOBDPermanentForWWHOBD [0..1]: set at pre-compile in variant post-build-loadable+pre-compile / post-build in variant post-build-selectable, origin=Vector Informatik, default-value=false  # OBD Support Permanent DTC for WWHOBD | Only relevant for WWH-OBD legislation. If enabled, class A or B1 DTCs commanding the MIL can store a permanent DTC. See Technical Reference for OBD for more details.
        boolean DemOBDPIDF501ComprehensiveComponentsAlwaysComplete [0..1]: set at pre-compile, origin=Vector Informatik, default-value=false  # OBD PIDF501 Comprehensive Components Always Complete | This switch describes whether the completeness status for comprehensive components monitors in PID $F501 is calculated or always indicated as complete.
        float DemEngineRuntimeSecondsPolling [0..1]: 0.001..2678400, scope=ECU, set at pre-compile, origin=Vector Informatik, default-value=60  # Engine Runtime Seconds Polling | Allow to configure the time for the periodic polling of the engine runtime in seconds. The value must be a multiple of the DemGeneral/DemTaskTime. Otherwise it is rounded down to the next multiple value of DemTaskTime. This value is mandatory, when parameter DemOBDTimeSinceEngineStartSeconds is required. If missing, it defaults to the DemTaskTime. The AUTOSAR configuration standard is to use SI units, so in the EcuC file this parameter is stored as float value in seconds - the DaVinci Configurator 5 GUI will convert the value when using a diffenent unit.
        boolean DemSupportedObdUdsDtcSeparation [0..1]: set at pre-compile, default-value=false  # OBD Support OBDonUDS DTC Separation | Only relevant for OBDonUDS legislation. When this parameter is set to true, the OBD UDS DTC separation feature is enabled, i.e. the configured 3 byte OBD DTC value (DemConfigSet/DemDTCClass/DemObdDTC3Byte) is reported in all OBDonUDS related services (see SAE J1979-2). If this parameter is set to false, the OBD UDS DTC separation is disabled, i.e. the UDS DTC value (DemConfigSet/DemDTCClass/DemUdsDTC) is reported instead. This is the default behavior.
        boolean DemDisableEventMonitoringInCurrentDcy: set at pre-compile, origin=Vector Informatik, default-value=false  # This switch allows the user to disable event monitoring in current driving cycle. Usage of the API Dem_DisableEventMonitoringInCurrentDcy() will make the event be considered as tested completed during the readiness calculation of the following readiness data: - PID $01, - PID $F501. - DM05.
        reference DemOBDInputAcceleratorPedalInformation [0..1]: scope=ECU, set at pre-compile, origin=Vector Informatik, destination=DemDataClass  # OBDInput Accelerator Pedal Information | Input variable for the accelerator pedal information, which is assigned to a specific data element used as interface for the Dem-internal PID calculations. (not supported)
        reference DemOBDInputAmbientPressure [0..1]: scope=ECU, set at pre-compile, origin=Vector Informatik, destination=DemDataClass  # OBDInput Ambient Pressure | Input variable for the ambient pressure, which is assigned to a specific data element used as interface for the Dem-internal PID calculations. (not supported)
        reference DemOBDInputAmbientTemperature [0..1]: scope=ECU, set at pre-compile, origin=Vector Informatik, destination=DemDataClass  # OBDInput Ambient Temperature | Input variable for the ambient temperature, which is assigned to a specific data element used as interface for the Dem-internal PID calculations. (not supported)
        reference DemOBDInputDistanceInformation [0..1]: scope=ECU, set at pre-compile, origin=Vector Informatik, destination=DemDataClass  # OBDInput Distance Information | This reference requests the current odometer for PID21, PID31, J1939 diagnostic readiness 2, and permanent DTC storage activation distance calculation, therefore this reference is mandatory if one those features is supported. The returned odometer value (4 Byte) must have a resolution of 1 kilometer or 1 mile. Furthermore, the odometer value must be provided in big endian format. If no valid odometer is available the return value must be E_NOT_OK. Furthermore the permanent DTC storage activation distance calculation is not performed until a valid odometer value is received.
        reference DemOBDInputEngineSpeed [0..1]: scope=ECU, set at pre-compile, origin=Vector Informatik, destination=DemDataClass  # OBDInput Engine Speed | Input variable for the engine speed, which is assigned to a specific data element used as interface for the Dem-internal PID calculations. (not supported)
        reference DemOBDInputEngineTemperature [0..1]: scope=ECU, set at pre-compile, origin=Vector Informatik, destination=DemDataClass  # OBDInput Engine Temperature | Input variable for the engine temperature, which is assigned to a specific data element used as interface for the Dem-internal PID calculations. (not supported)
        reference DemOBDInputProgrammingEvent [0..1]: scope=ECU, set at pre-compile, origin=Vector Informatik, destination=DemDataClass  # OBDInput Programming Event | Input variable for the programming event, which is assigned to a specific data element used as interface for the Dem-internal PID calculations. (not supported)
        reference DemOBDInputVehicleSpeed [0..1]: scope=ECU, set at pre-compile, origin=Vector Informatik, destination=DemDataClass  # OBDInput Vehicle Speed | Input variable for the vehicle speed, which is assigned to a specific data element used as interface for the Dem-internal PID calculations. (not supported)
        reference DemOBDTimeSinceEngineStart [0..1]: set at pre-compile, origin=Vector Informatik, destination=DemDataClass  # OBD Time Since Engine Start Minutes | This reference requests the current engine runtime in minutes for PID4D, PID4E, J1939 diagnostic readiness 2, WWH-OBD aging and B1 counter calculation. This reference is also used by the Dem to track the cumulative engine runtime with PTO active if any event is affected by the Dem PTO handling (see /DemEventParameter/DemEventClass/DemConsiderPtoStatus) and the Dem calculates the monitor status since DTCs cleared for PID $01, PID $F501 or J1939 diagnostic readiness 1. Therefore, this reference is mandatory if one of those features is supported. The returned engine runtime value (4 Byte) must have a resolution of 1 minute. Furthermore, the engine runtime value must be provided in big endian format. If no valid engine runtime is available the return value must be E_NOT_OK.
        reference DemOBDTimeSinceEngineStartSeconds [0..1]: set at pre-compile, origin=Vector Informatik, destination=DemDataClass  # This reference requests the current engine runtime in seconds for J1939 diagnostic readiness 3. Therefore, this reference is mandatory if this feature is supported. The returned engine runtime value (4 Byte) must have a resolution of 1 second. Furthermore, the engine runtime value must be provided in big endian format. If no valid engine runtime is available the return value must be E_NOT_OK.
        container DemCallbackOBDDTCStatusChanged [0..0]  # The presence of this container indicates, that the Dem has access to a "DTCStatusChanged" callback, which the Dem will call to notify other components about the change in the status of a DTC. (not supported)
          function name DemCallbackDTCStatusChangedFnc [0..1]: scope=ECU, set at pre-compile  # Function name of prototype "DTCStatusChanged". (not supported)
      container DemGroupOfDTC [0..4]  # This container represents a DTC group. DTC groups can be cleared by service $14, if allowed by the OEM specification. In case only $14 FFFFFF shall be offered, it is recommended to not configure DTC groups. Defined groups are sorted according their 'DemGroupDTCs' value in increasing sequence and get assigned these semantics: (1) PowertrainGroup, (2) ChassisGroup, (3) BodyGroup, (4) NetworkGroup. For example when you define only 2 groups, the lower GroupDTC value represents the PowertrainGroup, the higher GroupDTC value represents the ChassisGroup. Undefined are Body- and NetworkGroup.
        integer DemGroupDTCs: 1..16777214, scope=ECU, set at pre-compile, symbolic-name-value=true  # Group DTCs | DTC value of the selected group of DTC. A clear DTC request for this number will clear all DTCs that belong to this group.
      container DemIndicator [0..255]  # This container represents a warning indicator (e.g. indicator lamp).
        integer DemIndicatorID: 0..255, scope=ECU, set at pre-compile, symbolic-name-value=true, default-value=255  # Internal identifier of the indicator. This number is calculated internally and shall not be configured manually. This parameter is only available to publish the result of this calculation. Applications using Dem APIs must not rely on the value of this parameter. Instead, they must use the symbolic constant (SymbolicNameValue) DemConf_DemIndicator_{SHORT-NAME}.
      container DemNvRamBlockId [0..*]  # NvRam BlockId | This container represent a non-volatile memory block used by the Dem. If no permanent storage of event memory entries is required, no block needs to be configured.
        integer DemNvRamBlockIdIndex [0..1]: 0..255, set at pre-compile, origin=Vector Informatik  # NvRam BlockId Index | For non-unique block types, this index identifies the exact block (see DemNvRamBlockIdType). This parameter must exist and be able to identify all NvBlocks of following kind: PRIMARY: each index must have an unique value and the index values must complete the range 0 - (DemMaxNumberEventEntryPrimary -1), USERDEFINED: for all blocks with the same DemNvRamBlockIdEventMemoryRef reference, each index must have an unique value and all index values must complete the range 0 - (DemMaxNumberEventEntryUserDefined -1), TIMESERIES: for all blocks with the same DemNvRamBlockIdEventMemoryRef reference, each index must have an unique value and all index values must complete the range 0 - (DemMaxNumberTimeSeriesSnapshots -1), The value is necessary to store the correct memory entry in case it was changed. For all NvBlocks of other kind (e.g. ADMIN, STATUS,...) the parameter value will be ignored.
        enumeration DemNvRamBlockIdType: {DEM_NVBLOCK_ADMIN, DEM_NVBLOCK_STATUS, DEM_NVBLOCK_PRIMARY, DEM_NVBLOCK_PERMANENT, DEM_NVBLOCK_MIRROR, DEM_NVBLOCK_FREEZEFRAME, DEM_NVBLOCK_OBDIUMPR, DEM_NVBLOCK_DEBOUNCE, DEM_NVBLOCK_AVAILABILITY, DEM_NVBLOCK_TIMESERIES, DEM_NVBLOCK_DTR, DEM_NVBLOCK_AGING, DEM_NVBLOCK_CYCLECOUNTER, DEM_NVBLOCK_USERDEFINED, DEM_NVBLOCK_CUSTOMTRIGGER}, set at pre-compile, origin=Vector Informatik  # NvRam BlockId Type | Usage kind of this NvBlock. This parameter is used to identify which block data needs to be stored when event data is modified. Following block types exist at most once: ADMIN: Always required. STATUS: Always required. MIRROR: Only required if DemGeneral/DemMaxNumberEventEntryMirror > 0. PERMANENT: Only required if DemGeneral/DemMaxNumberEventEntryPermanent > 0. FREEZEFRAME: Only required if DemGeneral/DemOBDSupport is enabled and DemGeneral/DemGeneralOBD/DemOBDLegislation == OBDII or OBD_ON_UDS. OBDIUMPR: Only required if DemGeneral/DemOBDSupport is enabled and DemGeneral/DemRatioId containers are configured. DEBOUNCE: Only required if any event uses CounterBased Debouncing with DemDebounceCounterStorage==TRUE. AVAILABILITY: Only required if event availability status is persisted in non-volatile memory due DemAvailabilityStorage==TRUE. DTR: Only required if DemGeneral/DemOBDSupport is enabled and if DemConfigSet/DemDtrs/DemDtr container exist or DemGeneral/DemPostBuild/DemMaxNumberEventEntryPermanent > 0 AGING: Only required if aging data is persisted in non-volatile memory due to DemGeneral/DemSupportAgingForAllDTCs==TRUE or if DemGeneral/DemDataClass/DemDataElementInternalData == AGED_COUNTER is used. CYCLECOUNTER: Only required if cycle counter data is persisted in non-volatile memory due to DemGeneral/DemSupportStorageIndependentCycleCounters ==TRUE. Following block types can exist several times, depending on the configuration: PRIMARY: The number of containers of this type must match DemGeneral/DemEventMemorySet/DemPrimaryMemory/DemMaxNumberEventEntryPrimary. USERDEFINED: The number of containers of this type must match the summarized number of all DemGeneral/DemEventMemorySet/DemUserDefinedMemory/DemMaxNumberEventEntryUserDefined. TIMESERIES: The number of containers of this type must match the summarized number of DemMaxNumberTimeSeriesSnapshots in DemGeneral/DemEventMemorySet/DemPrimaryMemory and all DemGeneral/DemEventMemorySet/DemUserDefinedMemory containers. CUSTOMTRIGGER: The number of containers of this type must match the summarized number of DemMaxNumberCustomTriggeredSnapshots in DemGeneral/DemEventMemorySet/DemPrimaryMemory and all DemGeneral/DemEventMemorySet/DemUserDefinedMemory containers.
        symbolic name reference DemNvRamBlockIdRef: set at pre-compile, origin=AUTOSAR_ECUC V1.0.0, destination=NvMBlockDescriptor  # NvRam BlockId Ref | This reference contains the link to a non-volatile memory block. For post build time configurations worst case scenario shall be used to store the largest appearing data.
        choice reference DemNvRamBlockIdEventMemoryRef [0..1]: set at pre-compile, destination=[DemUserDefinedMemory, DemPrimaryMemory]  # Event Memory Ref | This parameter must ONLY exist and contain a reference to the event memory for the following DemNvRamBlockIdType values - DEM_NVBLOCK_PRIMARY: the primary memory must be referenced - DEM_NVBLOCK_USERDEFINED: a configured user defined memory must be referenced - DEM_NVBLOCK_TIMESERIES: either the primary memory or a configured user defined memory must be referenced
      container DemOperationCycle [1..16]  # OperationCycle | This container represents a monitoring cycle. They are used to control event monitoring and aging. Although this container does not define a symbolic name value, one is generated nonetheless.
        boolean DemOperationCycleAutomaticEnd: scope=ECU, set at pre-compile, default-value=false  # OperationCycle Automatic End | If configured to true the DEM automatically ends the cycle during ECU restart (e.g. in Dem_Shutdown or Dem_Init). Otherwise the application has to end the cycle by calling Dem_SetOperationCycleState with state DEM_CYCLE_STATE_END. This option is only relevant when DemOperationCycleStatusStorage is TRUE.
        boolean DemOperationCycleAutostart: scope=ECU, set at pre-compile, default-value=false  # OperationCycle Automatic Start | The autostart property defines if the operation cycles is automatically (re-)started during Dem_PreInit. (Not supported, please use DemGeneral/DemRestartCycleOnInitRef instead)
        enumeration DemOperationCycleType: {DEM_OPCYC_IGNITION, DEM_OPCYC_OBD_DCY, DEM_OPCYC_OTHER, DEM_OPCYC_POWER, DEM_OPCYC_TIME, DEM_OPCYC_WARMUP, DEM_OPCYC_IGNITION_HYBRID}, scope=ECU, set at pre-compile, default-value=DEM_OPCYC_OTHER  # OperationCycle Type | Select the operation cycle type. This value only has an effect in case of OBD ECUs, as certain actions are triggered by legislated cycle types. Note: As there is no way to read the value of the parameter at run time, the short name of the DemOperationCycle container should have a meaningful name.
      container DemRatioId [0..65534]  # RatioId | This container contains the OBD specific ratio Id configuration. It is related to a specific event, a FID, and an IUMPR group.
        enumeration DemIUMPRDenGroup: {DEM_IUMPR_DEN_NONE, DEM_IUMPR_DEN_PHYS_API, DEM_IUMPR_DEN_COLDSTART, DEM_IUMPR_DEN_EVAP, DEM_IUMPR_DEN_500MI, DEM_IUMPR_DEN_INDEPENDENT}, scope=ECU, set at post-build in variant post-build-loadable+post-build-selectable / pre-compile in variant pre-compile, origin=Vector Informatik  # Dem IUMPR Denominator Group | This parameter specifies the assigned denominator type which is applied in addition to the General Denominator conditions. NONE: The denominator is calculated based on the general individual denominator conditions. PHYS_API: The denominator is calculated based on the general individual denominator conditions. The denominator can be locked via dedicated APIs. COLDSTART, EVAP, 500MI: The denominator is calculated based on the general individual denominator conditions and additional conditions that must be fulfilled before the denominator is incremented. INDEPENDENT: Denominator may be incremented independently of the general individual denominator. The denominator may be locked via dedicated APIs.
        enumeration DemIUMPRGroup: {DEM_IUMPR_BOOSTPRS, DEM_IUMPR_CAT1, DEM_IUMPR_CAT2, DEM_IUMPR_EGR, DEM_IUMPR_EGSENSOR, DEM_IUMPR_EVAP, DEM_IUMPR_NMHCCAT, DEM_IUMPR_NOXADSORB, DEM_IUMPR_NOXCAT, DEM_IUMPR_OXS1, DEM_IUMPR_OXS2, DEM_IUMPR_PMFILTER, DEM_IUMPR_PRIVATE, DEM_IUMPR_SAIR, DEM_IUMPR_SECOXS1, DEM_IUMPR_SECOXS2, DEM_IUMPR_FLSYS, DEM_IUMPR_AFRI1, DEM_IUMPR_AFRI2, DEM_IUMPR_PF1, DEM_IUMPR_PF2}, scope=ECU, set at post-build in variant post-build-loadable+post-build-selectable / pre-compile in variant pre-compile, origin=Vector Informatik  # This parameter specifies the assigned IUMPR group of the ratio Id.
        enumeration DemRatioIdType: {DEM_RATIO_API, DEM_RATIO_OBSERVER}, set at pre-compile, origin=Vector Informatik  # RatioId Type | This parameter specifies how the numerator of the ratio is calculated: OBSERVER: The numerator is incremented whenever a test result is reported. This setting is used for symmetrical monitors. API: The numerator is incremented if the related monitoring function is able to detect a fault (reported by dedicated API). This setting is used for asymmetrical monitors.
        reference DemDiagnosticEventRef: set at pre-compile, origin=Vector Informatik, destination=DemEventParameter  # This reference contains the link to a diagnostic event.
        symbolic name reference DemFunctionIdRef: set at pre-compile, origin=Vector Informatik, destination=FiMFID  # FunctionId Ref | This reference contains the link to a function identifier within the FiM which is used as a primary FID. The FID is used to disable IUMPR calculation in case of an input fault.
        symbolic name reference DemSecondaryFunctionIdRef [0..*]: set at pre-compile, origin=Vector Informatik, destination=FiMFID  # Secondary FunctionId Ref | This reference contains the link to a function identifier within the FiM which is used as a secondary FID. The FID is used to disable IUMPR calculation in case of an input fault.
      container DemRatio [0..0]  # Ratio | (Not supported yet, please use the AUTOSAR 4.0.3 compliant definition in /Dem/DemGeneral/DemRatioId) This container contains the OBD specific ratio Id configuration. It is related to a specific event, a FID, and an IUMPR group.
        enumeration DemIUMPRDenGroup: {DEM_IUMPR_DEN_500MILL, DEM_IUMPR_DEN_COLDSTART, DEM_IUMPR_DEN_EVAP, DEM_IUMPR_DEN_NONE, DEM_IUMPR_DEN_PHYS_API}, set at pre-compile  # Dem IUMPR Denominator Group | (Not supported yet, please use the AUTOSAR 4.0.3 compliant definition in /Dem/DemGeneral/DemRatioId) This parameter specifies the assigned denominator type which is applied in addition to the General Denominator conditions. NONE: The denominator is calculated based on the general denominator conditions. PHYS_API: The denominator can be locked via dedicated APIs. COLDSTART, EVAP, 500MILL: Additional conditions must be fulfilled before the denominator is incremented.
        enumeration DemIUMPRGroup: {DEM_IUMPR_BOOSTPRS, DEM_IUMPR_CAT1, DEM_IUMPR_CAT2, DEM_IUMPR_EGR, DEM_IUMPR_EGSENSOR, DEM_IUMPR_EVAP, DEM_IUMPR_FLSYS, DEM_IUMPR_NMHCCAT, DEM_IUMPR_NOXADSORB, DEM_IUMPR_NOXCAT, DEM_IUMPR_OXS1, DEM_IUMPR_OXS2, DEM_IUMPR_PMFILTER, DEM_IUMPR_PRIVATE, DEM_IUMPR_SAIR, DEM_IUMPR_SECOXS1, DEM_IUMPR_SECOXS2}, set at pre-compile  # (Not supported yet, please use the AUTOSAR 4.0.3 compliant definition in /Dem/DemGeneral/DemRatioId) This parameter specifies the assigned IUMPR group of the ratio Id. Currently it is not used by the DEM and has no effect.
        integer DemRatioId: 0..65535, set at pre-compile, symbolic-name-value=true  # (Not supported yet, please use the AUTOSAR 4.0.3 compliant definition in /Dem/DemGeneral/DemRatioId) Defines a unique ratio Id.
        enumeration DemRatioKind: {DEM_RATIO_API, DEM_RATIO_OBSERVER}, set at pre-compile  # RatioId Kind | (Not supported yet, please use the AUTOSAR 4.0.3 compliant definition in /Dem/DemGeneral/DemRatioId) This parameter specifies how the numerator of the ratio is calculated: OBSERVER: The numerator is incremented whenever a test result is reported. This setting is used for symmetrical monitors. API: The numerator is incremented if the related monitoring function is able to detect a fault (reported by dedicated API). This setting is used for asymmetrical monitors.
        reference DemDiagnosticEventRef: set at pre-compile, destination=DemEventParameter  # (Not supported yet, please use the AUTOSAR 4.0.3 compliant definition in /Dem/DemGeneral/DemRatioId) This reference contains the link to a diagnostic event.
        symbolic name reference DemFunctionIdRef: set at pre-compile, destination=FiMFID  # FunctionId Ref | (Not supported yet, please use the AUTOSAR 4.0.3 compliant definition in /Dem/DemGeneral/DemRatioId) This reference contains the link to a function identifier within the FiM which is used as a primary FID. The FID is used to disable IUMPR calculation in case of an input fault.
        symbolic name reference DemSecondaryFunctionIdRef [0..*]: set at pre-compile, destination=FiMFID  # Secondary FunctionId Ref | (Not supported yet, please use the AUTOSAR 4.0.3 compliant definition in /Dem/DemGeneral/DemRatioId) This reference contains the link to a function identifier within the FiM which is used as a secondary FID. The FID is used to disable IUMPR calculation in case of an input fault.
      container DemStorageCondition [0..255]  # StorageCondition | This container represents a single storage condition. Please note: storage conditions can not be used directly but must be grouped (see DemStorageConditionGroup).
        integer DemStorageConditionId: 0..255, scope=ECU, set at pre-compile, symbolic-name-value=true, default-value=255  # StorageCondition Id | Internal identifier of the storage condition. This number is calculated internally and shall not be configured manually. This parameter is only available to publish the result of this calculation. Applications using Dem APIs must not rely on the value of this parameter. Instead, they must use the symbolic constant (SymbolicNameValue) DemConf_DemStorageCondition_{SHORT-NAME}.
        boolean DemStorageConditionStatus: set at pre-compile, default-value=true  # StorageCondition Status | Defines the status of this storage condition after full initialization, i.e. when Dem_MasterInit() or Dem_Init() finished. After pre-initialization, but before the full intialization (between Dem_(Master)PreInit() and Dem_(Master)Init() ) the status is always 'true'. Changes to the storage condition status during runtime are not persisted non-volatile. The status of this storage condition will always be reset to this configuration value during Dem_MasterInit() or Dem_Init().
      container DemStorageConditionGroup [0..255]: post-build-changeable=true  # StorageCondition Group | This container groups several storage conditions. EventParameters only reference one of these groups, not individual storage conditions.
        reference DemStorageConditionRef [1..255]: scope=ECU, set at post-build in variant post-build-loadable+post-build-selectable / pre-compile in variant pre-compile, origin=AUTOSAR_ECUC V1.0.0, destination=DemStorageCondition  # StorageCondition Ref | References an storage condition.
      container DemPidConfiguration [0..1]  # PID Configuration | This container contains options controlling the support of OBD PIDs by the Dem module.
        boolean DemSupportPid01 [0..1]: set at pre-compile, origin=Vector Informatik, default-value=true  # Support PID 01 | Monitor status since DTCs were last cleared.
        boolean DemSupportPid1C [0..1]: set at pre-compile, origin=Vector Informatik, default-value=true  # Support PID 1C | OBD requirements to which the vehicle is designed.
        boolean DemSupportPid21 [0..1]: set at pre-compile, origin=Vector Informatik, default-value=false  # Support PID 21 | Emission OBD: Distance travelled while MIL is active. ZEVonUDS: Distance travelled while any ZEV propulsion related DTC is confirmed.
        boolean DemSupportPid30 [0..1]: set at pre-compile, origin=Vector Informatik, default-value=true  # Support PID 30 | Number of WarmUp cycles since DTCs were last cleared.
        boolean DemSupportPid31 [0..1]: set at pre-compile, origin=Vector Informatik, default-value=false  # Support PID 31 | Distance since DTCs were last cleared.
        boolean DemSupportPid41 [0..1]: set at pre-compile, origin=Vector Informatik, default-value=true  # Support PID 41 | Monitor status of this driving cycle.
        boolean DemSupportPid4D [0..1]: set at pre-compile, origin=Vector Informatik, default-value=false  # Support PID 4D | Emission OBD: Engine run time while MIL is active. ZEVonUDS: Engine run time while any ZEV propulsion related DTC is confirmed.
        boolean DemSupportPid4E [0..1]: set at pre-compile, origin=Vector Informatik, default-value=false  # Support PID 4E | Engine run time since DTCs were last cleared
        boolean DemSupportPid91 [0..1]: set at pre-compile, origin=Vector Informatik, default-value=false  # Support PID 91 | WWH-OBD ECU OBD System Information
        boolean DemSupportVid08 [0..1]: set at pre-compile, origin=Vector Informatik, default-value=false  # Support VID 08 | In-use performance tracking - spark ignition vehicle. This parameter is not supported.
        boolean DemSupportVid0B [0..1]: set at pre-compile, origin=Vector Informatik, default-value=false  # Support VID 0B | In-use performance tracking - compression ignition vehicle. This parameter is not supported.
      container DemMILGroup [0..65534]  # This container represents a group of events that use a common trip counter to determine their MIL status. Incrementing the common trip counter is triggered by any event of the MIL group. Healing is performed individually for each event of the MIL group, but the common trip counter is only reset after all events of the group have been healed. The reference to a MIL group is configured at the DTCClass container.
      container DemPostbuild  # The content of this container is only relevant for the implementation variant PostBuild (POST-BUILD-LOADABLE). For implementation variant PreCompile (and therfore PostBuild-Selectable without -Loadable) all contained parameters are ignored.
        boolean DemEventAvailableDefaultSupport: set at pre-compile, origin=Vector Informatik, default-value=true  # Select whether the default availability value should be initialized with Dem_Init() TRUE: Use the default values from configuration parameter DemConfigSet/DemEventParameter/DemEventAvailable to set the initial value during Dem_Init() FALSE: The availability information is not changed during Dem_Init() If this setting is enabled, API Dem_SetEventAvailable cannot be used before Dem_Init() due to Dem_Init() overwriting the active setting.
        integer DemMaxSizeFreezeFrame: 0..65535, category=POST_BUILD_SPECIFIC, set at pre-compile, origin=Vector Informatik, default-value=0  # Max Size FreezeFrame | Enlarge the (RAM/NvRAM) size of the largest FreezeFrame record. This parameter is mandatory for implementation variant PostBuild-Loadable, it will be ignored for other implementation variants. It represents the size of largest defined FreezeFrame record. The minimum value is auto-calculated when you start "Validate" or "Generate" - set value 0 to force the recalculation of the min value. For PostBuild-Loadable variants, during the pre-compile configuration phase you can enlarge the value to reserve additional space in the NvRAM blocks. Later in the post-build phase you can choose different DIDs (or a different number of DIDs) for a defined FreezeFrame - as long as the size of the new selected DIDs still fit into the reserved space. Take care: for PostBuild-Loadable implementation variants the auto-calculation will only increase the value (when it is smaller than the configured, largest FreezeFrame's size. Changing the FreezeFrame's DIDs afterwards may shorten the largest FreezeFrame's size - but this will NOT decrease this value again! Set the value to '0' and start "Validate" or "Generate" for the DEM to calculate again the minimum size. "Size of a freeze frame" is calculated as: Summarize the size of all referred DemDidClasses in a DemGeneral/DemFreezeFrameClass. The size of a DidClass is calculated as: Summarize the size of all referred DemNNDataElementClass elements by adding their DemDataElementDataSize values.
        integer DemMaxNumberDtr: 0..65535, category=POST_BUILD_SPECIFIC, set at pre-compile, origin=Vector Informatik, default-value=0  # Max Number Dtr | Enlarge the (RAM/NvRAM) to store an upper limit of Dtr elements. This parameter is mandatory for implementation variant PostBuild-Loadable, it will be ignored for other implementation variants. It represents an upper limit to the maximum value (+1) of the DemDtrId, calculated over all variants. This maximum value is auto-calculated when you start "Validate" or "Generate" - set value 0 to force the recalculation of the min value. For PostBuild-Loadable variants, during the pre-compile configuration phase you can enlarge the value to reserve additional number of Dtr elements. Later in the post-build phase you can change Dtr configuration (also create and delete Dtrs) - as long as the maximum value (+1) of the DemDtrId calculated over all variants is smaller than this value. Take care: for PostBuild-Loadable implementation variants the auto-calculation will only increase the value (when it is smaller than the configured). Deleting Dtrs afterwards may decrease the lowest possible value - but this will NOT decrease this configured value again! Set the value to '0' and start "Validate" or "Generate" for the DEM to calculate again the minimum size.
        integer DemMaxSizeGlobalFreezeFrame: 0..65535, set at pre-compile, origin=Vector Informatik, default-value=0  # Enlarge the (RAM/NvRAM) size of the global freeze frame record. This parameter is mandatory for implementation variant PostBuild-Loadable, it will be ignored for other implementation variants. It represents the size of the global freeze frame record. The minimum value is auto-calculated when you start "Validate" or "Generate" - set value 0 to force the recalculation of the min value. For PostBuild-Loadable variants, during the pre-compile configuration phase you can enlarge the value to reserve additional space in the NvRAM blocks. Later in the post-build phase you can choose different DIDs (or a different number of DIDs) for the global freeze frame - as long as the size of the new selected DIDs still fits into the reserved space. Take care: for PostBuild-Loadable implementation variants the auto-calculation will only increase the value when it is smaller than the configured global freeze frame size. Changing the freeze frame's DIDs afterwards may shorten the global freeze frame size - but this will NOT decrease this value again! Set the value to '0' and start "Validate" or "Generate" for the DEM to calculate again the minimum size. "Size of the global freeze frame" is calculated as: Summarize the size of all referred DemDidClasses in the DemGeneral/DemGlobalFreezeFrame/DemGlobalFreezeFrameClassRef. The size of a DidClass is calculated as: Summarize the size of all referred DemDataClass elements by adding their DemDataElementDataSize values.
        integer DemMaxSizeOBDonUDSFreezeFrame: 0..65535, category=POST_BUILD_SPECIFIC, set at pre-compile, origin=Vector Informatik, default-value=0  # Max Size OBD on UDS FreezeFrame | Enlarge the (RAM/NvRAM) size of the largest OBD on UDS FreezeFrame record. This parameter is mandatory for implementation variant PostBuild-Loadable, it will be ignored for other implementation variants. It represents the size of largest defined OBD on UDS FreezeFrame record. The minimum value is auto-calculated when you start "Validate" or "Generate" - set value 0 to force the recalculation of the min value. For PostBuild-Loadable variants, during the pre-compile configuration phase you can enlarge the value to reserve additional space in the NvRAM blocks. Later in the post-build phase you can choose different DIDs (or a different number of DIDs) for a defined FreezeFrame - as long as the size of the new selected DIDs still fit into the reserved space. Take care: for PostBuild-Loadable implementation variants the auto-calculation will only increase the value (when it is smaller than the configured, largest FreezeFrame's size. Changing the FreezeFrame's DIDs afterwards may shorten the largest FreezeFrame's size - but this will NOT decrease this value again! Set the value to '0' and start "Validate" or "Generate" for the DEM to calculate again the minimum size. "Size of a freeze frame" is calculated as: Summarize the size of all referred DemDidClasses in a DemGeneral/DemFreezeFrameClass. The size of a DidClass is calculated as: Summarize the size of all referred DemDataElement Class elements by adding their DemDataElementDataSize values.
        integer DemMaxNumberEventsWithMonitorActivityData: 0..65535, set at pre-compile, origin=Vector Informatik, default-value=0  # Max Number Events With Monitor Activity Data | This parameter is only relevant for OBD on UDS legislation. Enlarge the (RAM/NvRAM) to store an upper limit of Monitor Activity Data (see Dem/DemGeneral/DemDataClass/DemDataElementInternalData MONITOR_ACTIVITY_DATA). This parameter is mandatory for implementation variant PostBuild-Loadable, it will be ignored for other implementation variants. It represents an upper limit for the number of events for which Monitor Activity Data can be stored. This maximum value is auto-calculated when you start "Validate" or "Generate" - set value 0 to force the recalculation of the min value. For PostBuild-Loadable variants, during the pre-compile configuration phase you can enlarge the value to reserve an additional number of events with Monitor Activity Data. Later in the post-build phase you can change the DemExtendedDataClassRef of an event and thereby the DemExtendedDataRecordClasses referenced by an event - as long as the maximum number of events with Monitor Activity Data is smaller or equal to this value. Take care: for PostBuild-Loadable implementation variants the auto-calculation will only increase the value (when it is smaller than the configured). Changing DemExtendedDataClassRefs or DemExtendedDataClasses afterwards may decrease the lowest possible value - but this will NOT decrease this configured value again! Set the value to '0' and start "Validate" or "Generate" for the DEM to calculate again the minimum number.
        integer DemMaxNumberEventsPtoTimer: 0..65535, set at pre-compile, origin=Vector Informatik, default-value=0  # Max Number Events With PTO Timer | This parameter is only relevant if any event is affected by the Dem PTO handling (see /DemEventParameter/DemEventClass/DemConsiderPtoStatus) and the Dem calculates the monitor status since DTCs cleared for PID $01, PID $F501 or J1939 diagnostic readiness 1. For each event affected by the Dem PTO handling that has an OBD Readiness group (see /DemEventParameter/DemEventClass/DemEventOBDReadinessGroup), an event specific PTO timer is maintained to track the cumulative engine runtime with PTO active. Enlarge the (RAM/NvRAM) to store an upper limit of event specific PTO timers. This parameter is mandatory for implementation variant PostBuild-Loadable, it will be ignored for other implementation variants. It represents an upper limit for the number of events for which a PTO timer can be maintained. This maximum value is auto-calculated when you start "Validate" or "Generate" - set value 0 to force the recalculation of the min value. For PostBuild-Loadable variants, during the pre-compile configuration phase you can enlarge the value to reserve an additional number of events with PTO timer. Later in the post-build phase you can change the DemEventOBDReadinessGroup of an event as long as the maximum number of events with PTO timer is smaller or equal to this value. Take care: for PostBuild-Loadable implementation variants the auto-calculation will only increase the value (when it is smaller than the configured). Changing the DemEventOBDReadinessGroup of an event afterwards may decrease the lowest possible value - but this will NOT decrease this configured value again! Set the value to '0' and start "Validate" or "Generate" for the DEM to calculate again the minimum number.
      container DemGlobalFreezeFrame [0..1]  # In this container the attributes and content of the global freeze frame can be configured. If this container is configured, global freeze frame data is stored for each event (In addition to Dem/DemConfigSet/DemEventParameter/DemFreezeFrameClassRef).
        integer DemGlobalFreezeFrameRecordNumber: 1..254, set at pre-compile, origin=Vector Informatik  # This parameter defines the record number of the global freeze frame.
        enumeration DemGlobalFreezeFrameRecordUpdate: {DEM_UPDATE_RECORD_NO}, set at pre-compile, origin=Vector Informatik  # This parameter defines, whether the global freeze frame is updated with each trigger. DEM_UPDATE_RECORD_NO: The global freeze frame is captured only once. DEM_UPDATE_RECORD_YES: The global freeze frame is captured with each trigger, overwriting the previously captured data (currently not supported).
        enumeration DemGlobalFreezeFrameRecordTrigger: {DEM_TRIGGER_ON_CONFIRMED}, set at pre-compile, origin=Vector Informatik  # This parameter defines the trigger to store the global freeze frame. Currently only trigger CONFIRMED is supported. FDC_THRESHOLD: The global freeze frame capture is triggered by a fault detection counter passing a storage threshold. CONFIRMED: The global freeze frame capture is triggered by the ConfirmedDTC transition from 0 to 1. PENDING: The global freeze frame capture is triggered by the PendingDTC transition from 0 to 1. TEST_FAILED: The global freeze frame capture is triggered by the TestFailed transition from 0 to 1. TEST_FAILED_FIRST_IN_CYCLE: The global freeze frame capture is triggered by the first TestFailed transition from 0 to 1 in an operation cycle. FDC_FIRST_IN_CYCLE: The global freeze frame capture is triggered by the first DTC fault detection counter reaching the storage threshold in an operation cycle. Please note that triggers occuring before an event memory entry is allocated are discarded.
        reference DemGlobalFreezeFrameClassRef: set at pre-compile, origin=Vector Informatik, destination=DemFreezeFrameClass  # This parameter references the list of DIDs to be stored in the global freeze frame.
      container DemTimeSeriesSnapshotClass [0..255]  # This container contains a list of dedicated, different time series snapshot records (also known as multi-sample development snapshot records)
        integer DemTimeSeriesMaxNumberPastSamples: 0..255, set at pre-compile, origin=Vector Informatik, default-value=0  # This configuration value defines how many past samples are stored for an event in each set of time series snapshot records (see DemPrimaryMemory/DemMaxNumberTimeSeriesSnapshotSets and DemUserDefinedMemory/DemMaxNumberTimeSeriesSnapshotSets). At least one past (this configuration value) or future (DemGeneral/DemTimeSeriesSnapshotClass/DemTimeSeriesMaxNumberFutureSamples) sample has to be configured.
        integer DemTimeSeriesMaxNumberFutureSamples: 0..255, set at pre-compile, origin=Vector Informatik, default-value=0  # This configuration value defines how many future samples are stored for an event in each set of time series snapshot records (see DemPrimaryMemory/DemMaxNumberTimeSeriesSnapshotSets and DemUserDefinedMemory/DemMaxNumberTimeSeriesSnapshotSets). At least one past (DemGeneral/DemTimeSeriesSnapshotClass/DemTimeSeriesMaxNumberPastSamples) or future (this configuration value) sample has to be configured.
        float DemTimeSeriesSamplingTime: 0.001..2678400, set at pre-compile, origin=Vector Informatik, default-value=1  # This configuration value defines the time interval for the periodic collection of the samples. The value must be a multiple of the DemGeneral/DemTaskTime. Otherwise it is rounded down to the next multiple value of DemTaskTime. The AUTOSAR configuration standard is to use SI units, so in the EcuC file this parameter is stored as float value in seconds - the DaVinci Configurator 5 GUI will convert the value when using a different unit.
        integer DemTimeSeriesSampleBufferSize: 1..65535, set at pre-compile  # This configuration value defines the size of the ring buffer in RAM in which the collected DIDs are stored. The value is multiplied with the number of past samples configured in DemGeneral/DemTimeSeriesSnapshotClass/DemTimeSeriesMaxNumberPastSamples. The ring buffer has to be large enough to store all DIDs relevant for events referencing this DemTimeSeriesSnapshotClass container. You get an error message when the configured value is too small.
      container DemGeneralCalibration [0..1]  # General Calibration | Contains configuration options for calibration.
        boolean DemCalibrationCounterBasedDebouncingSupport: set at pre-compile, origin=Vector Informatik, default-value=false  # Support Calibration for Counter Based Debouncing | If this parameter is set to true, the following parameters of a DemConfigSet/DemDebounceCounterBasedClass can be calibrated: - DemDebounceCounterIncrementStepSize - DemDebounceCounterFailedThreshold - DemDebounceCounterPassedThreshold - DemDebounceCounterJumpUp - DemDebounceCounterJumpUpValue - DemDebounceCounterJumpDown - DemDebounceCounterJumpDownValue - DemCounterBasedFdcThresholdStorageValue - DemDebounceContinuous - DemDebounceBehavior - DemDebounceCounterDecrementStepSize: In contrast to the initially configured value, when calibrating this parameter the modified value needs to be negative, i.e. it is equal to configured value * (-1). For events with counter based debouncing it is also possible to calibrate which event references which counter based debouncing class. Note: To support calibration of counter based debounce classes, optimizations are disabled for the tables containing these classes. This can lead to increased memory consumption.
        integer DemCalibrationAdditionalCounterBasedDebouncingClasses: 0..65535, set at pre-compile, origin=Vector Informatik, default-value=0  # Additional Counter Based Debounce Classes | This parameter is only relevant if DemGeneral/DemGeneralCalibration/DemCalibrationCounterBasedDebouncingSupport is set to true. This parameter specifies the number of DemCounterBasedDebouncingClasses that shall be calibratable in addition the configured and referenced DemConfigSet/DemDebounceCounterBasedClasses. The values of these additional classes can be calibrated (see DemCalibrationCounterBasedDebouncingSupport) and can be referenced by any event using counter based debouncing via calibration.
  module config Dem_Pre: definition=Dem
  module config Dem_Rec: definition=Dem
