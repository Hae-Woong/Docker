[part 1 of 2: package /MICROSAR]
AUTOSAR XML (schema 4-1-2)
# COPYRIGHT
# Copyright (c) 2024 by Vector Informatik GmbH. All rights reserved.
# This software is copyright protected and proprietary to Vector Informatik GmbH.
# Vector Informatik GmbH grants to you only those rights as set out in the license conditions.
package /MICROSAR
  bsw implementation Dem_Impl: programming-language=C, sw-version=27.00.00, used-code-generator=DaVinci Configurator, vendor-id=30, ar-release-version=4.01.02, behavior=DemBehavior, preconfigured-configuration=Dem_Pre, recommended-configuration=Dem_Rec, vendor-specific-module-def=Dem
  module definition Dem [0..1]: category=VENDOR_SPECIFIC_MODULE_DEFINITION, refined-module-def=Dem, variants pre-compile/post-build-loadable/post-build-selectable  # Diagnostic Event Manager (DEM). Processes and stores diagnostic events and associated environmental data. Provides the fault information to communication managers and SWCs. #Diag #Diagnostics #UDS #OBD #WWHOBD #AUTOSAR #ServiceComponent
    container DemConfigSet  # This container groups the Diagnostic Monitor configuration setup. One such data set can be activated during initialization in case of multiple configuration sets. Currently only one configuration set is supported.
      container DemDTCClass [0..65535]  # This container groups configuration options relating to the Diagnostic Trouble code (DTC) of a monitor. It is only valid if actually used by a monitor (see DemConfigSet/DemEventParameter/DemDTCClassRef). Unused DTCClass containers are ignored.
        integer DemDTCFunctionalUnit [0..1]: 0..255, scope=ECU, set at pre-compile, default-value=0  # A 1-byte value which identifies the corresponding basic vehicle / system function which monitors this DTC. This parameter is necessary for the report of severity information and will be returned in UDS services $19 08 and $19 09. If these services are not used, this parameter serves no use at all. This parameter has no further influence on the function of the Dem. If this parameter is not configured the value 0 is substituted, as required by AUTOSAR 4.3.
        enumeration DemDTCSeverity [0..1]: {DEM_DTC_SEV_CHECK_AT_NEXT_HALT, DEM_DTC_SEV_IMMEDIATELY, DEM_DTC_SEV_MAINTENANCE_ONLY, DEM_DTC_SEV_NO_SEVERITY}, scope=ECU, set at pre-compile, default-value=DEM_DTC_SEV_NO_SEVERITY  # DTC severity A missing configuration value (or parameter) is interpreted as NO_SEVERITY. The DTCSeverity byte according to ISO 14229-1 and J1979-2 consists of DTC severity and DTC class information (refer to DemWWHOBDDTCClass or DemOBDONUDSDTCClass) and is reported by UDS service $19 09 and can serve as a filter parameter for UDS services $19 07, $19 08, $19 42. This parameter has no further influence on the function of the Dem.
        boolean DemImmediateNvStorage: scope=ECU, set at pre-compile, default-value=false  # Select the write strategy for non-volatile storage of DTC related data. If enabled, environmental data for this DTC will be written to NV backing storage when it is stored or updated. If disabled, environmental data for this DTC will be persisted during shutdown. See also description of related parameters Dem/DemGeneral/DemImmediateNvStorageSupport and Dem/DemGeneral/DemImmediateNvStorageLimit.
        integer DemJ1939DTC [0..1]: 1..16777214, scope=ECU, set at pre-compile  # Unique Diagnostic Trouble Code value for J1939 (consisting of SPN and FMI). The Dem expects the SPN and FMI values of the J1939DTC to be configured according to the J1939 standard. For calculation of the SPN the Dem uses Conversion Method 4 from SAE J1939-73 Specification, e.g. for SPN in DM20.
        integer DemObdDTC [0..1]: 1..65535, scope=ECU, set at post-build in variant post-build-loadable+post-build-selectable / pre-compile in variant pre-compile  # OBD II DTC | Unique Diagnostic Trouble Code value for OBD II. This parameter is only valid if OBD II is supported (DemGeneral/DemOBDSupport == true and DemGeneral/DemGeneralOBD/DemOBDLegislation == DEM_OBD_LEGISLATION_OBDII) If a DTC is OBD II relevant (i.e. has this DTC number configured) certain legislated restrictions apply to the DTC configuration. Please refer to the OBD legislation.
        integer DemUdsDTC [0..1]: 1..16777214, scope=ECU, set at post-build in variant post-build-loadable+post-build-selectable / pre-compile in variant pre-compile  # Unique Diagnostic Trouble Code value for UDS (DTC number).
        enumeration DemWWHOBDDTCClass [0..1]: {DEM_DTC_WWHOBD_CLASS_A, DEM_DTC_WWHOBD_CLASS_B1, DEM_DTC_WWHOBD_CLASS_B2, DEM_DTC_WWHOBD_CLASS_C, DEM_DTC_WWHOBD_CLASS_NOCLASS}, scope=ECU, set at post-build in variant post-build-loadable+post-build-selectable / pre-compile in variant pre-compile, origin=Vector Informatik  # WWH OBD DTC Class | CLASS_A: If a DTC with this class occur, it is assumed that the OBD threshold limits (OTL) are exceeded. CLASS_B1: A DTC with this class has the potential to lead to emissions above the OBD threshold limits. CLASS_B2: The malfunction is assumed to influence the emissions but not in a level exceeding the OBD threshold limits. CLASS_C: The DTC is assumed to influence the emissions but not in a level above the regulated emission limits. CLASS_NOCLASS: The DTC does not influence the emissions. Together with DemDTCSeverity, the DTC class forms the DTC severity byte according to ISO 14229-1.
        integer DemFunctionalGroupIdentifier [0..1]: 51..51, scope=ECU, set at post-build in variant post-build-loadable+post-build-selectable / pre-compile in variant pre-compile, origin=Vector Informatik, default-value=51  # The identifier of the corresponding functional system group. Currently only support the identifier 0x33 for emissions-system group. If OBD II is supported (DemGeneral/DemOBDSupport == true and DemGeneral/DemGeneralOBD/DemOBDLegislation == DEM_OBD_LEGISLATION_OBDII), this parameter is automatically derived from Dem/DemConfigSet/DemDTCClass/DemObdDTC and shall not be configured manually. If WWHOBD is supported (DemGeneral/DemOBDSupport == true and DemGeneral/DemGeneralOBD/DemOBDLegislation == DEM_OBD_LEGISLATION_WWHOBD), this parameter is automatically derived from Dem/DemConfigSet/DemDTCClass/DemWWHOBDDTCClass and the Dem/DemConfigSet/DemEventParameter/DemOBDFreezeFrameClassRef of the referenced event and shall not be configured manually. If OBDonUDS is supported (DemGeneral/DemOBDSupport == true and DemGeneral/DemGeneralOBD/DemOBDLegislation == DEM_OBD_LEGISLATION_OBD_ON_UDS), this parameter is not derived and must be configured manually. If ZEVonUDS is supported (DemGeneral/DemOBDSupport == true and DemGeneral/DemGeneralOBD/DemOBDLegislation == DEM_OBD_LEGISLATION_ZEV_ON_UDS), this parameter is not derived and must be configured manually.
        enumeration DemOBDONUDSDTCClass [0..1]: {DEM_DTC_OBDONUDS_CLASS_0, DEM_DTC_OBDONUDS_CLASS_1, DEM_DTC_OBDONUDS_CLASS_2, DEM_DTC_OBDONUDS_CLASS_3, DEM_DTC_OBDONUDS_CLASS_4}, scope=ECU, set at pre-compile in variant post-build-loadable+pre-compile / post-build in variant post-build-selectable, origin=Vector Informatik  # OBD on UDS DTC Class | This parameter is only relevant for OBDonUDS and ZEVonUDS. Together with DemDTCSeverity, the DTC class forms the DTC severity byte according to ISO 14229-1, J1979-2 and J1979-3. OBDonUDS: DTC Class to classify the emission severity of a DTC according to SAE J1979-2. A DTC with Class 0 does not influence the emissions. ZEVonUDS: DTCClass_1 (ZEV Propulsion related DTC) according to SAE J1979-3.
        integer DemObdDTC3Byte [0..1]: 256..16777214, scope=ECU, set at post-build in variant post-build-loadable+post-build-selectable / pre-compile in variant pre-compile, origin=Vector Informatik  # OBD on UDS 3 Byte DTC | This parameter is only relevant for OBDonUDS. 3 Byte OBD DTC value that is used for the UDS Diagnostic Trouble Code (DTC). The value is defining a DTC based on SAE J2012. This parameter is only considered when UDS and OBD DTC handling is separated (DemGeneral/DemOBDSupport == true, DemGeneral/DemGeneralOBD/DemSupportedObdUdsDtcSeparation == true and DemGeneral/DemGeneralOBD/DemOBDLegislation == DEM_OBD_LEGISLATION_OBD_ON_UDS).
        reference DemMILGroupRef [0..1]: set at post-build in variant post-build-loadable+post-build-selectable / pre-compile in variant pre-compile, origin=Vector Informatik, destination=DemMILGroup  # Reference to a MIL group that is needed if different symptoms shall use one common trip counter.
        reference DemJ1939DTC_NodeAddressRef [0..1]: set at pre-compile, destination=DemJ1939NodeAddress  # Reference to a J1939 NodeAddress.
        reference DemDTCAttributesRef: set at pre-compile, destination=DemDTCAttributes  # This parameter defines the DTC Attributes associated with the DemDTC.
        container DemCallbackInitMForF [0..*]  # Callback InitMonitorForFunction | The presence of this container sets up an initialization function (InitMonitorForFunction) for this DTC. The Dem will call this function each time the related DTC is cleared, or the operation (monitoring) cycle of the related monitor restarts. This function is usually called through a RTE port interface. This behavior can be changed by creating the sub-parameter 'DemCallbackInitMForFFnc'.
          function name DemCallbackInitMForFFnc [0..1]: scope=ECU, set at pre-compile  # Callback InitMonitorForFunction Function | Function name of an InitMonitorForFunction callout. If this parameter exists, it must give a valid C-Function which is called instead of using an RTE port interface. See DemGeneral/DemHeaderFileInclusion to specify a header file which declares this function.
      container DemDtrs [0..1]: post-build-changeable=true  # This container holds the configuration of DTRs collection.
        container DemDtr [0..65534]: post-build-changeable=true  # This container holds the configuration of one individual DTR.
          float DemDtrCompuDenominator0: 0..3.4028235E+38, scope=ECU, set at post-build in variant post-build-loadable+post-build-selectable / pre-compile in variant pre-compile, default-value=1  # Part of the conversion between the binary representation and the physical meaning analogous to the SW-C Template conversion CompuRationalCoeffs with 2 numerator coefficients and 1 denominator coefficient in the direction compuInternalToPhys. The value must be greater than 0. In detail, the conversion of x (= old Value) to y (= new value) is given by y = (A*x + B)/C, where A = DemDtrCumpuNumerator1, B = DemDtrCompuNumerator0, C = DemDtrCompuDenominator0 (= this parameter).
          float DemDtrCompuNumerator0: -3.4028235E+38..3.4028235E+38, scope=ECU, set at post-build in variant post-build-loadable+post-build-selectable / pre-compile in variant pre-compile, default-value=0  # Part of the conversion between the binary representation and the physical meaning analogous to the SW-C Template conversion CompuRationalCoeffs with 2 numerator coefficients and 1 denominator coefficient in the direction compuInternalToPhys. In detail, the conversion of x (= old Value) to y (= new value) is given by y = (A*x + B)/C, where A = DemDtrCumpuNumerator1, B = DemDtrCompuNumerator0 (= this parameter), C = DemDtrCompuDenominator0.
          float DemDtrCompuNumerator1: 0..3.4028235E+38, scope=ECU, set at post-build in variant post-build-loadable+post-build-selectable / pre-compile in variant pre-compile, default-value=1  # Part of the conversion between the binary representation and the physical meaning analogous to the SW-C Template conversion CompuRationalCoeffs with 2 numerator coefficients and 1 denominator coefficient in the direction compuInternalToPhys. The value must be greater than 0. In detail, the conversion of x (= old Value) to y (= new value) is given by y = (A*x + B)/C, where A = DemDtrCumpuNumerator1 (= this parameter), B = DemDtrCompuNumerator0, C = DemDtrCompuDenominator0.
          integer DemDtrId: 0..65535, scope=ECU, set at pre-compile, symbolic-name-value=true, default-value=65535  # The index identifier value assigned to this DTR. The value is generated during the Dem configuration process.
          integer DemDtrMid: 1..255, scope=ECU, set at post-build in variant post-build-loadable+post-build-selectable / pre-compile in variant pre-compile  # The OBDMID of the DTR. The values 0x00, 0x20, 0x40, 0x60, 0x80, 0xA0, 0xC0, 0xE0 are reserved.
          integer DemDtrTid: 0..255, scope=ECU, set at post-build in variant post-build-loadable+post-build-selectable / pre-compile in variant pre-compile  # The OBDTID of the DTR.
          integer DemDtrUasid: 0..255, scope=ECU, set at post-build in variant post-build-loadable+post-build-selectable / pre-compile in variant pre-compile  # The UaSId the DTR data shall be scaled to, and reported together with the rescaled DTR data.
          enumeration DemDtrUpdateKind [0..1]: {DEM_DTR_UPDATE_ALWAYS, DEM_DTR_UPDATE_STEADY}, set at post-build in variant post-build-loadable+post-build-selectable / pre-compile in variant pre-compile  # Update conditions applied by the Dem to reports of DTR values. DEM_DTR_UPDATE_ALWAYS: The reported DTR values are always processed. DEM_DTR_UPDATE_STEADY: The reported DTR values are only processed, if the enable and storage conditions of the event referenced by DemDtrEventRef are fulfilled and the DTR values are consistent with the current event status of this event. This value can therefore only take effect if an event is referenced. If no event is referenced, the Dem behaves as if DemDtrUpdateKind is configured to DEM_DTR_UPDATE_ALWAYS.
          reference DemDtrEventRef [0..1]: scope=ECU, set at post-build in variant post-build-loadable+post-build-selectable / pre-compile in variant pre-compile, destination=DemEventParameter  # Reference to the DemEventParameter this DTR is related to. If the related event is not configured, the Dem cannot ensure consistency between the DTR and the event.
      container DemEventParameter [1..65534]  # This container contains the configuration of diagnostic events. These represent monitors and can be mapped onto a DTC.
        boolean DemEventAvailable: scope=ECU, set at post-build in variant post-build-loadable+post-build-selectable / pre-compile in variant pre-compile, default-value=true  # Event Available By Default | This parameter has only an effect when /Dem/DemGeneral/DemPostbuild/DemEventAvailableDefaultSupport is enabled. If this parameter is set to true, the event will be considered as available during initialization. If this parameter is set to false, the event will be considered as unavailable during initialization
        integer DemEventId: 1..65535, scope=ECU, set at pre-compile, symbolic-name-value=true, default-value=65535  # Internal identifier of a diagnostic event. This number is calculated internally and shall not be configured manually. This parameter is only available to publish the result of this calculation. Applications using Dem APIs must not rely on the value of this parameter. Instead, they must use the symbolic constant (SymbolicNameValue) DemConf_DemEventParameter_{SHORT-NAME}.
        enumeration DemEventKind: {DEM_EVENT_KIND_BSW, DEM_EVENT_KIND_SWC}, set at pre-compile, default-value=DEM_EVENT_KIND_SWC  # This parameter is used to distinguish between SW-C and BSW events. SW-C events are reported through the RTE port interface DiagnosticMonitor, operation SetEventStatus. BSW events are reported by C-API Dem_SetEventStatus.
        integer DemMaxNumberFreezeFrameRecords [0..1]: 0..255, scope=ECU, set at pre-compile, default-value=0  # Max Number FreezeFrameRecords | This parameter defines the number of snapshot records which can be stored for this event. The parameter will be mandatory, if the snapshot numbers are CALCULATED (refer to DemTypeOfFreezeFrameRecordNumeration of DemPrimaryMemory or DemUserDefinedMemory referenced by the event) and a FreezeFrame is configured for this DemEventParameter (see DemFreezeFrameClassRef). For configured record numbers this value has no meaning and should be removed.
        boolean DemEventAvailableInVariant: set at pre-compile in variant post-build-loadable+pre-compile / post-build in variant post-build-selectable, origin=Vector Informatik, default-value=true  # This parameter configures the event's availability in the variant. If this parameter is set to false for a specific variant, this event is not available at all in this variant. If this parameter is set to true, the event is available for the current variant. With Postbuild-Selectable setting not supported, this parameter will be set to true and shall not be changed manually. If the parameter is changed to false, the event will not be available at all, like it is not configured. If this parameter set to false, even though the switch DEM_CFG_SUPPORT_EVENTAVAILABLE (/Dem/DemGeneral/DemAvailabilitySupport) is enabled, changing the availability of events at runtime is not possible.
        boolean DemEventLatchTestFailed: set at pre-compile, origin=Vector Informatik, default-value=false  # Event Latch TestFailed | Switch to block TestPassed results for a qualified event. See DemGeneral/DemLatchTestFailedBehavior for the effect of this switch.
        boolean DemEventCreateInfoPort: set at pre-compile, origin=Vector Informatik, default-value=true  # Activate/deactivate the creation of the DiagnosticInfo port for the event. If this parameter is enabled, the interface DiagnosticInfo is provided for the event.
        boolean DemEventRecoverableInSameOperationCycle [0..0]: set at pre-compile  # Not supported. Please use the following parameters to configure the desired behavior DemEventRecoverableInSameOperationCycle = TRUE: DemEventLatchTestFailed = FALSE DemEventRecoverableInSameOperationCycle = FALSE: DemEventLatchTestFailed = TRUE AND DemGeneral/DemLatchTestFailedBehavior = DEM_LATCH_ONLY_THIS_CYCLE
        reference DemDTCClassRef [0..1]: set at pre-compile, destination=DemDTCClass  # DTC Class Ref | This parameter defines the DTC configuration associated with the diagnostic event, that means it maps the event onto a DTC number.
        foreign reference DemEventParameterSystemTemplateDiagnosticEventRef [0..1]: set at pre-compile, origin=Vector Informatik, destination-type=DIAGNOSTIC-EVENT  # EventParameter System Template DiagnosticEvent Ref | Reference to the DiagnosticEvent which is represented by this DemEventParameter.
        reference DemExtendedDataClassRef [0..1]: set at post-build in variant post-build-loadable+post-build-selectable / pre-compile in variant pre-compile, destination=DemExtendedDataClass  # ExtendedData Class Ref | This reference defines the list of extended data records available for this event.
        reference DemFreezeFrameClassRef [0..1]: set at pre-compile, destination=DemFreezeFrameClass  # FreezeFrame Class Ref | These references define the list of Data IDs (DIDs) stored in the snapshot records of this event.
        reference DemFreezeFrameRecNumClassRef [0..1]: scope=ECU, set at pre-compile, destination=DemFreezeFrameRecNumClass  # FreezeFrameRecNum Class Ref | This parameter defines the list of dedicated snapshot record numbers associated with the diagnostic event. These record numbers are assigned to the snapshot records. The parameter will be mandatory in the following cases: 1. if the snapshot numbers are CONFIGURED (refer to DemTypeOfFreezeFrameRecordNumeration of DemPrimaryMemory or DemUserDefinedMemory referenced by the event) and a FreezeFrame is configured for this DemEventParameter (see DemFreezeFrameClassRef) 2. if the time series snapshot data needs to be collected for this DemEventParameter (see Dem/DemGeneral/DemTimeSeriesSnapshotClass).
        reference DemJ1939ExpandedFreezeFrameClassRef [0..1]: set at pre-compile, destination=DemJ1939FreezeFrameClass  # J1939 Expanded FreezeFrame Class Ref | These references define the links to a J1939 freeze frame class sampler.
        reference DemJ1939FreezeFrameClassRef [0..1]: set at pre-compile, destination=DemJ1939FreezeFrameClass  # J1939 FreezeFrame Class Ref | These references define the links to a J1939 freeze frame class sampler.
        reference DemOBDGroupingAssociativeEventsRef [0..0]: scope=ECU, set at pre-compile, destination=DemEventParameter  # This parameter defines a reference which points to a representative event of one group of associate events. (Not supported, please use DemDTCClass/DemMILGroupRef instead)
        reference DemEventOsApplicationRef [0..1]: set at pre-compile, origin=Vector Informatik, destination=OsApplication  # OsApplication Ref for Event | Reference to the (satellite) partition, this event is assigned to. The Dem directly supports multi partition architectures, i.e. ECUs using multiple cores or memory protection for safety reasons. See chapter "Multi-Partition support" in the TechnicalReference for details.
        reference DemOBDFreezeFrameClassRef [0..1]: set at post-build in variant post-build-loadable+post-build-selectable / pre-compile in variant pre-compile, origin=Vector Informatik, destination=DemFreezeFrameClass  # OBD FreezeFrame Class Ref | This reference defines the link to a WWH-OBD or OBD on UDS freeze frame class sampler.
        container DemCallbackClearEventAllowed [0..1]  # Callback ClearEventAllowed | The presence of this container sets up a callout function 'ClearEventAllowed' for this DTC. The Dem will call this function each time the related DTC is about to be cleared by an external tool. (API Dem_ClearDTC, usually only called by Dcm). This function is usually called through a RTE port interface. This behavior can be changed by creating the sub-parameter 'DemCallbackClearEventAllowedFnc'.
          function name DemCallbackClearEventAllowedFnc [0..1]: scope=ECU, set at pre-compile  # Callback ClearEventAllowed Function | Function name of a 'ClearEventAllowed' callout. If this parameter exists, it must give a valid C-Function which is called instead of using an RTE port interface. See DemGeneral/DemHeaderFileInclusion to specify a header file which declares this function.
          enumeration DemClearEventAllowedBehavior: {DEM_NO_STATUS_BYTE_CHANGE, DEM_ONLY_THIS_CYCLE_AND_READINESS}, set at pre-compile, default-value=DEM_NO_STATUS_BYTE_CHANGE  # Defines the resulting UDS status byte for the related event, which must not be cleared according to the ClearEventAllowed callback. (not supported)
        container DemCallbackEventDataChanged [0..1]  # Callback EventDataChanged | The presence of this container sets up a callout function 'EventDataChanged' for this DTC. The Dem will call this function each time the stored data (extended record, snapshot record) has changed. Please note, data elements can be mapped to internal data. This callback is NOT called if such data changes, only if the stored data record is modified due to a new event report. Example: If an extended record is mapped to the fault detection counter, this API is not called each time the FDC changes even though a diagnostic service $19 06 would indeed return different data. This function is usually called through a RTE port interface. This behavior can be changed by creating the sub-parameter 'DemCallbackEventDataChangedFnc'. The presence of this container indicates that the Dem has access to an "EventDataChanged" callback. This container is ignored, if parameter DemGeneral/DemTriggerEventDataChangedCallback exists and has value False.
          function name DemCallbackEventDataChangedFnc [0..1]: scope=ECU, set at pre-compile  # Callback EventDataChanged Function | Function name of a 'EventDataChanged' callout. If this parameter exists, it must give a valid C-Function which is called instead of using an RTE port interface. See DemGeneral/DemHeaderFileInclusion to specify a header file which declares this function.
        container DemCallbackEventStatusChanged [0..*]  # Callback EventStatusChanged | The presence of this container sets up a callout function 'EventStatusChanged' for this DTC. The Dem will call this function each time the event status changes. Please note, the event status is independent of the DTC status availability mask (DemGeneral/DemDtcStatusAvailabilityMask). All transitions of status bits will be reported. Attention: Due to preemption it is possible that event status changes are reported in the wrong order. This is no issue if the Dem_Mainfunction is mapped to a non-preemptive task. This function is usually called through a RTE port interface. This behavior can be changed by creating the sub-parameter 'DemCallbackEventStatusChangedFnc'. This container is ignored, if parameter DemGeneral/DemTriggerEventStatusChangedCallback exists and has value False.
          function name DemCallbackEventStatusChangedFnc [0..1]: scope=ECU, set at pre-compile  # Callback EventStatusChanged Function | Function name of an 'EventStatusChanged' callout. If this parameter exists, it must give a valid C-Function which is called instead of using an RTE port interface. See DemGeneral/DemHeaderFileInclusion to specify a header file which declares this function.
        container DemCallbackInitMForE [0..1]  # Callback InitMonitorForEvent | The presence of this container sets up an initialization function 'InitMonitorForEvent' for this Event. The Dem will call this function each time this event is cleared, or the operation (monitoring) cycle restarts (see ./DemEventClass/DemOperationCycleRef). Using parameter DemTriggerMonitorInitForEnableConditions with value'true', this function will also be called if an enable condition or ControlDTC ($85 01) re-activates this event. This function is usually called through a RTE port interface. This behavior can be changed by creating the sub-parameter 'DemCallbackInitMForFFnc'.
          function name DemCallbackInitMForEFnc [0..1]: set at pre-compile  # Callback InitMonitorForEvent Function | Function name of a 'InitMonitorForEvent' callout. If this parameter exists, it must give a valid C-Function which is called instead of using an RTE port interface. See DemGeneral/DemHeaderFileInclusion to specify a header file which declares this function.
        container DemEventClass  # This container contains further configuration parameters for the event.
          boolean DemAgingAllowed: scope=ECU, set at pre-compile, default-value=false  # Switch to allow aging/unlearning of the event. If aging is supported, a valid aging cycle must be referenced (see DemAgingCycleRef) and a valid number of aging cycles must be set (see DemAgingCycleCounterThreshold).
          integer DemAgingCycleCounterThreshold [0..1]: 0..255, scope=ECU, set at post-build in variant post-build-loadable+post-build-selectable / pre-compile in variant pre-compile  # AgingCycle Counter Threshold | Number of aging cycles needed to unlearn/delete the event. A value of 0 means, the event is aged immediately with a passed event status. A value of 1 means the event is aged at the end of the current aging cycle (if the event is passive at that moment). Larger values represent the n-th cycle e.g. 2 is the next, 3 the cycle after the next etc. If this parameter is missing: - If aging allowed is set to true (refer to DemAgingAllowed), this value defaults to 0. - If aging allowed is set to false, this value defaults to 255. If aging allowed is set to false the value is still used as upper limit for the aging counter, given that the aging counter behavior (refer to Dem/DemGeneral/DemAgingCounterBehavior) is set to DEM_AGING_COUNT_ALWAYS. In this case the value is also used as initial value for the inverted aging counter. If the aging counter behavior is set to DEM_AGING_COUNT_ONLY_AGEABLE, this value is reported for the inverted aging counter, but has no effect for the incrementing aging counter (with aging allowed set to false).
          boolean DemConsiderPtoStatus: scope=ECU, set at pre-compile, default-value=false  # This parameter is TRUE, when the event is affected by the Dem PTO handling.
          integer DemEventFailureCycleCounterThreshold [0..1]: 0..254, scope=ECU, set at post-build in variant post-build-loadable+post-build-selectable / pre-compile in variant pre-compile, default-value=0  # Event FailureCycleCounter Threshold | Number of operation cycles needed to confirm the event. When the parameter is missing or has the value 0, use the standard UDS behavior of confirming the event (ConfirmedDTC status bit becomes set) with the first qualified FAILED result. A value of 1 means the event becomes confirmed if it fails again in the next operation cycle. Larger values represent confirmation in the n-th cycle e.g. 2 is confirmation in cycle after the next cycle, etc. All DTCs, that are in the same MIL Group, must have the same threshold value (refer to parameter /Dem/DemGeneral/DemMILGroup).
          integer DemEventMemoryEntryFdcThresholdStorageValue [0..0]: 0..255, set at pre-compile  # Threshold to allocate an event memory entry and to capture the Freeze Frame. (Not supported - please use /DemConfigSet/DemDebounceTimeBasedClass/DemTimeBasedFdcThresholdStorageValue or DemConfigSet/DemDebounceCounterBasedClass/DemCounterBasedFdcThresholdStorageValue instead.)
          enumeration DemEventOBDReadinessGroup [0..1]: {DEM_OBD_RDY_AC, DEM_OBD_RDY_BOOSTPR, DEM_OBD_RDY_CAT, DEM_OBD_RDY_CMPRCMPT, DEM_OBD_RDY_CSER, DEM_OBD_RDY_DOR, DEM_OBD_RDY_ECS, DEM_OBD_RDY_EGSENS, DEM_OBD_RDY_EGR, DEM_OBD_RDY_EVAP, DEM_OBD_RDY_FLSYS, DEM_OBD_RDY_FLSYS_NONCONT, DEM_OBD_RDY_HCCAT, DEM_OBD_RDY_HTCAT, DEM_OBD_RDY_MISF, DEM_OBD_RDY_NONE, DEM_OBD_RDY_NOXADSORB, DEM_OBD_RDY_NOXCAT, DEM_OBD_RDY_OTHER, DEM_OBD_RDY_O2SENS, DEM_OBD_RDY_O2SENSHT, DEM_OBD_RDY_PCV, DEM_OBD_RDY_PMFLT, DEM_OBD_RDY_SECAIR, DEM_OBD_RDY_VVT, DEM_OBD_RDY_EGHSENS, DEM_OBD_RDY_CSAS}, scope=ECU, set at post-build in variant post-build-loadable+post-build-selectable / pre-compile in variant pre-compile, default-value=DEM_OBD_RDY_NONE  # Select the Event OBD Readiness group. This parameter is only needed if OBD support is enabled (see DemGeneral/DemOBDSupport). The parameter is needed for PID $01, PID $F501, PID $41, J1939 diagnostic readiness 1 and 3 computation and to classify faults according to OBD requirements (e.g. OBD freeze frame related to misfire or fuel system faults can displace other freeze frames). The different values for this parameter are described in the Dem AUTOSAR SWS. In addition to the Readiness groups described there, the following groups are supported for spark and compression engines: - DEM_OBD_RDY_EGHSENS: Exhaust gas sensor heater monitoring - DEM_OBD_RDY_CSAS: Cold start aid system monitoring.
          integer DemEventPriority: 1..255, scope=ECU, set at post-build in variant post-build-loadable+post-build-selectable / pre-compile in variant pre-compile, default-value=2  # Set the priority of the event. A lower number represent higher priority. Same level priority is allowed. This value influences the event displacement in case the respective memory is completely filled at the time of event confirmation. Lower priority events will never displace higher priority events. Equal priority events will displace passive entries. This parameter only has an effect if event displacement is supported (see DemGeneral/DemEventDisplacementSupport).
          enumeration DemEventSignificance [0..1]: {DEM_EVENT_SIGNIFICANCE_FAULT, DEM_EVENT_SIGNIFICANCE_OCCURRENCE}, scope=ECU, set at pre-compile, default-value=DEM_EVENT_SIGNIFICANCE_FAULT  # Significance of the event, which indicates additional information concerning fault classification and resolution. This value can optionally be selected to be reported as event data (e.g. as data element inside an extended data record). It has no further effect on the Dem.
          boolean DemFFPrestorageSupported: scope=ECU, set at pre-compile, default-value=false  # FreezeFrame Prestorage Supported | Select the event for prestorage support. Only events with this flag enabled may request data prestorage (Port interface DiagnosticMonitor, operation PrestoreFreezeFrame). This parameter only has an effect if prestorage is enabled (see DemGeneral/DemMaxNumberPrestoredFF).
          boolean DemOBDVisibilityDelayedUntilDcyQualification [0..1]: set at pre-compile, origin=Vector Informatik  # This parameter defines when the ConfirmedDTC and the WarningIndicatorRequested status bits of an OBD relevant event become externally visible. Depending on the configuration, permanent DTC and the OBD FreezeFrame of the event are also only externally visible after the related status bit becomes externally visible. If this parameter is enabled, the two status bits are not visible before the OBD driving cycle is qualified. If this parameter is disabled, the two status bits are visible without the need for a qualified driving cycle. If this parameter is missing, the Dem will handle the visibility of the two status bits according to the settings of Dem/DemConfigSet/DemEventParameter/DemEventClass/DemEventFailureCycleCounterThreshold: If DemEventFailureCycleCounterThreshold is 0, the value of DemOBDVisibilityDelayedUntilDcyQualification is assumed as disabled. If DemEventFailureCycleCounterThreshold is > 0, the value of DemOBDVisibilityDelayedUntilDcyQualification is assumed as enabled.
          choice reference DemAgingCycleRef [0..1]: scope=ECU, set at post-build in variant post-build-loadable+post-build-selectable / pre-compile in variant pre-compile, origin=AUTOSAR_ECUC V1.0.0, destination=DemOperationCycle  # AgingCycle Ref | Select the cycle which triggers aging/unlearning of this event. This can either be the same as the operation cycle of the event (see DemOperationCycleRef) or a different cycle. Note: DemAgingCycle container (Dem/DemGeneral/DemAgingCycle) references are currently not supported. Use a DemOperationCycle container (Dem/DemGeneral/DemOperationCycle) instead for the same effect.
          reference DemEnableConditionGroupRef [0..1]: scope=ECU, set at post-build in variant post-build-loadable+post-build-selectable / pre-compile in variant pre-compile, origin=AUTOSAR_ECUC V1.0.0, destination=DemEnableConditionGroup  # EnableCondition Group Ref | References an enable condition group. An event status report ((Pre)Failed or (Pre)Passed) will only have an effect if all EnableConditions belonging to the referenced group are met at the time of report. Otherwise the result will be discarded.
          reference DemEventFailureCycleRef [0..1]: scope=ECU, set at pre-compile, origin=AUTOSAR_ECUC V1.0.0, destination=DemOperationCycle  # Event FailureCycle Ref | Select the cycle which is used as base of counting failures of this event. This must be the same value as the operation cycle of the event (see DemOperationCycleRef). Therefore this parameter value here is always ignored and (internally) substituted by the DemOperationCycleRef value. You can safely delete this parameter - it has no impact on your configuration.
          reference DemOperationCycleRef: scope=ECU, set at post-build in variant post-build-loadable+post-build-selectable / pre-compile in variant pre-compile, origin=AUTOSAR_ECUC V1.0.0, destination=DemOperationCycle  # OperationCycle Ref | Select the operation/monitoring cycle for the event. This cycle is used: - to reset the NotTestedThisCycle and FailedThisCycle bits of the event status, - as the basis of event confirmation in case multiple trips are required (see DemEventFailureCycleCounterThreshold), - as the basis for healing of the WarningIndicatorRequests bit in case multiple passed cycles are required (e.g. to disable the MIL).
          reference DemStorageConditionGroupRef [0..1]: scope=ECU, set at post-build in variant post-build-loadable+post-build-selectable / pre-compile in variant pre-compile, origin=AUTOSAR_ECUC V1.0.0, destination=DemStorageConditionGroup  # StorageCondition Group Ref | References a storage condition group. An event status report will not result in an event entry to be created or updated unless all StorageConditions belonging to the referenced group are met at the time of report. This means PendingDTC or ConfirmedDTC will not be set, and Indicators will not be enabled. Already stored events can still stop to age and heal, and the remaining status bits are modified if needed.
          container DemIndicatorAttribute [0..255]  # This container maps the event to a list of indicators which can be enabled due to the event failing.
            enumeration DemIndicatorBehaviour: {DEM_INDICATOR_BLINKING, DEM_INDICATOR_BLINK_CONT, DEM_INDICATOR_CONTINUOUS, DEM_INDICATOR_FAST_FLASH, DEM_INDICATOR_SLOW_FLASH}, scope=ECU, set at post-build in variant post-build-loadable+post-build-selectable / pre-compile in variant pre-compile, default-value=DEM_INDICATOR_CONTINUOUS  # Select how the referenced indicator will react on this event (Blink, continuous light, application decides)
            integer DemIndicatorFailureCycleCounterThreshold [0..1]: 0..255, scope=ECU, set at pre-compile  # Indicator FailureCycle Counter Threshold | Number of continuous failed cycles until the indicator is enabled. This parameter is only valid if DemIndicatorFailureCycleSource is set to INDICATOR, so this parameter is effectively not supported. All DTCs, that are in the same MIL Group, must have the same threshold value (refer to parameter /Dem/DemGeneral/DemMILGroup).
            enumeration DemIndicatorFailureCycleSource: {DEM_FAILURE_CYCLE_EVENT, DEM_FAILURE_CYCLE_INDICATOR}, scope=ECU, set at pre-compile, default-value=DEM_FAILURE_CYCLE_EVENT  # Indicator FailureCycle Source | Select if the indicator is enabled as defined by the event status, or if the indicator requires a different set of event status bits to determine indicator state. This feature is required if an indicator is not enabled together with the event confirmation, but e.g. uses a different cycle or confirmation threshold. This parameter is currently not supported and is assumed to be set to 'DEM_FAILURE_CYCLE_EVENT'
            integer DemIndicatorHealingCycleCounterThreshold: 0..255, scope=ECU, set at post-build in variant post-build-loadable+post-build-selectable / pre-compile in variant pre-compile, default-value=3  # Indicator HealingCycle Counter Threshold | Defines the number of consecutive cycles in which the event has been tested passed, and not tested failed until this indicator heals. Currently it is only supported to set the same value for each indicator attached to this event.
            reference DemIndicatorFailureCycleRef [0..1]: scope=ECU, set at pre-compile, destination=DemOperationCycle  # Indicator FailureCycle Ref | Set the DemOperationCycle as base of the failure counting used to confirm the indicator. This parameter is only valid if DemIndicatorFailureCycleSource is set to INDICATOR.
            reference DemIndicatorHealingCycleRef: scope=ECU, set at pre-compile, destination=DemOperationCycle  # Indicator HealingCycle Ref | Set the DemOperationCycle as base of the healing counting used to heal the indicator. This parameter is not supported. Currently the value of DemEventClass/DemOperationCycleRef is used to heal indicators. Use that setting here too, to get a consistent configuration.
            reference DemIndicatorRef [0..1]: scope=ECU, set at post-build in variant post-build-loadable+post-build-selectable / pre-compile in variant pre-compile, destination=DemIndicator  # Reference to the used indicator.
        choice container DemDebounceAlgorithmClass  # DebounceAlgorithm Class | Select the debouncing algorithm used for the event.
          container DemDebounceCounterBased [0..1]  # Debounce CounterBased | Counter based debouncing will increment a counter with each Prefailed result, and decrement the counter with each Prepassed result. A qualified 'Passed' or 'Failed' result will be generated when a given threshold value is reached. This debouncing type is ideal for cyclic monitors that generate a monitoring result regularly since it involves little overhead. The debounce value is mapped to a faultdetection count (FDC) as such: If the Failed threshould is reached, FDC is 127. If the DebounceCounter is 0, FDC is 0. If the Passed threshold is reached, FDC is -128. Values between 0 and the threshold values are linearly mapped to 1..126 respectively -1..-127.
            reference DemDebounceCounterBasedClassRef: set at pre-compile, destination=DemDebounceCounterBasedClass  # This reference selects the DemDebounceCounterBasedClass applied for the debouncing of the DemEventParameter.
          container DemDebounceMonitorInternal [0..1]  # Debounce MonitorInternal | Monitor internal debouncing is used for monitors that implement the debouncing themselves, and only report qualified results (PASSED/FAILED) to the Dem. In order to implement the diagnostic services that report the fault detection counter, a callout function is required.
            container DemCallbackGetFDC [0..1]  # Callback GetFDC | This container sets up the callout function 'DemCallbackGetFDC' for this Event. The Dem will call this function each time the value of the fault detection counter is needed, e.g. requested by the Dcm. This function is usually called through a RTE port interface. This behavior can be changed by creating the sub-parameter 'DemCallbackGetFDCFnc'.
              function name DemCallbackGetFDCFnc [0..1]: scope=ECU, set at pre-compile  # Callback GetFaultDetectionCounter Function | Function name of a 'DemCallbackGetFDC' callout. If this parameter exists, it must give a valid C-Function which is called instead of using an RTE port interface. See DemGeneral/DemHeaderFileInclusion to specify a header file which declares this function.
          container DemDebounceTimeBased [0..1]  # Debounce Time Based | Time based debouncing will use a timer started in either passed or failed direction with an unqualified result. The timer is not restarted in case it is already running, unless a direction change is detected - e.g. after a PrePassed result the next PrePassed result will not restart the timer, a following PreFailed will stop the passed timer and start the failed timer. Timer supervision incurs a substantial runtime and RAM overhead compared to counter based denouncing and should be used sparingly. The debounce value is mapped to a faultdetection count as such: If the Failed time is reached, FDC is 127. If no timer is running (and no qualified result has been reached), FDC is 0. If the Passed time is reached, FDC is -128. If the timer is currently running in either direction, the timer is linearly mapped to 1..126 respectively -1..-127.
            reference DemDebounceTimeBasedClassRef: set at pre-compile, destination=DemDebounceTimeBasedClass  # This reference selects the DemDebounceTimeBasedClass applied for the debouncing of the DemEventParameter.
      container DemJ1939NodeAddress [0..255]  # Contains the parameters for the support of a logical J1939 node (identified by an ECU address).
        symbolic name reference DemJ1939NmNodeRef [1..255]: scope=ECU, set at pre-compile, destination=J1939NmNode  # Reference to the corresponding J1939Nm node.
      container DemPidClass [0..255]  # Only relevant for OBD II. These containers represent the different PIDs stored in the single global OBD relevant freeze frame. Each PID consists of one or several data elements.
        integer DemPidIdentifier: 0..255, scope=ECU, set at pre-compile  # PID Identifier | PID Identifier as requested in Mode $02
        integer DemSPNId [0..1]: 0..524287, set at pre-compile, origin=Vector Informatik  # Suspect parameter number. Must be configured if OBDII is supported and DemJ1939ExpandedFreezeFrameSupport is enabled.
        container DemPidDataElement [1..255]: requires-index=true  # PID DataElement | These containers are used to reference the different data elements contained in the specific PID.
          reference DemPidDataClassRef: scope=ECU, set at pre-compile, origin=Vector Informatik, destination=DemDataClass  # PID Data Class Ref | This reference contains the link to a data element class.
      container DemDTCAttributes [0..65535]  # This container contains the configuration (parameters) for DemDTCAttributes.
        choice reference DemMemoryDestinationRef: set at pre-compile, destination=[DemUserDefinedMemory, DemPrimaryMemory]  # The Memory destination defines the dedicated storage location of the DTC and its related data. OBD relevant DTCs must be located in primary memory. Mirror Memory is currently not supported, hence a DTC is not able to be located in more than one memory at the same time.
      container DemMultiEventTriggering [0..65535]  # Configures an event that will trigger other events whenever the event is reported.
        reference DemMultiEventTriggeringMasterEventRef: scope=ECU, set at pre-compile, destination=DemEventParameter  # Reference to the event that will trigger other events upon reception of this event.
        reference DemMultiEventTriggeringSlaveEventRef [1..255]: scope=ECU, set at pre-compile, destination=DemEventParameter  # Reference to the event that is triggered upon triggering the master event.
      container DemDebounceCounterBasedClass [0..65535]  # Debounce Counter Based Class | Inside this container the parameters for the debouncing of counter based debouncing are configured.
        integer DemDebounceCounterIncrementStepSize: 1..32767, scope=ECU, set at post-build in variant post-build-loadable+post-build-selectable / pre-compile in variant pre-compile, default-value=1  # DebounceCounter Increment Step Size | The debounce counter will be incremented by this amount with each PREFAILED monitor result.
        integer DemDebounceCounterDecrementStepSize: 1..32768, scope=ECU, set at post-build in variant post-build-loadable+post-build-selectable / pre-compile in variant pre-compile, default-value=1  # DebounceCounter Decrement Step Size | The debounce counter will be decremented by this amount with each PREPASSED monitor result. Note: The value is subtracted, so it must be positive.
        integer DemDebounceCounterFailedThreshold: 1..32767, scope=ECU, set at post-build in variant post-build-loadable+post-build-selectable / pre-compile in variant pre-compile, default-value=127  # DebounceCounter Failed Threshold | If a PREFAILED monitor result increments the debounce counter to(or above) this value, a qualified FAILED result is generated.
        integer DemDebounceCounterPassedThreshold: -32768..-1, scope=ECU, set at post-build in variant post-build-loadable+post-build-selectable / pre-compile in variant pre-compile, default-value=-128  # DebounceCounter Passed Threshold | If a PREPASSED monitor result decrements the debounce counter to (or below) this value, a qualified PASSED result is generated.
        boolean DemDebounceCounterJumpUp: scope=ECU, set at post-build in variant post-build-loadable+post-build-selectable / pre-compile in variant pre-compile, default-value=true  # DebounceCounter Jump Up | Select the jump up behavior. If enabled, the debounce counter is set to the value of DemDebounceCounterJumpUpValue before incrementing, unless the counter already is larger. This can be used to achieve constant times for a qualified FAILED result.
        boolean DemDebounceCounterJumpDown: scope=ECU, set at post-build in variant post-build-loadable+post-build-selectable / pre-compile in variant pre-compile, default-value=true  # DebounceCounter Jump Down | Select the jump down behavior. If enabled, the debounce counter is set to the value of DemDebounceCounterJumpDownValue before decrementing, unless the counter already is smaller. This can be used to achieve constant times for a qualified PASSED result.
        integer DemDebounceCounterJumpDownValue: -32768..32767, scope=ECU, set at post-build in variant post-build-loadable+post-build-selectable / pre-compile in variant pre-compile, default-value=0  # DebounceCounter Jump Down Value | This is the debounce counter value set if a 'JumpDown' is triggered. This parameter is used only if DemDebounceCounterJumpDown is enabled.
        enumeration DemDebounceBehavior: {DEM_DEBOUNCE_FREEZE, DEM_DEBOUNCE_RESET}, set at post-build in variant post-build-loadable+post-build-selectable / pre-compile in variant pre-compile, default-value=DEM_DEBOUNCE_FREEZE  # Debounce Behavior | This parameter defines how the event debounce algorithm will behave, if a related enable condition is not fulfilled or ControlDTCSetting of the related event is disabled. FREEZE: The FDC will continue at the current value when enable conditions / ControlDTCSetting allow event reports again. RESET: The FDC will revert to 0. See also (DemGeneral/DemResetDebounceBehavior)
        boolean DemDebounceCounterStorage: set at pre-compile, default-value=false  # Debounce Counter Storage | Switch to store the debounce counter value non-volatile or not. When activating this feature, the configuration needs an additional NV-RAM block with DemNvRamBlockIdType "DEM_NVBLOCK_DEBOUNCE".
        integer DemCounterBasedFdcThresholdStorageValue [0..1]: 1..32767, set at post-build in variant post-build-loadable+post-build-selectable / pre-compile in variant pre-compile, default-value=127  # Counter Based Fdc Threshold Storage Value | If a PREFAILED monitor result increments the debounce counter to (or above) this value, a FDC TRIP result is generated. This value has to be less or equal to DemDebounceCounterFailedThreshold. This parameter is only relevant if data is stored at a time where the DTC fault detection counter passes a threshold lower than the failed threshold, or if parameter Dem/DemGeneral/DemSupportExtendedFiM is available and enabled.
        integer DemDebounceCounterJumpUpValue: -32768..32767, scope=ECU, set at post-build in variant post-build-loadable+post-build-selectable / pre-compile in variant pre-compile, default-value=0  # DebounceCounter Jump Up Value | This is the debounce counter value which is set if a 'JumpUp' is triggered. Usually this is set to 0 as shown in ISO14229. This parameter is used only if DemDebounceCounterJumpUp is enabled.
        boolean DemDebounceContinuous: set at post-build in variant post-build-loadable+post-build-selectable / pre-compile in variant pre-compile, origin=Vector Informatik, default-value=false  # Debounce Continuous | This parameter defines whether the event debounce algorithm will continue counting while enable conditions are not fulfilled / ControlDTCSetting is disabled. To prevent the event from qualifying after the enable conditions become enabled / ControlDTCSetting is enabled again, it is recommended to set DemDebounceBehavior to DEM_DEBOUNCE_RESET if this option is used.
      container DemDebounceTimeBasedClass [0..65535]  # Debounce Counter Based Class | Inside this container the parameters for the debouncing of time based debouncing are configured.
        float DemDebounceTimeFailedThreshold: 0.001..3600, scope=ECU, set at post-build in variant post-build-loadable+post-build-selectable / pre-compile in variant pre-compile  # DebounceTime Failed Threshold | Time after a PreFailed report, after which a qualified FAILED result is generated. The AUTOSAR configuration standard is to use SI units, so in the EcuC file this parameter is stored as float value in seconds - the DaVinci Configurator 5 GUI will convert the value when using a diffenent unit.
        float DemDebounceTimePassedThreshold: 0.001..3600, scope=ECU, set at post-build in variant post-build-loadable+post-build-selectable / pre-compile in variant pre-compile  # DebounceTime Passed Threshold | Time after a PrePassed report, after which a qualified PASSED result is generated. The AUTOSAR configuration standard is to use SI units, so in the EcuC file this parameter is stored as float value in seconds - the DaVinci Configurator 5 GUI will convert the value when using a diffenent unit.
        enumeration DemDebounceBehavior: {DEM_DEBOUNCE_FREEZE, DEM_DEBOUNCE_RESET}, set at post-build in variant post-build-loadable+post-build-selectable / pre-compile in variant pre-compile, default-value=DEM_DEBOUNCE_FREEZE  # Debounce Behavior | This parameter defines how the event debounce algorithm will behave, if a related enable condition is not fulfilled or ControlDTCSetting of the related event is disabled. FREEZE: The debounce timer will pause while enable conditions are not active. To continue, report prepassed/prefailed after the enableconditions are fulfilled / ControlDTCSetting is enabled RESET: The FDC will revert to 0. See also (DemGeneral/DemResetDebounceBehavior)
        float DemTimeBasedFdcThresholdStorageValue [0..1]: 0.001..3600, set at post-build in variant post-build-loadable+post-build-selectable / pre-compile in variant pre-compile  # Time Based Fdc Threshold Storage Value | If a monitor fails for this time, a FDC TRIP result is generated. This value has to be less than or equal to DemDebounceTimeFailedThreshold. This parameter is only relevant if data is stored at a time where the DTC fault detection counter passes a threshold lower than the failed threshold, or if parameter Dem/DemGeneral/DemSupportExtendedFiM is available and enabled.
        boolean DemDebounceContinuous: set at pre-compile, origin=Vector Informatik, default-value=false  # Debounce Continuous | This parameter defines whether the event debounce algorithm will continue counting while enable conditions are not fulfilled / ControlDTCSetting is disabled. To prevent the event from qualifying after the enable conditions become enabled / ControlDTCSetting is enabled again, it is recommended to set DemDebounceBehavior to DEM_DEBOUNCE_RESET if this option is used. If DemDebounceBehavior is set to DEM_DEBOUNCE_FREEZE, an active debounce timer is paused, but the timer can be re-started while enable conditions are inactive.
