AUTOSAR XML (schema 00048)
# COPYRIGHT
# Copyright (c) 2022 by Vector Informatik GmbH. All rights reserved.
# This software is copyright protected and proprietary to Vector Informatik GmbH.
# Vector Informatik GmbH grants to you only those rights as set out in the license conditions.
package /MICROSAR
  bsw implementation Dem_Impl
    required-artifacts:
      dependency on artifact Dem_MemMap: category=MEMMAP, artifact-descriptor={short-label=Dem_MemMap.h, category=SWHDR}
