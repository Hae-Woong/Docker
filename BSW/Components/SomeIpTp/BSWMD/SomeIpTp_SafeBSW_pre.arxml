AUTOSAR XML (schema 4-3-0)
package /MICROSAR
  module config SomeIpTp_Rec: definition=SomeIpTp
    SomeIpTpGeneral: SomeIpTpSafeBswChecks=1
