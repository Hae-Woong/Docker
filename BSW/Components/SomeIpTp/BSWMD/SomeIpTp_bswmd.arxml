AUTOSAR XML (schema 4-3-0)
package /MICROSAR
  module definition SomeIpTp [0..1]: category=VENDOR_SPECIFIC_MODULE_DEFINITION, post-build-variant-support=true, refined-module-def=SomeIpTp, variants link-time/post-build/pre-compile  # SOME/IP Transport Protocol. SOME/IP TP module segments SOME/IP packets, which do not fit into one single UDP packet. On the reception side, it assembles the received SOME/IP segments. #TP #Ethernet #SOMEIP #AUTOSAR
    container SomeIpTpChannel [1..*]: multiplicity set at link in variant link-time / post-build in variant post-build / pre-compile in variant pre-compile, post-build-variant-multiplicity=true  # This container contains the configuration parameters of the SomeIpTp channel.
      float SomeIpTpNPduSeparationTime: 0..65.535, multiplicity set at pre-compile, post-build-variant-value=true, set at link in variant link-time / post-build in variant post-build / pre-compile in variant pre-compile, default-value=0.001  # Sets the duration of the minimum time in seconds the SomeIpTp module shall wait between the transmissions of N-PDUs.
      float SomeIpTpRxTimeoutTime: 0..65.535, multiplicity set at pre-compile, post-build-variant-value=true, set at link in variant link-time / post-build in variant post-build / pre-compile in variant pre-compile, default-value=0.5  # Timer to monitor the successful reception. It is started when the first NPdu is received, restarted after reception of intermediate NPdus, and is stopped when the last NPdu has been received.
      float SomeIpTpTxConfTimeoutTime: 0..65.535, multiplicity set at pre-compile, origin=Vector Informatik, post-build-variant-value=true, set at link in variant link-time / post-build in variant post-build / pre-compile in variant pre-compile, default-value=0.5  # Tx Confirmation Timeout Time | Timer to monitor the successful Transmission Confirmation. It is started when the NPdu is triggered and is stopped when the Confirmation has been received.
      container SomeIpTpRxNSdu [0..*]: multiplicity set at link in variant link-time / post-build in variant post-build / pre-compile in variant pre-compile, post-build-variant-multiplicity=true  # The following parameters needs to be configured for each N-SDU which has to be passed as one assembled RxPdu to the upper layer.
        reference SomeIpTpRxSduRef: multiplicity set at pre-compile, post-build-variant-value=true, set at link in variant link-time / post-build in variant post-build / pre-compile in variant pre-compile, destination=Pdu  # Reference to a Pdu in the COM-Stack that represents the assembled RxPdu which is passed via the PduR to the upper layer.
        container SomeIpTpRxNPdu: multiplicity set at pre-compile  # This container contains the configuration parameters of the NPdu that is received from a lower layer
          integer SomeIpTpRxNPduHandleId: 0..65535, multiplicity set at pre-compile, set at pre-compile, symbolic-name-value=true, default-value=0  # This parameter defines the handle ID that is used by the PduR when calling SomeIpTp_RxIndication.
          reference SomeIpTpRxNPduRef: multiplicity set at pre-compile, post-build-variant-value=true, set at link in variant link-time / post-build in variant post-build / pre-compile in variant pre-compile, destination=Pdu  # Reference to a global Pdu that is used to harmonize HandleIDs in the COM-Stack.
      container SomeIpTpTxNSdu [0..*]: multiplicity set at link in variant link-time / post-build in variant post-build / pre-compile in variant pre-compile, post-build-variant-multiplicity=true  # The following parameters needs to be configured for each N-SDU that the SomeIpTp module transmits via the SomeIpTpChannel.
        integer SomeIpTpTxNSduHandleId: 0..65535, multiplicity set at pre-compile, set at pre-compile, symbolic-name-value=true, default-value=0  # This parameter defines the handle ID of the NSdu that represents the original TxSdu which is segmented and passed via the PduR to the lower layer. This handle ID is used by PduR when calling SomeIpTp_Transmit.
        integer SomeIpTpTxBurstSize: 1..255, multiplicity set at pre-compile, origin=Vector Informatik, post-build-variant-value=true, set at link in variant link-time / post-build in variant post-build / pre-compile in variant pre-compile, default-value=1  # Number of SomeIpTp segments transmitted consecutively in the SomeIpTp mainfunction without waiting for separation time.
        reference SomeIpTpTxNSduRef: multiplicity set at pre-compile, post-build-variant-value=true, set at link in variant link-time / post-build in variant post-build / pre-compile in variant pre-compile, destination=Pdu  # Reference to a global Pdu in the COM-Stack that represents the original TxSdu which is segmented and passed via the PduR to the lower layer.
        container SomeIpTpTxNPdu: multiplicity set at pre-compile  # This container contains the configuration parameters of the segmented Tx NPdus that are transmitted to a lower layer.
          integer SomeIpTpTxNPduHandleId: 0..65535, multiplicity set at pre-compile, set at pre-compile, symbolic-name-value=true, default-value=0  # This parameter defines the handle ID that is used by PduR when calling SomeIpTp_TriggerTransmit.
          reference SomeIpTpTxNPduRef: multiplicity set at pre-compile, post-build-variant-value=true, set at link in variant link-time / post-build in variant post-build / pre-compile in variant pre-compile, destination=Pdu  # Reference to a global Pdu that is used to harmonize HandleIDs in the COM-Stack.
    container SomeIpTpGeneral: multiplicity set at pre-compile  # This container contains the general configuration parameters of the SomeIpTp module.
      boolean SomeIpTpDevErrorDetect: multiplicity set at pre-compile, set at pre-compile, default-value=true  # Switches the Development Error Detection and Notification ON or OFF.
      float SomeIpTpRxMainFunctionPeriod: 0..1.7976931348623157E+308, multiplicity set at pre-compile, set at pre-compile, default-value=0.001  # This parameter defines the cycle time in seconds of the periodic call of the SomeIpTp_MainFunctionRx.
      float SomeIpTpTxMainFunctionPeriod: 0..1.7976931348623157E+308, multiplicity set at pre-compile, set at pre-compile, default-value=0.001  # This parameter defines the cycle time in seconds of the periodic call of the SomeIpTp_MainFunctionTx.
      boolean SomeIpTpVersionInfoApi: multiplicity set at pre-compile, set at pre-compile, default-value=false  # Activates the SomeIpTp_GetVersionInfo() API. | TRUE: Enables the SomeIpTp_GetVersionInfo() API. FALSE: SomeIpTp_GetVersionInfo() API is not included.
      boolean SomeIpTpRuntimeErrorReport: multiplicity set at pre-compile, origin=Vector Informatik, set at pre-compile, default-value=true  # Switches the Runtime Error Notification ON or OFF.
      string SomeIpTpUserConfigFile [0..1]: multiplicity set at link in variant link-time / post-build in variant post-build / pre-compile in variant pre-compile, origin=Vector Informatik, post-build-variant-multiplicity=true, post-build-variant-value=true, set at pre-compile  # Reference to an external text file that will be included during generation to SomeIpTp_Cfg.h. The content of the user configuration file will be added at the end of the generated module configuration file and allows altering or extending the generated code. Caution: User configuration files can cause the software module to malfunction and must only be used with great care!
      boolean SomeIpTpSafeBswChecks: multiplicity set at pre-compile, origin=Vector Informatik, set at pre-compile, default-value=false  # Selects if safety checks are used. These checks improve robustness as e.g. invalid parameters are checked before function is executed. This attribute has to be enabled for safety projects where this component is mapped to an ASIL partition.
  bsw implementation SomeIpTp_Impl: programming-language=C, sw-version=5.00.00, used-code-generator=DaVinci Configurator, vendor-id=30, ar-release-version=4.03.01, behavior=SomeIpTpBehavior, preconfigured-configuration=SomeIpTp_Pre, recommended-configuration=SomeIpTp_Rec, vendor-specific-module-def=SomeIpTp
  module config SomeIpTp_Pre: definition=SomeIpTp
  module config SomeIpTp_Rec: definition=SomeIpTp
