AUTOSAR XML (schema 00044)
# COPYRIGHT
# Copyright (c) 2023 by Vector Informatik GmbH. All rights reserved.
# This software is copyright protected and proprietary to Vector Informatik GmbH.
# Vector Informatik GmbH grants to you only those rights as set out in the license conditions.
package /MICROSAR
  module definition FiM [0..1]: category=VENDOR_SPECIFIC_MODULE_DEFINITION, refined-module-def=FiM, variants post-build/pre-compile  # Function Inhibition Manager (FiM) Allows querying the permission / inhibition status of software components and the functionality therein. An application functionality can be identified along with its inhibition conditions. #Diag #Diagnostics #OBD #WWHOBD #AUTOSAR #ServiceComponent
    container FiMConfigSet: multiplicity set at pre-compile  # This container contains the configuration parameters and sub containers of the FiM module supporting multiple configuration sets.
      container FiMFID [1..*]: multiplicity set at pre-compile  # This container includes symbolic names of all FIDs.
        integer FiMFunctionId: 0..65535, scope=ECU, multiplicity set at pre-compile, set at pre-compile, symbolic-name-value=true, default-value=0  # Unique identifier of a FimFunctionId. This parameter should not be changeable by user, because the Id should be generated by Fim itself to prevent gaps and multiple use of an Id. | Note: The implementer can add the attribute 'withAuto' to the parameter definition which indicates that the value can be calculated by the generator automatically. When 'withAuto' is set to 'true' for this parameter definition the 'isAutoValue' can be set to 'true'. If 'isAutoValue' is set to 'true' the actual value will not be considered during ECU Configuration but will be (re-)calculated by the code generator and stored in the value attribute afterwards.
        reference FiMSatelliteRef [0..1]: multiplicity set at pre-compile, origin=Vector Informatik, set at pre-compile, destination=FiMSatellite  # Reference to the satellite (partition) this FiD is assigned to.
        foreign reference FiMFIDSystemTemplateDiagnosticFunctionIdentifierRef [0..1]: multiplicity set at pre-compile, origin=Vector Informatik, set at pre-compile, destination-type=DIAGNOSTIC-FUNCTION-IDENTIFIER  # Reference to the DiagnosticFunctionIdentifier (DiagnosticExtract) which is represented by this FID.
      container FiMInhibitionConfiguration [1..*]: multiplicity set at post-build in variant post-build / pre-compile in variant pre-compile, post-build-variant-multiplicity=true  # This container includes all configuration parameters concerning the relationship between event and FID.
        enumeration FiMInhInhibitionMask: {FIM_LAST_FAILED, FIM_NOT_TESTED, FIM_TESTED, FIM_TESTED_AND_FAILED, FIM_PENDING}, multiplicity set at pre-compile, post-build-variant-value=true, set at post-build in variant post-build / pre-compile in variant pre-compile, default-value=FIM_TESTED  # This parameter defines the inhibition mask for a DEM event - FID relation.
        reference FiMInhComponentRef [0..*]: multiplicity set at pre-compile, post-build-variant-multiplicity=true, post-build-variant-value=true, set at pre-compile, destination=DemComponent  # NOT USED Reference to a DemComponent which is necessary for function permission.
        symbolic name reference FiMInhEventRef [0..*]: multiplicity set at post-build in variant post-build / pre-compile in variant pre-compile, post-build-variant-multiplicity=true, post-build-variant-value=true, set at post-build in variant post-build / pre-compile in variant pre-compile, destination=DemEventParameter  # Reference to a DemEventParameter within the DEM configuration.
        reference FiMInhFunctionIdRef: multiplicity set at pre-compile, post-build-variant-value=true, set at post-build in variant post-build / pre-compile in variant pre-compile, destination=FiMFID  # Reference to a FiMFID container.
        reference FiMInhSumRef [0..*]: multiplicity set at pre-compile, post-build-variant-multiplicity=true, post-build-variant-value=true, set at pre-compile, destination=FiMSummaryEvent  # NOT USED Selection of a summarized Event.
      container FiMSummaryEvent [0..*]: multiplicity set at pre-compile  # NOT USED The summarized EventId definition record consists of a summarized event ID and specific Dem Events. | This record means that a particular FID that has to be disabled in case of summarized event (defined above) is to be disabled in any of the specific events. A possible solution could be assigning events as summarized events along with a list of specific events. During the configuration process the summarized event substitutes the referenced single events. However, it is not outlined how this requirement is solved - whether by configuration process or by implementation within the FiM. The FiM configuration tool could also build up a suitable data structure for summarized events and deal with it in the FiM implementation.
        symbolic name reference FiMInputEventRef [1..*]: multiplicity set at pre-compile, post-build-variant-multiplicity=true, post-build-variant-value=true, set at pre-compile, destination=DemEventParameter  # NOT USED Reference to DemEventParameters combined to this summarized event.
      container FiMSatellite [1..255]: multiplicity set at pre-compile  # List of FiM satellites (partitions).
        integer FiMMaxNrInhStates: 1..65535, multiplicity set at pre-compile, origin=Vector Informatik, set at pre-compile, default-value=1  # Maximum number of inhibition states which can be stored on this satellite. Estimation of number (upper limit): Number of inhibition configurations that differ in event id and inhibition code and where event id is located on satellite.
        reference FiMOsApplicationRef [0..1]: multiplicity set at pre-compile, origin=Vector Informatik, set at pre-compile, destination=OsApplication  # Reference to the (satellite) partition this satellite is assigned to. If this parameter is missing the Os application of the FiMMaster is used (FiMMasterOsApplicationRef). The FiM directly supports multi partition architectures, i.e. ECUs using multiple cores or memory protection for safety reasons. See the TechnicalReference for details.
    container FiMGeneral: multiplicity set at pre-compile  # General configuration parameters of the FIM.
      boolean FiMAvailabilitySupport: multiplicity set at pre-compile, set at pre-compile, default-value=false  # This configuration parameter specifies, if the Fim shall support the service to set the Availabity of a Funtionality. Note: This parameter enabled is not supported! | true: Service is supported. false: Service is not supported
      boolean FiMDevErrorDetect: multiplicity set at pre-compile, set at pre-compile, default-value=true  # This parameter switches the Development Error Detection and Notification ON or OFF. true: Development error detection is enabled. false: Development error detection is disabled. Note: In general, the development error detection is recommended during pre-test phase. It is not recommended to enable the development error detection in production code due to increased runtime and ROM needs. | * true: detection and notification is enabled. * false: detection and notification is disabled.
      boolean FiMEventUpdateTriggeredByDem: multiplicity set at pre-compile, set at pre-compile, default-value=true  # This parameter defines the way the FIM obtains status of DEM events. If the parameter is enabled the DEM has to inform the FIM on changed events. If the parameter is disabled the FIM polls the event changes from the DEM. Note: This parameter disabled is not supported! | TRUE: the DEM informs FIM about changes of monitor status, FALSE: the FIM polls monitor status from the DEM module either cyclically or on demand.
      float FiMMainFunctionPeriod: 0..0.1, multiplicity set at pre-compile, set at pre-compile, default-value=0.01  # TaskTime | This value specifies the time for the periodic cyclic task of the FiM_MainFunction. | Please note: This configuration value shall be equal to the value in the Basic Software Scheduler configuration of the RTE module. The AUTOSAR configuration standard is to use SI units, so this parameter is defined as float value in seconds. FiM configuration tools shall convert this float value to the appropriate value format for the use in the software implementation of FiM.
      integer FiMMaxEventsPerFidInhibitionConfiguration [0..1]: 1..65535, multiplicity set at pre-compile, set at pre-compile, default-value=1  # NOT USED This configuration parameter specifies the total maximum number of inhibiting events in a FiMInhibitionConfiguration. | Its applicable for post build configuration versions only and may be used to allocate the maximum size of memory to store and execute the configuration.
      integer FiMMaxFiMInhibitionConfigurations [0..1]: 1..65535, multiplicity set at pre-compile, set at pre-compile, default-value=1  # Max FiM Inhibition Configurations | NOT USED This configuration parameter specifies the total maximum number of FiMInhibitionConfigurations. | Its applicable for post build configuration versions only and may be used to allocate the maximum size of memory to store and execute the configuration.
      integer FiMMaxInputEventsPerSummaryEvents [0..1]: 1..65535, multiplicity set at pre-compile, set at pre-compile, default-value=1  # NOT USED This configuration parameter specifies the total maximum number of input events per summary event. | Its applicable for post build configuration versions only and may be used to allocate the maximum size of memory to store and execute the configuration.
      integer FiMMaxSumEventsPerFidInhibitionConfiguration [0..1]: 1..65535, multiplicity set at pre-compile, set at pre-compile, default-value=1  # NOT USED This configuration parameter specifies the total maximum number of inhibiting summary events in a FiMInhibitionConfiguration. | Its applicable for post build configuration versions only and may be used to allocate the maximum size of memory to store and execute the configuration.
      integer FiMMaxSummaryEvents: 0..65535, multiplicity set at pre-compile, set at pre-compile, default-value=0  # NOT USED This configuration parameter specifies the maximum number of summarized events that can be configured.
      boolean FiMVersionInfoApi: multiplicity set at pre-compile, set at pre-compile, default-value=false  # This parameter enables/disables the function FiM_GetVersionInfo() to get major, minor and patch version information.
      string FiMUserConfigFile [0..1]: multiplicity set at pre-compile, origin=Vector Informatik, set at pre-compile  # Reference to an external user configuration file that will be included during generation. The content of the user configuration file will be added at the end of the generated module configuration file and allows altering or extending the generated code. Caution: User configuration files can cause the software module to malfunction and must only be used with great care!
      boolean FiMOBDSupport [0..1]: multiplicity set at pre-compile, origin=Vector Informatik, set at pre-compile, default-value=false  # This parameter defines if OBD support for FIM module is enabled. OBD support can only be enabled, if OBD support is licensed.
      boolean FiMUseRte: multiplicity set at pre-compile, origin=Vector Informatik, set at pre-compile, default-value=true  # Globally disable the usage of RTE callbacks. All port interfaces are suppressed, and all callouts must be replaced by direct function calls.
      boolean FiMOptimizationForInhibitionMasks [0..1]: multiplicity set at post-build in variant post-build / pre-compile in variant pre-compile, origin=Vector Informatik, post-build-variant-multiplicity=true, post-build-variant-value=true, set at post-build in variant post-build / pre-compile in variant pre-compile, default-value=false  # If enabled, the code generator will try to optimize usage of inhibition masks. For example different inhibition configurations with identical event id and function id are combined to a single inhibition configuration (e.g., FIM_NOT_TESTED/FIM_LAST_FAILED to FIM_NOT_TESTED_OR_FAILED).
      boolean FiMSafeBswChecks: multiplicity set at pre-compile, origin=Vector Informatik, set at pre-compile, default-value=false  # Selects if safety checks are used. These checks improve robustness as e.g. invalid parameters are checked before function is executed. This attribute has to be enabled for safety projects where this component is mapped to an ASIL partition.
      boolean FiMUserDefinedCompareAndSwap [0..1]: multiplicity set at pre-compile, origin=Vector Informatik, set at pre-compile, default-value=false  # Implement and use a hardware optimized ApplFiM_SyncCompareAndSwap() function. The API ApplFiM_SyncCompareAndSwap(uint32* AddressPtr, uint32 OldValue, uint32 NewValue) performs an atomic compare and swap of memory contents. If disabled, the FiM uses an internal implementation, that needs the critical section 'FIM_EXCLUSIVE_AREA_0'. If enabled, the FiM uses an external implementation that has to be provided.
      boolean FiMCyclicFidCalculation [0..1]: multiplicity set at pre-compile, origin=Vector Informatik, set at pre-compile, default-value=false  # Calculation of FID permission status from event's inhibition status is done on FiM main task if selected. Otherwise it is done during the call of FiM_GetFunctionPermission.
      integer FiMMaxHandledFidsPerCycle [0..1]: 1..65535, multiplicity set at post-build in variant post-build / pre-compile in variant pre-compile, origin=Vector Informatik, post-build-variant-value=true, set at post-build in variant post-build / pre-compile in variant pre-compile, default-value=1  # Maximum number of FIDs that are calculated during one call of FiM_MainFunction when cyclic FID calculation is selected.
      string FiMHeaderFileInclusion [0..*]: multiplicity set at pre-compile, origin=Vector Informatik, set at pre-compile  # Name of the header file(s) to be included by the FiM module containing the used C-callback declarations.
      integer FiMMaxEventFidLinks: 1..65535, multiplicity set at pre-compile, origin=Vector Informatik, set at pre-compile, default-value=1  # This value specifies the total maximum number of links between DEM events and FID/InhibitionConfiguration combinations.
      integer FiMMaxEventsPerFid: 1..65535, multiplicity set at pre-compile, origin=Vector Informatik, set at pre-compile, default-value=1  # This value specifies the maximum number of DEM events/InhibitionConfiguration combinations that can be linked to a single FID.
      integer FiMMaxFidsPerEvent: 1..65535, multiplicity set at pre-compile, origin=Vector Informatik, set at pre-compile, default-value=1  # This value specifies the maximum number of FID/InhibitionConfiguration combinations that can be linked to a single DEM event.
      boolean FiMAffectedFIDsIdentification [0..1]: multiplicity set at pre-compile, origin=Vector Informatik, set at pre-compile, default-value=false  # Cyclic Fid Calculation - Affected FIDs Identification | If enabled, FiM re-calculates only those FIDs during cyclic calculation that might be affected by a changed event status. Upon call of FiM_DemTriggerOnMonitorStatus, FiM tags those FIDs as affected that are connected to the passed event (independent of inhibition configuration or actual status change). During cyclic calculation FiM only re-calculates FIDs that were tagged since the last calculation of that FID. Note: Memory consumption may increase significantly when enabling this option.
      reference FiMMasterOsApplicationRef [0..1]: multiplicity set at pre-compile, origin=Vector Informatik, set at pre-compile, destination=OsApplication  # This partition is used as FiM Master partition. If this configuration value is missing, a pseudo partition "0" is substituted. This value acts as default for FIDs which are not directly mapped to a FiMSatellite via FiMSatelliteRef.
  bsw implementation FiM_Impl: programming-language=C, sw-version=10.00.00, used-code-generator=DaVinci Configurator, vendor-id=30, ar-release-version=4.03.00, behavior=FiMBehavior, preconfigured-configuration=FiM_Pre, recommended-configuration=FiM_Rec, vendor-specific-module-def=FiM
  module config FiM_Pre: definition=FiM
  module config FiM_Rec: definition=FiM
