AUTOSAR XML (schema 4-0-3)
package /MICROSAR
  module definition Rte [0..1]: category=VENDOR_SPECIFIC_MODULE_DEFINITION, refined-module-def=Rte, variants pre-compile/post-build-selectable  # Runtime Environment (RTE). Scalable and highly optimized. Manages communication between the software components (SWC), assures consistency of the overall information flow and represents the interface between the functional software, basic software (BSW) and complex drivers (CDD). Includes the SchM (Schedule Manager) functionality. #SWC #Scheduling #TaskMapping #RuntimeEnvironment #AUTOSAR
    container RteBswGeneral  # General configuration parameters of the Bsw Scheduler section.
      boolean RteSchMVersionInfoApi: set at pre-compile, default-value=false  # SchM Version Info Api | Enables the generation of the SchM_GetVersionInfo() API.
      boolean RteUseComShadowSignalApi [0..1]: set at pre-compile, default-value=false  # This parameter defines whether the ComShadowSignalAPIs ((Com_UpdateShadowSignal, Com_InvalidateShadowSignal, Com_ReceiveShadowSignal) are used or not. | If this parameter is set to true the ShadowSignal APIs and Signal APIs (Com_SendSignal, Com_InvalidateSignal, Com_ReceiveSignal) are used. If this parameter is set to false only the Signal APIs (Com_SendSignal, Com_InvalidateSignal, Com_ReceiveSignal) are used.
    container RteBswModuleInstance [0..*]  # Represents one instance of a Bsw-Module configured on one ECU.
      foreign reference RteBswImplementationRef: set at pre-compile, destination-type=BSW-IMPLEMENTATION  # Reference to the BswImplementation for which the Rte /SchM is configured.
      foreign reference RteBswModuleConfigurationRef [0..1]: set at pre-compile, destination-type=MODULE-CONFIGURATION  # Reference to the ECU Configuration Values provided for this BswImplementation.
      container RteBswEventToTaskMapping [0..*]  # Maps a BswSchedulableEntity onto one OsTask based on the activating BswEvent.
        float RteBswActivationOffset [0..1]: 0.., set at pre-compile  # Activation offset.
        boolean RteBswImmediateRestart: set at pre-compile, default-value=false  # When RteBswImmediateRestart is set to true the BswSchedulableEntitiy shall be immediately re-started after termination if it was activated by this BswEvent while it was already started. | This parameter shall not be set to true when the mapped BswEvent refers to a BswSchedulableEntitiy which minimumStartInterval attribute is > 0.
        integer RteBswPositionInTask [0..1]: 0..65535, set at pre-compile  # Each BswSchedulableEntity activation mapped to an OsTask has a specific position within the task execution. | For periodic activation this is the order of execution. For event driver activation this is the order of evaluation which actual BswSchedulableEntity has to be executed.
        enumeration RteOsSchedulePoint [0..1]: {CONDITIONAL, NONE, UNCONDITIONAL}, set at pre-compile, default-value=NONE  # Introduce a schedule point by explicitly calling Os Schedule service after the execution of the ExecutableEntity. The Rte generator is allowed to optimize several consecutive calls to Os schedule into one single call if the ExecutableEntity executions in between have been skipped. | The absence of this parameter is interpreted as "NONE". It shall be considered an invalid configuration if the task is preemptable and the value of this parameter is not set to "NONE" or the parameter is absent.
        enumeration RteCyclicTriggerImplementation [0..1]: {Auto, None}, configuration-class-affection=affection-kind=NO-AFFECT, set at pre-compile, origin=Vector Informatik, default-value=Auto  # If set to 'Auto' the RTE generator automatically creates the necessary OS alarm to realize the cyclic trigger with the configured activation offset. If set to 'None' the trigger is not implemented by the RTE generator. It has to be implemented by the user either by configuring an appropriate OS alarm or an OS schedule table. The OS task and optional the OS event for that trigger can be found in the generated RTE report.
        foreign reference RteBswEventRef: set at pre-compile, destination-type=BSW-EVENT  # Reference to the BswEvent which is pointing to the BswSchedulableEntity being mapped. This allows a fine grained mapping of BswSchedulableEntites based on the activating BswEvent.
        reference RteBswMappedToTaskRef [0..1]: set at pre-compile, destination=OsTask  # Reference to the OsTask the BswSchedulableEntity activated by the RteBswEventRef is mapped to. | If no reference to the OsTask is specified the BswSchedulableEntity activated by this BswEvent is executed in the context of the caller.
        reference RteBswUsedOsAlarmRef [0..1]: set at pre-compile, destination=OsAlarm  # If an OsAlarm is used to activate the OsTask this BswEvent is mapped to it shall be referenced here.
        reference RteBswUsedOsEventRef [0..1]: set at pre-compile, destination=OsEvent  # If an OsEvent is used to activate the OsTask this BswEvent is mapped to it shall be referenced here.
        reference RteBswUsedOsSchTblExpiryPointRef [0..1]: set at pre-compile, destination=OsScheduleTableExpiryPoint  # If an OsScheduleTableExpiryPoint is used to activate the OsTask this BswEvent is mapped to it shall be referenced here.
        foreign reference RteRipsFillRoutineRef [0..*]: set at pre-compile, origin=Vector Informatik, destination-type=CONTAINER  # Reference to a Buffer-Fill Routine implemented by an RTE Implementation Plug-In.
        foreign reference RteRipsFlushRoutineRef [0..*]: set at pre-compile, origin=Vector Informatik, destination-type=CONTAINER  # Reference to a Buffer-Flush Routine implemented by an RTE Implementation Plug-In.
      container RteBswExclusiveAreaImpl [0..*]  # Represents one ExclusiveArea of one BswImplementation. Used to specify the implementation means of this ExclusiveArea.
        enumeration RteExclusiveAreaImplMechanism: {ALL_INTERRUPT_BLOCKING, COOPERATIVE_RUNNABLE_PLACEMENT, OS_INTERRUPT_BLOCKING, OS_RESOURCE, OS_SPINLOCK, NONE, CUSTOM}, set at pre-compile, default-value=ALL_INTERRUPT_BLOCKING  # To be used implementation mechanism for the specified ExclusiveArea.
        boolean RteExclusiveAreaOptimization [0..1]: set at pre-compile, origin=Vector Informatik, default-value=false  # This parameter is not yet supported by the RTE generator. Changing the value has no impact on the generated code.
        boolean RteExclusiveAreaGenerateFunction [0..1]: set at pre-compile, origin=Vector Informatik, default-value=false  # If set to false/undefined, the BSW Module ImplementationCodeType is used to determine the implementation if possible. If the BSW Module ImplementationCodeType is set to EcuCSourceCode, the following limitations apply: the RTE generator generates a function if the BSW Module is Postbuild loadable, or if the implementation mechanism is set to custom. Otherwise, a macro is generated. This parameter forces the RTE generator to generate a function for the ExclusiveArea interface implementation (disabling the RTE generator macro optimization).
        foreign reference RteBswExclusiveAreaRef: set at pre-compile, destination-type=EXCLUSIVE-AREA  # Reference to the ExclusiveArea for which the implementation mechanism shall be specified.
        reference RteBswExclusiveAreaOsResourceRef [0..1]: set at pre-compile, destination=OsResource  # Optional reference to an OsResource in case RteExclusiveAreaImplMechanism is configured to OS_RESOURCE for this ExclusiveArea.
        reference RteBswExclusiveAreaOsSpinlockRef [0..1]: set at pre-compile, destination=OsSpinlock  # Optional reference to an OsSpinlock in case RteExclusiveAreaImplMechanism is configured to OS_SPINLOCK for this ExclusiveArea.
      container RteBswExternalTriggerConfig [0..*]  # Defines the configuration of Inter Basic Software Module Entity Triggering
        integer RteBswTriggerSourceQueueLength: 0..4294967295, set at pre-compile, default-value=0  # Length of trigger queue on the trigger source side. | The queue is implemented by the RTE. A value greater or equal to 1 requests an queued behavior. Setting the value of RteTriggerSourceQueueLength to 0 requests an none queued implementation of the trigger communication. If there is no RteBswTriggerSourceQueueLength configured for a Trigger Emitter the default value of 0 applies as well.
        foreign reference RteBswTriggerSourceRef: set at pre-compile, destination-type=TRIGGER  # Reference to a Trigger instance in the role releasedTrigger of the related BSW Module instance. | The referenced Trigger has to belong to the same BSW Module instance as the RteBswModuleInstance owning this parameter configures.
      container RteBswInternalTriggerConfig [0..*]  # Defines the configuration of internal Basic Software Module Entity Triggering
        integer RteBswTriggerSourceQueueLength: 0..4294967295, set at pre-compile, default-value=0  # Length of trigger queue on the trigger source side. | The queue is implemented by the RTE. A value greater or equal to 1 requests an queued behavior. Setting the value of RteTriggerSourceQueueLength to 0 requests an none queued implementation of the trigger communication. If there is no RteBswTriggerSourceQueueLength configured for a Trigger Emitter the default value of 0 applies as well.
        foreign reference RteBswTriggerSourceRef: set at pre-compile, destination-type=BSW-INTERNAL-TRIGGERING-POINT  # Reference to a BswInternalTriggeringPoint of the related BSW Module instance. | The referenced BswInternalTriggeringPoint has to belong to the same BSW Module instance as the RteBswModuleInstance owning this parameter configures.
      container RteBswRequiredModeGroupConnection [0..*]  # Defines the connection between one requiredModeGroup of this BSW Module instance and one providedModeGroup instance.
        foreign reference RteBswProvidedModeGroupRef: set at pre-compile, destination-type=MODE-DECLARATION-GROUP-PROTOTYPE  # References the providedModeGroupPrototype to which this requiredModeGroup shall be connected.
        foreign reference RteBswRequiredModeGroupRef: set at pre-compile, destination-type=MODE-DECLARATION-GROUP-PROTOTYPE  # References requiredModeGroupPrototype which shall be connected to the providedModeGroupPrototype.
        reference RteBswProvidedModeGrpModInstRef: set at pre-compile, destination=RteBswModuleInstance  # Reference to the RteBswModuleInstance configuration container which identifies the instance of the BSW Module. | Used with the RteBswProvidedModeGroupRef to unambiguously identify the ModeDeclarationGroupPrototype instance.
      container RteBswRequiredTriggerConnection [0..*]  # Defines the connection between one requiredTrigger of this BSW Module instance and one releasedTrigger instance.
        foreign reference RteBswReleasedTriggerRef: set at pre-compile, destination-type=TRIGGER  # References the releasedTrigger to which this requiredTrigger shall be connected.
        foreign reference RteBswRequiredTriggerRef: set at pre-compile, destination-type=TRIGGER  # References one requiredTrigger which shall be connected to the releasedTrigger.
        reference RteBswReleasedTriggerModInstRef: set at pre-compile, destination=RteBswModuleInstance  # Reference to the RteBswModuleInstance configuration container which identifies the instance of the BSW Module. | Used with the RteBswReleasedTriggerRef to unambiguously identify the Trigger instance.
    container RteExclusiveAccessOptimization [0..*]  # Configuration of the optimized access behavior to be generated. In other words, access shall be mutually exclusive. How this is realized e.g. non preemptive task mapping, exclusive areas, mode management, exclusive access during ECU startup and shutdown or scheduling in exclusive time slots is up to the ECU integrator.
      foreign reference RteAccessingEntityRef [0..*]: set at pre-compile, origin=Vector Informatik, destination-type=EXECUTABLE-ENTITY  # Reference to executable entities (e.g. NvM main function) that access the CommunicationGraph with non-modeled standardized interfaces.
      instance reference RteSoftwareComponentReadRef [0..1]: set at pre-compile, origin=Vector Informatik, destination-context=ROOT-SW-COMPOSITION-PROTOTYPE SW-COMPONENT-PROTOTYPE, destination-type=VARIABLE-ACCESS  # Reference to the read variableAccess role.
      instance reference RteSoftwareComponentWriteRef [0..1]: set at pre-compile, origin=Vector Informatik, destination-context=ROOT-SW-COMPOSITION-PROTOTYPE SW-COMPONENT-PROTOTYPE, destination-type=VARIABLE-ACCESS  # Reference to the VariableAccess in the dataSendPoint role of the writing software-component.
    container RteGeneration  # This container holds the parameters for the configuration of the RTE Generation.
      enumeration RteCalibrationSupport: {DOUBLE_POINTERED, INITIALIZED_RAM, NONE, SINGLE_POINTERED}, set at pre-compile, default-value=NONE  # The RTE generator shall have the option to switch off support for calibration for generated RTE code. This option shall influence complete RTE code at once.
      integer RteCodeVendorId: 0..65535, set at pre-compile, default-value=30  # Holds the vendor ID of the generated Rte code.
      boolean RteDevErrorDetect: set at pre-compile, default-value=false  # The Rte shall log development errors to the Det module.
      boolean RteDevErrorDetectUninit: set at pre-compile, default-value=false  # The Rte shall detect if it is started when its APIs are called, and the BSW Scheduler shall check if it is initialized when its APIs are called.
      enumeration RteGenerationMode: {COMPATIBILITY_MODE, VENDOR_MODE}, set at pre-compile, default-value=COMPATIBILITY_MODE  # Switch between the two available generation modes of the RTE generator.
      enumeration RteIocInteractionReturnValue: {RTE_COM, RTE_IOC}, set at pre-compile, default-value=RTE_IOC  # Defines whether the return value of RTE APIs is based on RTE-IOC interaction or RTE-COM interaction.
      boolean RteMeasurementSupport: set at pre-compile, default-value=false  # The RTE generator shall have the option to switch off support for measurement for generated RTE code. This option shall influence complete RTE code at once.
      enumeration RteOptimizationMode: {MEMORY, RUNTIME}, set at pre-compile, default-value=RUNTIME  # Switch between the two available optimization modes of the RTE generator.
      integer RteToolChainSignificantCharacters [0..1]: 0..65535, set at pre-compile, default-value=31  # If present, the RTE generator shall provide the list of C RTE identifiers whose name is not unique when only the first RteToolChainSignificantCharacters characters are considered.
      boolean RteValueRangeCheckEnabled: set at pre-compile, default-value=false  # If set to true the RTE generator shall enable the value range checking for the specified VariableDataPrototypes.
      linker symbol RteVfbTraceClientPrefix [0..*]: set at pre-compile  # Defines an additional prefix for all VFB trace functions to be generated. With this approach it is possible to have debugging and DLT trace functions at the same time.
      boolean RteVfbTraceEnabled: set at pre-compile, default-value=false  # The RTE generator shall globally enable VFB tracing when RteVfbTrace is set to "true".
      function name RteVfbTraceFunction [0..*]: set at pre-compile  # The RTE generator shall enable VFB tracing for a given hook function when there is a #define in the RTE configuration header file for the hook function name and tracing is globally enabled. | Example: #define Rte_WriteHook_i1_p1_a_Start This also applies to VFB trace functions with a RteVfbTraceClientPrefix, e.g. Rte_Dbg_WriteHook_I1_P1_a_Start.
      enumeration RteA2LVersion [0..1]: {V151, V160, V171}, configuration-class-affection=affection-kind=NO-AFFECT, set at pre-compile, origin=Vector Informatik, default-value=V160  # A2L Version | When measurement is enabled, the RTE generator generates an A2L file that contains the measurement and characteristic objects of the generated RTE. This parameter specifies the ASAM MCD-2MC standard to which the A2L file is compliant. Version 1.6.0 supports additional features like linker map references for the measurement objects.
      boolean RteXcpEventSupport [0..1]: configuration-class-affection=affection-kind=NO-AFFECT, set at pre-compile, origin=Vector Informatik, default-value=false  # If set to true, the RTE generator uses the Xcp driver to send Xcp Events when the runnables of a task were processed. These events can be used to trigger the measurement of variables in a measurement and calibration tool. This also allows the measurement of sender / receiver ports when implicit inter-ECU communication is used.
      integer RteCalibrationBufferSize [0..1]: 0..4294967295, set at pre-compile, origin=Vector Informatik, default-value=0  # This parameter specifies the size of the RAM buffer for the calibration, if single-pointered or double-pointered online calibration is used. If set to 0, the RTE generator won't generate a RAM buffer.
      boolean RteEnforceIoc [0..1]: set at pre-compile, origin=Vector Informatik, default-value=false  # Enforce the usage of IOCs for cross-partition communication. If this parameter is set to false, the RTE assumes that all partitions have read access to all RTE variables. Buffers are allocated to the writing partition and IOCs are only used for N:1 communication. Buffers that are used for cross-core communication need to be mapped to synchronized RAM so that spinlocks only need to be used for variables that cannot be accessed atomically. If this parameter is set to true, the RTE relies on OS IOC objects for cross-partition communication. As the OS does not know which runnables access the individual IOCs, this tends to be less efficient when it comes to interrupt/spinlock locking times, runtime, ram and rom consumption. The parameter is ignored for: - mode communication - inter-ECU client-server communication - nv data communication - sender-receiver communication when transformers and scaling are configured
      string RteVttVfbTraceFunction [0..*]: set at pre-compile, origin=Vector Informatik  # The RTE generator shall enable VTT tracing for the given hook function.
      boolean RteInitializeImplicitBuffers [0..1]: set at pre-compile, origin=Vector Informatik, default-value=false  # This parameter ensures that no undefined values are written back at runnable termination. If this parameter is set to true, the RTE will send the last written value. If no RTE API for implicit write is called before, the initValue will be sent. [SWS_Rte_08418]
      enumeration RteComTimeoutSource [0..1]: {SWC, SIGNAL}, set at pre-compile, origin=Vector Informatik, default-value=SWC  # This parameter specifies the source for deriving the ComTimeout parameter of a ComSignal / ComSignalGroup. SWC: The timeout value is derived from the ReceiverComSpec (AliveTimeout) of the SWC port description. SIGNAL: The timeout value is derived from the ISignalPort of the communication description. This still requires a timeout value (AliveTimoeut) at the ReceiverComSpec != 0 to generally enable the timeout handling.
      boolean RteEnforceQueuedIoc [0..1]: set at pre-compile, origin=Vector Informatik, default-value=false  # Enforce the usage of IOCs for queued cross-partition communication. Unlike the RteEnforceIoc parameter, this parameter only affects queued communication. If this parameter is set to true, the RTE relies on OS IOC objects for queued cross-partition communication. If the OS provides spinlock free IOCs, this parameter can be set to true to avoid the spinlock generation in the RTE for queued sender-receiver communication. The parameter is ignored for: - mode communication - inter-ECU client-server communication - sender-receiver communication when transformers and scaling are configured
      boolean RteUseAbsAlarmInitialization [0..1]: set at pre-compile, origin=Vector Informatik, default-value=false  # Use AbsAlarm Initialization | The RTE generator shall use SetAbsAlarm() for alarm initialization.
      boolean RteOptimizeLocksInASILPartitions [0..1]: set at pre-compile, origin=Vector Informatik, default-value=false  # If this parameter is set to true, the RTE generator also considers the task priorities and preemption settings to optimize APIs in ASIL partitions. Otherwise, the RTE generator uses a more conservative locking strategy for ASIL partitions to reduce the risk of data consistency problems when the APIs are accidentally called from the wrong task. Independently of the value of this switch, it is the responsibility of the user to call the APIs only from runnables that are configured to use the APIs.
      boolean UseRteSemanticsForIntraLetCommunication [0..1]: set at pre-compile, origin=Vector Informatik, default-value=true  # Enables an alternative LET communication semantic. If this parameter is set to true the RTE generator treats the implicit communication within a LET interval as if it were the classic implicit communication. Otherwise the communication will be purely handled by LET semantics.
      boolean RteBasicRuntimeEnvironmentMode [0..1]: set at pre-compile, origin=Vector Informatik, default-value=false  # Activates Generation of BRE.
      boolean RteEnableLET [0..1]: set at pre-compile, origin=Vector Informatik, default-value=false  # Enables generation of LET.
      boolean RteEnableMemoryProtection [0..1]: set at pre-compile, origin=Vector Informatik, default-value=false  # Is set to true if memory protection is configured.
      boolean RteEnableMultiCore [0..1]: set at pre-compile, origin=Vector Informatik, default-value=false  # Is set to true if multi core is configured.
      boolean RteDisableInterEcuIntToIntDataConversion [0..1]: set at pre-compile, origin=Vector Informatik, default-value=false  # Disables inter ecu integer to integer data conversion. For BSW packages before R31, the switch gets automatically set to true if it is not configured. Starting with R31 the conversion is always enabled if not explicitly disabled by this switch. The RTE generator derives the conversion formula from the CompuMethod on the system signal and the data element.
      integer RteAlarmGlobalStartOffset [0..1]: 0..4294967295, set at pre-compile, origin=Vector Informatik, default-value=1  # global start offset for cyclic runnables when SetAbsAlarm or SetRelAlarm is used.
      boolean RteDisableRteInitMemory [0..1]: set at pre-compile, origin=Vector Informatik, default-value=false  # The API function Rte_InitMemory and SomeIpXf_InitMemory is a MICROSAR Classic RTE/SomeIpXf specific extension and should be used to initialize RTE/SomeIpXf internal state variables if the compiler does not support initialized variables. If the system has already initialized the variables, the Rte_InitMemory and SomeIpXf_InitMemory-API can be deactivated and the API will no longer be generated to save ROM.
      boolean RteDisableOsScheduleTableAndAlarmGeneration [0..1]: set at pre-compile, origin=Vector Informatik  # Disables the generation of the os schedule tables and alarms for timing events. The elements are no longer added to the OS configuration and the RTE no longer starts them in the RTE lifecycle APIs. This parameter can be used for cases where the tasks are activated manually by the integration code.
      container RteVfbTraceClient [0..*]  # The RTE shall add the VFB Trace client with the ShortName of this container as the client’s prefix.
        integer RteVfbTraceClientPosition [0..1]: 0..65535, set at pre-compile, origin=Vector Informatik  # Defines the position within all trace clients at which to call the trace functions of this trace client. The bigger the number the later the start trace functions and the sooner the stop trace functions will be called.
        function name RteVfbTraceFunction [0..*]: set at pre-compile, origin=Vector Informatik  # The RTE generator shall enable VFB tracing for a given hook function when its name starts with the string configured here. Example: If Rte_Dbg_WriteHook_i2 is configured, Rte_Dbg_WriteHook_i1_p1_a_Start will be enabled.
        foreign reference RteVfbTraceHooksRef [0..1]: set at pre-compile, origin=Vector Informatik, destination-type=CONTAINER  # Reference to the container in the VFB Trace client’s configuration to which the RTE shall add the descriptions of the trace hooks created for this client.
    container RteImplicitCommunication [0..*]  # Configuration of the Implicit Communication behavior to be generated.
      boolean RteCoherentAccess: set at pre-compile, default-value=false  # If set to true the referenced VariableAccess'es of this RteImplicitCommunication container are in one CoherencyGroup. | Data values for Coherent Implicit Read Access'es are read before the first reading RunnbaleEntity starts and are stable during the execution of all the reading RunnableEntitys; except Coherent Implicit Write Access'es belongs to the same Coherency Group. Data values written by Coherent Implicit Write Access'es are available for readers not belonging to the Coherency Group after the last writing RunnableEntity has terminated. Please note that a Coherent Implicit Data Access can be defined for VariableAccess'es to same and different VariableDataElements. Nevertheless all Coherent Implicit Data Access'es of one Coherency Group have to be executed in the same task.
      boolean RteImmediateBufferUpdate: set at pre-compile, default-value=false  # If set to true the RTE will perform preemption area specific buffer update immediately before (for VariableAccess in the role dataReadAccess) resp. after (for VariableAccess in the role dataWriteAccess) Runnable execution.
      foreign reference RteVariableReadAccessRef [0..*]: set at pre-compile, destination-type=VARIABLE-ACCESS  # Reference to the VariableAccess in the dataReadAccess role.
      foreign reference RteVariableWriteAccessRef [0..*]: set at pre-compile, destination-type=VARIABLE-ACCESS  # Reference to the VariableAccess in the dataWriteAccess role.
      instance reference RteSoftwareComponentInstanceRef [1..*]: set at pre-compile, destination-context=ROOT-SW-COMPOSITION-PROTOTYPE, destination-type=SW-COMPONENT-PROTOTYPE  # Reference to a SwComponentPrototype. | This denotes the instances of the VariableAccess belonging to the RteImplicitCommunication.
    container RteInitializationBehavior [1..*]  # Specifies the initialization strategy for variables allocated by RTE with the purpose to implement VariableDataPrototypes. | The container defines a set of RteSectionInitializationPolicys and one RteInitializationStrategy which is applicable for this set.
      enumeration RteInitializationStrategy: {RTE_INITIALIZATION_STRATEGY_AT_DATA_DECLARATION, RTE_INITIALIZATION_STRATEGY_AT_DATA_DECLARATION_AND_PARTITION_RESTART, RTE_INITIALIZATION_STRATEGY_AT_RTE_START_AND_PARTITION_RESTART, RTE_INITIALIZATION_STRATEGY_NONE}, set at pre-compile, default-value=RTE_INITIALIZATION_STRATEGY_AT_RTE_START_AND_PARTITION_RESTART  # Definition of the initialization strategy applicable for the SectionInitializationPolicys selected by RteSectionInitializationPolicy.
      string RteSectionInitializationPolicy [1..*]: set at pre-compile  # This parameter describes the SectionInitializationPolicys for which a particular RTE initialization strategy applies. | The SectionInitializationPolicy describes the intended initialization of MemorySections. The following values are standardized in AUTOSAR Methodology: * '''NO-INIT''': No initialization and no clearing is performed. Such data elements must not be read before one has written a value into it. * '''INIT''': To be used for data that are initialized by every reset to the specified value (initValue). * '''POWER-ON-INIT''': To be used for data that are initialized by "Power On" to the specified value (initValue). Note: there might be several resets between power on resets. * '''CLEARED''': To be used for data that are initialized by every reset to zero. * '''POWER-ON-CLEARED''': To be used for data that are initialized by "Power On" to zero. Note: there might be several resets between power on resets.
    container RteOsInteraction [1..*]  # Interaction of the Rte with the Os.
      container RteModeToScheduleTableMapping [0..*]  # Provides configuration input in which Modes of a ModeDeclarionGroupPrototype of a Mode Manager a OsScheudleTable shall be active. | The Mode Manager is either specified as a SwComponentPrototype (RteModeSchtblMapSwc) or as a BSW-Module (RteModeSchtblMapBsw).
        foreign reference RteModeSchtblMapModeDeclarationRef [1..*]: set at pre-compile, destination-type=MODE-DECLARATION  # Reference to the ModeDeclarations.
        reference RteModeScheduleTableRef: set at pre-compile, destination=OsScheduleTable  # Reference to the OsScheduleTable which shall be active in the specified RteModeSchblMapModeDeclarationRefs.
        container RteModeSchtblMapBsw [0..1]  # Specifies an instance of a ModeDeclarationGroupPrototype of a Bsw-Module.
          foreign reference RteModeSchtblMapBswProvidedModeGroupRef: set at pre-compile, destination-type=MODE-DECLARATION-GROUP-PROTOTYPE  # Reference to an instance of a ModeDeclarationGroupPrototype of a Bsw-Module.
          reference RteModeSchtblMapBswInstanceRef: set at pre-compile, destination=RteBswModuleInstance  # Reference to an instance specification of a Bsw-Module.
        container RteModeSchtblMapSwc [0..1]  # Specifies an instance of a ModeDeclarationGroupPrototype of a SwComponentPrototype.
          foreign reference RteModeSchtblMapSwcPortRef: set at pre-compile, destination-type=P-PORT-PROTOTYPE  # Reference to the PPortPrototype of a SwComponentPrototype.
          reference RteModeSchtblMapSwcInstanceRef: set at pre-compile, destination=RteSwComponentInstance  # Reference to an instance specification of a SwComponentPrototype.
      container RteUsedOsActivation [0..*]  # Attributes used in the activation of OsTasks and Runnable Entities.
        float RteExpectedActivationOffset: 0.., set at pre-compile, default-value=0  # Activation offset. | Important: This is a requirement from the Rte towards the Os/Mcu setup. The Rte Generator shall assume this activation offset to be fulfilled.
        float RteExpectedTickDuration: 0.., set at pre-compile, default-value=0  # The expected tick duration which shall be configured to drive the OsScheduleTables or OsAlarm. | Important: This is a requirement from the Rte towards the Os/Mcu setup. The Rte Generator shall assume this tick duration to be fulfilled. A value of "0" disables the evaluation of this attribute.
        reference RteActivationOsAlarmRef [0..1]: set at pre-compile, destination=OsAlarm  # Reference to an OsAlarm.
        reference RteActivationOsSchTblRef [0..1]: set at pre-compile, destination=OsScheduleTable  # Reference to an OsScheduleTable.
        reference RteActivationOsTaskRef [0..1]: set at pre-compile, destination=OsTask  # Reference to an OsTask.
    container RtePostBuildVariantConfiguration [0..1]: multiple-configuration-container=true  # Specifies the PostbuildVariantSets for each of the PostBuild configurations of the RTE. | The shortName of this container defines the name of the RtePostBuildVariant.
      foreign reference RtePostBuildUsedPredefinedVariant [1..*]: set at pre-compile, destination-type=PREDEFINED-VARIANT  # Reference to the PredefinedVariant element which defines the values for PostBuildVariationCriterion elements.
    container RteSwComponentInstance [0..*]  # Representation of one SwComponentPrototype located on the to be configured ECU. All subcontainer configuration aspects are in relation to this SwComponentPrototype. | The RteSwComponentInstance can be associated with either a AtomicSwComponentType or ParameterSwComponentType.
      foreign reference RteSoftwareComponentInstanceRef [0..1]: set at pre-compile, destination-type=SW-COMPONENT-PROTOTYPE  # Reference to a SwComponentPrototype.
      container RteEventToTaskMapping [0..*]  # Maps a RunnableEntity onto one OsTask based on the activating RTEEvent. | Even if a RunnableEntity shall be executed via a direct function call this RteEventToTaskMapping shall be specified, but no RteMappedToTask and RtePositionInTask elements given.
        float RteActivationOffset [0..1]: 0.., set at pre-compile  # Activation offset.
        boolean RteImmediateRestart: set at pre-compile, default-value=false  # When RteImmediateRestart is set to true the RunnableEntitiy shall be immediately re-started after termination if it was activated by this RTEEvent while it was already started. | This parameter shall not be set to true when the mapped RTEEvent refers to a RunnableEntity which minimumStartInterval attribute is > 0.
        enumeration RteOsSchedulePoint [0..1]: {CONDITIONAL, NONE, UNCONDITIONAL}, set at pre-compile, default-value=NONE  # Introduce a schedule point by explicitly calling Os Schedule service after the execution of the ExecutableEntity. The Rte generator is allowed to optimize several consecutive calls to Os schedule into one single call if the ExecutableEntity executions in between have been skipped. | The absence of this parameter is interpreted as "NONE". It shall be considered an invalid configuration if the task is preemptable and the value of this parameter is not set to "NONE" or the parameter is absent.
        integer RtePositionInTask [0..1]: 0..65535, set at pre-compile  # Each RunnableEntity mapped to an OsTask has a specific position within the task execution. | For periodic activation this is the order of execution. For event driver activation this is the order of evaluation which actual RunnableEntity has to be executed.
        enumeration RteCyclicTriggerImplementation [0..1]: {Auto, None}, configuration-class-affection=affection-kind=NO-AFFECT, set at pre-compile, origin=Vector Informatik, default-value=Auto  # If set to 'Auto' the RTE generator automatically creates the necessary OS alarm to realize the cyclic trigger with the configured activation offset. If set to 'None' the trigger is not implemented by the RTE generator. It has to be implemented by the user either by configuring an appropriate OS alarm or an OS schedule table. The OS task and optional the OS event for that trigger can be found in the generated RTE report.
        integer RteServerQueueLength [0..1]: 0..65535, set at pre-compile, origin=Vector Informatik  # Specifies the length of the queue for the server call serialization. This value overwrites the queueLength specified at the ServerComSpec.
        foreign reference RteEventRef: set at pre-compile, destination-type=RTE-EVENT  # Reference to the description of the RTEEvent which is pointing to the RunnableEntity being mapped. This allows a fine grained mapping of RunnableEntites based on the activating RTEEvent.
        reference RteMappedToTaskRef [0..1]: set at pre-compile, destination=OsTask  # Reference to the OsTask the RunnableEntity activated by the RteEventRef is mapped to. | If no reference to the OsTask is specified the RunnableEntity shall be executed via a direct function call.
        reference RteUsedOsAlarmRef [0..1]: set at pre-compile, destination=OsAlarm  # If an OsAlarm is used to activate the OsTask this RteEvent is mapped to it shall be referenced here.
        reference RteUsedOsEventRef [0..1]: set at pre-compile, destination=OsEvent  # If an OsEvent is used to activate the OsTask this RteEvent is mapped to it shall be referenced here.
        reference RteUsedOsSchTblExpiryPointRef [0..1]: set at pre-compile, destination=OsScheduleTableExpiryPoint  # If an OsScheduleTableExpiryPoint is used to activate the OsTask this RteEvent is mapped to it shall be referenced here.
        reference RteVirtuallyMappedToTaskRef [0..1]: set at pre-compile, destination=OsTask  # Optional reference to an OsTask where the activation of this RteEvent shall be evaluated. The actual execution of the Runnable Entity shall happen in the OsTask referenced by RteMappedToTaskRef.
        foreign reference RteRipsFillRoutineRef [0..*]: set at pre-compile, origin=Vector Informatik, destination-type=CONTAINER  # Reference to a Buffer-Fill Routine implemented by an RTE Implementation Plug-In.
        foreign reference RteRipsFlushRoutineRef [0..*]: set at pre-compile, origin=Vector Informatik, destination-type=CONTAINER  # Reference to a Buffer-Flush Routine implemented by an RTE Implementation Plug-In.
      container RteExclusiveAreaImplementation [0..*]  # Specifies the implementation to be used for the data consistency of this ExclusiveArea.
        enumeration RteExclusiveAreaImplMechanism: {ALL_INTERRUPT_BLOCKING, COOPERATIVE_RUNNABLE_PLACEMENT, OS_INTERRUPT_BLOCKING, OS_RESOURCE, NONE, CUSTOM}, set at pre-compile, default-value=OS_INTERRUPT_BLOCKING  # To be used implementation mechanism for the specified ExclusiveArea.
        boolean RteExclusiveAreaOptimization [0..1]: set at pre-compile, origin=Vector Informatik, default-value=true  # If set to true, the RTE generator tries to optimize the implementation (e.g. disable unnecessary interrupt lock) of the exclusive area if possible. If set to false, the RTE generator does not optimize the exclusive area.
        foreign reference RteExclusiveAreaRef: set at pre-compile, destination-type=EXCLUSIVE-AREA  # Reference to the ExclusiveArea.
        reference RteExclusiveAreaOsResourceRef [0..1]: set at pre-compile, destination=OsResource  # Optional reference to an OsResource in case RteExclusiveAreaImplMechanism is configured to OS_RESOURCE for this ExclusiveArea.
      container RteExternalTriggerConfig [0..*]  # Defines the configuration of External Trigger Event Communication for Software Components
        integer RteTriggerSourceQueueLength: 0..4294967295, set at pre-compile, default-value=0  # Length of trigger queue on the trigger source side. | The queue is implemented by the RTE. A value greater or equal to 1 requests an queued behavior. Setting the value of RteTriggerSourceQueueLength to 0 requests an none queued implementation of the trigger communication. If there is no RteTriggerSourceQueueLength configured for a Trigger Emitter the default value of 0 applies as well.
        instance reference RteSwcTriggerSourceRef: set at pre-compile, destination-context=P-PORT-PROTOTYPE, destination-type=TRIGGER  # Reference to a Trigger instance in the pPortPrototype of the related component instance. | The referenced Trigger instance has to belong to the same software component instance as the RteSwComponentInstance owning this parameter configures.
      container RteInternalTriggerConfig [0..*]  # Defines the configuration of Inter Runnable Triggering for Software Components
        integer RteTriggerSourceQueueLength: 0..4294967295, set at pre-compile, default-value=0  # Length of trigger queue on the trigger source side. | The queue is implemented by the RTE. A value greater or equal to 1 requests an queued behavior. Setting the value of RteTriggerSourceQueueLength to 0 requests an none queued implementation of the trigger communication. If there is no RteTriggerSourceQueueLength configured for a Trigger Emitter the default value of 0 applies as well.
        foreign reference RteSwcTriggerSourceRef: set at pre-compile, destination-type=INTERNAL-TRIGGERING-POINT  # Reference to an InternalTriggeringPoint of the related component instance. | The referenced InternalTriggeringPoint has to belong to the same software component instance as the RteSwComponentInstance owning this parameter configures.
      container RteModeMachineInstanceConfig [0..*]  # Defines the configuration of RTE assigned ( SWS_Rte_07533) mode machine instances.
        instance reference RteSwcModeManagerRef: set at pre-compile, origin=Vector Informatik, destination-context=ABSTRACT-PROVIDED-PORT-PROTOTYPE, destination-type=MODE-DECLARATION-GROUP-PROTOTYPE  # Reference to a ModeDeclarationGroupPrototype instance in the provided PortPrototype (AbstractProvidedPortPrototype) of the related component instance. | The referenced ModeDeclarationGroupPrototype instance has to belong to the same software component instance as the RteSwComponentInstance owning this parameter configures.
      container RteNvRamAllocation [0..*]  # Specifies the relationship between the AtomicSwComponentType's NVRAMMapping / NVRAM needs and the NvM module configuration.
        linker symbol RteNvmRamBlockLocationSymbol [0..1]: set at pre-compile  # This is the name of the linker object name where the NVRam Block will be mirrored by the Nvm. | This symbol will be resolved into the parameter "NvmRamBlockDataAddress" from the "NvmBlockDescriptor".
        linker symbol RteNvmRomBlockLocationSymbol [0..1]: set at pre-compile  # This is the name of the linker object name where the NVRom Block will be accessed by the Nvm. | This symbol will be resolved into the parameter "NvmRomBlockDataAddress" from the "NvmBlockDescriptor".
        foreign reference RteSwNvRamMappingRef [0..1]: set at pre-compile, destination-type=SWC-SERVICE-DEPENDENCY  # Reference to the SwServiceDependency which is used to specify the NvBlockNeeds. If this reference exists RteSwNvBlockRamMappingRef must not exists (XOR)
        symbolic name reference RteNvmBlockRef: set at pre-compile, destination=NvMBlockDescriptor  # Reference to the used NvM block for storage of the NVRAMMapping information.
        foreign reference RteSwNvBlockDescriptorRef [0..1]: set at pre-compile, origin=Vector Informatik, destination-type=NV-BLOCK-DESCRIPTOR  # Reference to the NvBlockDescriptor in case the RTE needs to call the NvM directly (e.g. for the supportDirtyFlag feature). | XOR
    container RteSwComponentType [0..*]  # Representation of one SwComponentType for the base of all configuration parameter which are affecting the whole type and not a specific instance.
      boolean RteSwcMemMapGeneration [0..1]: set at pre-compile, origin=Vector Informatik, default-value=true  # MemMap Generation | Enables or disables the generation of MemMap files for the specified Software Component by the RTE generator. Default is enabled when the generation is not done by the MemMap generator.
      foreign reference RteComponentTypeRef: set at pre-compile, destination-type=SW-COMPONENT-TYPE  # Reference to either AtomicSwComponentType or ParameterSwComponentType.
      foreign reference RteImplementationRef [0..1]: set at pre-compile, destination-type=SWC-IMPLEMENTATION  # The Implementation which shall be assiged to the SwComponentType.
      container RteComponentTypeCalibration [0..1]  # Specifies for each ParameterSwComponentType or AtomicSwComponentType whether calibration is enabled. | If references to SwAddrMethod are provided in RteCalibrationSwAddrMethodRef only ParameterDataPrototypes with the referenced SwAddrMethod shall have software calibration support enabled.
        boolean RteCalibrationSupportEnabled: set at pre-compile, default-value=false  # Enables calibration support for the specified ParameterSwComponentType or AtomicSwComponentType.
        foreign reference RteCalibrationSwAddrMethodRef [0..*]: set at pre-compile, destination-type=SW-ADDR-METHOD  # Reference to the SwAddrMethod for which software calibration support shall be enabled.
    container RteInitializationRunnableBatch [0..*]  # Presence of at least one RteInitializationRunnableBatch enables the Rte_StartTiming API.
  bsw implementation Rte_Impl: programming-language=C, sw-version=4.37.00, used-code-generator=DaVinci Configurator, vendor-id=30, ar-release-version=4.03.01, behavior=RteBehavior, preconfigured-configuration=Rte_Pre, recommended-configuration=Rte_Rec, vendor-specific-module-def=Rte
  module config Rte_Pre: definition=Rte
    RteGeneration: RteGenerationMode=COMPATIBILITY_MODE, RteIocInteractionReturnValue=RTE_IOC, RteValueRangeCheckEnabled=0
    RteInitializationBehavior: RteInitializationStrategy=RTE_INITIALIZATION_STRATEGY_AT_DATA_DECLARATION, RteSectionInitializationPolicy=INIT
  module config Rte_Rec: definition=Rte
    RteOsInteraction
  module definition RteCalculation [0..1]: category=VENDOR_SPECIFIC_MODULE_DEFINITION, variants pre-compile  # Runtime Environment (RTE) calculation. Automatically updates the configuration of modules that are used by the RTE generator (COM, LDCOM, NVM, OS) during the calculation phase in DaVinci CFG. If this module is part of the configuration: Allows disabling of the automatic calculation phase of the RTE in the generator selection. The RTE generator then only displays validation messages with solving actions for the update. It might be necessary to regenerate the updated modules afterwards. If this module is not part of the configuration: Automatic calculation is always done. It is recommended to always execute the calculation. However, when only local configuration changes are done, experts can deselect this module for faster generation. #RuntimeEnvironment #AUTOSAR
  module definition RteChecks [0..1]: category=VENDOR_SPECIFIC_MODULE_DEFINITION, variants pre-compile  # Runtime Environment (RTE) extended checks. Checks the model with additional model consistency checks from the DaVinci Developer Framework. If this module is part of the configuration: Allows disabling of the checks in the generator selection. Beware that this may lead to undescriptive error messages and not compilable code. If this module is not part of the configuration: Checks are always done. It is recommended to always execute the checks. However, when only local configuration changes are done, experts can deselect this module for faster generation. #RuntimeEnvironment #AUTOSAR
