AUTOSAR XML (schema 00048)
# COPYRIGHT
# Copyright (c) 2022 by Vector Informatik GmbH. All rights reserved.
# This software is copyright protected and proprietary to Vector Informatik GmbH.
# Vector Informatik GmbH grants to you only those rights as set out in the license conditions.
package /MICROSAR
  bsw implementation TcpIp_Impl
    required-artifacts:
      dependency on artifact TcpIp_MemMap: category=MEMMAP, artifact-descriptor={short-label=TcpIp_MemMap.h, category=SWHDR}
    resource consumption ResourceConsumption
      29 x memory section:
        TCPIP_CODE: sw-addrmethod=CODE, symbol=CODE
        TCPIP_CODE_ISR: sw-addrmethod=CODE_ISR, symbol=CODE_ISR
        TCPIP_PBCFG: sw-addrmethod=CONST_PBCFG, symbol=PBCFG
        TCPIP_CONST_PBCFG: sw-addrmethod=CONST_PBCFG, symbol=CONST_PBCFG
        TCPIP_PBCFG_GLOBALROOT: sw-addrmethod=PBCFG_GLOBALROOT, symbol=PBCFG_GLOBALROOT
        TCPIP_CONFIG_DATA: sw-addrmethod=CONFIG_DATA, symbol=CONFIG_DATA
        TCPIP_CONST_8: alignment=8, sw-addrmethod=CONST, symbol=CONST_8
        TCPIP_CONST_16: alignment=16, sw-addrmethod=CONST, symbol=CONST_16
        TCPIP_CONST_32: alignment=32, sw-addrmethod=CONST, symbol=CONST_32
        TCPIP_CONST_UNSPECIFIED: alignment=UNSPECIFIED, sw-addrmethod=CONST, symbol=CONST_UNSPECIFIED
        TCPIP_VAR_PBCFG: sw-addrmethod=VAR_PBCFG, symbol=VAR_PBCFG
        TCPIP_VAR_NO_INIT_8: alignment=8, sw-addrmethod=VAR_NO_INIT, symbol=VAR_NO_INIT_8
        TCPIP_REASSEMBLYBUFFER_VAR_NO_INIT_8: alignment=8, sw-addrmethod=VAR_NO_INIT, symbol=REASSEMBLYBUFFER_VAR_NO_INIT_8
        TCPIP_TCPRXBUFFER_VAR_NO_INIT_8: alignment=8, sw-addrmethod=VAR_NO_INIT, symbol=TCPRXBUFFER_VAR_NO_INIT_8
        TCPIP_TCPTXBUFFER_VAR_NO_INIT_8: alignment=8, sw-addrmethod=VAR_NO_INIT, symbol=TCPTXBUFFER_VAR_NO_INIT_8
        TCPIP_TLSBUFFERRX_VAR_NO_INIT_8: alignment=8, sw-addrmethod=VAR_NO_INIT, symbol=TLSBUFFERRX_VAR_NO_INIT_8
        TCPIP_TLSBUFFERTX_VAR_NO_INIT_8: alignment=8, sw-addrmethod=VAR_NO_INIT, symbol=TLSBUFFERTX_VAR_NO_INIT_8
        TCPIP_IPV6FRAGMENTTXDATABUFFER_VAR_NO_INIT_8: alignment=8, sw-addrmethod=VAR_NO_INIT, symbol=IPV6FRAGMENTTXDATABUFFER_VAR_NO_INIT_8
        TCPIP_IPV6REASSEMBLYDATABUFFER_VAR_NO_INIT_8: alignment=8, sw-addrmethod=VAR_NO_INIT, symbol=IPV6REASSEMBLYDATABUFFER_VAR_NO_INIT_8
        TCPIP_RXPROCESSBUFFER_VAR_NO_INIT_8: alignment=8, sw-addrmethod=VAR_NO_INIT, symbol=RXPROCESSBUFFER_VAR_NO_INIT_8
        TCPIP_VAR_NO_INIT_16: alignment=16, sw-addrmethod=VAR_NO_INIT, symbol=VAR_NO_INIT_16
        TCPIP_VAR_NO_INIT_32: alignment=32, sw-addrmethod=VAR_NO_INIT, symbol=VAR_NO_INIT_32
        TCPIP_VAR_NO_INIT_UNSPECIFIED: alignment=UNSPECIFIED, sw-addrmethod=VAR_NO_INIT, symbol=VAR_NO_INIT_UNSPECIFIED
        TCPIP_SOCKETTCPDYN_VAR_NO_INIT_UNSPECIFIED: alignment=UNSPECIFIED, sw-addrmethod=VAR_NO_INIT, symbol=SOCKETTCPDYN_VAR_NO_INIT_UNSPECIFIED
        TCPIP_TCPOOOQELEMENT_VAR_NO_INIT_UNSPECIFIED: alignment=UNSPECIFIED, sw-addrmethod=VAR_NO_INIT, symbol=TCPOOOQELEMENT_VAR_NO_INIT_UNSPECIFIED
        TCPIP_TCPRETRYQELEMENT_VAR_NO_INIT_UNSPECIFIED: alignment=UNSPECIFIED, sw-addrmethod=VAR_NO_INIT, symbol=TCPRETRYQELEMENT_VAR_NO_INIT_UNSPECIFIED
        TCPIP_SAENTRY_VAR_NO_INIT_UNSPECIFIED: alignment=UNSPECIFIED, sw-addrmethod=VAR_NO_INIT, symbol=SAENTRY_VAR_NO_INIT_UNSPECIFIED
        TCPIP_VAR_CLEARED_8: alignment=8, sw-addrmethod=VAR_CLEARED, symbol=VAR_CLEARED_8
        TCPIP_VAR_CLEARED_UNSPECIFIED: alignment=UNSPECIFIED, sw-addrmethod=VAR_CLEARED, symbol=VAR_CLEARED_UNSPECIFIED
