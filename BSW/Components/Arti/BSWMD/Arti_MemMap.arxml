AUTOSAR XML (schema 00048)
# COPYRIGHT
# Copyright (c) 2022 by Vector Informatik GmbH. All rights reserved.
# This software is copyright protected and proprietary to Vector Informatik GmbH.
# Vector Informatik GmbH grants to you only those rights as set out in the license conditions.
package /MICROSAR
  bsw implementation Arti_Impl
    required-artifacts:
      dependency on artifact Arti_MemMap: category=MEMMAP, artifact-descriptor={short-label=Arti_MemMap.h, category=SWHDR}
    resource consumption ResourceConsumption
      memory section ARTI_CODE: sw-addrmethod=CODE, symbol=CODE
      memory section ARTI_VAR_NO_INIT_32: alignment=32, sw-addrmethod=VAR_NO_INIT, symbol=VAR_NO_INIT_32
