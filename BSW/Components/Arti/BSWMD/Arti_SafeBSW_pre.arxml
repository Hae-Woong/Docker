AUTOSAR XML (schema 4-3-0)
package /MICROSAR
  module config Arti_Rec: definition=Arti
    ArtiGeneral: ArtiSafeBswChecks=1
