AUTOSAR XML (schema 4-0-3)
package /MICROSAR
  module config ComM_Rec: definition=ComM
    ComMGeneral: ComMSafeBswChecks=1
