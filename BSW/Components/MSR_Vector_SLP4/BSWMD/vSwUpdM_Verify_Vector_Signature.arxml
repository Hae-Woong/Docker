AUTOSAR XML (schema 00048)
package /MICROSAR
  module config vStreamProc_Pre: definition=vStreamProc, implementation-config-variant=VARIANT-LINK-TIME, module-description=vStreamProc_Impl
    vSwUpdMVerifyModulePipe (vStreamProcPipe)
      vStreamProcEdges
        SignatureVerification_SignatureReferenceData_In (vStreamProcConsumer):
          vStreamProcProcessingNodeInputRef = vSwUpdMVerifyModule_SignatureVerification_SignatureReferenceData
          vStreamProcStorageNodeRef = vSwUpdMVerifyModule_Entry_Signature
        SignatureVerification_Result_Out (vStreamProcProducer):
          vStreamProcStorageNodeRef = vSwUpdMVerifyModule_Exit_Result
          vStreamProcProcessingNodeOutputRef = vSwUpdMVerifyModule_SignatureVerification_ResultData
        SignatureVerification_InputData_In (vStreamProcConsumer): vStreamProcProcessingNodeInputRef=vSwUpdMVerifyModule_SignatureVerification_InputData, vStreamProcStorageNodeRef=vSwUpdMVerifyModule_Read_Data
      vStreamProcAccessPoints
        vSwUpdMVerifyModule_Signature_Entry (vStreamProcEntryPoint): vStreamProcEntryStorageNode=vSwUpdMVerifyModule_Entry_Signature
      vStreamProcNodes
        vSwUpdMVerifyModule_Entry_Signature (vStreamProcStorageNode): vStreamProcBufferSize=64, vStreamProcDataTypeRef=uint8, vStreamProcStorageNodeTypeRef=vStreamProcSimpleBuffer
        vSwUpdMVerifyModule_SignatureVerification (vStreamProcProcessingNode): vStreamProcProcessingNodeTypeRef=SignatureVerification
          vSwUpdMVerifyModule_SignatureVerification_InputData (vStreamProcProcessingNodeInputPort): vStreamProcProcessingNodeInput=SignatureVerificationNode_InputData
          vSwUpdMVerifyModule_SignatureVerification_SignatureReferenceData (vStreamProcProcessingNodeInputPort): vStreamProcProcessingNodeInput=SignatureVerificationNode_SignatureReferenceData
          vSwUpdMVerifyModule_SignatureVerification_ResultData (vStreamProcProcessingNodeOutputPort): vStreamProcProcessingNodeOutput=SignatureVerificationNode_ResultData
    vStreamProcDefinitions
      vStreamProcNodeTypes
        SignatureVerification (vStreamProcProcessingNodeType)
          vStreamProcSignatureVerificationNode
            vStreamProcRequiredInputPorts
              SignatureVerificationNode_InputData
              SignatureVerificationNode_SignatureReferenceData
            vStreamProcRequiredOutputPorts
              SignatureVerificationNode_ResultData
  module config vStreamProc_Rec: definition=vStreamProc, implementation-config-variant=VARIANT-LINK-TIME, module-description=vStreamProc_Impl
    CRCPipe (vStreamProcPipe): vStreamProcPipeId=4
  module config vSwUpdM_Pre: definition=vSwUpdM
    vSwUpdMDataProcessing
      VerifyModule (vSwUpdMDataProcess): vSwUpdMDataProcessType=VERIFY_MODULE, vSwUpdMDataProcessPipeRef=vSwUpdMVerifyModulePipe
        VerifyModuleInput_Signature (vSwUpdMExternalDataInput): vSwUpdMExternalDataInputId=0, vSwUpdMExternalDataInputRef=vSwUpdMVerifyModule_Signature_Entry
