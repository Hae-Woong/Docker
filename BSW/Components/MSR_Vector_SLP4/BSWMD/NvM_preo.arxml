AUTOSAR XML (schema 4-0-3)
package /MICROSAR
  module config NvM_Rec: definition=NvM
  module config NvM_Rec_Class1: definition=NvM
    NvMBlockDescriptor: NvMBlockCrcType=NVM_CRC16, NvMSelectBlockForWriteAll=0, NvMBlockUseCrc=1
