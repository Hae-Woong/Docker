AUTOSAR XML (schema 4-0-3)
package /MICROSAR
  module config CanTp_Rec: definition=CanTp
    CanTpGeneral: CanTpUseOnlyFirstFc=1
