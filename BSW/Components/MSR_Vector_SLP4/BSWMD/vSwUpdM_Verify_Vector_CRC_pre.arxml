AUTOSAR XML (schema 00048)
package /MICROSAR
  module config vStreamProc_Pre: definition=vStreamProc, implementation-config-variant=VARIANT-LINK-TIME, module-description=vStreamProc_Impl
    vSwUpdMVerifyModulePipe (vStreamProcPipe)
      vStreamProcEdges
        Crc_Data_In (vStreamProcConsumer): vStreamProcProcessingNodeInputRef=vStreamProcProcessingNodeInputPort, vStreamProcStorageNodeRef=vSwUpdMVerifyModule_Read_Data
        Read_Data_Out (vStreamProcProducer): vStreamProcStorageNodeRef=vSwUpdMVerifyModule_Read_Data, vStreamProcProcessingNodeOutputRef=vSwUpdMVerifyModule_Read_Data_Out
        Crc_Crc_Out (vStreamProcProducer):
          vStreamProcStorageNodeRef = vSwUpdMVerifyModule_CalculateCRC_CRC
          vStreamProcProcessingNodeOutputRef = vSwUpdMVerifyModule_CalculateCRC/vStreamProcProcessingNodeOutputPort
        Compare_CRC1_In (vStreamProcConsumer): vStreamProcProcessingNodeInputRef=vStreamProcProcessingNodeInputPort_CRC1, vStreamProcStorageNodeRef=vSwUpdMVerifyModule_CalculateCRC_CRC
        Compare_CRC2_In (vStreamProcConsumer): vStreamProcProcessingNodeInputRef=vStreamProcProcessingNodeInputPort_CRC2, vStreamProcStorageNodeRef=vSwUpdMVerifyModule_Entry_CRC
        Compare_Result_Out (vStreamProcProducer):
          vStreamProcStorageNodeRef = vSwUpdMVerifyModule_Exit_Result
          vStreamProcProcessingNodeOutputRef = vSwUpdMVerifyModule_CompareCRC/vStreamProcProcessingNodeOutputPort
      vStreamProcNodes
        vSwUpdMVerifyModule_CalculateCRC_CRC (vStreamProcStorageNode): vStreamProcBufferSize=4, vStreamProcDataTypeRef=uint8, vStreamProcStorageNodeTypeRef=vStreamProcSimpleBuffer
        vSwUpdMVerifyModule_Entry_CRC (vStreamProcStorageNode): vStreamProcBufferSize=4, vStreamProcDataTypeRef=uint8, vStreamProcStorageNodeTypeRef=vStreamProcSimpleBuffer
        3 x vStreamProcProcessingNode:
          vSwUpdMVerifyModule_Read: vStreamProcProcessingNodeTypeRef=vSwUpdM_Read
            vSwUpdMVerifyModule_Read_Range_In (vStreamProcProcessingNodeInputPort): vStreamProcProcessingNodeInput=RangeInputPort
            vSwUpdMVerifyModule_Read_Entites_In (vStreamProcProcessingNodeInputPort): vStreamProcProcessingNodeInput=EntitiesInputPort
            vSwUpdMVerifyModule_Read_Data_Out (vStreamProcProcessingNodeOutputPort): vStreamProcProcessingNodeOutput=DataOutputPort
          vSwUpdMVerifyModule_CalculateCRC: vStreamProcProcessingNodeTypeRef=CrcNode
            vStreamProcProcessingNodeInputPort: vStreamProcProcessingNodeInput=CRCNode_InputData
            vStreamProcProcessingNodeOutputPort: vStreamProcProcessingNodeOutput=CRCNode_OutputData
          vSwUpdMVerifyModule_CompareCRC: vStreamProcProcessingNodeTypeRef=CrcCompare
            vStreamProcProcessingNodeInputPort_CRC1 (vStreamProcProcessingNodeInputPort): vStreamProcProcessingNodeInput=vStreamProcCompareInputPort_0
            vStreamProcProcessingNodeInputPort_CRC2 (vStreamProcProcessingNodeInputPort): vStreamProcProcessingNodeInput=vStreamProcCompareInputPort_1
            vStreamProcProcessingNodeOutputPort: vStreamProcProcessingNodeOutput=ByteCompareNode_ResultData
      vStreamProcAccessPoints
        vSwUpdMVerifyModule_CRC_Entry (vStreamProcEntryPoint): vStreamProcEntryStorageNode=vSwUpdMVerifyModule_Entry_CRC
    vStreamProcDefinitions
      vStreamProcNodeTypes
        CrcNode (vStreamProcProcessingNodeType)
          vStreamProcCRCNode: vStreamProcCRCType=CRC32
            vStreamProcRequiredInputPorts
              CRCNode_InputData: vStreamProcDataTypeRef=uint8
            vStreamProcRequiredOutputPorts
              CRCNode_OutputData: vStreamProcDataTypeRef=uint8
        CrcCompare (vStreamProcProcessingNodeType)
          vStreamProcByteCompareNode
            vStreamProcOptionalOutputPorts
              ByteCompareNode_ComparedCount: vStreamProcDataTypeRef=uint8
            vStreamProcOptionalInputPorts
            vStreamProcRequiredInputPorts
              vStreamProcCompareInputPort_0 (vStreamProcCompareInputPort): vStreamProcDataTypeRef=uint8
              vStreamProcCompareInputPort_1 (vStreamProcCompareInputPort): vStreamProcDataTypeRef=uint8
            vStreamProcRequiredOutputPorts
              ByteCompareNode_ResultData: vStreamProcDataTypeRef=Std_ReturnType
  module config vStreamProc_Rec: definition=vStreamProc, implementation-config-variant=VARIANT-LINK-TIME, module-description=vStreamProc_Impl
    vSwUpdMVerifyModulePipe (vStreamProcPipe): vStreamProcPipeId=4
  module config vSwUpdM_Pre: definition=vSwUpdM
    vSwUpdMDataProcessing
      VerifyModule (vSwUpdMDataProcess): vSwUpdMDataProcessType=VERIFY_MODULE, vSwUpdMDataProcessPipeRef=vStreamProc_Pre/vSwUpdMVerifyModulePipe
        VerifyModuleInput_CRC (vSwUpdMExternalDataInput): vSwUpdMExternalDataInputId=0, vSwUpdMExternalDataInputRef=vSwUpdMVerifyModule_CRC_Entry
