AUTOSAR XML (schema 00048)
package /MICROSAR
  module config vStreamProc_Pre: definition=vStreamProc, implementation-config-variant=VARIANT-LINK-TIME, module-description=vStreamProc_Impl
    vSwUpdMVerifyModulePipe (vStreamProcPipe)
      vStreamProcEdges
        Read_Entities_In (vStreamProcConsumer): vStreamProcProcessingNodeInputRef=vSwUpdMVerifyModule_Read_Entites_In, vStreamProcStorageNodeRef=vSwUpdMVerifyModule_Entry_Entities
        Read_Range_In (vStreamProcConsumer): vStreamProcProcessingNodeInputRef=vSwUpdMVerifyModule_Read_Range_In, vStreamProcStorageNodeRef=vSwUpdMVerifyModule_Entry_Range
      vStreamProcNodes
        4 x vStreamProcStorageNode, all with vStreamProcStorageNodeTypeRef=vStreamProcSimpleBuffer:
          vSwUpdMVerifyModule_Entry_Entities: vStreamProcBufferSize=1, vStreamProcDataTypeRef=vSwUpdM_EntityIdsType
          vSwUpdMVerifyModule_Entry_Range: vStreamProcBufferSize=1, vStreamProcDataTypeRef=vSwUpdM_RangeInfoType
          vSwUpdMVerifyModule_Read_Data: vStreamProcBufferSize=256, vStreamProcDataTypeRef=uint8
          vSwUpdMVerifyModule_Exit_Result: vStreamProcBufferSize=1, vStreamProcDataTypeRef=Std_ReturnType
      vStreamProcAccessPoints
        vSwUpdMVerifyModule_Entities_Entry (vStreamProcEntryPoint): vStreamProcEntryStorageNode=vSwUpdMVerifyModule_Entry_Entities
        vSwUpdMVerifyModule_Range_Entry (vStreamProcEntryPoint): vStreamProcEntryStorageNode=vSwUpdMVerifyModule_Entry_Range
        vSwUpdMVerifyModule_Result_Exit (vStreamProcExitPoint): vStreamProcExitStorageNode=vSwUpdMVerifyModule_Exit_Result
  module config vStreamProc_Rec: definition=vStreamProc, implementation-config-variant=VARIANT-LINK-TIME, module-description=vStreamProc_Impl
    vSwUpdMVerifyModulePipe (vStreamProcPipe): vStreamProcPipeId=4
  module config vSwUpdM_Pre: definition=vSwUpdM
    vSwUpdMDataProcessing
      VerifyModule (vSwUpdMDataProcess): vSwUpdMDataProcessType=VERIFY_MODULE, vSwUpdMDataProcessPipeRef=vStreamProc_Pre/vSwUpdMVerifyModulePipe
        VerifyModuleOutput_Result (vSwUpdMInternalDataOutput): vSwUpdMInternalDataOutputId=0, vSwUpdMInternalDataOutputType=OutputResult, vSwUpdMInternalDataOutputRef=vSwUpdMVerifyModule_Result_Exit
        VerifyModuleInput_Entities (vSwUpdMInternalDataInput): vSwUpdMInternalDataInputId=0, vSwUpdMInternalDataInputType=InputEntities, vSwUpdMInternalDataInputRef=vSwUpdMVerifyModule_Entities_Entry
        VerifyModuleInput_Range (vSwUpdMInternalDataInput): vSwUpdMInternalDataInputId=1, vSwUpdMInternalDataInputType=InputRange, vSwUpdMInternalDataInputRef=vSwUpdMVerifyModule_Range_Entry
