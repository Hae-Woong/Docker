AUTOSAR XML (schema 4-0-3)
package /MICROSAR
  module config RamTst_Rec: definition=RamTst
    RamTstCommon
      RamTstConfigParams: RamTstTestCompletedNotification=NULL_PTR, RamTstTestErrorNotification=NULL_PTR
