AUTOSAR XML (schema 4-0-3)
package /MICROSAR
  module config Dcm_Rec: definition=Dcm
    DcmConfigSet
      DcmGeneral: DcmAutosarVersion=AUTOSAR_4_02_02
