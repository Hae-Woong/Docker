AUTOSAR XML (schema 00048)
package /MICROSAR
  module config vStreamProc_Pre: definition=vStreamProc, implementation-config-variant=VARIANT-LINK-TIME, module-description=vStreamProc_Impl
    vSwUpdMVerifyModulePipe (vStreamProcPipe)
      vStreamProcEdges
        Read_Data_Out (vStreamProcProducer): vStreamProcStorageNodeRef=vSwUpdMVerifyModule_Read_Data, vStreamProcProcessingNodeOutputRef=vSwUpdMVerifyModule_Read_AddrLenData_Out
      vStreamProcNodes
        vSwUpdMVerifyModule_Read (vStreamProcProcessingNode): vStreamProcProcessingNodeTypeRef=vSwUpdM_Read
          vSwUpdMVerifyModule_Read_Range_In (vStreamProcProcessingNodeInputPort): vStreamProcProcessingNodeInput=RangeInputPort
          vSwUpdMVerifyModule_Read_Entites_In (vStreamProcProcessingNodeInputPort): vStreamProcProcessingNodeInput=EntitiesInputPort
          vSwUpdMVerifyModule_Read_AddrLenData_Out (vStreamProcProcessingNodeOutputPort): vStreamProcProcessingNodeOutput=AddrLenDataOutputPort
  module config vStreamProc_Rec: definition=vStreamProc, implementation-config-variant=VARIANT-LINK-TIME, module-description=vStreamProc_Impl
