AUTOSAR XML (schema 4-0-3)
package /MICROSAR
  module config Fee_Rec: definition=Fee
    FeeSpecificFeatures: FeeApplErrorCallbackFunction=Appl_FeeCriticalErrorCallback, FeeApplErrorCallbackIncludeFile=ApplMain.h
