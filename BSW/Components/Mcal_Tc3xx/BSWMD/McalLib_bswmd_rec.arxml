AUTOSAR XML (schema 00046)
package /AURIX2G/EcucDefs
  module config McalLib_Rec: definition=McalLib
  bsw implementation McalLib_Impl: programming-language=C, behavior=McalLibBehavior, recommended-configuration=McalLib_Rec, vendor-specific-module-def=McalLib
