AUTOSAR XML (schema 00046)
package /AURIX2G/EcucDefs
  module definition FlsLoader [0..1]: variants pre-compile  # Configuration of the FlsLoader module.
    container FlsLoaderGeneral  # FlsLoader driver configuration.
      boolean FlsLoaderDevErrorDetect: origin=INFINEON_AURIX2G, set at pre-compile, default-value=false  # Preprocessor switch to enable/disable the FlsLoaderDevErrorDetect.
      boolean FlsLoaderEnableLockCheck: origin=INFINEON_AURIX2G, set at pre-compile, default-value=false  # Preprocessor switch to enable/disable the Lock Check functionality in Erase and Write API's.
      function name FlsLoaderCallOutFunction: origin=INFINEON_AURIX2G, set at pre-compile, default-value=NULL_PTR  # User defined call out function. User can provide either a call out function name or address of call out function. Default value of NULL_PTR is considered as call out disabled.
      integer FlsLoaderCallOutTime: 10000..4294967295, origin=INFINEON_AURIX2G, set at pre-compile, default-value=5000000  # Specifies the maximum time in nanoseconds to wait before invoking call-out function to application
    container FlsLoaderOptionalApi  # FlsLoader driver optional API Configuration.
      boolean FlsLoaderDeInitApi: origin=INFINEON_AURIX2G, set at pre-compile, default-value=false  # Preprocessor switch to enable/disable the FlsLoader_DeInit API.
      boolean FlsLoaderLockUnlockApi: origin=INFINEON_AURIX2G, set at pre-compile, default-value=false  # Preprocessor switch to enable/disable the FlsLoader_Lock and FlsLoader_Unlock APIs
      boolean FlsLoaderVersionInfoApi: origin=INFINEON_AURIX2G, set at pre-compile, default-value=false  # Preprocessor switch to enable/disable the FlsLoader_GetVersionInfo API
    container FlsLoaderPFLASHConfig  # This container contains the sub containers for each PFLASH Bank configuration.
      container FlsLoaderPFlash0ProtConfig  # PFLASH Bank 0 protection configuration.
        enumeration FlsLoaderPFLash0WriteProt: {NO_PROTECTION, WRITE_PROTECTION, OTP_PROTECTION, WOP_PROTECTION}, origin=INFINEON_AURIX2G, set at pre-compile, default-value=NO_PROTECTION  # PFLASH Bank 0 protection configuration.
        integer FlsLoaderPFUcbPW0_0: 0..4294967295, origin=INFINEON_AURIX2G, set at pre-compile, default-value=0  # 1th least significant word password out of 8 words password
        integer FlsLoaderPFUcbPW0_1: 0..4294967295, origin=INFINEON_AURIX2G, set at pre-compile, default-value=0  # 2nd least significant word password out of 8 words password
        integer FlsLoaderPFUcbPW1_0: 0..4294967295, origin=INFINEON_AURIX2G, set at pre-compile, default-value=0  # 3rd least significant word password out of 8 words password
        integer FlsLoaderPFUcbPW1_1: 0..4294967295, origin=INFINEON_AURIX2G, set at pre-compile, default-value=0  # 4th least significant word password out of 8 words password
        integer FlsLoaderPFUcbPW2_0: 0..4294967295, origin=INFINEON_AURIX2G, set at pre-compile, default-value=0  # 5th least significant word password out of 8 words password
        integer FlsLoaderPFUcbPW2_1: 0..4294967295, origin=INFINEON_AURIX2G, set at pre-compile, default-value=0  # 6th least significant word password out of 8 words password
        integer FlsLoaderPFUcbPW3_0: 0..4294967295, origin=INFINEON_AURIX2G, set at pre-compile, default-value=0  # 7th least significant word password out of 8 words password
        integer FlsLoaderPFUcbPW3_1: 0..4294967295, origin=INFINEON_AURIX2G, set at pre-compile, default-value=0  # Most significant word password out of 8 words password
        container FlsLoaderPF0Sector [192..192]  # Configuration of the individual PF0 sectors.PFLASH Bank and its corresponding sectors to be protected shall have same protection configured.
          enumeration FlsLoaderPFSectorWriteProtection: {NO_PROTECTION, WRITE_PROTECTION, OTP_PROTECTION, WOP_PROTECTION}, origin=INFINEON_AURIX2G, set at pre-compile, default-value=NO_PROTECTION  # Sector Write protection.
      container FlsLoaderPFlash1ProtConfig  # PFLASH Bank 1 protection configuration.
        enumeration FlsLoaderPFLash1WriteProt: {NO_PROTECTION, WRITE_PROTECTION, OTP_PROTECTION, WOP_PROTECTION}, origin=INFINEON_AURIX2G, set at pre-compile, default-value=NO_PROTECTION  # PFlash Read/Write protection.
        container FlsLoaderPF1Sector [192..192]  # PFLASH Bank 1 sector protection configuration.PFLASH Bank and its corresponding sectors to be protected shall have same protection configured
          enumeration FlsLoaderPFSectorWriteProtection: {NO_PROTECTION, WRITE_PROTECTION, OTP_PROTECTION, WOP_PROTECTION}, origin=INFINEON_AURIX2G, set at pre-compile, default-value=NO_PROTECTION  # Sector Write protection.
      container FlsLoaderPFlash2ProtConfig  # PFLASH Bank 2 protection configuration.
        enumeration FlsLoaderPFLash2WriteProt: {NO_PROTECTION, WRITE_PROTECTION, OTP_PROTECTION, WOP_PROTECTION}, origin=INFINEON_AURIX2G, set at pre-compile, default-value=NO_PROTECTION  # PFlash Read/Write protection.
        container FlsLoaderPF2Sector [192..192]  # PFLASH Bank 2 sector protection configuration.PFLASH Bank and its corresponding sectors to be protected shall have same protection configured.
          enumeration FlsLoaderPFSectorWriteProtection: {NO_PROTECTION, WRITE_PROTECTION, OTP_PROTECTION, WOP_PROTECTION}, origin=INFINEON_AURIX2G, set at pre-compile, default-value=NO_PROTECTION  # Sector Write protection.
      container FlsLoaderPFlash3ProtConfig  # PFLASH Bank 3 protection configuration.
        enumeration FlsLoaderPFLash3WriteProt: {NO_PROTECTION, WRITE_PROTECTION, OTP_PROTECTION, WOP_PROTECTION}, origin=INFINEON_AURIX2G, set at pre-compile, default-value=NO_PROTECTION  # PFlash Read/Write protection.
        container FlsLoaderPF3Sector [192..192]  # PFLASH Bank 3 sector protection configuration.PFLASH Bank and its corresponding sectors to be protected shall have same protection configured.
          enumeration FlsLoaderPFSectorWriteProtection: {NO_PROTECTION, WRITE_PROTECTION, OTP_PROTECTION, WOP_PROTECTION}, origin=INFINEON_AURIX2G, set at pre-compile, default-value=NO_PROTECTION  # Sector Write protection.
      container FlsLoaderPFlash4ProtConfig  # PFLASH Bank 4 protection configuration.
        enumeration FlsLoaderPFLash4WriteProt: {NO_PROTECTION, WRITE_PROTECTION, OTP_PROTECTION, WOP_PROTECTION}, origin=INFINEON_AURIX2G, set at pre-compile, default-value=NO_PROTECTION  # PFlash Read/Write protection.
        container FlsLoaderPF4Sector [192..192]  # PFLASH Bank 4 sector protection configuration.PFLASH Bank and its corresponding sectors to be protected shall have same protection configured.
          enumeration FlsLoaderPFSectorWriteProtection: {NO_PROTECTION, WRITE_PROTECTION, OTP_PROTECTION, WOP_PROTECTION}, origin=INFINEON_AURIX2G, set at pre-compile, default-value=NO_PROTECTION  # Sector Write protection.
      container FlsLoaderPFlash5ProtConfig  # PFLASH Bank 5 protection configuration.
        enumeration FlsLoaderPFLash5WriteProt: {NO_PROTECTION, WRITE_PROTECTION, OTP_PROTECTION, WOP_PROTECTION}, origin=INFINEON_AURIX2G, set at pre-compile, default-value=NO_PROTECTION  # PFlash Read/Write protection.
        container FlsLoaderPF5Sector [64..64]  # PFLASH Bank 5 sector protection configuration.PFLASH Bank and its corresponding sectors to be protected shall have same protection configured.
          enumeration FlsLoaderPFSectorWriteProtection: {NO_PROTECTION, WRITE_PROTECTION, OTP_PROTECTION, WOP_PROTECTION}, origin=INFINEON_AURIX2G, set at pre-compile, default-value=NO_PROTECTION  # Sector Write protection.
    container FlsLoaderDFLASHConfig  # This container contains the configuration parameters and sub containers of the FlsLoader module.
      container FlsLoaderDFlash0ProtConfig  # DF protection configuration.
        enumeration FlsLoaderDF0Prot: {NO_PROTECTION, READ_PROTECTION, WRITE_PROTECTION}, origin=INFINEON_AURIX2G, set at pre-compile, default-value=NO_PROTECTION  # DF0 Read/Write protection.
        integer FlsLoaderDF0UcbPW0_0: 0..4294967295, origin=INFINEON_AURIX2G, set at pre-compile, default-value=0  # 1st least significant word password out of 8 words password
        integer FlsLoaderDF0UcbPW0_1: 0..4294967295, origin=INFINEON_AURIX2G, set at pre-compile, default-value=0  # 2nd least significant word password out of 8 words password
        integer FlsLoaderDF0UcbPW1_0: 0..4294967295, origin=INFINEON_AURIX2G, set at pre-compile, default-value=0  # 3rd least significant word password out of 8 words password
        integer FlsLoaderDF0UcbPW1_1: 0..4294967295, origin=INFINEON_AURIX2G, set at pre-compile, default-value=0  # 4th least significant word password out of 8 words password
        integer FlsLoaderDF0UcbPW2_0: 0..4294967295, origin=INFINEON_AURIX2G, set at pre-compile, default-value=0  # 5th least significant word password out of 8 words password
        integer FlsLoaderDF0UcbPW2_1: 0..4294967295, origin=INFINEON_AURIX2G, set at pre-compile, default-value=0  # 6th least significant word password out of 8 words password
        integer FlsLoaderDF0UcbPW3_0: 0..4294967295, origin=INFINEON_AURIX2G, set at pre-compile, default-value=0  # 7th least significant word password out of 8 words password
        integer FlsLoaderDF0UcbPW3_1: 0..4294967295, origin=INFINEON_AURIX2G, set at pre-compile, default-value=0  # Most significant word password out of 8 words password
    container CommonPublishedInformation  # Common container, aggregated by all modules. It contains published information about vendor and versions.
      integer ArMajorVersion: 0..255, origin=INFINEON_AURIX2G, set at published-information, default-value=4  # Major version number of AUTOSAR specification on which the appropriate implementation is based on.
      integer ArMinorVersion: 0..255, origin=INFINEON_AURIX2G, set at published-information, default-value=4  # Minor version number of AUTOSAR specification on which the appropriate implementation is based on.
      integer ArPatchVersion: 0..255, origin=INFINEON_AURIX2G, set at published-information, default-value=0  # Patch level version number of AUTOSAR specification on which the appropriate implementation is based on.
      integer SwMajorVersion: 0..255, origin=INFINEON_AURIX2G, set at published-information, default-value=20  # Major version number of the vendor specific implementation of the module. The numbering is vendor specific.
      integer SwMinorVersion: 0..255, origin=INFINEON_AURIX2G, set at published-information, default-value=20  # Minor version number of the vendor specific implementation of the module. The numbering is vendor specific.
      integer SwPatchVersion: 0..255, origin=INFINEON_AURIX2G, set at published-information, default-value=0  # Patch level version number of the vendor specific implementation of the module. The numbering is vendor specific.
      integer ModuleId: 0..65535, origin=INFINEON_AURIX2G, set at published-information, default-value=255  # Module ID of this module from Module List
      integer VendorId: 0..65535, origin=INFINEON_AURIX2G, set at published-information, default-value=17  # Vendor ID of the dedicated implementation of this module according to the AUTOSAR vendor list
      string Release: origin=INFINEON_AURIX2G, set at published-information, default-value=_TRICORE_TC397_ADAS  # Aurix2G derivative used for the implementation
