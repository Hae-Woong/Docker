AUTOSAR XML (schema 00046)
package /AURIX2G/EcucDefs
  module config Spi_Rec: definition=Spi
  bsw implementation Spi_Impl: programming-language=C, behavior=SpiBehavior, recommended-configuration=Spi_Rec, vendor-specific-module-def=Spi
