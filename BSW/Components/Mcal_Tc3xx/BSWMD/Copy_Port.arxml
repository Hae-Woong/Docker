AUTOSAR XML (schema 00046)
package /AURIX2G/EcucDefs
  module definition Port [0..1]: post-build-variant-support=true, refined-module-def=Port, variants post-build  # Configuration of the Port module.
    container PortConfigSet  # This container contains the configuration parameters and sub containers of the Port module.
      container PortContainer [15..15]  # Container collecting the PortPins.
        integer PortNumber: 0..40, origin=INFINEON_AURIX2G, set at pre-compile, default-value=0  # The specified port number of this PortContainer.
        integer PortNumberOfPortPins: 1..16, set at pre-compile, default-value=13  # The number of specified PortPins in this PortContainer.
        container PortPin [1..16]: multiplicity set at pre-compile  # Configuration of the individual port pins.
          integer PortPinId: 0..652, set at pre-compile, default-value=0  # Pin Id of the port pin. This value will be assigned to the symbolic name derived from the port pin container short name.
          string PortPinSymbolicName: origin=INFINEON_AURIX2G, set at pre-compile, default-value=PORT_0_PIN_0  # Symbolic name of the Port Pin.
          enumeration PortPinDirection: {PORT_PIN_IN, PORT_PIN_OUT}, post-build-variant-value=true, set at post-build, default-value=PORT_PIN_IN  # The initial direction of the pin (IN or OUT). If the direction is not changeable, the value configured here is fixed.
          boolean PortPinDirectionChangeable: post-build-variant-value=true, set at post-build, default-value=false  # Parameter to indicate if the direction is changeable on a port pin during runtime. true: Port Pin direction changeable enabled. false: Port Pin direction changeable disabled.
          enumeration PortPinInitialMode: {GPIO, ALT1, ALT2, ALT3, ALT4, ALT5, ALT6, ALT7}, post-build-variant-value=true, set at post-build, default-value=GPIO  # Port pin mode from mode list for use with Port_Init() function.
          enumeration PortPinLevelValue: {PORT_PIN_LEVEL_HIGH, PORT_PIN_LEVEL_LOW}, post-build-variant-value=true, set at post-build, default-value=PORT_PIN_LEVEL_LOW  # Port Pin Level value from Port pin list.
          enumeration PortPinMode [1..8]: {PORT_PIN_MODE_ALL, PORT_PIN_MODE_GPIO, PORT_PIN_MODE_ALT1, PORT_PIN_MODE_ALT2, PORT_PIN_MODE_ALT3, PORT_PIN_MODE_ALT4, PORT_PIN_MODE_ALT5, PORT_PIN_MODE_ALT6, PORT_PIN_MODE_ALT7}, multiplicity set at post-build, post-build-variant-multiplicity=true, post-build-variant-value=true, set at post-build, default-value=PORT_PIN_MODE_ALL  # Supported modes for Port pin from mode list.
          boolean PortPinModeChangeable: post-build-variant-value=true, set at post-build, default-value=false  # Parameter to indicate if the mode is changeable on a port pin during runtime. True: Port Pin mode changeable allowed. False: Port Pin mode changeable not permitted.
          enumeration PortPinInputPullResistor: {PORT_PIN_IN_PULL_UP, PORT_PIN_IN_PULL_DOWN, PORT_PIN_IN_NO_PULL}, origin=INFINEON_AURIX2G, post-build-variant-value=true, set at post-build, default-value=PORT_PIN_IN_PULL_UP  # Parameter to indicate to the driver what type of internal Pull resistor [up/down] is to be connected to the PORT Pin.
          enumeration PortPinOutputPadDriveStrength: {PORT_PIN_STRONG_DRIVER_SHARP_EDGE, PORT_PIN_STRONG_DRIVER_MEDIUM_EDGE, PORT_PIN_MEDIUM_DRIVER_SHARP_EDGE, PORT_PIN_MEDIUM_DRIVER, PORT_PIN_RGMII_DRIVER, PORT_PIN_DEFAULT_DRIVER}, origin=INFINEON_AURIX2G, post-build-variant-value=true, set at post-build, default-value=PORT_PIN_DEFAULT_DRIVER  # Parameter to configure the output drive strength and slew rate of a PORT pin.
          enumeration PortPinOutputPinDriveMode: {PORT_PIN_OUT_PUSHPULL, PORT_PIN_OUT_OPENDRAIN}, origin=INFINEON_AURIX2G, post-build-variant-value=true, set at post-build, default-value=PORT_PIN_OUT_PUSHPULL  # Parameter to indicate how the output of the pad is to be connected to the package pin.
          enumeration PortPinInputPadLevel: {PORT_INPUT_LEVEL_CMOS_AUTOMOTIVE, PORT_INPUT_LEVEL_TTL_3_3V, PORT_INPUT_LEVEL_TTL_5_0V, PORT_RGMII_INPUT}, origin=INFINEON_AURIX2G, post-build-variant-value=true, set at post-build, default-value=PORT_INPUT_LEVEL_CMOS_AUTOMOTIVE  # Parameter to select between TTL and automotive level for input function of Port Pin.
          enumeration PortPinEnableAnalogInputOnly: {PORT_PIN_ANALOG_INPUT_DISABLE, PORT_PIN_ANALOG_INPUT_ENABLE}, origin=INFINEON_AURIX2G, post-build-variant-value=true, set at post-build, default-value=PORT_PIN_ANALOG_INPUT_DISABLE  # This parameter allows configuration of the PDISC register. Range: ENABLE: Pin has support for Analog Input. DISABLE: Pin do not have support for Analog Input.
          boolean PortPinEmergencyStop: origin=INFINEON_AURIX2G, post-build-variant-value=true, set at post-build, default-value=false  # Parameter to enable/disable the Emergency Stop functionality of a pin configured as an output pin. With this feature enabled, an output pin will automatically be reconfigured as an input pin when emergency conditions are encountered.
          enumeration PortPinControllerSelect: {DISABLE, ENABLE}, origin=INFINEON_AURIX2G, post-build-variant-value=true, set at post-build, default-value=DISABLE  # With this feature enabled, certain controllers can be allowed to take control of certain ports [e.g. SCR, VADC, ETH and SMU].
          reference PortPinEcucPartitionRef [0..*]: scope=ECU, multiplicity set at pre-compile, post-build-variant-multiplicity=true, post-build-variant-value=true, set at pre-compile, destination=EcucPartition  # Maps the Port pin to zero a multiple ECUC partitions. The ECUC partitions referenced are a subset of the ECUC partitions where the Port driver is mapped to. Tags: atp.Status=draft
        container PortLVDS [0..4]: multiplicity set at pre-compile  # Configuration of the individual port pins.
          string PortLVDSPinPair: origin=INFINEON_AURIX2G, set at post-build, default-value=Pin_X_Pin_Y  # Parameter identifies the PortPinPair supporting the LVDS feature..
          enumeration PortLVDSRxEnController: {PORT_CONTROLLED, HSCT_CONTROLLED}, origin=INFINEON_AURIX2G, post-build-variant-value=true, set at post-build, default-value=PORT_CONTROLLED  # This parameter determines who controls the LVDS enable/disable function - PORT controlled or HSCT controlled.
          boolean PortLVDSRxPathEnable: origin=INFINEON_AURIX2G, post-build-variant-value=true, set at post-build, default-value=false  # This parameter specifies whether the Pin-Pair is in LVDS mode or CMOS mode.
          enumeration PortLVDSRxTerminationMode: {INTERNAL_TERMINATION, EXTERNAL_TERMINATION}, origin=INFINEON_AURIX2G, post-build-variant-value=true, set at post-build, default-value=INTERNAL_TERMINATION  # This parameter selects the internal load capacitance, EXTERNAL_TERMINATION selects external termination on the PCB, INTERNAL_TERMINATION selects an 100ohm Receiver internal termination
          enumeration PortLVDSMode: {LVDSH, LVDSM}, origin=INFINEON_AURIX2G, post-build-variant-value=true, set at post-build, default-value=LVDSH  # Parameter to select reduced frequency mode LVDS-M of the receiver
          enumeration PortLVDSPadSupply: {V3_3, V5_0}, origin=INFINEON_AURIX2G, post-build-variant-value=true, set at post-build, default-value=V3_3  # Parameter to select pad supply value
          enumeration PortLVDSTxEnController: {PORT_CONTROLLED, HSCT_CONTROLLED}, origin=INFINEON_AURIX2G, post-build-variant-value=true, set at post-build, default-value=PORT_CONTROLLED  # This parameter determines who controls the LVDS enable/disable function - PORT controlled or HSCT controlled.
          boolean PortLVDSTxPathEnable: origin=INFINEON_AURIX2G, post-build-variant-value=true, set at post-build, default-value=false  # This parameter specifies whether the Pin-Pair is in LVDS mode or CMOS mode.
          enumeration PortLVDSTxPowerDownPullDown: {ENABLE, DISABLE}, origin=INFINEON_AURIX2G, post-build-variant-value=true, set at post-build, default-value=DISABLE  # This parameter specifies the state of the Transmit Pull down resistor.
    container PortGeneral  # Module wide configuration parameters of the PORT driver.
      boolean PortDevErrorDetect: set at pre-compile, default-value=false  # Switches the Default Error Tracer (Det) detection and notification ON or OFF.
      boolean PortSetPinDirectionApi: set at pre-compile, default-value=false  # Pre-processor switch to enable / disable the use of the function Port_SetPinDirection().
      boolean PortSetPinModeApi: set at pre-compile, default-value=false  # Pre-processor switch to enable / disable the use of the function Port_SetPinMode().
      boolean PortVersionInfoApi: set at pre-compile, default-value=false  # Pre-processor switch to enable / disable the API to read out the modules version information.
      enumeration PortInitApiMode: {PORT_MCAL_USER1, PORT_MCAL_SUPERVISOR}, scope=ECU, origin=INFINEON_AURIX2G, set at pre-compile, default-value=PORT_MCAL_SUPERVISOR  # This configuration parameter defines the mode in which the Port Init API will be used.
      boolean PortSafetyEnable: origin=INFINEON_AURIX2G, set at pre-compile, default-value=true  # Enable/Disable the Safety check and all associated notifications.
      boolean PortInitCheckApi: origin=INFINEON_AURIX2G, set at pre-compile, default-value=false  # Adds / removes the service Port_InitCheck() from the code.
      reference PortEcucPartitionRef [0..*]: scope=ECU, multiplicity set at pre-compile, post-build-variant-multiplicity=true, post-build-variant-value=true, set at pre-compile, destination=EcucPartition  # Maps the Port driver to zero a multiple ECUC partitions to make the modules API available in this partition. Tags: atp.Status=draft
    container CommonPublishedInformation  # Common container, aggregated by all modules. It contains published information about vendor and versions.
      integer ArMajorVersion: 0..255, origin=INFINEON_AURIX2G, set at published-information, default-value=4  # Major version number of AUTOSAR specification on which the appropriate implementation is based on.
      integer ArMinorVersion: 0..255, origin=INFINEON_AURIX2G, set at published-information, default-value=4  # Minor version number of AUTOSAR specification on which the appropriate implementation is based on.
      integer ArPatchVersion: 0..255, origin=INFINEON_AURIX2G, set at published-information, default-value=0  # Patch level version number of AUTOSAR specification on which the appropriate implementation is based on.
      integer SwMajorVersion: 0..255, origin=INFINEON_AURIX2G, set at published-information, default-value=20  # Major version number of the vendor specific implementation of the module. The numbering is vendor specific.
      integer SwMinorVersion: 0..255, origin=INFINEON_AURIX2G, set at published-information, default-value=10  # Minor version number of the vendor specific implementation of the module. The numbering is vendor specific.
      integer SwPatchVersion: 0..255, origin=INFINEON_AURIX2G, set at published-information, default-value=0  # Patch level version number of the vendor specific implementation of the module. The numbering is vendor specific.
      integer ModuleId: 0..65535, origin=INFINEON_AURIX2G, set at published-information, default-value=124  # Module ID of this module from Module List
      integer VendorId: 0..65535, origin=INFINEON_AURIX2G, set at published-information, default-value=17  # Vendor ID of the dedicated implementation of this module according to the AUTOSAR vendor list
      string Release: origin=INFINEON_AURIX2G, set at published-information, default-value=_TRICORE_TC397_ADAS  # Aurix2G derivative used for the implementation
