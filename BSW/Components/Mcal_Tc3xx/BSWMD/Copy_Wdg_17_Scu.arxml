AUTOSAR XML (schema 00046)
package /AURIX2G/EcucDefs
  module definition Wdg [0..*]: post-build-variant-support=true, refined-module-def=Wdg, variants post-build  # Configuration of the Wdg (Watchdog driver) module.
    container WdgGeneral  # All general parameters of the watchdog driver are collected here.
      boolean WdgDevErrorDetect: set at pre-compile, default-value=false  # Switches the Default Error Tracer (Det) detection and notification ON or OFF.
      boolean WdgSafetyEnable: origin=INFINEON_AURIX2G, set at pre-compile, default-value=true  # Switches the Safety Error detection and notification ON or OFF.
      boolean WdgInitCheckApi: origin=INFINEON_AURIX2G, set at pre-compile, default-value=false  # Switches the Init Check API to ON or OFF.
      boolean WdgDisableAllowed: set at pre-compile, default-value=false  # This parameter is disabled. Instead, WdgCPUDisableAllowed is provided to enable/disable CPU specific Wdg for every CPU Wdg configured. Compile switch to allow / forbid disabling the watchdog driver during runtime.
      integer WdgIndex: 0..255, set at pre-compile, symbolic-name-value=true, default-value=0  # Represents the watchdog driver's ID so that it can be referenced by the watchdog interface.
      float WdgInitialTimeout: 0.001..65.535, set at pre-compile, default-value=5.0  # This parameter is disabled. Instead, WdgCPUInitialTimeout is provided as initial timeout for every CPU Wdg configured. This initial timeout (sec) for the trigger condition to be initialized during Init function. It shall be not larger than WdgMaxTimeout.
      float WdgMaxTimeout: 0.001..65.535, set at pre-compile, default-value=32.0  # This parameter is disabled. Instead, WdgCPUMaxTimeout is provided as maximum CPU specific Wdg timeout for every CPU Wdg configured. The maximum timeout (sec) to which the watchdog trigger condition can be initialized.
      enumeration WdgTriggerTimerSelection: {GTM_TIMER, STM_TIMER}, origin=INFINEON_AURIX2G, set at pre-compile, default-value=STM_TIMER  # Hardware timer used to service WDG during STC window period.
      enumeration WdgRunArea: {RAM, ROM}, set at pre-compile, default-value=ROM  # This feature is not provided by IFX.This parameter is disabled. Represents the watchdog driver execution area is either from ROM(Flash) or RAM as required with the particular microcontroller.
      function name WdgTriggerLocation: set at pre-compile, default-value=NULL_PTR  # This feature is not provided by IFX.This parameter is disabled.Location (memory address) of the watchdog trigger routine.
      enumeration WdgInitApiMode: {WDG_MCAL_SUPERVISOR, WDG_MCAL_USER1}, origin=INFINEON_AURIX2G, set at pre-compile, default-value=WDG_MCAL_SUPERVISOR  # This parameter selects the operating modes for WDG initialization API.
      enumeration WdgRuntimeApiMode: {WDG_MCAL_SUPERVISOR, WDG_MCAL_USER1}, origin=INFINEON_AURIX2G, set at pre-compile, default-value=WDG_MCAL_SUPERVISOR  # This parameter selects the operating modes for WDG runtime APIs
      boolean WdgVersionInfoApi: set at pre-compile, default-value=false  # Compile switch to enable / disable the version information API
      reference WdgEcucPartitionRef [0..1]: scope=ECU, multiplicity set at pre-compile, post-build-variant-multiplicity=true, post-build-variant-value=true, set at pre-compile, destination=EcucPartition  # Maps the Wdg driver to zero or one ECUC partitions to make the modules API available in this partition. Tags: atp.Status=draft
    container WdgSettingsConfig [1..6]: multiplicity set at pre-compile  # Configuration items for the different watchdog settings, including those for external watchdog hardware.
      integer WdgCoreId: 0..5, origin=INFINEON_AURIX2G, set at pre-compile, symbolic-name-value=true, default-value=0  # This parameter refers to CORE ID to which the watchdog settings belong
      boolean WdgCPUDisableAllowed: origin=INFINEON_AURIX2G, post-build-variant-value=true, set at post-build, default-value=false  # Core specific switch to allow / forbid disabling the watchdog driver during runtime.
      float WdgCPUInitialTimeout: 0.001..65.535, origin=INFINEON_AURIX2G, post-build-variant-value=true, set at post-build, default-value=5.0  # The initial timeout (sec) for the trigger condition to be initialized during Init function for a core. It shall be not larger than WdgMaxTimeout of the core.
      float WdgCPUMaxTimeout: 0.0..65.535, origin=INFINEON_AURIX2G, post-build-variant-value=true, set at post-build, default-value=32.0  # The maximum timeout (sec) to which the watchdog trigger condition can be initialized for a core.
      integer WdgCPUInitialPassword: 0..16383, origin=INFINEON_AURIX2G, post-build-variant-value=true, set at post-build, default-value=60  # Initial password for the password access.
      enumeration WdgDefaultMode: {WDGIF_FAST_MODE, WDGIF_OFF_MODE, WDGIF_SLOW_MODE}, post-build-variant-value=true, set at post-build, default-value=WDGIF_SLOW_MODE  # Default mode for watchdog driver initialization.
      reference WdgSystemClockRef: origin=INFINEON_AURIX2G, post-build-variant-value=true, set at post-build, destination=McuClockReferencePointConfig  # This parameter refers to the system clock configured using the Mcu_InitClock function. This parameter should refer to a valid McuClockSetting Configuration (/AURIX2G/EcucDefs/Mcu/McuModuleConfiguration/McuClockSettingConfig/McuClockReferencePointConfig) Also the WDG module will work correctly only for this system clock setting. No changes should be done to the system clock if WDG is to be kept functioning.
      container WdgExternalConfiguration [0..1]: multiplicity set at pre-compile, post-build-variant-multiplicity=true  # This configuration is not provided as the external watchdog is not supported by IFX.Configuration items for an external watchdog hardware
        choice reference WdgExternalContainerRef [0..1]: multiplicity set at post-build, post-build-variant-multiplicity=true, post-build-variant-value=true, set at post-build, destination=[DioChannelGroup, SpiSequence]  # Reference to either
      container WdgSettingsFast  # Hardware dependent settings for the watchdog drivers fast mode.
        float WdgFastModeTimeoutValue: 0.001..0.16777216, origin=INFINEON_AURIX2G, post-build-variant-value=true, set at post-build, default-value=0.01  # Fast mode timeout in seconds for WDT
      container WdgSettingsSlow  # Hardware dependent settings for the watchdog driver's "slow" mode.
        float WdgSlowModeTimeoutValue: 0.001..10.73741824, origin=INFINEON_AURIX2G, post-build-variant-value=true, set at post-build, default-value=0.02  # Slow mode timeout in seconds for WDT
      container WdgSettingsOff  # Hardware dependent settings for the watchdog driver's "off" mode.
      container WdgTriggerTimerSetting  # This container contains the configuration elements for configuring GTM\STM hardware
        float WdgSlowRefreshTime: 0.001..10.73741824, origin=INFINEON_AURIX2G, post-build-variant-value=true, set at post-build, default-value=0.015  # Slow mode Gtm/Stm callback period in seconds for WDT.
        float WdgFastRefreshTime: 0.001..0.16777216, origin=INFINEON_AURIX2G, post-build-variant-value=true, set at post-build, default-value=0.007  # Fast mode Gtm/Stm callback period in seconds for WDT.
        container GtmTimerConfiguration [0..1]: multiplicity set at pre-compile, post-build-variant-multiplicity=true  # This container contains the configuration elements for configuring GTM timer hardware.
          container GtmTimerOutputModuleConfiguration  # This container contains the TOM/ATOM channel Configuration for GTM.
            enumeration GtmTimerClockSelect: {GTM_FIXED_CLOCK_0, GTM_FIXED_CLOCK_1, GTM_FIXED_CLOCK_2, GTM_FIXED_CLOCK_3, GTM_FIXED_CLOCK_4, GTM_CONFIGURABLE_CLOCK_0, GTM_CONFIGURABLE_CLOCK_1, GTM_CONFIGURABLE_CLOCK_2, GTM_CONFIGURABLE_CLOCK_3, GTM_CONFIGURABLE_CLOCK_4, GTM_CONFIGURABLE_CLOCK_5, GTM_CONFIGURABLE_CLOCK_6, GTM_CONFIGURABLE_CLOCK_7}, origin=INFINEON_AURIX2G, post-build-variant-value=true, set at post-build, default-value=GTM_FIXED_CLOCK_0  # This parameter decides the Clock Source for GTM timer.
            choice reference GtmTimerUsed: scope=ECU, origin=INFINEON_AURIX2G, post-build-variant-value=true, set at post-build, destination=[McuGtmTomChannelAllocationConf, McuGtmAtomChannelAllocationConf]  # This parameter lists all the GTM timer channels (TOM/ATOM).
    container WdgDemEventParameterRefs [0..1]: multiplicity set at pre-compile  # Container for the references to DemEventParameter elements which shall be invoked using the API Mcal_Wrapper_Dem_SetEventStatus in case the corresponding error occurs. The EventId is taken from the referenced DemEventParameter's DemEventId value.
      reference WDG_E_DISABLE_REJECTED: multiplicity set at pre-compile, set at pre-compile, requires-symbolic-name-value=true, destination=DemEventParameter  # Reference to the DemEventParameter which shall be issued when the error "Initialization or mode switch failed because it would disable the watchdog" has occurred.
      reference WDG_E_MODE_FAILED: multiplicity set at pre-compile, set at pre-compile, requires-symbolic-name-value=true, destination=DemEventParameter  # Reference to the DemEventParameter which shall be issued when the error "Setting a watchdog mode failed (during initialization or mode switch)" has occurred.
    container WdgPublishedInformation  # Container holding all WDG specific published information parameters
      enumeration WdgTriggerMode: {WDG_BOTH, WDG_TOGGLE, WDG_WINDOW}, set at published-information, default-value=WDG_WINDOW  # Watchdog trigger mode (toggle/window/both)
    container CommonPublishedInformation  # Common container, aggregated by all modules. It contains published information about vendor and versions.
      integer ArMajorVersion: 0..255, origin=INFINEON_AURIX2G, set at published-information, default-value=4  # Major version number of AUTOSAR specification on which the appropriate implementation is based on.
      integer ArMinorVersion: 0..255, origin=INFINEON_AURIX2G, set at published-information, default-value=4  # Minor version number of AUTOSAR specification on which the appropriate implementation is based on.
      integer ArPatchVersion: 0..255, origin=INFINEON_AURIX2G, set at published-information, default-value=0  # Patch level version number of AUTOSAR specification on which the appropriate implementation is based on.
      integer SwMajorVersion: 0..255, origin=INFINEON_AURIX2G, set at published-information, default-value=20  # Major version number of the vendor specific implementation of the module. The numbering is vendor specific.
      integer SwMinorVersion: 0..255, origin=INFINEON_AURIX2G, set at published-information, default-value=25  # Minor version number of the vendor specific implementation of the module. The numbering is vendor specific.
      integer SwPatchVersion: 0..255, origin=INFINEON_AURIX2G, set at published-information, default-value=0  # Patch level version number of the vendor specific implementation of the module. The numbering is vendor specific.
      integer ModuleId: 0..65535, origin=INFINEON_AURIX2G, set at published-information, default-value=102  # Module ID of this module from Module List
      integer VendorId: 0..65535, origin=INFINEON_AURIX2G, set at published-information, default-value=17  # Vendor ID of the dedicated implementation of this module according to the AUTOSAR vendor list
      string Release: origin=INFINEON_AURIX2G, set at published-information, default-value=_TRICORE_TC397_ADAS  # Aurix2G derivative used for the implementation
      string VendorApiInfix: origin=INFINEON_AURIX2G, set at published-information, default-value=Scu  # In driver modules which can be instantiated several times on a single ECU, BSW00347 requires that the name of APIs is extended by the VendorId and a vendor specific name. This parameter is used to specify the vendor specific name. In total, the implementation specific name is generated as follows: <ModuleName>_>VendorId>_<VendorApiInfix><Api name from SWS>. E.g. assuming that the VendorId of the implementer is 17 and the implementer chose a VendorApiInfix of "Scu" a api name Wdg_SetMode defined in the SWS will translate to Wdg_17_Scu_SetMode. This parameter is mandatory for all modules with upper multiplicity > 1. It shall not be used for modules with upper multiplicity =1.
