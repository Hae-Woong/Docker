AUTOSAR XML (schema 00046)
package /AURIX2G/EcucDefs
  module config Ocu_Rec: definition=Ocu
  bsw implementation Ocu_Impl: programming-language=C, behavior=OcuBehavior, recommended-configuration=Ocu_Rec, vendor-specific-module-def=Ocu
