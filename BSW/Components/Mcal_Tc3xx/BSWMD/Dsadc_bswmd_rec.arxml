AUTOSAR XML (schema 00046)
package /AURIX2G/EcucDefs
  module config Dsadc_Rec: definition=Dsadc
  bsw implementation Dsadc_Impl: programming-language=C, behavior=DsadcBehavior, recommended-configuration=Dsadc_Rec, vendor-specific-module-def=Dsadc
