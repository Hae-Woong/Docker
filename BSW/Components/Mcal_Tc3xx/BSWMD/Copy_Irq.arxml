AUTOSAR XML (schema 00046)
package /AURIX2G/EcucDefs
  module definition Irq [0..1]: variants pre-compile  # Configuration of the Irq module.
    container IrqGeneral  # Interrupt Module global settings and module specific settings are present in this container
      boolean IrqOsekEnable: origin=INFINEON_AURIX2G, set at pre-compile, default-value=false  # Parameter to identify the use of OS. This controls the available configuration options for Interrupt Category.
    container IrqGPT120Config  # This container contains the GPT120 module interrupt nodes configuration parameters.
      container IrqGPT120CatConfig  # This container contains parameters to configure the interrupt category of all SRN supported by GPT120 module.
        enumeration Irq_GPT120CIRQ_Cat: {CAT1, CAT2}, origin=INFINEON_AURIX2G, set at pre-compile, default-value=CAT1  # The interrupt category setting of GPT120_CIRQ SRN. Depending upon the category the interrupt Frame is different.
        enumeration Irq_GPT120T{2..6}_Cat: {CAT1, CAT2}, origin=INFINEON_AURIX2G, set at pre-compile, default-value=CAT1  # The interrupt category setting of GPT120_T{2..6} SRN. Depending upon the category the interrupt Frame is different.
      container IrqGPT120PrioConfig  # This container contains the parameter to configure the priority of all the SRN supported by GPT120 module.
        integer Irq_GPT120CIRQ_Prio: 0..255, origin=INFINEON_AURIX2G, set at pre-compile, default-value=0  # The interrupt priority setting of GPT120_CIRQ of GPT120 Module.
        integer Irq_GPT120T{2..6}_Prio: 0..255, origin=INFINEON_AURIX2G, set at pre-compile, default-value=0  # The interrupt priority setting of GPT120_T{2..6} of GPT120 Module.
      container IrqGPT120TosConfig  # This container contains the parameter to configure the type of service providers of all SRN supported by GPT120 module.
        enumeration Irq_GPT120CIRQ_Tos: {CPU0, CPU1, CPU2, CPU3, CPU4, CPU5, DMA}, origin=INFINEON_AURIX2G, set at pre-compile, default-value=CPU0  # The interrupt type of service provider setting of GPT120_CIRQ of GPT120 Module.
        enumeration Irq_GPT120T{2..6}_Tos: {CPU0, CPU1, CPU2, CPU3, CPU4, CPU5, DMA}, origin=INFINEON_AURIX2G, set at pre-compile, default-value=CPU0  # The interrupt type of service provider setting of GPT120_T2 of GPT120 Module.
    container IrqQSPIConfig  # This container contains the QSPI module interrupt nodes configuration parameters.
      container IrqQspiCatConfig  # This container contains parameters to configure the interrupt category of all SRN supported by QSPI module.
        container IrqQspiTxCatConfig  # This container contains the parameter to configure the category of all the Transmit SRN supported by Qspi module.
          enumeration IrqQspi{0..5}TxCat: {CAT1, CAT2}, origin=INFINEON_AURIX2G, set at pre-compile, default-value=CAT1  # The interrupt category setting of SRNTx of Qspi{0..5} Module. Depending upon the category the interrupt Frame is different.
        container IrqQspiRxCatConfig  # This container contains the parameter to configure the category of all the Receive SRN supported by Qspi module.
          enumeration IrqQspi{0..5}RxCat: {CAT1, CAT2}, origin=INFINEON_AURIX2G, set at pre-compile, default-value=CAT1  # The interrupt category setting of SRNRx of Qspi{0..5} Module. Depending upon the category the interrupt Frame is different.
        container IrqQspiErrCatConfig  # This container contains the parameter to configure the category of all the Error SRN supported by Qspi module.
          enumeration IrqQspi{0..5}ErrCat: {CAT1, CAT2}, origin=INFINEON_AURIX2G, set at pre-compile, default-value=CAT1  # The interrupt category setting of SRN Err of Qspi{0..5} Module. Depending upon the category the interrupt Frame is different.
        container IrqQspiPTCatConfig  # This container contains the parameter to configure the category of all the Phase Transition SRN supported by Qspi module.
          enumeration IrqQspi{0..5}PTCat: {CAT1, CAT2}, origin=INFINEON_AURIX2G, set at pre-compile, default-value=CAT1  # The interrupt category setting of SRNPT of Qspi{0..5} Module. Depending upon the category the interrupt Frame is different.
        container IrqQspiHCCatConfig  # This container contains the parameter to configure the category of all the Half Cycle SRN supported by Qspi module.
          enumeration IrqQspi2HCCat: {CAT1, CAT2}, origin=INFINEON_AURIX2G, set at pre-compile, default-value=CAT1  # The interrupt category setting of SRNHC of Qspi2 Module. Depending upon the category the interrupt Frame is different.
          enumeration IrqQspi3HCCat: {CAT1, CAT2}, origin=INFINEON_AURIX2G, set at pre-compile, default-value=CAT1  # The interrupt category setting of SRNHC of Qspi3 Module. Depending upon the category the interrupt Frame is different.
        container IrqQspiUDCatConfig  # This container contains the parameter to configure the category of all the User Defined SRN supported by Qspi module.
          enumeration IrqQspi{0..5}UDCat: {CAT1, CAT2}, origin=INFINEON_AURIX2G, set at pre-compile, default-value=CAT1  # The interrupt category setting of SRNU of Qspi{0..5} Module. Depending upon the category the interrupt Frame is different.
      container IrqQspiPrioConfig  # This container contains the parameter to configure the priority of all the SRN supported by Qspi module.
        container IrqQspiTxPrioConfig  # This container contains the parameter to configure the priority of all the Transmit SRN supported by Qspi module.
          integer IrqQspi{0..5}TxPrio: 0..255, origin=INFINEON_AURIX2G, set at pre-compile, default-value=0  # The interrupt priority setting of SRNTx of Qspi{0..5}. The SRN number indicates the SRN configured.
        container IrqQspiRxPrioConfig  # This container contains the parameter to configure the priority of all the Receive SRN supported by Qspi module.
          integer IrqQspi{0..5}RxPrio: 0..255, origin=INFINEON_AURIX2G, set at pre-compile, default-value=0  # The interrupt priority setting of SRNRx of AscLin{0..5}. The SRN number indicates the SRN configured.
        container IrqQspiErrPrioConfig  # This container contains the parameter to configure the priority of all the Error SRN supported by Qspi module.
          integer IrqQspi{0..5}ErrPrio: 0..255, origin=INFINEON_AURIX2G, set at pre-compile, default-value=0  # The interrupt priority setting of SRN Error of Qspi{0..5}. The SRN number indicates the SRN configured.
        container IrqQspiPTPrioConfig  # This container contains the parameter to configure the priority of all the Phase Transmission SRN supported by Qspi module.
          integer IrqQspi{0..5}PTPrio: 0..255, origin=INFINEON_AURIX2G, set at pre-compile, default-value=0  # The interrupt priority setting of SRNPT of Qspi{0..5}. The SRN number indicates the SRN configured.
        container IrqQspiHCPrioConfig  # This container contains the parameter to configure the priority of all the Half Cycle SRN supported by Qspi module.
          integer IrqQspi2HCPrio: 0..255, origin=INFINEON_AURIX2G, set at pre-compile, default-value=0  # The interrupt priority setting of SRNHC of Qspi2. The SRN number indicates the SRN configured.
          integer IrqQspi3HCPrio: 0..255, origin=INFINEON_AURIX2G, set at pre-compile, default-value=0  # The interrupt priority setting of SRNHC of Qspi3. The SRN number indicates the SRN configured.
        container IrqQspiUDPrioConfig  # This container contains the parameter to configure the priority of all the User Defined SRN supported by Qspi module.
          integer IrqQspi{0..5}UDPrio: 0..255, origin=INFINEON_AURIX2G, set at pre-compile, default-value=0  # The interrupt priority setting of SRNUD of Qspi{0..5}. The SRN number indicates the SRN configured.
      container IrqQspiTosConfig  # This container contains the Qspi interrupt configuration parameters.
        container IrqQspiTxTosConfig  # This container contains the parameter to configure the Type of service of all the Transmit SRN supported by Qspi module.
          enumeration IrqQspi{0..5}TxTos: {CPU0, CPU1, CPU2, CPU3, CPU4, CPU5, DMA}, origin=INFINEON_AURIX2G, set at pre-compile, default-value=CPU0  # The interrupt type of service setting of SRNTx of Qspi{0..5} Module.
        container IrqQspiRxTosConfig  # This container contains the parameter to configure the Type of service of all the Transmit SRN supported by Qspi module.
          enumeration IrqQspi{0..5}RxTos: {CPU0, CPU1, CPU2, CPU3, CPU4, CPU5, DMA}, origin=INFINEON_AURIX2G, set at pre-compile, default-value=CPU0  # The interrupt type of service setting of SRNRx of Qspi{0..5} Module.
        container IrqQspiErrTosConfig  # This container contains the parameter to configure the Type of service of all the Transmit SRN supported by Qspi module.
          enumeration IrqQspi{0..5}ErrTos: {CPU0, CPU1, CPU2, CPU3, CPU4, CPU5, DMA}, origin=INFINEON_AURIX2G, set at pre-compile, default-value=CPU0  # The interrupt type of service setting of SRN Err of Qspi{0..5} Module.
        container IrqQspiPTTosConfig  # This container contains the parameter to configure the Type of service of all the Transmit SRN supported by Qspi module.
          enumeration IrqQspi{0..5}PTTos: {CPU0, CPU1, CPU2, CPU3, CPU4, CPU5, DMA}, origin=INFINEON_AURIX2G, set at pre-compile, default-value=CPU0  # The intPTupt type of service setting of SRNPT of Qspi{0..5} Module.
        container IrqQspiHCTosConfig  # This container contains the parameter to configure the Type of service of all the Transmit SRN supported by Qspi module.
          enumeration IrqQspi2HCTos: {CPU0, CPU1, CPU2, CPU3, CPU4, CPU5, DMA}, origin=INFINEON_AURIX2G, set at pre-compile, default-value=CPU0  # The intHCuHC type of service setting of SRNHC of Qspi2 Module.
          enumeration IrqQspi3HCTos: {CPU0, CPU1, CPU2, CPU3, CPU4, CPU5, DMA}, origin=INFINEON_AURIX2G, set at pre-compile, default-value=CPU0  # The intHCuHC type of service setting of SRNHC of Qspi3 Module.
        container IrqQspiUDTosConfig  # This container contains the parameter to configure the Type of service of all the Transmit SRN supported by Qspi module.
          enumeration IrqQspi{0..5}UDTos: {CPU0, CPU1, CPU2, CPU3, CPU4, CPU5, DMA}, origin=INFINEON_AURIX2G, set at pre-compile, default-value=CPU0  # The intUDuUD type of service setting of SRNUD of Qspi{0..5} Module.
    container IrqDmaConfig  # This container contains the Dma interrupt configuration parameters.
      container IrqDmaCatConfig  # This container contains the parameter to configure the category of all the SRN supported by Dma module.
        enumeration IrqDmaErr{0..3}SRCat: {CAT1, CAT2}, origin=INFINEON_AURIX2G, set at pre-compile, default-value=CAT1  # The interrupt category setting of DMA Error Service Reuest. Depending upon the category the interrupt Frame is different.
        enumeration IrqDmaCh{0..127}SRCat: {CAT1, CAT2}, origin=INFINEON_AURIX2G, set at pre-compile, default-value=CAT1  # The interrupt category setting of DMA Channel {0..127} Service Request. Depending upon the category the interrupt Frame is different.
      container IrqDmaPrioConfig  # This container contains the parameter to configure the priority of all the SRN supported by Dma module.
        integer IrqDmaErr{0..3}SRPrio: 0..255, origin=INFINEON_AURIX2G, set at pre-compile, default-value=0  # The interrupt priority setting of DMA Error Service Reuest.The SRN number indicates the SRN configured
        integer IrqDmaCh{0..127}SRPrio: 0..255, origin=INFINEON_AURIX2G, set at pre-compile, default-value=0  # The interrupt priority setting of DMA Channel {0..127} Service Request.The SRN number indicates the SRN configured
      container IrqDmaTosConfig  # This container contains the parameter to configure the type of service of all the SRN supported by Dma module.
        enumeration IrqDmaErr{0..3}SRTos: {CPU0, CPU1, CPU2, CPU3, CPU4, CPU5, DMA}, origin=INFINEON_AURIX2G, set at pre-compile, default-value=CPU0  # The interrupt type of service setting of DMA Error Service Reuest.
        enumeration IrqDmaCh{0..127}SRTos: {CPU0, CPU1, CPU2, CPU3, CPU4, CPU5, DMA}, origin=INFINEON_AURIX2G, set at pre-compile, default-value=CPU0  # The interrupt type of service setting of DMA Channel {0..127} Service Request.
    container IrqGPSRGroupConfig  # This container contains the GPSRGroup interrupt configuration parameters.
      container Irq_GPSRGroup0_Config  # This container contains the General Purpose Service Request Group 0 interrupt configuration parameters.
        container Irq_GPSRGroup0Cat_Config  # This container contains the parameter to configure the category of all the SRN supported by General Purpose Service Request Group 0.
          enumeration Irq_GPSRGroup0SR{0..7}_Cat: {CAT1, CAT2}, origin=INFINEON_AURIX2G, set at pre-compile, default-value=CAT1  # The interrupt category setting of SRN0 of General Purpose Service Request Group 0. Depending upon the category the interrupt Frame is different.
        container Irq_GPSRGroup0Prio_Config  # This container contains the parameter to configure the priority of all the SRN supported by General Purpose Service Request Group 0.
          integer Irq_GPSRGroup0SR{0..3}_Prio: 0..255, origin=INFINEON_AURIX2G, set at pre-compile, default-value=0  # The interrupt priority setting of SRN{0..3} of General Purpose Service Request Group 0.
          integer Irq_GPSRGroup0SR{4..7}_Prio: 0..255, origin=INFINEON_AURIX2G, set at pre-compile, default-value=0  # The interrupt priority setting of SRN3 of General Purpose Service Request Group 0.
        container Irq_GPSRGroup0Tos_Config  # This container contains the parameter to configure the type of service of all the SRN supported by General Purpose Service Request Group 0.
          enumeration Irq_GPSRGroup0SR{0..7}_Tos: {CPU0, CPU1, CPU2, CPU3, CPU4, CPU5, DMA}, origin=INFINEON_AURIX2G, set at pre-compile, default-value=CPU0  # The interrupt type of service setting of SRN0 of General Purpose Service Request Group 0.
      container Irq_GPSRGroup1_Config  # This container contains the General Purpose Service Request Group 1 interrupt configuration parameters.
        container Irq_GPSRGroup1Cat_Config  # This container contains the parameter to configure the category of all the SRN supported by General Purpose Service Request Group 1.
          enumeration Irq_GPSRGroup1SR{0..7}_Cat: {CAT1, CAT2}, origin=INFINEON_AURIX2G, set at pre-compile, default-value=CAT1  # The interrupt category setting of SRN0 of General Purpose Service Request Group 1. Depending upon the category the interrupt Frame is different.
        container Irq_GPSRGroup1Prio_Config  # This container contains the parameter to configure the priority of all the SRN supported by General Purpose Service Request Group 1.
          integer Irq_GPSRGroup1SR{0..3}_Prio: 0..255, origin=INFINEON_AURIX2G, set at pre-compile, default-value=0  # The interrupt priority setting of SRN{0..3} of General Purpose Service Request Group 1.
          integer Irq_GPSRGroup1SR{4..7}_Prio: 0..255, origin=INFINEON_AURIX2G, set at pre-compile, default-value=0  # The interrupt priority setting of SRN3 of General Purpose Service Request Group 1.
        container Irq_GPSRGroup1Tos_Config  # This container contains the parameter to configure the type of service of all the SRN supported by General Purpose Service Request Group 1.
          enumeration Irq_GPSRGroup1SR{0..7}_Tos: {CPU0, CPU1, CPU2, CPU3, CPU4, CPU5, DMA}, origin=INFINEON_AURIX2G, set at pre-compile, default-value=CPU0  # The interrupt type of service setting of SRN0 of General Purpose Service Request Group 1.
      container Irq_GPSRGroup2_Config  # This container contains the General Purpose Service Request Group 2 interrupt configuration parameters.
        container Irq_GPSRGroup2Cat_Config  # This container contains the parameter to configure the category of all the SRN supported by General Purpose Service Request Group 2.
          enumeration Irq_GPSRGroup2SR{0..7}_Cat: {CAT1, CAT2}, origin=INFINEON_AURIX2G, set at pre-compile, default-value=CAT1  # The interrupt category setting of SRN0 of General Purpose Service Request Group 2. Depending upon the category the interrupt Frame is different.
        container Irq_GPSRGroup2Prio_Config  # This container contains the parameter to configure the priority of all the SRN supported by General Purpose Service Request Group 2.
          integer Irq_GPSRGroup2SR{0..3}_Prio: 0..255, origin=INFINEON_AURIX2G, set at pre-compile, default-value=0  # The interrupt priority setting of SRN{0..3} of General Purpose Service Request Group 2.
          integer Irq_GPSRGroup2SR{4..7}_Prio: 0..255, origin=INFINEON_AURIX2G, set at pre-compile, default-value=0  # The interrupt priority setting of SRN3 of General Purpose Service Request Group 2.
        container Irq_GPSRGroup2Tos_Config  # This container contains the parameter to configure the type of service of all the SRN supported by General Purpose Service Request Group 2.
          enumeration Irq_GPSRGroup2SR{0..7}_Tos: {CPU0, CPU1, CPU2, CPU3, CPU4, CPU5, DMA}, origin=INFINEON_AURIX2G, set at pre-compile, default-value=CPU0  # The interrupt type of service setting of SRN0 of General Purpose Service Request Group 2.
      container Irq_GPSRGroup3_Config  # This container contains the General Purpose Service Request Group 3 interrupt configuration parameters.
        container Irq_GPSRGroup3Cat_Config  # This container contains the parameter to configure the category of all the SRN supported by General Purpose Service Request Group 3.
          enumeration Irq_GPSRGroup3SR{0..7}_Cat: {CAT1, CAT2}, origin=INFINEON_AURIX2G, set at pre-compile, default-value=CAT1  # The interrupt category setting of SRN0 of General Purpose Service Request Group 3. Depending upon the category the interrupt Frame is different.
        container Irq_GPSRGroup3Prio_Config  # This container contains the parameter to configure the priority of all the SRN supported by General Purpose Service Request Group 3.
          integer Irq_GPSRGroup3SR{0..3}_Prio: 0..255, origin=INFINEON_AURIX2G, set at pre-compile, default-value=0  # The interrupt priority setting of SRN{0..3} of General Purpose Service Request Group 3.
          integer Irq_GPSRGroup3SR{4..7}_Prio: 0..255, origin=INFINEON_AURIX2G, set at pre-compile, default-value=0  # The interrupt priority setting of SRN3 of General Purpose Service Request Group 3.
        container Irq_GPSRGroup3Tos_Config  # This container contains the parameter to configure the type of service of all the SRN supported by General Purpose Service Request Group 3.
          enumeration Irq_GPSRGroup3SR{0..7}_Tos: {CPU0, CPU1, CPU2, CPU3, CPU4, CPU5, DMA}, origin=INFINEON_AURIX2G, set at pre-compile, default-value=CPU0  # The interrupt type of service setting of SRN0 of General Purpose Service Request Group 3.
      container Irq_GPSRGroup4_Config  # This container contains the General Purpose Service Request Group 4 interrupt configuration parameters.
        container Irq_GPSRGroup4Cat_Config  # This container contains the parameter to configure the category of all the SRN supported by General Purpose Service Request Group 4.
          enumeration Irq_GPSRGroup4SR{0..7}_Cat: {CAT1, CAT2}, origin=INFINEON_AURIX2G, set at pre-compile, default-value=CAT1  # The interrupt category setting of SRN0 of General Purpose Service Request Group 4. Depending upon the category the interrupt Frame is different.
        container Irq_GPSRGroup4Prio_Config  # This container contains the parameter to configure the priority of all the SRN supported by General Purpose Service Request Group 4.
          integer Irq_GPSRGroup4SR{0..3}_Prio: 0..255, origin=INFINEON_AURIX2G, set at pre-compile, default-value=0  # The interrupt priority setting of SRN{0..3} of General Purpose Service Request Group 4.
          integer Irq_GPSRGroup4SR{4..7}_Prio: 0..255, origin=INFINEON_AURIX2G, set at pre-compile, default-value=0  # The interrupt priority setting of SRN3 of General Purpose Service Request Group 4.
        container Irq_GPSRGroup4Tos_Config  # This container contains the parameter to configure the type of service of all the SRN supported by General Purpose Service Request Group 4.
          enumeration Irq_GPSRGroup4SR{0..7}_Tos: {CPU0, CPU1, CPU2, CPU3, CPU4, CPU5, DMA}, origin=INFINEON_AURIX2G, set at pre-compile, default-value=CPU0  # The interrupt type of service setting of SRN0 of General Purpose Service Request Group 4.
      container Irq_GPSRGroup5_Config  # This container contains the General Purpose Service Request Group 5 interrupt configuration parameters.
        container Irq_GPSRGroup5Cat_Config  # This container contains the parameter to configure the category of all the SRN supported by General Purpose Service Request Group 5.
          enumeration Irq_GPSRGroup5SR{0..7}_Cat: {CAT1, CAT2}, origin=INFINEON_AURIX2G, set at pre-compile, default-value=CAT1  # The interrupt category setting of SRN0 of General Purpose Service Request Group 5. Depending upon the category the interrupt Frame is different.
        container Irq_GPSRGroup5Prio_Config  # This container contains the parameter to configure the priority of all the SRN supported by General Purpose Service Request Group 5.
          integer Irq_GPSRGroup5SR{0..3}_Prio: 0..255, origin=INFINEON_AURIX2G, set at pre-compile, default-value=0  # The interrupt priority setting of SRN{0..3} of General Purpose Service Request Group 5.
          integer Irq_GPSRGroup5SR{4..7}_Prio: 0..255, origin=INFINEON_AURIX2G, set at pre-compile, default-value=0  # The interrupt priority setting of SRN3 of General Purpose Service Request Group 5.
        container Irq_GPSRGroup5Tos_Config  # This container contains the parameter to configure the type of service of all the SRN supported by General Purpose Service Request Group 5.
          enumeration Irq_GPSRGroup5SR{0..7}_Tos: {CPU0, CPU1, CPU2, CPU3, CPU4, CPU5, DMA}, origin=INFINEON_AURIX2G, set at pre-compile, default-value=CPU0  # The interrupt type of service setting of SRN0 of General Purpose Service Request Group 5.
    container IrqFlexRayConfig  # This container contains the FlexRay interrupt configuration parameters.
      container Irq_FlexRay0_Config  # This container contains the FlexRay0 interrupt configuration parameters.
        container Irq_FlexRay0Cat_Config  # This container contains the FlexRay0 category configuration parameters.
          enumeration Irq_FlexRay0INT0_Cat: {CAT1, CAT2}, origin=INFINEON_AURIX2G, set at pre-compile, default-value=CAT1  # The interrupt category setting of INT0 of FlexRay0 Module. The SR number indicates the SRN configured. Depending upon the category the interrupt Frame is different.
          enumeration Irq_FlexRay0INT1_Cat: {CAT1, CAT2}, origin=INFINEON_AURIX2G, set at pre-compile, default-value=CAT1  # The interrupt category setting of INT1 of FlexRay0 Module. The SR number indicates the SRN configured. Depending upon the category the interrupt Frame is different.
          enumeration Irq_FlexRay0TimerInt0_Cat: {CAT1, CAT2}, origin=INFINEON_AURIX2G, set at pre-compile, default-value=CAT1  # The interrupt category setting of Timer Interrupt 0 Service request of FlexRay0 Module. Depending upon the category the interrupt Frame is different.
          enumeration Irq_FlexRay0TimerInt1_Cat: {CAT1, CAT2}, origin=INFINEON_AURIX2G, set at pre-compile, default-value=CAT1  # The interrupt category setting of Timer Interrupt 1 Service request of FlexRay0 Module. Depending upon the category the interrupt Frame is different.
          enumeration Irq_FlexRay0NewData0_Cat: {CAT1, CAT2}, origin=INFINEON_AURIX2G, set at pre-compile, default-value=CAT1  # The interrupt category setting of New Data 0 Service request of FlexRay0 Module. Depending upon the category the interrupt Frame is different.
          enumeration Irq_FlexRay0NewData1_Cat: {CAT1, CAT2}, origin=INFINEON_AURIX2G, set at pre-compile, default-value=CAT1  # The interrupt category setting of New Data 1 Service request of FlexRay0 Module. Depending upon the category the interrupt Frame is different.
          enumeration Irq_FlexRay0MBSC0_Cat: {CAT1, CAT2}, origin=INFINEON_AURIX2G, set at pre-compile, default-value=CAT1  # The interrupt category setting of Message Buffer Status Changed 0 Service Request of FlexRay0 Module. Depending upon the category the interrupt Frame is different.
          enumeration Irq_FlexRay0MBSC1_Cat: {CAT1, CAT2}, origin=INFINEON_AURIX2G, set at pre-compile, default-value=CAT1  # The interrupt category setting of Message Buffer Status Changed 1 Service Request of FlexRay0 Module. Depending upon the category the interrupt Frame is different.
          enumeration Irq_FlexRay0OBusy_Cat: {CAT1, CAT2}, origin=INFINEON_AURIX2G, set at pre-compile, default-value=CAT1  # The interrupt category setting of Output Buffer Busy Service Request of FlexRay0 Module. Depending upon the category the interrupt Frame is different.
          enumeration Irq_FlexRay0IBusy_Cat: {CAT1, CAT2}, origin=INFINEON_AURIX2G, set at pre-compile, default-value=CAT1  # The interrupt category setting of Input Buffer Busy Service Request of FlexRay0 Module. Depending upon the category the interrupt Frame is different.
        container Irq_FlexRay0Prio_Config  # This container contains the FlexRay0 priority configuration parameters.
          integer Irq_FlexRay0INT0_Prio: 0..255, origin=INFINEON_AURIX2G, set at pre-compile, default-value=0  # The interrupt priority setting of INT0 of the FlexRay0.
          integer Irq_FlexRay0INT1_Prio: 0..255, origin=INFINEON_AURIX2G, set at pre-compile, default-value=0  # The interrupt priority setting of INT1 of the FlexRay0.
          integer Irq_FlexRay0TimerInt0_Prio: 0..255, origin=INFINEON_AURIX2G, set at pre-compile, default-value=0  # The interrupt priority setting of SRN2 of the FlexRay0.
          integer Irq_FlexRay0TimerInt1_Prio: 0..255, origin=INFINEON_AURIX2G, set at pre-compile, default-value=0  # The interrupt priority setting of SRN3 of the FlexRay0.
          integer Irq_FlexRay0NewData0_Prio: 0..255, origin=INFINEON_AURIX2G, set at pre-compile, default-value=0  # The interrupt priority setting of SRN4 of the FlexRay0.
          integer Irq_FlexRay0NewData1_Prio: 0..255, origin=INFINEON_AURIX2G, set at pre-compile, default-value=0  # The interrupt priority setting of SRN5 of the FlexRay0.
          integer Irq_FlexRay0MBSC0_Prio: 0..255, origin=INFINEON_AURIX2G, set at pre-compile, default-value=0  # The interrupt priority setting of SRN6 of the FlexRay0.
          integer Irq_FlexRay0MBSC1_Prio: 0..255, origin=INFINEON_AURIX2G, set at pre-compile, default-value=0  # The interrupt priority setting of SRN7 of the FlexRay0.
          integer Irq_FlexRay0OBusy_Prio: 0..255, origin=INFINEON_AURIX2G, set at pre-compile, default-value=0  # The interrupt priority setting of SRN8 of the FlexRay0.
          integer Irq_FlexRay0IBusy_Prio: 0..255, origin=INFINEON_AURIX2G, set at pre-compile, default-value=0  # The interrupt priority setting of SRN9 of the FlexRay0.
        container Irq_FlexRay0Tos_Config  # This container contains the FlexRay0 Type of Service configuration parameters.
          enumeration Irq_FlexRay0INT0_Tos: {CPU0, CPU1, CPU2, CPU3, CPU4, CPU5, DMA}, origin=INFINEON_AURIX2G, set at pre-compile, default-value=CPU0  # The interrupt type of service setting of INT0 of FlexRay0 Module.
          enumeration Irq_FlexRay0INT1_Tos: {CPU0, CPU1, CPU2, CPU3, CPU4, CPU5, DMA}, origin=INFINEON_AURIX2G, set at pre-compile, default-value=CPU0  # The interrupt type of service setting of INT1 of FlexRay0 Module.
          enumeration Irq_FlexRay0TimerInt0_Tos: {CPU0, CPU1, CPU2, CPU3, CPU4, CPU5, DMA}, origin=INFINEON_AURIX2G, set at pre-compile, default-value=CPU0  # The interrupt type of service setting of Timer Interrupt 0 Service request of FlexRay0 Module.
          enumeration Irq_FlexRay0TimerInt1_Tos: {CPU0, CPU1, CPU2, CPU3, CPU4, CPU5, DMA}, origin=INFINEON_AURIX2G, set at pre-compile, default-value=CPU0  # The interrupt type of service setting of Timer Interrupt 1 Service request of FlexRay0 Module.
          enumeration Irq_FlexRay0NewData0_Tos: {CPU0, CPU1, CPU2, CPU3, CPU4, CPU5, DMA}, origin=INFINEON_AURIX2G, set at pre-compile, default-value=CPU0  # The interrupt type of service setting of New Data 0 Service request of FlexRay0 Module.
          enumeration Irq_FlexRay0NewData1_Tos: {CPU0, CPU1, CPU2, CPU3, CPU4, CPU5, DMA}, origin=INFINEON_AURIX2G, set at pre-compile, default-value=CPU0  # The interrupt type of service setting of New Data 1 Service request of FlexRay0 Module.
          enumeration Irq_FlexRay0MBSC0_Tos: {CPU0, CPU1, CPU2, CPU3, CPU4, CPU5, DMA}, origin=INFINEON_AURIX2G, set at pre-compile, default-value=CPU0  # The interrupt type of service setting of Message Buffer Status Changed 0 Service request of FlexRay0 Module.
          enumeration Irq_FlexRay0MBSC1_Tos: {CPU0, CPU1, CPU2, CPU3, CPU4, CPU5, DMA}, origin=INFINEON_AURIX2G, set at pre-compile, default-value=CPU0  # The interrupt type of service setting of Message Buffer Status Changed 1 Service request of FlexRay0 Module.
          enumeration Irq_FlexRay0OBusy_Tos: {CPU0, CPU1, CPU2, CPU3, CPU4, CPU5, DMA}, origin=INFINEON_AURIX2G, set at pre-compile, default-value=CPU0  # The interrupt type of service setting of Output Buffer Busy Service request of FlexRay0 Module.
          enumeration Irq_FlexRay0IBusy_Tos: {CPU0, CPU1, CPU2, CPU3, CPU4, CPU5, DMA}, origin=INFINEON_AURIX2G, set at pre-compile, default-value=CPU0  # The interrupt type of service setting of Input Buffer Busy Service request of FlexRay0 Module.
      container Irq_FlexRay1_Config  # This container contains the FlexRay0 interrupt configuration parameters.
        container Irq_FlexRay1Cat_Config  # This container contains the FlexRay1 category configuration parameters.
          enumeration Irq_FlexRay1INT0_Cat: {CAT1, CAT2}, origin=INFINEON_AURIX2G, set at pre-compile, default-value=CAT1  # The interrupt category setting of SRN1 of FlexRay1 Module. The SR number indicates the SRN configured. Depending upon the category the interrupt Frame is different.
          enumeration Irq_FlexRay1INT1_Cat: {CAT1, CAT2}, origin=INFINEON_AURIX2G, set at pre-compile, default-value=CAT1  # The interrupt category setting of SRN1 of FlexRay1 Module. The SR number indicates the SRN configured. Depending upon the category the interrupt Frame is different.
          enumeration Irq_FlexRay1TimerInt0_Cat: {CAT1, CAT2}, origin=INFINEON_AURIX2G, set at pre-compile, default-value=CAT1  # The interrupt category setting of Timer Interrupt 0 Service request of FlexRay1 Module. Depending upon the category the interrupt Frame is different.
          enumeration Irq_FlexRay1TimerInt1_Cat: {CAT1, CAT2}, origin=INFINEON_AURIX2G, set at pre-compile, default-value=CAT1  # The interrupt category setting of Timer Interrupt 1 Service request of FlexRay1 Module. Depending upon the category the interrupt Frame is different.
          enumeration Irq_FlexRay1NewData0_Cat: {CAT1, CAT2}, origin=INFINEON_AURIX2G, set at pre-compile, default-value=CAT1  # The interrupt category setting of New Data 0 Service request of FlexRay1 Module. Depending upon the category the interrupt Frame is different.
          enumeration Irq_FlexRay1NewData1_Cat: {CAT1, CAT2}, origin=INFINEON_AURIX2G, set at pre-compile, default-value=CAT1  # The interrupt category setting of New Data 1 Service request of FlexRay1 Module. Depending upon the category the interrupt Frame is different.
          enumeration Irq_FlexRay1MBSC0_Cat: {CAT1, CAT2}, origin=INFINEON_AURIX2G, set at pre-compile, default-value=CAT1  # The interrupt category setting of Message Buffer Status Changed 0 Service Request of FlexRay1 Module. Depending upon the category the interrupt Frame is different.
          enumeration Irq_FlexRay1MBSC1_Cat: {CAT1, CAT2}, origin=INFINEON_AURIX2G, set at pre-compile, default-value=CAT1  # The interrupt category setting of Message Buffer Status Changed 1 Service Request of FlexRay1 Module. Depending upon the category the interrupt Frame is different.
          enumeration Irq_FlexRay1OBusy_Cat: {CAT1, CAT2}, origin=INFINEON_AURIX2G, set at pre-compile, default-value=CAT1  # The interrupt category setting of Output Buffer Busy Service Request of FlexRay1 Module. Depending upon the category the interrupt Frame is different.
          enumeration Irq_FlexRay1IBusy_Cat: {CAT1, CAT2}, origin=INFINEON_AURIX2G, set at pre-compile, default-value=CAT1  # The interrupt category setting of Input Buffer Busy Service Request of FlexRay1 Module. Depending upon the category the interrupt Frame is different.
        container Irq_FlexRay1Prio_Config  # This container contains the FlexRay1 priority configuration parameters.
          integer Irq_FlexRay1INT0_Prio: 0..255, origin=INFINEON_AURIX2G, set at pre-compile, default-value=0  # The interrupt priority setting of SRN0 of the FlexRay1.
          integer Irq_FlexRay1INT1_Prio: 0..255, origin=INFINEON_AURIX2G, set at pre-compile, default-value=0  # The interrupt priority setting of SRN1 of the FlexRay1.
          integer Irq_FlexRay1TimerInt0_Prio: 0..255, origin=INFINEON_AURIX2G, set at pre-compile, default-value=0  # The interrupt priority setting of SRN2 of the FlexRay1.
          integer Irq_FlexRay1TimerInt1_Prio: 0..255, origin=INFINEON_AURIX2G, set at pre-compile, default-value=0  # The interrupt priority setting of SRN3 of the FlexRay1.
          integer Irq_FlexRay1NewData0_Prio: 0..255, origin=INFINEON_AURIX2G, set at pre-compile, default-value=0  # The interrupt priority setting of SRN4 of the FlexRay1.
          integer Irq_FlexRay1NewData1_Prio: 0..255, origin=INFINEON_AURIX2G, set at pre-compile, default-value=0  # The interrupt priority setting of SRN5 of the FlexRay1.
          integer Irq_FlexRay1MBSC0_Prio: 0..255, origin=INFINEON_AURIX2G, set at pre-compile, default-value=0  # The interrupt priority setting of SRN6 of the FlexRay1.
          integer Irq_FlexRay1MBSC1_Prio: 0..255, origin=INFINEON_AURIX2G, set at pre-compile, default-value=0  # The interrupt priority setting of SRN7 of the FlexRay1.
          integer Irq_FlexRay1OBusy_Prio: 0..255, origin=INFINEON_AURIX2G, set at pre-compile, default-value=0  # The interrupt priority setting of SRN8 of the FlexRay1.
          integer Irq_FlexRay1IBusy_Prio: 0..255, origin=INFINEON_AURIX2G, set at pre-compile, default-value=0  # The interrupt priority setting of SRN9 of the FlexRay1.
        container Irq_FlexRay1Tos_Config  # This container contains the FlexRay1 Type of Service configuration parameters.
          enumeration Irq_FlexRay1INT0_Tos: {CPU0, CPU1, CPU2, CPU3, CPU4, CPU5, DMA}, origin=INFINEON_AURIX2G, set at pre-compile, default-value=CPU0  # The interrupt type of service setting of SRN0 of FlexRay1 Module.
          enumeration Irq_FlexRay1INT1_Tos: {CPU0, CPU1, CPU2, CPU3, CPU4, CPU5, DMA}, origin=INFINEON_AURIX2G, set at pre-compile, default-value=CPU0  # The interrupt type of service setting of SRN1 of FlexRay1 Module.
          enumeration Irq_FlexRay1TimerInt0_Tos: {CPU0, CPU1, CPU2, CPU3, CPU4, CPU5, DMA}, origin=INFINEON_AURIX2G, set at pre-compile, default-value=CPU0  # The interrupt type of service setting of Timer Interrupt 0 Service request of FlexRay1 Module.
          enumeration Irq_FlexRay1TimerInt1_Tos: {CPU0, CPU1, CPU2, CPU3, CPU4, CPU5, DMA}, origin=INFINEON_AURIX2G, set at pre-compile, default-value=CPU0  # The interrupt type of service setting of Timer Interrupt 1 Service request of FlexRay1 Module.
          enumeration Irq_FlexRay1NewData0_Tos: {CPU0, CPU1, CPU2, CPU3, CPU4, CPU5, DMA}, origin=INFINEON_AURIX2G, set at pre-compile, default-value=CPU0  # The interrupt type of service setting of New Data 0 Service request of FlexRay1 Module.
          enumeration Irq_FlexRay1NewData1_Tos: {CPU0, CPU1, CPU2, CPU3, CPU4, CPU5, DMA}, origin=INFINEON_AURIX2G, set at pre-compile, default-value=CPU0  # The interrupt type of service setting of New Data 1 Service request of FlexRay1 Module.
          enumeration Irq_FlexRay1MBSC0_Tos: {CPU0, CPU1, CPU2, CPU3, CPU4, CPU5, DMA}, origin=INFINEON_AURIX2G, set at pre-compile, default-value=CPU0  # The interrupt type of service setting of Message Buffer Status Changed 0 Service request of FlexRay1 Module.
          enumeration Irq_FlexRay1MBSC1_Tos: {CPU0, CPU1, CPU2, CPU3, CPU4, CPU5, DMA}, origin=INFINEON_AURIX2G, set at pre-compile, default-value=CPU0  # The interrupt type of service setting of Message Buffer Status Changed 1 Service request of FlexRay1 Module.
          enumeration Irq_FlexRay1OBusy_Tos: {CPU0, CPU1, CPU2, CPU3, CPU4, CPU5, DMA}, origin=INFINEON_AURIX2G, set at pre-compile, default-value=CPU0  # The interrupt type of service setting of Output Buffer Busy Service request of FlexRay1 Module.
          enumeration Irq_FlexRay1IBusy_Tos: {CPU0, CPU1, CPU2, CPU3, CPU4, CPU5, DMA}, origin=INFINEON_AURIX2G, set at pre-compile, default-value=CPU0  # The interrupt type of service setting of Input Buffer Busy Service request of FlexRay1 Module.
    container IrqScuConfig  # This container contains the SCU interrupt configuration parameters.
      container Irq_ScuCat_Config  # This container contains the parameter to configure the category of all the SRN supported by SCU module.
        enumeration Irq_ScuEruSR0_Cat: {CAT1, CAT2}, origin=INFINEON_AURIX2G, set at pre-compile, default-value=CAT1  # The interrupt category setting of SRN0 of Scu Eru Module. Depending upon the category the interrupt Frame is different.
        enumeration Irq_ScuEruSR{1..3}_Cat: {CAT1, CAT2}, origin=INFINEON_AURIX2G, set at pre-compile, default-value=CAT1  # The interrupt category setting of SRN{1..3} of SCU ERU Module. Depending upon the category the interrupt Frame is different.
      container Irq_ScuPrio_Config  # This container contains the parameter to configure the priority of all the SRN supported by SCU module.
        integer Irq_ScuEruSR{0..2}_Prio: 0..255, origin=INFINEON_AURIX2G, set at pre-compile, default-value=0  # The interrupt priority setting of SRN{0..2} of SCU ERU.
        integer Irq_ScuEruSR3_Prio: 0..255, origin=INFINEON_AURIX2G, set at pre-compile, default-value=0  # The interrupt priority setting of SRN3 of SCU.
      container Irq_ScuTos_Config  # This container contains the parameter to configure the type of service of all the SRN supported by SCU module.
        enumeration Irq_ScuEruSR{0..3}_Tos: {CPU0, CPU1, CPU2, CPU3, CPU4, CPU5, DMA}, origin=INFINEON_AURIX2G, set at pre-compile, default-value=CPU0  # The interrupt type of service setting of SRN{0..3} of Scu Eru Module.
    container IrqCCU6Config  # This container contains the CCU6 interrupt configuration parameters.
      container Irq_CCU60_Config  # This container contains the CCU60 interrupt configuration parameters.
        container Irq_CCU60Cat_Config  # This container contains the parameter to configure the category of all the SRN supported by CCU60 module.
          enumeration Irq_CCU60SR{0..3}_Cat: {CAT1, CAT2}, origin=INFINEON_AURIX2G, set at pre-compile, default-value=CAT1  # The interrupt category setting of SRN{0..3} of CCU60 Module. Depending upon the category the interrupt Frame is different.
        container Irq_CCU60Prio_Config  # This container contains the parameter to configure the priority of all the SRN supported by CCU60 module.
          integer Irq_CCU60SR{0..3}_Prio: 0..255, origin=INFINEON_AURIX2G, set at pre-compile, default-value=0  # The interrupt priority setting of SRN{0..3} of the CCU60.
        container Irq_CCU60Tos_Config  # This container contains the parameter to configure the type of service of all the SRN supported by CCU60 module.
          enumeration Irq_CCU60SR{0..3}_Tos: {CPU0, CPU1, CPU2, CPU3, CPU4, CPU5, DMA}, origin=INFINEON_AURIX2G, set at pre-compile, default-value=CPU0  # The interrupt type of service setting of SRN{0..3} of CCU60 Module.
      container Irq_CCU61_Config  # This container contains the CCU61 interrupt configuration parameters.
        container Irq_CCU61Cat_Config  # This container contains the parameter to configure the category of all the SRN supported by CCU61 module.
          enumeration Irq_CCU61SR{0..3}_Cat: {CAT1, CAT2}, origin=INFINEON_AURIX2G, set at pre-compile, default-value=CAT1  # The interrupt category setting of SRN{0..3} of CCU61 Module. Depending upon the category the interrupt Frame is different.
        container Irq_CCU61Prio_Config  # This container contains the parameter to configure the priority of all the SRN supported by CCU61 module.
          integer Irq_CCU61SR{0..3}_Prio: 0..255, origin=INFINEON_AURIX2G, set at pre-compile, default-value=0  # The interrupt priority setting of SRN{0..3} of the CCU61.
        container Irq_CCU61Tos_Config  # This container contains the parameter to configure the type of service of all the SRN supported by CCU61 module.
          enumeration Irq_CCU61SR{0..3}_Tos: {CPU0, CPU1, CPU2, CPU3, CPU4, CPU5, DMA}, origin=INFINEON_AURIX2G, set at pre-compile, default-value=CPU0  # The interrupt type of service setting of SRN{0..3} of CCU61 Module.
    container IrqGtmConfig  # This container contains the Gtm interrupt configuration parameters.
      container Irq_GtmAEI_Config  # This container contains the GTMAEI interrupt configuration parameters.
        container Irq_GtmAEICat_Config  # This container contains the parameter to configure the category of all the SRN supported by GTMAEI module.
          enumeration Irq_GtmAEI_Cat: {CAT1, CAT2}, origin=INFINEON_AURIX2G, set at pre-compile, default-value=CAT1  # The interrupt category setting of AEI shared service request of GTM. Depending upon the category the interrupt Frame is different
        container Irq_GtmAEIPrio_Config  # This container contains the parameter to configure the priority of all the SRN supported by GTMAEI module.
          integer Irq_GtmAEI_Prio: 0..255, origin=INFINEON_AURIX2G, set at pre-compile, default-value=0  # The interrupt priority setting of AEI shared service request of GTM. The SRN number indicates the SRN configured
        container Irq_GtmAEITos_Config  # This container contains the parameter to configure the type of service of all the SRN supported by GTMAEI module.
          enumeration Irq_GtmAEI_Tos: {CPU0, CPU1, CPU2, CPU3, CPU4, CPU5, DMA}, origin=INFINEON_AURIX2G, set at pre-compile, default-value=CPU0  # The interrupt category setting of AEI shared service request of GTM.
      container Irq_GtmARU_Config  # This container contains the GTMARU interrupt configuration parameters.
        container Irq_GtmARUCat_Config  # This container contains the parameter to configure the category of all the SRN supported by GTMARU module.
          enumeration Irq_GtmARUSR{0..2}_Cat: {CAT1, CAT2}, origin=INFINEON_AURIX2G, set at pre-compile, default-value=CAT1  # The interrupt category setting of ARU shared service request {0..2} of GTM. Depending upon the category the interrupt Frame is different
        container Irq_GtmARUPrio_Config  # This container contains the parameter to configure the priority of all the SRN supported by GTMARU module.
          integer Irq_GtmARUSR{0..2}_Prio: 0..255, origin=INFINEON_AURIX2G, set at pre-compile, default-value=0  # The interrupt priority setting of ARU shared service request {0..2} of GTM. The SRN number indicates the SRN configured
        container Irq_GtmARUTos_Config  # This container contains the parameter to configure the type of service of all the SRN supported by GTMARU module.
          enumeration Irq_GtmARUSR{0..2}_Tos: {CPU0, CPU1, CPU2, CPU3, CPU4, CPU5, DMA}, origin=INFINEON_AURIX2G, set at pre-compile, default-value=CPU0  # The interrupt type of service setting of ARU shared service request {0..2} of GTM.
      container Irq_GtmBRC_Config  # This container contains the GTMBRC interrupt configuration parameters.
        container Irq_GtmBRCCat_Config  # This container contains the parameter to configure the category of all the SRN supported by GTMBRC module.
          enumeration Irq_GtmBRC_Cat: {CAT1, CAT2}, origin=INFINEON_AURIX2G, set at pre-compile, default-value=CAT1  # The interrupt category setting of BRC shared service request of GTM. Depending upon the category the interrupt Frame is different
        container Irq_GtmBRCPrio_Config  # This container contains the parameter to configure the priority of all the SRN supported by GTMBRC module.
          integer Irq_GtmBRC_Prio: 0..255, origin=INFINEON_AURIX2G, set at pre-compile, default-value=0  # The interrupt priority setting of BRC shared service request of GTM. The SRN number indicates the SRN configured
        container Irq_GtmBRCTos_Config  # This container contains the parameter to configure the type of service of all the SRN supported by GTMBRC module.
          enumeration IrqGtmBRCTos: {CPU0, CPU1, CPU2, CPU3, CPU4, CPU5, DMA}, origin=INFINEON_AURIX2G, set at pre-compile, default-value=CPU0  # The interrupt type of service setting of BRC shared service request of GTM.
      container Irq_GtmCMP_Config  # This container contains the GTMCMP interrupt configuration parameters.
        container Irq_GtmCMPCat_Config  # This container contains the parameter to configure the category of all the SRN supported by GTMCMP module.
          enumeration Irq_GtmCMP_Cat: {CAT1, CAT2}, origin=INFINEON_AURIX2G, set at pre-compile, default-value=CAT1  # The interrupt category setting of CMP shared service request of GTM. Depending upon the category the interrupt Frame is different
        container Irq_GtmCMPPrio_Config  # This container contains the parameter to configure the priority of all the SRN supported by GTMCMP module.
          integer Irq_GtmCMP_Prio: 0..255, origin=INFINEON_AURIX2G, set at pre-compile, default-value=0  # The interrupt priority setting of CMP shared service request of GTM. The SRN number indicates the SRN configured
        container Irq_GtmCMPTos_Config  # This container contains the parameter to configure the type of service of all the SRN supported by GTMCMP module.
          enumeration Irq_GtmCMP_Tos: {CPU0, CPU1, CPU2, CPU3, CPU4, CPU5, DMA}, origin=INFINEON_AURIX2G, set at pre-compile, default-value=CPU0  # The interrupt type of service setting of CMP shared service request of GTM.
      container Irq_GtmSPE_Config  # This container contains the GTMSPE interrupt configuration parameters.
        container Irq_GtmSPECat_Config  # This container contains the parameter to configure the category of all the SRN supported by GTMSPE module.
          enumeration Irq_GtmSPE{0..5}_Cat: {CAT1, CAT2}, origin=INFINEON_AURIX2G, set at pre-compile, default-value=CAT1  # The interrupt category setting of SPE{0..5} shared service request of GTM. Depending upon the category the interrupt Frame is different
        container Irq_GtmSPEPrio_Config  # This container contains the parameter to configure the priority of all the SRN supported by GTMSPE module.
          integer Irq_GtmSPE{0..5}_Prio: 0..255, origin=INFINEON_AURIX2G, set at pre-compile, default-value=0  # The interrupt priority setting of SPE{0..5} shared service request of GTM. The SRN number indicates the SRN configured
        container Irq_GtmSPETos_Config  # This container contains the parameter to configure the type of service of all the SRN supported by GTMSPE module.
          enumeration Irq_GtmSPE{0..5}_Tos: {CPU0, CPU1, CPU2, CPU3, CPU4, CPU5, DMA}, origin=INFINEON_AURIX2G, set at pre-compile, default-value=CPU0  # The interrupt type of service setting of SPE{0..5} shared service request of GTM.
      container Irq_GtmPSM0_Config  # This container contains the GTMPSM0 interrupt configuration parameters.
        container Irq_GtmPSM0Cat_Config  # This container contains the parameter to configure the category of all the SRN supported by GTMPSM0 module.
          enumeration Irq_GtmPSM0SR{0..7}_Cat: {CAT1, CAT2}, origin=INFINEON_AURIX2G, set at pre-compile, default-value=CAT1  # The interrupt category setting of PSM0 shared service request {0..7} of GTM. Depending upon the category the interrupt Frame is different
        container Irq_GtmPSM0Prio_Config  # This container contains the parameter to configure the priority of all the SRN supported by GTMPSM0 module.
          integer IrqGtmPSM0SR0Prio: 0..255, origin=INFINEON_AURIX2G, set at pre-compile, default-value=0  # The interrupt priority setting of PSM0 shared service request 0 of GTM. The SRN number indicates the SRN configured
          integer Irq_GtmPSM0SR{1..7}_Prio: 0..255, origin=INFINEON_AURIX2G, set at pre-compile, default-value=0  # The interrupt priority setting of PSM0 shared service request {1..7} of GTM. The SRN number indicates the SRN configured
        container Irq_GtmPSM0Tos_Config  # This container contains the parameter to configure the type of service of all the SRN supported by GTMPSM0 module.
          enumeration IrqGtmPSM0SR0Tos: {CPU0, CPU1, CPU2, CPU3, CPU4, CPU5, DMA}, origin=INFINEON_AURIX2G, set at pre-compile, default-value=CPU0  # The interrupt type of service setting of PSM0 shared service request 0 of GTM. Depending upon the category the interrupt Frame is different
          enumeration Irq_GtmPSM0SR{1..7}_Tos: {CPU0, CPU1, CPU2, CPU3, CPU4, CPU5, DMA}, origin=INFINEON_AURIX2G, set at pre-compile, default-value=CPU0  # The interrupt type of service setting of PSM0 shared service request {1..7} of GTM. Depending upon the category the interrupt Frame is different
      container Irq_GtmPSM1_Config  # This container contains the GTMPSM0 interrupt configuration parameters.
        container Irq_GtmPSM1Cat_Config  # This container contains the parameter to configure the category of all the SRN supported by GTM PSM1 module.
          enumeration Irq_GtmPSM1SR{0..7}_Cat: {CAT1, CAT2}, origin=INFINEON_AURIX2G, set at pre-compile, default-value=CAT1  # The interrupt category setting of PSM1 shared service request {0..7} of GTM. Depending upon the category the interrupt Frame is different
        container Irq_GtmPSM1Prio_Config  # This container contains the parameter to configure the priority of all the SRN supported by GTMPSM1 module.
          integer IrqGtmPSM1SR0Prio: 0..255, origin=INFINEON_AURIX2G, set at pre-compile, default-value=0  # The interrupt priority setting of PSM1 shared service request 0 of GTM. The SRN number indicates the SRN configured
          integer Irq_GtmPSM1SR{1..7}_Prio: 0..255, origin=INFINEON_AURIX2G, set at pre-compile, default-value=0  # The interrupt priority setting of PSM1 shared service request {1..7} of GTM. The SRN number indicates the SRN configured
        container Irq_GtmPSM1Tos_Config  # This container contains the parameter to configure the type of service of all the SRN supported by GTMPSM1 module.
          enumeration IrqGtmPSM1SR0Tos: {CPU0, CPU1, CPU2, CPU3, CPU4, CPU5, DMA}, origin=INFINEON_AURIX2G, set at pre-compile, default-value=CPU0  # The interrupt type of service setting of PSM1 shared service request 0 of GTM. Depending upon the category the interrupt Frame is different
          enumeration Irq_GtmPSM1SR{1..7}_Tos: {CPU0, CPU1, CPU2, CPU3, CPU4, CPU5, DMA}, origin=INFINEON_AURIX2G, set at pre-compile, default-value=CPU0  # The interrupt type of service setting of PSM1 shared service request {1..7} of GTM. Depending upon the category the interrupt Frame is different
      container Irq_GtmPSM2_Config  # This container contains the GTMPSM2 interrupt configuration parameters.
        container Irq_GtmPSM2Cat_Config  # This container contains the parameter to configure the category of all the SRN supported by GTMPSM2 module.
          enumeration Irq_GtmPSM2SR{0..7}_Cat: {CAT1, CAT2}, origin=INFINEON_AURIX2G, set at pre-compile, default-value=CAT1  # The interrupt category setting of PSM2 shared service request {0..7} of GTM. Depending upon the category the interrupt Frame is different
        container Irq_GtmPSM2Prio_Config  # This container contains the parameter to configure the priority of all the SRN supported by GTMPSM2 module.
          integer IrqGtmPSM2SR0Prio: 0..255, origin=INFINEON_AURIX2G, set at pre-compile, default-value=0  # The interrupt priority setting of PSM2 shared service request 0 of GTM. The SRN number indicates the SRN configured
          integer Irq_GtmPSM2SR{1..7}_Prio: 0..255, origin=INFINEON_AURIX2G, set at pre-compile, default-value=0  # The interrupt priority setting of PSM2 shared service request {1..7} of GTM. The SRN number indicates the SRN configured
        container Irq_GtmPSM2Tos_Config  # This container contains the parameter to configure the type of service of all the SRN supported by GTMPSM2 module.
          enumeration IrqGtmPSM2SR0Tos: {CPU0, CPU1, CPU2, CPU3, CPU4, CPU5, DMA}, origin=INFINEON_AURIX2G, set at pre-compile, default-value=CPU0  # The interrupt type of service setting of PSM2 shared service request 0 of GTM. Depending upon the category the interrupt Frame is different
          enumeration Irq_GtmPSM2SR{1..7}_Tos: {CPU0, CPU1, CPU2, CPU3, CPU4, CPU5, DMA}, origin=INFINEON_AURIX2G, set at pre-compile, default-value=CPU0  # The interrupt type of service setting of PSM2 shared service request {1..7} of GTM. Depending upon the category the interrupt Frame is different
      container Irq_GtmDPLL_Config [27..27]  # This container contains the GTMDPLL interrupt configuration parameters.
        enumeration Irq_GtmDPLLSR_Cat: {CAT1, CAT2}, origin=INFINEON_AURIX2G, set at pre-compile, default-value=CAT1  # The interrupt category setting of DPLL shared service request of GTM. Depending upon the category the interrupt Frame is different
        integer Irq_GtmDPLLSR_Prio: 0..255, origin=INFINEON_AURIX2G, set at pre-compile, default-value=0  # The interrupt priority setting of DPLL shared service request of GTM. The SRN number indicates the SRN configured
        enumeration Irq_GtmDPLLSR_Tos: {CPU0, CPU1, CPU2, CPU3, CPU4, CPU5, DMA}, origin=INFINEON_AURIX2G, set at pre-compile, default-value=CPU0  # The interrupt type of service setting of DPLL shared service request of GTM.
      container Irq_GtmERR_Config  # This container contains the GTMERR interrupt configuration parameters.
        container Irq_GtmERRCat_Config  # This container contains the parameter to configure the category of all the SRN supported by GTMERR module.
          enumeration Irq_GtmERRSR_Cat: {CAT1, CAT2}, origin=INFINEON_AURIX2G, set at pre-compile, default-value=CAT1  # The interrupt category setting of ERR shared service request 0 of GTM. Depending upon the category the interrupt Frame is different
        container Irq_GtmERRPrio_Config  # This container contains the parameter to configure the priority of all the SRN supported by GTMERR module.
          integer Irq_GtmERRSR_Prio: 0..255, origin=INFINEON_AURIX2G, set at pre-compile, default-value=0  # The interrupt priority setting of ERR shared service request 0 of GTM. The SRN number indicates the SRN configured
        container Irq_GtmERRTos_Config  # This container contains the parameter to configure the type of service of all the SRN supported by GTMERR module.
          enumeration IrqGtmERRSRTos: {CPU0, CPU1, CPU2, CPU3, CPU4, CPU5, DMA}, origin=INFINEON_AURIX2G, set at pre-compile, default-value=CPU0  # The interrupt type of service setting of ERR shared service request 0 of GTM.
      container Irq_GtmTIM_Config [8..8]  # This container contains the GTM TIM interrupt configuration parameters.
        container IrqGtmTIMCatConfig  # This container contains the parameter to configure the category of all the SRN supported by GTMTIM module.
          enumeration IrqGtmTIMSR{0..7}Cat: {CAT1, CAT2}, origin=INFINEON_AURIX2G, set at pre-compile, default-value=CAT1  # The interrupt category setting of TIM shared service request {0..7} of GTM. Depending upon the category the interrupt Frame is different
        container IrqGtmTIMPrioConfig  # This container contains the parameter to configure the priority of all the SRN supported by GTMTIM module.
          integer IrqGtmTIMSR{0..7}Prio: 0..255, origin=INFINEON_AURIX2G, set at pre-compile, default-value=0  # The interrupt priority setting of TIM shared service request {0..7} of GTM. The SRN number indicates the SRN configured
        container IrqGtmTIMTosConfig  # This container contains the parameter to configure the type of service of all the SRN supported by GTMTIM module.
          enumeration IrqGtmTIMSR{0..7}Tos: {CPU0, CPU1, CPU2, CPU3, CPU4, CPU5, DMA}, origin=INFINEON_AURIX2G, set at pre-compile, default-value=CPU0  # The interrupt type of service setting of TIM shared service request {0..7} of GTM. Depending upon the category the interrupt Frame is different
      container Irq_GtmMCS_Config [10..10]  # This container contains the GTM MCS interrupt configuration parameters.
        container IrqGtmMCSCatConfig  # This container contains the parameter to configure the category of all the SRN supported by GTMMCS module.
          enumeration IrqGtmMCSSR{0..7}Cat: {CAT1, CAT2}, origin=INFINEON_AURIX2G, set at pre-compile, default-value=CAT1  # The interrupt category setting of MCS shared service request {0..7} of GTM. Depending upon the category the interrupt Frame is different
        container IrqGtmMCSPrioConfig  # This container contains the parameter to configure the priority of all the SRN supported by GTMMCS module.
          integer IrqGtmMCSSR{0..7}Prio: 0..255, origin=INFINEON_AURIX2G, set at pre-compile, default-value=0  # The interrupt priority setting of MCS shared service request {0..7} of GTM. The SRN number indicates the SRN configured
        container IrqGtmMCSTosConfig  # This container contains the parameter to configure the type of service of all the SRN supported by GTMMCS module.
          enumeration IrqGtmMCSSR{0..7}Tos: {CPU0, CPU1, CPU2, CPU3, CPU4, CPU5, DMA}, origin=INFINEON_AURIX2G, set at pre-compile, default-value=CPU0  # The interrupt type of service setting of MCS shared service request {0..7} of GTM. Depending upon the category the interrupt Frame is different
      container Irq_GtmTOM_Config [6..6]  # This container contains the GTMTOM interrupt configuration parameters.
        container IrqGtmTOMCatConfig  # This container contains the parameter to configure the category of all the SRN supported by GTMTOM module.
          enumeration IrqGtmTOMSR{0..7}Cat: {CAT1, CAT2}, origin=INFINEON_AURIX2G, set at pre-compile, default-value=CAT1  # The interrupt category setting of TOM shared service request {0..7} of GTM. Depending upon the category the interrupt Frame is different
        container IrqGtmTOMPrioConfig  # This container contains the parameter to configure the priority of all the SRN supported by GTMTOM module.
          integer IrqGtmTOMSR{0..7}Prio: 0..255, origin=INFINEON_AURIX2G, set at pre-compile, default-value=0  # The interrupt priority setting of TOM shared service request {0..7} of GTM. The SRN number indicates the SRN configured
        container IrqGtmTOMTosConfig  # This container contains the parameter to configure the type of service of all the SRN supported by GTMTOM module.
          enumeration IrqGtmTOMSR{0..7}Tos: {CPU0, CPU1, CPU2, CPU3, CPU4, CPU5, DMA}, origin=INFINEON_AURIX2G, set at pre-compile, default-value=CPU0  # The interrupt type of service setting of TOM shared service request {0..7} of GTM. Depending upon the category the interrupt Frame is different
      container Irq_GtmATOM_Config [12..12]  # This container contains the GTMATOM interrupt configuration parameters.
        container IrqGtmATOMCatConfig  # This container contains the parameter to configure the category of all the SRN supported by GTMATOM module.
          enumeration IrqGtmATOMSR{0..3}Cat: {CAT1, CAT2}, origin=INFINEON_AURIX2G, set at pre-compile, default-value=CAT1  # The interrupt category setting of ATOM shared service request {0..3} of GTM. Depending upon the category the interrupt Frame is different
        container IrqGtmATOMPrioConfig  # This container contains the parameter to configure the priority of all the SRN supported by GTMATOM module.
          integer IrqGtmATOMSR{0..3}Prio: 0..255, origin=INFINEON_AURIX2G, set at pre-compile, default-value=0  # The interrupt priority setting of ATOM shared service request {0..3} of GTM. The SRN number indicates the SRN configured
        container IrqGtmATOMTosConfig  # This container contains the parameter to configure the type of service of all the SRN supported by GTMATOM module.
          enumeration IrqGtmATOMSR{0..3}Tos: {CPU0, CPU1, CPU2, CPU3, CPU4, CPU5, DMA}, origin=INFINEON_AURIX2G, set at pre-compile, default-value=CPU0  # The interrupt type of service setting of ATOM shared service request {0..3} of GTM. Depending upon the category the interrupt Frame is different
      container Irq_GtmMCSW_Config  # This container contains the GTMMCSW interrupt configuration parameters.
        container IrqGtmMCSWCatConfig  # This container contains the parameter to configure the category of all the SRN supported by GTMMCSW module.
          enumeration IrqGtmMCSW{0..9}Cat: {CAT1, CAT2}, origin=INFINEON_AURIX2G, set at pre-compile, default-value=CAT1  # The interrupt category setting of MCSW shared service request {0..9} of GTM. Depending upon the category the interrupt Frame is different
        container IrqGtmMCSWPrioConfig  # This container contains the parameter to configure the priority of all the SRN supported by GTMMCSW module.
          integer IrqGtmMCSW{0..9}Prio: 0..255, origin=INFINEON_AURIX2G, set at pre-compile, default-value=0  # The interrupt priority setting of MCSW shared service request {0..9} of GTM. The SRN number indicates the SRN configured
        container IrqGtmMCSWTosConfig  # This container contains the parameter to configure the type of service of all the SRN supported by GTMMCSW module.
          enumeration IrqGtmMCSW{0..9}Tos: {CPU0, CPU1, CPU2, CPU3, CPU4, CPU5, DMA}, origin=INFINEON_AURIX2G, set at pre-compile, default-value=CPU0  # The interrupt type of service setting of MCSW shared service request {0..9} of GTM. Depending upon the category the interrupt Frame is different
    container IrqStmConfig  # This container contains the Stm interrupt configuration parameters.
      container IrqStm0Config  # This container contains the stm interrupt configuration parameters.
        container IrqStm0CatConfig  # This container contains the parameter to configure the category of all the SRN supported by Stm0 module.
          enumeration IrqStm0SR0Cat: {CAT1, CAT2}, origin=INFINEON_AURIX2G, set at pre-compile, default-value=CAT1  # The interrupt category setting of SRN0 of Stm0 Module. Depending upon the category the interrupt Frame is different
          enumeration IrqStm0SR1Cat: {CAT1, CAT2}, origin=INFINEON_AURIX2G, set at pre-compile, default-value=CAT1  # The interrupt category setting of SRN1 of Stm0 Module. Depending upon the category the interrupt Frame is different
        container IrqStm0PrioConfig  # This container contains the parameter to configure the priority of all the SRN supported by Stm0 module.
          integer IrqStm0SR0Prio: 0..255, origin=INFINEON_AURIX2G, set at pre-compile, default-value=0  # The interrupt priority setting of SRN0 of Stm0. The SRN number indicates the SRN configured
          integer IrqStm0SR1Prio: 0..255, origin=INFINEON_AURIX2G, set at pre-compile, default-value=0  # The interrupt priority setting of SRN1 of Stm0. The SRN number indicates the SRN configured
        container IrqStm0TosConfig  # This container contains the parameter to configure the type of service of all the SRN supported by Stm0 module.
          enumeration IrqStm0SR0Tos: {CPU0, CPU1, CPU2, CPU3, CPU4, CPU5, DMA}, origin=INFINEON_AURIX2G, set at pre-compile, default-value=CPU0  # The interrupt type of service setting of SRN0 of Stm0 Module.
          enumeration IrqStm0SR1Tos: {CPU0, CPU1, CPU2, CPU3, CPU4, CPU5, DMA}, origin=INFINEON_AURIX2G, set at pre-compile, default-value=CPU0  # The interrupt type of service setting of SRN1 of Stm0 Module.
      container IrqStm1Config  # This container contains the stm interrupt configuration parameters.
        container IrqStm1CatConfig  # This container contains the parameter to configure the category of all the SRN supported by Stm1 module.
          enumeration IrqStm1SR0Cat: {CAT1, CAT2}, origin=INFINEON_AURIX2G, set at pre-compile, default-value=CAT1  # The interrupt category setting of SRN0 of Stm1 Module. Depending upon the category the interrupt Frame is different
          enumeration IrqStm1SR1Cat: {CAT1, CAT2}, origin=INFINEON_AURIX2G, set at pre-compile, default-value=CAT1  # The interrupt category setting of SRN1 of Stm1 Module. Depending upon the category the interrupt Frame is different
        container IrqStm1PrioConfig  # This container contains the parameter to configure the priority of all the SRN supported by Stm1 module.
          integer IrqStm1SR0Prio: 0..255, origin=INFINEON_AURIX2G, set at pre-compile, default-value=0  # The interrupt priority setting of SRN0 of Stm1. The SRN number indicates the SRN configured
          integer IrqStm1SR1Prio: 0..255, origin=INFINEON_AURIX2G, set at pre-compile, default-value=0  # The interrupt priority setting of SRN1 of Stm1. The SRN number indicates the SRN configured
        container IrqStm1TosConfig  # This container contains the parameter to configure the type of service of all the SRN supported by Stm1 module.
          enumeration IrqStm1SR0Tos: {CPU0, CPU1, CPU2, CPU3, CPU4, CPU5, DMA}, origin=INFINEON_AURIX2G, set at pre-compile, default-value=CPU0  # The interrupt type of service setting of SRN0 of Stm1 Module.
          enumeration IrqStm1SR1Tos: {CPU0, CPU1, CPU2, CPU3, CPU4, CPU5, DMA}, origin=INFINEON_AURIX2G, set at pre-compile, default-value=CPU0  # The interrupt type of service setting of SRN1 of Stm1 Module.
      container IrqStm2Config  # This container contains the stm interrupt configuration parameters.
        container IrqStm2CatConfig  # This container contains the parameter to configure the category of all the SRN supported by Stm2 module.
          enumeration IrqStm2SR0Cat: {CAT1, CAT2}, origin=INFINEON_AURIX2G, set at pre-compile, default-value=CAT1  # The interrupt category setting of SRN0 of Stm2 Module. Depending upon the category the interrupt Frame is different
          enumeration IrqStm2SR1Cat: {CAT1, CAT2}, origin=INFINEON_AURIX2G, set at pre-compile, default-value=CAT1  # The interrupt category setting of SRN1 of Stm2 Module. Depending upon the category the interrupt Frame is different
        container IrqStm2PrioConfig  # This container contains the parameter to configure the priority of all the SRN supported by Stm1 module.
          integer IrqStm2SR0Prio: 0..255, origin=INFINEON_AURIX2G, set at pre-compile, default-value=0  # The interrupt priority setting of SRN0 of Stm2. The SRN number indicates the SRN configured
          integer IrqStm2SR1Prio: 0..255, origin=INFINEON_AURIX2G, set at pre-compile, default-value=0  # The interrupt priority setting of SRN1 of Stm2. The SRN number indicates the SRN configured
        container IrqStm2TosConfig  # This container contains the parameter to configure the type of service of all the SRN supported by Stm2 module.
          enumeration IrqStm2SR0Tos: {CPU0, CPU1, CPU2, CPU3, CPU4, CPU5, DMA}, origin=INFINEON_AURIX2G, set at pre-compile, default-value=CPU0  # The interrupt type of service setting of SRN0 of Stm2 Module.
          enumeration IrqStm2SR1Tos: {CPU0, CPU1, CPU2, CPU3, CPU4, CPU5, DMA}, origin=INFINEON_AURIX2G, set at pre-compile, default-value=CPU0  # The interrupt type of service setting of SRN1 of Stm2 Module.
      container IrqStm3Config  # This container contains the stm3 interrupt configuration parameters.
        container IrqStm3CatConfig  # This container contains the parameter to configure the category of all the SRN supported by Stm3 module.
          enumeration IrqStm3SR0Cat: {CAT1, CAT2}, origin=INFINEON_AURIX2G, set at pre-compile, default-value=CAT1  # The interrupt category setting of SRN0 of Stm3 Module. Depending upon the category the interrupt Frame is different
          enumeration IrqStm3SR1Cat: {CAT1, CAT2}, origin=INFINEON_AURIX2G, set at pre-compile, default-value=CAT1  # The interrupt category setting of SRN1 of Stm3 Module. Depending upon the category the interrupt Frame is different
        container IrqStm3PrioConfig  # This container contains the parameter to configure the priority of all the SRN supported by Stm3 module.
          integer IrqStm3SR0Prio: 0..255, origin=INFINEON_AURIX2G, set at pre-compile, default-value=0  # The interrupt priority setting of SRN0 of Stm3. The SRN number indicates the SRN configured
          integer IrqStm3SR1Prio: 0..255, origin=INFINEON_AURIX2G, set at pre-compile, default-value=0  # The interrupt priority setting of SRN1 of Stm3. The SRN number indicates the SRN configured
        container IrqStm3TosConfig  # This container contains the parameter to configure the type of service of all the SRN supported by Stm3 module.
          enumeration IrqStm3SR0Tos: {CPU0, CPU1, CPU2, CPU3, CPU4, CPU5, DMA}, origin=INFINEON_AURIX2G, set at pre-compile, default-value=CPU0  # The interrupt type of service setting of SRN0 of Stm3 Module.
          enumeration IrqStm3SR1Tos: {CPU0, CPU1, CPU2, CPU3, CPU4, CPU5, DMA}, origin=INFINEON_AURIX2G, set at pre-compile, default-value=CPU0  # The interrupt type of service setting of SRN1 of Stm3 Module.
      container IrqStm4Config  # This container contains the stm interrupt configuration parameters.
        container IrqStm4CatConfig  # This container contains the parameter to configure the category of all the SRN supported by Stm4 module.
          enumeration IrqStm4SR0Cat: {CAT1, CAT2}, origin=INFINEON_AURIX2G, set at pre-compile, default-value=CAT1  # The interrupt category setting of SRN0 of Stm4 Module. Depending upon the category the interrupt Frame is different
          enumeration IrqStm4SR1Cat: {CAT1, CAT2}, origin=INFINEON_AURIX2G, set at pre-compile, default-value=CAT1  # The interrupt category setting of SRN1 of Stm4 Module. Depending upon the category the interrupt Frame is different
        container IrqStm4PrioConfig  # This container contains the parameter to configure the priority of all the SRN supported by Stm4 module.
          integer IrqStm4SR0Prio: 0..255, origin=INFINEON_AURIX2G, set at pre-compile, default-value=0  # The interrupt priority setting of SRN0 of Stm4. The SRN number indicates the SRN configured
          integer IrqStm4SR1Prio: 0..255, origin=INFINEON_AURIX2G, set at pre-compile, default-value=0  # The interrupt priority setting of SRN1 of Stm4. The SRN number indicates the SRN configured
        container IrqStm4TosConfig  # This container contains the parameter to configure the type of service of all the SRN supported by Stm4 module.
          enumeration IrqStm4SR0Tos: {CPU0, CPU1, CPU2, CPU3, CPU4, CPU5, DMA}, origin=INFINEON_AURIX2G, set at pre-compile, default-value=CPU0  # The interrupt type of service setting of SRN0 of Stm4 Module.
          enumeration IrqStm4SR1Tos: {CPU0, CPU1, CPU2, CPU3, CPU4, CPU5, DMA}, origin=INFINEON_AURIX2G, set at pre-compile, default-value=CPU0  # The interrupt type of service setting of SRN1 of Stm4 Module.
      container IrqStm5Config  # This container contains the stm interrupt configuration parameters.
        container IrqStm5CatConfig  # This container contains the parameter to configure the category of all the SRN supported by Stm5 module.
          enumeration IrqStm5SR0Cat: {CAT1, CAT2}, origin=INFINEON_AURIX2G, set at pre-compile, default-value=CAT1  # The interrupt category setting of SRN0 of Stm5 Module. Depending upon the category the interrupt Frame is different
          enumeration IrqStm5SR1Cat: {CAT1, CAT2}, origin=INFINEON_AURIX2G, set at pre-compile, default-value=CAT1  # The interrupt category setting of SRN1 of Stm5 Module. Depending upon the category the interrupt Frame is different
        container IrqStm5PrioConfig  # This container contains the parameter to configure the priority of all the SRN supported by Stm5 module.
          integer IrqStm5SR0Prio: 0..255, origin=INFINEON_AURIX2G, set at pre-compile, default-value=0  # The interrupt priority setting of SRN0 of Stm5. The SRN number indicates the SRN configured
          integer IrqStm5SR1Prio: 0..255, origin=INFINEON_AURIX2G, set at pre-compile, default-value=0  # The interrupt priority setting of SRN1 of Stm5. The SRN number indicates the SRN configured
        container IrqStm5TosConfig  # This container contains the parameter to configure the type of service of all the SRN supported by Stm5 module.
          enumeration IrqStm5SR0Tos: {CPU0, CPU1, CPU2, CPU3, CPU4, CPU5, DMA}, origin=INFINEON_AURIX2G, set at pre-compile, default-value=CPU0  # The interrupt type of service setting of SRN0 of Stm5 Module.
          enumeration IrqStm5SR1Tos: {CPU0, CPU1, CPU2, CPU3, CPU4, CPU5, DMA}, origin=INFINEON_AURIX2G, set at pre-compile, default-value=CPU0  # The interrupt type of service setting of SRN1 of Stm5 Module.
    container IrqETHConfig  # This container contains the Ethernet interrupt configuration parameters.
      container IrqETHCatConfig  # This container contains the parameter to configure the category of all the SRN supported by Ethernet module.
        enumeration IrqETHSR{0..9}Cat: {CAT1, CAT2}, origin=INFINEON_AURIX2G, set at pre-compile, default-value=CAT1  # The interrupt category setting of Ethernet Service Request. Depending upon the category the interrupt Frame is different.
      container IrqETHPrioConfig  # This container contains the parameter to configure the priority of all the SRN supported by Ethernet module.
        integer IrqETHSR{0..9}Prio: 0..255, origin=INFINEON_AURIX2G, set at pre-compile, default-value=0  # The interrupt priority setting of Ethernet Service Request.
      container IrqETHTosConfig  # This container contains the parameter to configure the type of service of all the SRN supported by Ethernet module.
        enumeration IrqETHSR{0..9}Tos: {CPU0, CPU1, CPU2, CPU3, CPU4, CPU5, DMA}, origin=INFINEON_AURIX2G, set at pre-compile, default-value=CPU0  # The interrupt type of service setting of Ethernet Service Request.
    container IrqCanConfig  # This container contains the Can module interrupt configuration parameters.
      container IrqCan0Config  # This container contains the Can module interrupt configuration parameters.
        container IrqCanCatConfig  # This container contains the Can category configuration parameters.
          enumeration IrqCanSR{0..11}Cat: {CAT1, CAT2}, origin=INFINEON_AURIX2G, set at pre-compile, default-value=CAT1  # The interrupt category setting of SRN{0..11} of Can Module. Depending upon the category the interrupt Frame is different.
          enumeration IrqCanSR12Cat: {CAT1, CAT2}, origin=INFINEON_AURIX2G, set at pre-compile, default-value=CAT1  # The interrupt category setting of SRN5 of Can Module. Depending upon the category the interrupt Frame is different.
          enumeration IrqCanSR{13..15}Cat: {CAT1, CAT2}, origin=INFINEON_AURIX2G, set at pre-compile, default-value=CAT1  # The interrupt category setting of SRN{13..15} of Can Module. Depending upon the category the interrupt Frame is different.
        container IrqCanPrioConfig  # This container contains the parameter to configure the priority of all the SRN supported by Can module.
          integer IrqCanSR{0..15}Prio: 0..255, origin=INFINEON_AURIX2G, set at pre-compile, default-value=0  # The interrupt priority setting of SRN{0..15} of Can Module.
        container IrqCanTosConfig  # This container contains the Can Type of Service configuration parameters.
          enumeration IrqCanSR{0..15}Tos: {CPU0, CPU1, CPU2, CPU3, CPU4, CPU5, DMA}, origin=INFINEON_AURIX2G, set at pre-compile, default-value=CPU0  # The interrupt type of service setting of SRN{0..15} of Can Module.
      container IrqCan1Config  # This container contains the Can module interrupt configuration parameters.
        container IrqCanCatConfig  # This container contains the Can category configuration parameters.
          enumeration IrqCanSR{0..11}Cat: {CAT1, CAT2}, origin=INFINEON_AURIX2G, set at pre-compile, default-value=CAT1  # The interrupt category setting of SRN{0..11} of Can Module. Depending upon the category the interrupt Frame is different.
          enumeration IrqCanSR12Cat: {CAT1, CAT2}, origin=INFINEON_AURIX2G, set at pre-compile, default-value=CAT1  # The interrupt category setting of SRN5 of Can Module. Depending upon the category the interrupt Frame is different.
          enumeration IrqCanSR{13..15}Cat: {CAT1, CAT2}, origin=INFINEON_AURIX2G, set at pre-compile, default-value=CAT1  # The interrupt category setting of SRN{13..15} of Can Module. Depending upon the category the interrupt Frame is different.
        container IrqCanPrioConfig  # This container contains the parameter to configure the priority of all the SRN supported by Can module.
          integer IrqCanSR{0..15}Prio: 0..255, origin=INFINEON_AURIX2G, set at pre-compile, default-value=0  # The interrupt priority setting of SRN{0..15} of Can Module.
        container IrqCanTosConfig  # This container contains the Can Type of Service configuration parameters.
          enumeration IrqCanSR{0..15}Tos: {CPU0, CPU1, CPU2, CPU3, CPU4, CPU5, DMA}, origin=INFINEON_AURIX2G, set at pre-compile, default-value=CPU0  # The interrupt type of service setting of SRN{0..15} of Can Module.
      container IrqCan2Config  # This container contains the Can module interrupt configuration parameters.
        container IrqCanCatConfig  # This container contains the Can category configuration parameters.
          enumeration IrqCanSR{0..11}Cat: {CAT1, CAT2}, origin=INFINEON_AURIX2G, set at pre-compile, default-value=CAT1  # The interrupt category setting of SRN{0..11} of Can Module. Depending upon the category the interrupt Frame is different.
          enumeration IrqCanSR12Cat: {CAT1, CAT2}, origin=INFINEON_AURIX2G, set at pre-compile, default-value=CAT1  # The interrupt category setting of SRN5 of Can Module. Depending upon the category the interrupt Frame is different.
          enumeration IrqCanSR{13..15}Cat: {CAT1, CAT2}, origin=INFINEON_AURIX2G, set at pre-compile, default-value=CAT1  # The interrupt category setting of SRN{13..15} of Can Module. Depending upon the category the interrupt Frame is different.
        container IrqCanPrioConfig  # This container contains the parameter to configure the priority of all the SRN supported by Can module.
          integer IrqCanSR{0..15}Prio: 0..255, origin=INFINEON_AURIX2G, set at pre-compile, default-value=0  # The interrupt priority setting of SRN{0..15} of Can Module.
        container IrqCanTosConfig  # This container contains the Can Type of Service configuration parameters.
          enumeration IrqCanSR{0..15}Tos: {CPU0, CPU1, CPU2, CPU3, CPU4, CPU5, DMA}, origin=INFINEON_AURIX2G, set at pre-compile, default-value=CPU0  # The interrupt type of service setting of SRN{0..15} of Can Module.
      container IrqCan3Config  # This container contains the Can module interrupt configuration parameters.
        container IrqCanCatConfig  # This container contains the Can category configuration parameters.
          enumeration IrqCanSR{0..11}Cat: {CAT1, CAT2}, origin=INFINEON_AURIX2G, set at pre-compile, default-value=CAT1  # The interrupt category setting of SRN{0..11} of Can Module. Depending upon the category the interrupt Frame is different.
          enumeration IrqCanSR12Cat: {CAT1, CAT2}, origin=INFINEON_AURIX2G, set at pre-compile, default-value=CAT1  # The interrupt category setting of SRN5 of Can Module. Depending upon the category the interrupt Frame is different.
          enumeration IrqCanSR{13..15}Cat: {CAT1, CAT2}, origin=INFINEON_AURIX2G, set at pre-compile, default-value=CAT1  # The interrupt category setting of SRN{13..15} of Can Module. Depending upon the category the interrupt Frame is different.
        container IrqCanPrioConfig  # This container contains the parameter to configure the priority of all the SRN supported by Can module.
          integer IrqCanSR{0..15}Prio: 0..255, origin=INFINEON_AURIX2G, set at pre-compile, default-value=0  # The interrupt priority setting of SRN{0..15} of Can Module.
        container IrqCanTosConfig  # This container contains the Can Type of Service configuration parameters.
          enumeration IrqCanSR{0..15}Tos: {CPU0, CPU1, CPU2, CPU3, CPU4, CPU5, DMA}, origin=INFINEON_AURIX2G, set at pre-compile, default-value=CPU0  # The interrupt type of service setting of SRN{0..15} of Can Module.
      container IrqCan4Config  # This container contains the Can module interrupt configuration parameters.
        container IrqCanCatConfig  # This container contains the Can category configuration parameters.
          enumeration IrqCanSR{0..11}Cat: {CAT1, CAT2}, origin=INFINEON_AURIX2G, set at pre-compile, default-value=CAT1  # The interrupt category setting of SRN{0..11} of Can Module. Depending upon the category the interrupt Frame is different.
          enumeration IrqCanSR12Cat: {CAT1, CAT2}, origin=INFINEON_AURIX2G, set at pre-compile, default-value=CAT1  # The interrupt category setting of SRN5 of Can Module. Depending upon the category the interrupt Frame is different.
          enumeration IrqCanSR{13..15}Cat: {CAT1, CAT2}, origin=INFINEON_AURIX2G, set at pre-compile, default-value=CAT1  # The interrupt category setting of SRN{13..15} of Can Module. Depending upon the category the interrupt Frame is different.
        container IrqCanPrioConfig  # This container contains the parameter to configure the priority of all the SRN supported by Can module.
          integer IrqCanSR{0..15}Prio: 0..255, origin=INFINEON_AURIX2G, set at pre-compile, default-value=0  # The interrupt priority setting of SRN{0..15} of Can Module.
        container IrqCanTosConfig  # This container contains the Can Type of Service configuration parameters.
          enumeration IrqCanSR{0..15}Tos: {CPU0, CPU1, CPU2, CPU3, CPU4, CPU5, DMA}, origin=INFINEON_AURIX2G, set at pre-compile, default-value=CPU0  # The interrupt type of service setting of SRN{0..15} of Can Module.
    container IrqAdcConfig  # This container contains the Adc interrupt configuration parameters.
      container IrqAdc0Config  # This container contains the Adc0 interrupt configuration parameters.
        container IrqAdc0CatConfig  # This container contains the parameter to configure the category of all the SRN supported by Adc module.
          enumeration IrqAdc0SR{0..3}Cat: {CAT1, CAT2}, origin=INFINEON_AURIX2G, set at pre-compile, default-value=CAT1  # The interrupt category setting of SRN{0..3} of Adc Module. The SRN number indicates the SRN configured. Depending upon the category the interrupt frame is different.
        container IrqAdc0PrioConfig  # This container contains the parameter to configure the priority of all the SRN supported by Adc module.
          integer IrqAdc0SR{0..3}Prio: 0..255, origin=INFINEON_AURIX2G, set at pre-compile, default-value=0  # The interrupt priority setting of SRN{0..3} of Adc.The SRN number indicates the SRN configured.
        container IrqAdc0TosConfig  # This container contains the parameter to configure the type of service of all the SRN supported by Adc0 module.
          enumeration IrqAdc0SR{0..3}Tos: {CPU0, CPU1, CPU2, CPU3, CPU4, CPU5, DMA}, origin=INFINEON_AURIX2G, set at pre-compile, default-value=CPU0  # The interrupt type of service setting of SRN{0..3} of Adc0 Module.
      container IrqAdc1Config  # This container contains the Adc1 interrupt configuration parameters.
        container IrqAdc1CatConfig  # This container contains the parameter to configure the category of all the SRN supported by Adc module.
          enumeration IrqAdc1SR{0..3}Cat: {CAT1, CAT2}, origin=INFINEON_AURIX2G, set at pre-compile, default-value=CAT1  # The interrupt category setting of SRN{0..3} of Adc Module. The SRN number indicates the SRN configured. Depending upon the category the interrupt frame is different.
        container IrqAdc1PrioConfig  # This container contains the parameter to configure the priority of all the SRN supported by Adc module.
          integer IrqAdc1SR{0..3}Prio: 0..255, origin=INFINEON_AURIX2G, set at pre-compile, default-value=0  # The interrupt priority setting of SRN{0..3} of Adc.The SRN number indicates the SRN configured.
        container IrqAdc1TosConfig  # This container contains the parameter to configure the type of service of all the SRN supported by Adc1 module.
          enumeration IrqAdc1SR{0..3}Tos: {CPU0, CPU1, CPU2, CPU3, CPU4, CPU5, DMA}, origin=INFINEON_AURIX2G, set at pre-compile, default-value=CPU0  # The interrupt type of service setting of SRN{0..3} of Adc1 Module.
      container IrqAdc2Config  # This container contains the Adc2 interrupt configuration parameters.
        container IrqAdc2CatConfig  # This container contains the parameter to configure the category of all the SRN supported by Adc module.
          enumeration IrqAdc2SR{0..3}Cat: {CAT1, CAT2}, origin=INFINEON_AURIX2G, set at pre-compile, default-value=CAT1  # The interrupt category setting of SRN{0..3} of Adc Module. The SRN number indicates the SRN configured. Depending upon the category the interrupt frame is different.
        container IrqAdc2PrioConfig  # This container contains the parameter to configure the priority of all the SRN supported by Adc module.
          integer IrqAdc2SR{0..3}Prio: 0..255, origin=INFINEON_AURIX2G, set at pre-compile, default-value=0  # The interrupt priority setting of SRN{0..3} of Adc.The SRN number indicates the SRN configured.
        container IrqAdc2TosConfig  # This container contains the parameter to configure the type of service of all the SRN supported by Adc2 module.
          enumeration IrqAdc2SR{0..3}Tos: {CPU0, CPU1, CPU2, CPU3, CPU4, CPU5, DMA}, origin=INFINEON_AURIX2G, set at pre-compile, default-value=CPU0  # The interrupt type of service setting of SRN{0..3} of Adc2 Module.
      container IrqAdc3Config  # This container contains the Adc3 interrupt configuration parameters.
        container IrqAdc3CatConfig  # This container contains the parameter to configure the category of all the SRN supported by Adc module.
          enumeration IrqAdc3SR{0..3}Cat: {CAT1, CAT2}, origin=INFINEON_AURIX2G, set at pre-compile, default-value=CAT1  # The interrupt category setting of SRN{0..3} of Adc Module. The SRN number indicates the SRN configured. Depending upon the category the interrupt frame is different.
        container IrqAdc3PrioConfig  # This container contains the parameter to configure the priority of all the SRN supported by Adc module.
          integer IrqAdc3SR{0..3}Prio: 0..255, origin=INFINEON_AURIX2G, set at pre-compile, default-value=0  # The interrupt priority setting of SRN{0..3} of Adc.The SRN number indicates the SRN configured.
        container IrqAdc3TosConfig  # This container contains the parameter to configure the type of service of all the SRN supported by Adc3 module.
          enumeration IrqAdc3SR{0..3}Tos: {CPU0, CPU1, CPU2, CPU3, CPU4, CPU5, DMA}, origin=INFINEON_AURIX2G, set at pre-compile, default-value=CPU0  # The interrupt type of service setting of SRN{0..3} of Adc3 Module.
      container IrqAdc4Config  # This container contains the Adc4 interrupt configuration parameters.
        container IrqAdc4CatConfig  # This container contains the parameter to configure the category of all the SRN supported by Adc module.
          enumeration IrqAdc4SR{0..3}Cat: {CAT1, CAT2}, origin=INFINEON_AURIX2G, set at pre-compile, default-value=CAT1  # The interrupt category setting of SRN{0..3} of Adc Module. The SRN number indicates the SRN configured. Depending upon the category the interrupt frame is different.
        container IrqAdc4PrioConfig  # This container contains the parameter to configure the priority of all the SRN supported by Adc module.
          integer IrqAdc4SR{0..3}Prio: 0..255, origin=INFINEON_AURIX2G, set at pre-compile, default-value=0  # The interrupt priority setting of SRN{0..3} of Adc.The SRN number indicates the SRN configured.
        container IrqAdc4TosConfig  # This container contains the parameter to configure the type of service of all the SRN supported by Adc4 module.
          enumeration IrqAdc4SR{0..3}Tos: {CPU0, CPU1, CPU2, CPU3, CPU4, CPU5, DMA}, origin=INFINEON_AURIX2G, set at pre-compile, default-value=CPU0  # The interrupt type of service setting of SRN{0..3} of Adc4 Module.
      container IrqAdc5Config  # This container contains the Adc5 interrupt configuration parameters.
        container IrqAdc5CatConfig  # This container contains the parameter to configure the category of all the SRN supported by Adc module.
          enumeration IrqAdc5SR{0..3}Cat: {CAT1, CAT2}, origin=INFINEON_AURIX2G, set at pre-compile, default-value=CAT1  # The interrupt category setting of SRN{0..3} of Adc Module. The SRN number indicates the SRN configured. Depending upon the category the interrupt frame is different.
        container IrqAdc5PrioConfig  # This container contains the parameter to configure the priority of all the SRN supported by Adc module.
          integer IrqAdc5SR{0..3}Prio: 0..255, origin=INFINEON_AURIX2G, set at pre-compile, default-value=0  # The interrupt priority setting of SRN{0..3} of Adc.The SRN number indicates the SRN configured.
        container IrqAdc5TosConfig  # This container contains the parameter to configure the type of service of all the SRN supported by Adc5 module.
          enumeration IrqAdc5SR{0..3}Tos: {CPU0, CPU1, CPU2, CPU3, CPU4, CPU5, DMA}, origin=INFINEON_AURIX2G, set at pre-compile, default-value=CPU0  # The interrupt type of service setting of SRN{0..3} of Adc5 Module.
      container IrqAdc6Config  # This container contains the Adc6 interrupt configuration parameters.
        container IrqAdc6CatConfig  # This container contains the parameter to configure the category of all the SRN supported by Adc module.
          enumeration IrqAdc6SR{0..3}Cat: {CAT1, CAT2}, origin=INFINEON_AURIX2G, set at pre-compile, default-value=CAT1  # The interrupt category setting of SRN{0..3} of Adc Module. The SRN number indicates the SRN configured. Depending upon the category the interrupt frame is different.
        container IrqAdc6PrioConfig  # This container contains the parameter to configure the priority of all the SRN supported by Adc module.
          integer IrqAdc6SR{0..3}Prio: 0..255, origin=INFINEON_AURIX2G, set at pre-compile, default-value=0  # The interrupt priority setting of SRN{0..3} of Adc.The SRN number indicates the SRN configured.
        container IrqAdc6TosConfig  # This container contains the parameter to configure the type of service of all the SRN supported by Adc6 module.
          enumeration IrqAdc6SR{0..3}Tos: {CPU0, CPU1, CPU2, CPU3, CPU4, CPU5, DMA}, origin=INFINEON_AURIX2G, set at pre-compile, default-value=CPU0  # The interrupt type of service setting of SRN{0..3} of Adc6 Module.
      container IrqAdc7Config  # This container contains the Adc7 interrupt configuration parameters.
        container IrqAdc7CatConfig  # This container contains the parameter to configure the category of all the SRN supported by Adc module.
          enumeration IrqAdc7SR{0..3}Cat: {CAT1, CAT2}, origin=INFINEON_AURIX2G, set at pre-compile, default-value=CAT1  # The interrupt category setting of SRN{0..3} of Adc Module. The SRN number indicates the SRN configured. Depending upon the category the interrupt frame is different.
        container IrqAdc7PrioConfig  # This container contains the parameter to configure the priority of all the SRN supported by Adc module.
          integer IrqAdc7SR{0..3}Prio: 0..255, origin=INFINEON_AURIX2G, set at pre-compile, default-value=0  # The interrupt priority setting of SRN{0..3} of Adc.The SRN number indicates the SRN configured.
        container IrqAdc7TosConfig  # This container contains the parameter to configure the type of service of all the SRN supported by Adc7 module.
          enumeration IrqAdc7SR{0..3}Tos: {CPU0, CPU1, CPU2, CPU3, CPU4, CPU5, DMA}, origin=INFINEON_AURIX2G, set at pre-compile, default-value=CPU0  # The interrupt type of service setting of SRN{0..3} of Adc7 Module.
      container IrqAdc8Config  # This container contains the Adc8 interrupt configuration parameters.
        container IrqAdc8CatConfig  # This container contains the parameter to configure the category of all the SRN supported by Adc module.
          enumeration IrqAdc8SR{0..3}Cat: {CAT1, CAT2}, origin=INFINEON_AURIX2G, set at pre-compile, default-value=CAT1  # The interrupt category setting of SRN{0..3} of Adc Module. The SRN number indicates the SRN configured. Depending upon the category the interrupt frame is different.
        container IrqAdc8PrioConfig  # This container contains the parameter to configure the priority of all the SRN supported by Adc module.
          integer IrqAdc8SR{0..3}Prio: 0..255, origin=INFINEON_AURIX2G, set at pre-compile, default-value=0  # The interrupt priority setting of SRN{0..3} of Adc.The SRN number indicates the SRN configured.
        container IrqAdc8TosConfig  # This container contains the parameter to configure the type of service of all the SRN supported by Adc8 module.
          enumeration IrqAdc8SR{0..3}Tos: {CPU0, CPU1, CPU2, CPU3, CPU4, CPU5, DMA}, origin=INFINEON_AURIX2G, set at pre-compile, default-value=CPU0  # The interrupt type of service setting of SRN{0..3} of Adc8 Module.
      container IrqAdc9Config  # This container contains the Adc9 interrupt configuration parameters.
        container IrqAdc9CatConfig  # This container contains the parameter to configure the category of all the SRN supported by Adc module.
          enumeration IrqAdc9SR{0..3}Cat: {CAT1, CAT2}, origin=INFINEON_AURIX2G, set at pre-compile, default-value=CAT1  # The interrupt category setting of SRN{0..3} of Adc Module. The SRN number indicates the SRN configured. Depending upon the category the interrupt frame is different.
        container IrqAdc9PrioConfig  # This container contains the parameter to configure the priority of all the SRN supported by Adc module.
          integer IrqAdc9SR{0..3}Prio: 0..255, origin=INFINEON_AURIX2G, set at pre-compile, default-value=0  # The interrupt priority setting of SRN{0..3} of Adc.The SRN number indicates the SRN configured.
        container IrqAdc9TosConfig  # This container contains the parameter to configure the type of service of all the SRN supported by Adc9 module.
          enumeration IrqAdc9SR{0..3}Tos: {CPU0, CPU1, CPU2, CPU3, CPU4, CPU5, DMA}, origin=INFINEON_AURIX2G, set at pre-compile, default-value=CPU0  # The interrupt type of service setting of SRN{0..3} of Adc9 Module.
      container IrqAdc10Config  # This container contains the Adc10 interrupt configuration parameters.
        container IrqAdc10CatConfig  # This container contains the parameter to configure the category of all the SRN supported by Adc module.
          enumeration IrqAdc10SR{0..3}Cat: {CAT1, CAT2}, origin=INFINEON_AURIX2G, set at pre-compile, default-value=CAT1  # The interrupt category setting of SRN{0..3} of Adc Module. The SRN number indicates the SRN configured. Depending upon the category the interrupt frame is different.
        container IrqAdc10PrioConfig  # This container contains the parameter to configure the priority of all the SRN supported by Adc module.
          integer IrqAdc10SR{0..3}Prio: 0..255, origin=INFINEON_AURIX2G, set at pre-compile, default-value=0  # The interrupt priority setting of SRN{0..3} of Adc.The SRN number indicates the SRN configured.
        container IrqAdc10TosConfig  # This container contains the parameter to configure the type of service of all the SRN supported by Adc10 module.
          enumeration IrqAdc10SR{0..3}Tos: {CPU0, CPU1, CPU2, CPU3, CPU4, CPU5, DMA}, origin=INFINEON_AURIX2G, set at pre-compile, default-value=CPU0  # The interrupt type of service setting of SRN{0..3} of Adc10 Module.
      container IrqAdc11Config  # This container contains the Adc10 interrupt configuration parameters.
        container IrqAdc11CatConfig  # This container contains the parameter to configure the category of all the SRN supported by Adc11 module.
          enumeration IrqAdc11SR{0..3}Cat: {CAT1, CAT2}, origin=INFINEON_AURIX2G, set at pre-compile, default-value=CAT1  # The interrupt category setting of SRN{0..3} of Adc Module. The SRN number indicates the SRN configured. Depending upon the category the interrupt frame is different.
        container IrqAdc11PrioConfig  # This container contains the parameter to configure the priority of all the SRN supported by Adc11 module.
          integer IrqAdc11SR{0..3}Prio: 0..255, origin=INFINEON_AURIX2G, set at pre-compile, default-value=0  # The interrupt priority setting of SRN{0..3} of Adc.The SRN number indicates the SRN configured.
        container IrqAdc11TosConfig  # This container contains the parameter to configure the type of service of all the SRN supported by Adc11 module.
          enumeration IrqAdc11SR{0..3}Tos: {CPU0, CPU1, CPU2, CPU3, CPU4, CPU5, DMA}, origin=INFINEON_AURIX2G, set at pre-compile, default-value=CPU0  # The interrupt type of service setting of SRN{0..3} of Adc11 Module.
      container IrqAdcCG0Config  # This container contains the AdcCG0 interrupt configuration parameters.
        container IrqAdcCG0CatConfig  # This container contains the parameter to configure the category of all the SRN supported by Adc Common Group.
          enumeration IrqAdcCG0SR{0..3}Cat: {CAT1, CAT2}, origin=INFINEON_AURIX2G, set at pre-compile, default-value=CAT1  # The interrupt category setting of SRN{0..3} of Adc Common Group. The SRN number indicates the SRN configured. Depending upon the category the interrupt frame is different.
        container IrqAdcCG0PrioConfig  # This container contains the parameter to configure the priority of all the SRN supported by Adc Common Group.
          integer IrqAdcCG0SR{0..3}Prio: 0..255, origin=INFINEON_AURIX2G, set at pre-compile, default-value=0  # The interrupt priority setting of SRN{0..3} of Adc Common Group.The SRN number indicates the SRN configured.
        container IrqAdcCG0TosConfig  # This container contains the parameter to configure the type of service of all the SRN supported by Adc Common Group.
          enumeration IrqAdcCG0SR{0..3}Tos: {CPU0, CPU1, CPU2, CPU3, CPU4, CPU5, DMA}, origin=INFINEON_AURIX2G, set at pre-compile, default-value=CPU0  # The interrupt type of service setting of SRN{0..3} of Adc Common Group.
      container IrqAdcCG1Config  # This container contains the AdcCG1 interrupt configuration parameters.
        container IrqAdcCG1CatConfig  # This container contains the parameter to configure the category of all the SRN supported by Adc Common Group.
          enumeration IrqAdcCG1SR{0..3}Cat: {CAT1, CAT2}, origin=INFINEON_AURIX2G, set at pre-compile, default-value=CAT1  # The interrupt category setting of SRN{0..3} of Adc Common Group. The SRN number indicates the SRN configured. Depending upon the category the interrupt frame is different.
        container IrqAdcCG1PrioConfig  # This container contains the parameter to configure the priority of all the SRN supported by Adc Common Group.
          integer IrqAdcCG1SR{0..3}Prio: 0..255, origin=INFINEON_AURIX2G, set at pre-compile, default-value=0  # The interrupt priority setting of SRN{0..3} of Adc Common Group.The SRN number indicates the SRN configured.
        container IrqAdcCG1TosConfig  # This container contains the parameter to configure the type of service of all the SRN supported by Adc Common Group.
          enumeration IrqAdcCG1SR{0..3}Tos: {CPU0, CPU1, CPU2, CPU3, CPU4, CPU5, DMA}, origin=INFINEON_AURIX2G, set at pre-compile, default-value=CPU0  # The interrupt type of service setting of SRN{0..3} of Adc Common Group.
    container IrqDMUConfig  # This container contains the DMU interrupt configuration parameters.
      container IrqDMUCatConfig  # This container contains the parameter to configure the category of all the SRN supported by DMU module.
        enumeration IrqDMUHOSTCat: {CAT1, CAT2}, origin=INFINEON_AURIX2G, set at pre-compile, default-value=CAT1  # The interrupt category setting of DMU HOST. Depending upon the category the interrupt Frame is different.
        enumeration IrqDMUFSICat: {CAT1, CAT2}, origin=INFINEON_AURIX2G, set at pre-compile, default-value=CAT1  # The interrupt category setting of DMU FSI. Depending upon the category the interrupt Frame is different.
      container IrqDMUPrioConfig  # This container contains the parameter to configure the priority of all the SRN supported by DMU module.
        integer IrqDMUHOSTPrio: 0..255, origin=INFINEON_AURIX2G, set at pre-compile, default-value=0  # The interrupt priority setting of DMU HOST.
        integer IrqDMUFSIPrio: 0..255, origin=INFINEON_AURIX2G, set at pre-compile, default-value=0  # The interrupt priority setting of DMU FSI.
      container IrqDMUTosConfig  # This container contains the parameter to configure the type of service of all the SRN supported by DMU module.
        enumeration IrqDMUHOSTTos: {CPU0, CPU1, CPU2, CPU3, CPU4, CPU5, DMA}, origin=INFINEON_AURIX2G, set at pre-compile, default-value=CPU0  # The interrupt type of service setting of DMU HOST.
        enumeration IrqDMUFSITos: {CPU0, CPU1, CPU2, CPU3, CPU4, CPU5, DMA}, origin=INFINEON_AURIX2G, set at pre-compile, default-value=CPU0  # The interrupt type of service setting of DMU FSI.
    container IrqASCLINConfig  # This container contains the ASCLIN module interrupt nodes configuration parameters.
      container IrqAsclinCatConfig  # This container contains parameters to configure the interrupt category of all SRN supported by ASCLIN module.
        container IrqAsclinTxCatConfig  # This container contains the parameter to configure the category of all the Transmit SRN supported by Asclin module.
          enumeration IrqAsclin{0..23}TxCat: {CAT1, CAT2}, origin=INFINEON_AURIX2G, set at pre-compile, default-value=CAT1  # The interrupt category setting of SRNTx of Asclin{0..23} Module. Depending upon the category the interrupt Frame is different.
        container IrqAsclinRxCatConfig  # This container contains the parameter to configure the category of all the Receive SRN supported by Asclin module.
          enumeration IrqAsclin{0..23}RxCat: {CAT1, CAT2}, origin=INFINEON_AURIX2G, set at pre-compile, default-value=CAT1  # The interrupt category setting of SRNRx of Asclin{0..23} Module. Depending upon the category the interrupt Frame is different.
        container IrqAsclinErrCatConfig  # This container contains the parameter to configure the category of all the Error SRN supported by Asclin module.
          enumeration IrqAsclin{0..23}ErrCat: {CAT1, CAT2}, origin=INFINEON_AURIX2G, set at pre-compile, default-value=CAT1  # The interrupt category setting of SRN Err of Asclin{0..23} Module. Depending upon the category the interrupt Frame is different.
      container IrqAsclinPrioConfig  # This container contains the parameter to configure the priority of all the SRN supported by Asclin module.
        container IrqAsclinTxPrioConfig  # This container contains the parameter to configure the priority of all the Transmit SRN supported by Asclin module.
          integer IrqAsclin{0..23}TxPrio: 0..255, origin=INFINEON_AURIX2G, set at pre-compile, default-value=0  # The interrupt priority setting of SRNTx of Asclin{0..23}. The SRN number indicates the SRN configured.
        container IrqAsclinRxPrioConfig  # This container contains the parameter to configure the priority of all the Receive SRN supported by Asclin module.
          integer IrqAsclin{0..7}RxPrio: 0..255, origin=INFINEON_AURIX2G, set at pre-compile, default-value=0  # The interrupt priority setting of SRNRx of AscLin{0..7}. The SRN number indicates the SRN configured.
          integer IrqAsclin{8..23}RxPrio: 0..255, origin=INFINEON_AURIX2G, set at pre-compile, default-value=0  # The interrupt priority setting of SRNRx of Asclin{8..23}. The SRN number indicates the SRN configured.
        container IrqAsclinErrPrioConfig  # This container contains the parameter to configure the priority of all the Error SRN supported by Asclin module.
          integer IrqAsclin{0..23}ErrPrio: 0..255, origin=INFINEON_AURIX2G, set at pre-compile, default-value=0  # The interrupt priority setting of SRN Error of Asclin{0..23}. The SRN number indicates the SRN configured.
      container IrqAsclinTosConfig  # This container contains the Asclin interrupt configuration parameters.
        container IrqAsclinTxTosConfig  # This container contains the parameter to configure the Type of service of all the Transmit SRN supported by Asclin module.
          enumeration IrqAsclin{0..23}TxTos: {CPU0, CPU1, CPU2, CPU3, CPU4, CPU5, DMA}, origin=INFINEON_AURIX2G, set at pre-compile, default-value=CPU0  # The interrupt type of service setting of SRNTx of Asclin{0..23} Module.
        container IrqAsclinRxTosConfig  # This container contains the parameter to configure the Type of service of all the Transmit SRN supported by Asclin module.
          enumeration IrqAsclin{0..23}RxTos: {CPU0, CPU1, CPU2, CPU3, CPU4, CPU5, DMA}, origin=INFINEON_AURIX2G, set at pre-compile, default-value=CPU0  # The interrupt type of service setting of SRNRx of Asclin{0..23} Module.
        container IrqAsclinErrTosConfig  # This container contains the parameter to configure the Type of service of all the Transmit SRN supported by Asclin module.
          enumeration IrqAsclin{0..23}ErrTos: {CPU0, CPU1, CPU2, CPU3, CPU4, CPU5, DMA}, origin=INFINEON_AURIX2G, set at pre-compile, default-value=CPU0  # The interrupt type of service setting of SRN Err of Asclin{0..23} Module.
    container IrqHsslConfig  # This container contains the Hssl interrupt configuration parameters.
      container IrqHssl0Config  # This container contains the Hssl0 interrupt configuration parameters.
        container IrqHssl0CatConfig  # This container contains the parameter to configure the category of all the SRN supported by Hssl module.
          container IrqHssl0COKCatConfig  # This container contains the parameter to configure the category of all the Transmit SRN supported by Hssl module.
            enumeration IrqHssl0COK_{0..3}Cat: {CAT1, CAT2}, origin=INFINEON_AURIX2G, set at pre-compile, default-value=CAT1  # The interrupt category setting of SRNCOK of Hssl0_{0..3} Module. Depending upon the category the interrupt Frame is different.
          container IrqHssl0RDICatConfig  # This container contains the parameter to configure the category of all the Transmit SRN supported by Hssl module.
            enumeration IrqHssl0RDI_{0..3}Cat: {CAT1, CAT2}, origin=INFINEON_AURIX2G, set at pre-compile, default-value=CAT1  # The interrupt category setting of SRNRDI of Hssl0_{0..3} Module. Depending upon the category the interrupt Frame is different.
          container IrqHssl0ERRCatConfig  # This container contains the parameter to configure the category of all the Transmit SRN supported by Hssl module.
            enumeration IrqHssl0ERR_{0..3}Cat: {CAT1, CAT2}, origin=INFINEON_AURIX2G, set at pre-compile, default-value=CAT1  # The interrupt category setting of SRNERR of Hssl0_{0..3} Module. Depending upon the category the interrupt Frame is different.
          container IrqHssl0TRGCatConfig  # This container contains the parameter to configure the category of all the Transmit SRN supported by Hssl module.
            enumeration IrqHssl0TRG_{0..3}Cat: {CAT1, CAT2}, origin=INFINEON_AURIX2G, set at pre-compile, default-value=CAT1  # The interrupt category setting of SRNTRG of Hssl0_{0..3} Module. Depending upon the category the interrupt Frame is different.
          container IrqHssl0EXICatConfig  # This container contains the parameter to configure the category of all the Transmit SRN supported by Hssl module.
            enumeration IrqHssl0EXICat: {CAT1, CAT2}, origin=INFINEON_AURIX2G, set at pre-compile, default-value=CAT1  # The interrupt category setting of SRNEXI of Hssl0 Module. Depending upon the category the interrupt Frame is different.
        container IrqHssl0PrioConfig  # This container contains the parameter to configure the priority of all the SRN supported by Hssl module.
          container IrqHssl0COKPrioConfig  # This container contains the parameter to configure the priority of all the Transmit SRN supported by Hssl module.
            integer IrqHssl0COK_{0..3}Prio: 0..255, origin=INFINEON_AURIX2G, set at pre-compile, default-value=0  # The interrupt priority setting of SRNCOK of Hssl0. The SRN number indicates the SRN configured.
          container IrqHssl0RDIPrioConfig  # This container contains the parameter to configure the priority of all the Transmit SRN supported by Hssl module.
            integer IrqHssl0RDI_{0..3}Prio: 0..255, origin=INFINEON_AURIX2G, set at pre-compile, default-value=0  # The interrupt priority setting of SRNRDI of Hssl0. The SRN number indicates the SRN configured.
          container IrqHssl0ERRPrioConfig  # This container contains the parameter to configure the priority of all the Transmit SRN supported by Hssl module.
            integer IrqHssl0ERR_{0..3}Prio: 0..255, origin=INFINEON_AURIX2G, set at pre-compile, default-value=0  # The interrupt priority setting of SRNERR of Hssl0. The SRN number indicates the SRN configured.
          container IrqHssl0TRGPrioConfig  # This container contains the parameter to configure the priority of all the Transmit SRN supported by Hssl module.
            integer IrqHssl0TRG_{0..3}Prio: 0..255, origin=INFINEON_AURIX2G, set at pre-compile, default-value=0  # The interrupt priority setting of SRNTRG of Hssl0. The SRN number indicates the SRN configured.
          container IrqHssl0EXIPrioConfig  # This container contains the parameter to configure the priority of all the Transmit SRN supported by Hssl module.
            integer IrqHssl0EXIPrio: 0..255, origin=INFINEON_AURIX2G, set at pre-compile, default-value=0  # The interrupt priority setting of SRNEXI of Hssl0. The SRN number indicates the SRN configured.
        container IrqHssl0TosConfig  # This container contains the parameter to configure the type of service of all the SRN supported by Hssl0 module.
          container IrqHssl0COKTosConfig  # This container contains the parameter to configure the Type of service of all the Transmit SRN supported by Hssl module.
            enumeration IrqHssl0COK_{0..3}Tos: {CPU0, CPU1, CPU2, CPU3, CPU4, CPU5, DMA}, origin=INFINEON_AURIX2G, set at pre-compile, default-value=CPU0  # The interrupt type of service setting of SRNCOK of Hssl0 Module.
          container IrqHssl0RDITosConfig  # This container contains the parameter to configure the Type of service of all the Transmit SRN supported by Hssl module.
            enumeration IrqHssl0RDI_{0..3}Tos: {CPU0, CPU1, CPU2, CPU3, CPU4, CPU5, DMA}, origin=INFINEON_AURIX2G, set at pre-compile, default-value=CPU0  # The interrupt type of service setting of SRNRDI of Hssl0 Module.
          container IrqHssl0ERRTosConfig  # This container contains the parameter to configure the Type of service of all the Transmit SRN supported by Hssl module.
            enumeration IrqHssl0ERR_{0..3}Tos: {CPU0, CPU1, CPU2, CPU3, CPU4, CPU5, DMA}, origin=INFINEON_AURIX2G, set at pre-compile, default-value=CPU0  # The interrupt type of service setting of SRNERR of Hssl0 Module.
          container IrqHssl0TRGTosConfig  # This container contains the parameter to configure the Type of service of all the Transmit SRN supported by Hssl module.
            enumeration IrqHssl0TRG_{0..3}Tos: {CPU0, CPU1, CPU2, CPU3, CPU4, CPU5, DMA}, origin=INFINEON_AURIX2G, set at pre-compile, default-value=CPU0  # The interrupt type of service setting of SRNTRG of Hssl0 Module.
          container IrqHssl0EXITosConfig  # This container contains the parameter to configure the Type of service of all the Transmit SRN supported by Hssl module.
            enumeration IrqHssl0EXITos: {CPU0, CPU1, CPU2, CPU3, CPU4, CPU5, DMA}, origin=INFINEON_AURIX2G, set at pre-compile, default-value=CPU0  # The interrupt type of service setting of SRNEXI of Hssl0 Module.
      container IrqHssl1Config  # This container contains the Hssl1 interrupt configuration parameters.
        container IrqHssl1CatConfig  # This container contains the parameter to configure the category of all the SRN supported by Hssl module.
          container IrqHssl1COKCatConfig  # This container contains the parameter to configure the category of all the Transmit SRN supported by Hssl module.
            enumeration IrqHssl1COK_{0..3}Cat: {CAT1, CAT2}, origin=INFINEON_AURIX2G, set at pre-compile, default-value=CAT1  # The interrupt category setting of SRNCOK of Hssl1_{0..3} Module. Depending upon the category the interrupt Frame is different.
          container IrqHssl1RDICatConfig  # This container contains the parameter to configure the category of all the Transmit SRN supported by Hssl module.
            enumeration IrqHssl1RDI_{0..3}Cat: {CAT1, CAT2}, origin=INFINEON_AURIX2G, set at pre-compile, default-value=CAT1  # The interrupt category setting of SRNRDI of Hssl1_{0..3} Module. Depending upon the category the interrupt Frame is different.
          container IrqHssl1ERRCatConfig  # This container contains the parameter to configure the category of all the Transmit SRN supported by Hssl module.
            enumeration IrqHssl1ERR_{0..3}Cat: {CAT1, CAT2}, origin=INFINEON_AURIX2G, set at pre-compile, default-value=CAT1  # The interrupt category setting of SRNERR of Hssl1_{0..3} Module. Depending upon the category the interrupt Frame is different.
          container IrqHssl1TRGCatConfig  # This container contains the parameter to configure the category of all the Transmit SRN supported by Hssl module.
            enumeration IrqHssl1TRG_{0..3}Cat: {CAT1, CAT2}, origin=INFINEON_AURIX2G, set at pre-compile, default-value=CAT1  # The interrupt category setting of SRNTRG of Hssl1_{0..3} Module. Depending upon the category the interrupt Frame is different.
          container IrqHssl1EXICatConfig  # This container contains the parameter to configure the category of all the Transmit SRN supported by Hssl module.
            enumeration IrqHssl1EXICat: {CAT1, CAT2}, origin=INFINEON_AURIX2G, set at pre-compile, default-value=CAT1  # The interrupt category setting of SRNEXI of Hssl1 Module. Depending upon the category the interrupt Frame is different.
        container IrqHssl1PrioConfig  # This container contains the parameter to configure the priority of all the SRN supported by Hssl module.
          container IrqHssl1COKPrioConfig  # This container contains the parameter to configure the priority of all the Transmit SRN supported by Hssl module.
            integer IrqHssl1COK_{0..3}Prio: 0..255, origin=INFINEON_AURIX2G, set at pre-compile, default-value=0  # The interrupt priority setting of SRNCOK of Hssl1. The SRN number indicates the SRN configured.
          container IrqHssl1RDIPrioConfig  # This container contains the parameter to configure the priority of all the Transmit SRN supported by Hssl module.
            integer IrqHssl1RDI_{0..3}Prio: 0..255, origin=INFINEON_AURIX2G, set at pre-compile, default-value=0  # The interrupt priority setting of SRNRDI of Hssl1. The SRN number indicates the SRN configured.
          container IrqHssl1ERRPrioConfig  # This container contains the parameter to configure the priority of all the Transmit SRN supported by Hssl module.
            integer IrqHssl1ERR_{0..3}Prio: 0..255, origin=INFINEON_AURIX2G, set at pre-compile, default-value=0  # The interrupt priority setting of SRNERR of Hssl1. The SRN number indicates the SRN configured.
          container IrqHssl1TRGPrioConfig  # This container contains the parameter to configure the priority of all the Transmit SRN supported by Hssl module.
            integer IrqHssl1TRG_{0..3}Prio: 0..255, origin=INFINEON_AURIX2G, set at pre-compile, default-value=0  # The interrupt priority setting of SRNTRG of Hssl1. The SRN number indicates the SRN configured.
          container IrqHssl1EXIPrioConfig  # This container contains the parameter to configure the priority of all the Transmit SRN supported by Hssl module.
            integer IrqHssl1EXIPrio: 0..255, origin=INFINEON_AURIX2G, set at pre-compile, default-value=0  # The interrupt priority setting of SRNEXI of Hssl1. The SRN number indicates the SRN configured.
        container IrqHssl1TosConfig  # This container contains the parameter to configure the type of service of all the SRN supported by Hssl1 module.
          container IrqHssl1COKTosConfig  # This container contains the parameter to configure the Type of service of all the Transmit SRN supported by Hssl module.
            enumeration IrqHssl1COK_{0..3}Tos: {CPU0, CPU1, CPU2, CPU3, CPU4, CPU5, DMA}, origin=INFINEON_AURIX2G, set at pre-compile, default-value=CPU0  # The interrupt type of service setting of SRNCOK of Hssl1 Module.
          container IrqHssl1RDITosConfig  # This container contains the parameter to configure the Type of service of all the Transmit SRN supported by Hssl module.
            enumeration IrqHssl1RDI_{0..3}Tos: {CPU0, CPU1, CPU2, CPU3, CPU4, CPU5, DMA}, origin=INFINEON_AURIX2G, set at pre-compile, default-value=CPU0  # The interrupt type of service setting of SRNRDI of Hssl1 Module.
          container IrqHssl1ERRTosConfig  # This container contains the parameter to configure the Type of service of all the Transmit SRN supported by Hssl module.
            enumeration IrqHssl1ERR_{0..3}Tos: {CPU0, CPU1, CPU2, CPU3, CPU4, CPU5, DMA}, origin=INFINEON_AURIX2G, set at pre-compile, default-value=CPU0  # The interrupt type of service setting of SRNERR of Hssl1 Module.
          container IrqHssl1TRGTosConfig  # This container contains the parameter to configure the Type of service of all the Transmit SRN supported by Hssl module.
            enumeration IrqHssl1TRG_{0..3}Tos: {CPU0, CPU1, CPU2, CPU3, CPU4, CPU5, DMA}, origin=INFINEON_AURIX2G, set at pre-compile, default-value=CPU0  # The interrupt type of service setting of SRNTRG of Hssl1 Module.
          container IrqHssl1EXITosConfig  # This container contains the parameter to configure the Type of service of all the Transmit SRN supported by Hssl module.
            enumeration IrqHssl1EXITos: {CPU0, CPU1, CPU2, CPU3, CPU4, CPU5, DMA}, origin=INFINEON_AURIX2G, set at pre-compile, default-value=CPU0  # The interrupt type of service setting of SRNEXI of Hssl1 Module.
    container IrqSentConfig  # This container contains the Sent module interrupt configuration parameters.
      container IrqSentCatConfig  # This container contains the Sent module category configuration parameters.
        enumeration IrqSentSR{0..9}Cat: {CAT1, CAT2}, origin=INFINEON_AURIX2G, set at pre-compile, default-value=CAT1  # The interrupt category setting of SRN{0..9} of Sent Module. The SRN number indicates the SRN configured. Depending upon the category the interrupt frame is different.
      container IrqSentPrioConfig  # This container contains the parameter to configure the priority of all the SRN supported by Sent module.
        integer IrqSentSR{0..9}Prio: 0..255, origin=INFINEON_AURIX2G, set at pre-compile, default-value=0  # The interrupt priority setting of SRN{0..9} of Sent Module. The SRN number indicates the SRN configured.
      container IrqSentTosConfig  # This container contains the Sent Module Type of Service configuration parameters.
        enumeration IrqSentSR{0..9}Tos: {CPU0, CPU1, CPU2, CPU3, CPU4, CPU5, DMA}, origin=INFINEON_AURIX2G, set at pre-compile, default-value=CPU0  # The interrupt type of service setting of SRN{0..9} of Sent Module.
    container IrqI2cConfig  # This container contains the I2C module interrupt nodes configuration parameters.
      container IrqI2cCatConfig  # This container contains parameters to configure the interrupt category of all SRN supported by I2C module.
        container IrqI2cDtrCatConfig  # This container contains the parameter to configure the category of all the Data Trasfer Request SRN supported by I2C module.
          enumeration IrqI2c0DtrCat: {CAT1, CAT2}, origin=INFINEON_AURIX2G, set at pre-compile, default-value=CAT1  # The interrupt category setting of SRNDtr of I2c0 Module. Depending upon the category the interrupt Frame is different.
          enumeration IrqI2c1DtrCat: {CAT1, CAT2}, origin=INFINEON_AURIX2G, set at pre-compile, default-value=CAT1  # The interrupt category setting of SRNDtr of I2c1 Module. Depending upon the category the interrupt Frame is different.
        container IrqI2cErrCatConfig  # This container contains the parameter to configure the category of all the Error SRN supported by I2c module.
          enumeration IrqI2c0ErrCat: {CAT1, CAT2}, origin=INFINEON_AURIX2G, set at pre-compile, default-value=CAT1  # The interrupt category setting of SRNErr of I2c0 Module. Depending upon the category the interrupt Frame is different.
          enumeration IrqI2c1ErrCat: {CAT1, CAT2}, origin=INFINEON_AURIX2G, set at pre-compile, default-value=CAT1  # The interrupt category setting of SRNErr of I2c1 Module. Depending upon the category the interrupt Frame is different.
        container IrqI2cPCatConfig  # This container contains the parameter to configure the category of all the Protocol SRN supported by I2c module.
          enumeration IrqI2c0PCat: {CAT1, CAT2}, origin=INFINEON_AURIX2G, set at pre-compile, default-value=CAT1  # The interrupt category setting of SRNP of I2c0 Module. Depending upon the category the interrupt Frame is different.
          enumeration IrqI2c1PCat: {CAT1, CAT2}, origin=INFINEON_AURIX2G, set at pre-compile, default-value=CAT1  # The interrupt category setting of SRNP of I2c1 Module. Depending upon the category the interrupt Frame is different.
      container IrqI2cPrioConfig  # This container contains the parameter to configure the priority of all the SRN supported by I2c module.
        container IrqI2cDtrPrioConfig  # This container contains the parameter to configure the priority of all the Transmit SRN supported by I2c module.
          integer IrqI2c0DtrPrio: 0..255, origin=INFINEON_AURIX2G, set at pre-compile, default-value=0  # The interrupt priority setting of SRNDtr of I2c0. The SRN number indicates the SRN configured.
          integer IrqI2c1DtrPrio: 0..255, origin=INFINEON_AURIX2G, set at pre-compile, default-value=0  # The interrupt priority setting of SRNDtr of I2c1. The SRN number indicates the SRN configured.
        container IrqI2cErrPrioConfig  # This container contains the parameter to configure the priority of all the Receive SRN supported by I2c module.
          integer IrqI2c0ErrPrio: 0..255, origin=INFINEON_AURIX2G, set at pre-compile, default-value=0  # The interrupt priority setting of SRNErr of AscLin0. The SRN number indicates the SRN configured.
          integer IrqI2c1ErrPrio: 0..255, origin=INFINEON_AURIX2G, set at pre-compile, default-value=0  # The interrupt priority setting of SRNErr of AscLin1. The SRN number indicates the SRN configured.
        container IrqI2cPPrioConfig  # This container contains the parameter to configure the priority of all the Protocol SRN supported by I2c module.
          integer IrqI2c0PPrio: 0..255, origin=INFINEON_AURIX2G, set at pre-compile, default-value=0  # The interrupt priority setting of SRNP of I2c0. The SRN number indicates the SRN configured.
          integer IrqI2c1PPrio: 0..255, origin=INFINEON_AURIX2G, set at pre-compile, default-value=0  # The interrupt priority setting of SRNP of I2c1. The SRN number indicates the SRN configured.
      container IrqI2cTosConfig  # This container contains the I2c interrupt configuration parameters.
        container IrqI2cDtrTosConfig  # This container contains the parameter to configure the Type of service of all the Transmit SRN supported by I2c module.
          enumeration IrqI2c0DtrTos: {CPU0, CPU1, CPU2, CPU3, CPU4, CPU5, DMA}, origin=INFINEON_AURIX2G, set at pre-compile, default-value=CPU0  # The interrupt type of service setting of SRNDtr of I2c0 Module.
          enumeration IrqI2c1DtrTos: {CPU0, CPU1, CPU2, CPU3, CPU4, CPU5, DMA}, origin=INFINEON_AURIX2G, set at pre-compile, default-value=CPU0  # The interrupt type of service setting of SRNDtr of I2c1 Module.
        container IrqI2cErrTosConfig  # This container contains the parameter to configure the Type of service of all the Transmit SRN supported by I2c module.
          enumeration IrqI2c0ErrTos: {CPU0, CPU1, CPU2, CPU3, CPU4, CPU5, DMA}, origin=INFINEON_AURIX2G, set at pre-compile, default-value=CPU0  # The interrupt type of service setting of SRNErr of I2c0 Module.
          enumeration IrqI2c1ErrTos: {CPU0, CPU1, CPU2, CPU3, CPU4, CPU5, DMA}, origin=INFINEON_AURIX2G, set at pre-compile, default-value=CPU0  # The interrupt type of service setting of SRNErr of I2c1 Module.
        container IrqI2cPTosConfig  # This container contains the parameter to configure the Type of service of all the Protocol SRN supported by I2c module.
          enumeration IrqI2c0PTos: {CPU0, CPU1, CPU2, CPU3, CPU4, CPU5, DMA}, origin=INFINEON_AURIX2G, set at pre-compile, default-value=CPU0  # The interrupt type of service setting of SRNP of I2c0 Module.
          enumeration IrqI2c1PTos: {CPU0, CPU1, CPU2, CPU3, CPU4, CPU5, DMA}, origin=INFINEON_AURIX2G, set at pre-compile, default-value=CPU0  # The interrupt type of service setting of SRNP of I2c1 Module.
    container IrqDsadcConfig  # This container contains the Dsadc interrupt configuration parameters.
      container IrqDsadcCatConfig  # This container contains the parameter to configure the category of all the SRN supported by Dsadc module.
        container IrqDsadcSRMCatConfig  # This container contains the parameter to configure the category of all the Transmit SRN supported by Dsadc module.
          enumeration IrqDSAdcSRM{0..5}Cat: {CAT1, CAT2}, origin=INFINEON_AURIX2G, set at pre-compile, default-value=CAT1  # The interrupt category setting of SRN RM{0..5} of Dsadc Module. Depending upon the category the interrupt Frame is different.
          enumeration IrqDSAdcSRM{6..13}Cat: {CAT1, CAT2}, origin=INFINEON_AURIX2G, set at pre-compile, default-value=CAT1  # The interrupt category setting of SRN RM {6..13} of Dsadc Module. Depending upon the category the interrupt Frame is different.
        container IrqDsadcSRACatConfig  # This container contains the parameter to configure the category of all the Transmit SRN supported by Dsadc module.
          enumeration IrqDSAdcSRA{0..5}Cat: {CAT1, CAT2}, origin=INFINEON_AURIX2G, set at pre-compile, default-value=CAT1  # The interrupt category setting of SRN RA{0..5} of Dsadc Module. Depending upon the category the interrupt Frame is different.
          enumeration IrqDSAdcSRA{6..13}Cat: {CAT1, CAT2}, origin=INFINEON_AURIX2G, set at pre-compile, default-value=CAT1  # The interrupt category setting of SRN RA {6..13} of Dsadc Module. Depending upon the category the interrupt Frame is different.
      container IrqDsadcPrioConfig  # This container contains the parameter to configure the priority of all the SRN supported by Dsadc module.
        container IrqDsadcSRMPrioConfig  # This container contains the parameter to configure the priority of all the Transmit SRN supported by Dsadc module.
          integer IrqDsadcSRM{0..13}Prio: 0..255, origin=INFINEON_AURIX2G, set at pre-compile, default-value=0  # The interrupt priority setting of SRN RM {0..13} of Dsadc. The SRN number indicates the SRN configured.
        container IrqDsadcSRAPrioConfig  # This container contains the parameter to configure the priority of all the Transmit SRN supported by Dsadc module.
          integer IrqDsadcSRA{0..13}Prio: 0..255, origin=INFINEON_AURIX2G, set at pre-compile, default-value=0  # The interrupt priority setting of SRN RA {0..13} of Dsadc. The SRN number indicates the SRN configured.
      container IrqDsadcTosConfig  # This container contains the parameter to configure the type of service of all the SRN supported by Dsadc0 module.
        container IrqDsadcSRMTosConfig  # This container contains the parameter to configure the Type of service of all the Transmit SRN supported by Dsadc module.
          enumeration IrqDsadcSRM{0..11}Tos: {CPU0, CPU1, CPU2, CPU3, CPU4, CPU5, DMA}, origin=INFINEON_AURIX2G, set at pre-compile, default-value=CPU0  # The interrupt type of service setting of SRN RM {0..11} of Dsadc Module.
          enumeration IrqDsadcSRM12Tos: {CPU0, CPU1, CPU2, CPU3, CPU4, CPU5, DMA}, origin=INFINEON_AURIX2G, set at pre-compile, default-value=CPU0  # The interrupt type of service setting of SRN RM 3 of Dsadc Module.
          enumeration IrqDsadcSRM13Tos: {CPU0, CPU1, CPU2, CPU3, CPU4, CPU5, DMA}, origin=INFINEON_AURIX2G, set at pre-compile, default-value=CPU0  # The interrupt type of service setting of SRN RM 13 of Dsadc Module.
        container IrqDsadcSRATosConfig  # This container contains the parameter to configure the Type of service of all the Transmit SRN supported by Dsadc module.
          enumeration IrqDsadcSRA{0..11}Tos: {CPU0, CPU1, CPU2, CPU3, CPU4, CPU5, DMA}, origin=INFINEON_AURIX2G, set at pre-compile, default-value=CPU0  # The interrupt type of service setting of SRN RA {0..11} of Dsadc Module.
          enumeration IrqDsadcSRA12Tos: {CPU0, CPU1, CPU2, CPU3, CPU4, CPU5, DMA}, origin=INFINEON_AURIX2G, set at pre-compile, default-value=CPU0  # The interrupt type of service setting of SRN RA 3 of Dsadc Module.
          enumeration IrqDsadcSRA13Tos: {CPU0, CPU1, CPU2, CPU3, CPU4, CPU5, DMA}, origin=INFINEON_AURIX2G, set at pre-compile, default-value=CPU0  # The interrupt type of service setting of SRN RA 13 of Dsadc Module.
    container CommonPublishedInformation  # Common container, aggregated by all modules. It contains published information about vendor and versions.
      integer ArMajorVersion: 0..255, origin=INFINEON_AURIX2G, set at published-information, default-value=4  # Major version number of AUTOSAR specification on which the appropriate implementation is based on.
      integer ArMinorVersion: 0..255, origin=INFINEON_AURIX2G, set at published-information, default-value=4  # Minor version number of AUTOSAR specification on which the appropriate implementation is based on.
      integer ArPatchVersion: 0..255, origin=INFINEON_AURIX2G, set at published-information, default-value=0  # Patch level version number of AUTOSAR specification on which the appropriate implementation is based on.
      integer SwMajorVersion: 0..255, origin=INFINEON_AURIX2G, set at published-information, default-value=20  # Major version number of the vendor specific implementation of the module. The numbering is vendor specific.
      integer SwMinorVersion: 0..255, origin=INFINEON_AURIX2G, set at published-information, default-value=0  # Minor version number of the vendor specific implementation of the module. The numbering is vendor specific.
      integer SwPatchVersion: 0..255, origin=INFINEON_AURIX2G, set at published-information, default-value=0  # Patch level version number of the vendor specific implementation of the module. The numbering is vendor specific.
      integer ModuleId: 0..65535, origin=INFINEON_AURIX2G, set at published-information, default-value=255  # Module ID of this module ENom Module List
      integer VendorId: 0..65535, origin=INFINEON_AURIX2G, set at published-information, default-value=17  # Vendor ID of the dedicated implementation of this module according to the AUTOSAR vendor list
      string Release: origin=INFINEON_AURIX2G, set at published-information, default-value=_TRICORE_TC397_ADAS  # Aurix2G derivative used for the implementation
