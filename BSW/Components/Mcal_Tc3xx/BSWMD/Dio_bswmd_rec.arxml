AUTOSAR XML (schema 00046)
package /AURIX2G/EcucDefs
  module config Dio_Rec: definition=Dio
  bsw implementation Dio_Impl: programming-language=C, behavior=DioBehavior, recommended-configuration=Dio_Rec, vendor-specific-module-def=Dio
