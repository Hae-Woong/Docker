AUTOSAR XML (schema 00046)
package /AURIX2G/EcucDefs
  module definition Fee [0..1]: post-build-variant-support=true, refined-module-def=Fee, variants post-build  # Configuration of the Fee (Flash EEPROM Emulation) module.
    container FeeBlockConfiguration [1..21719]: multiplicity set at pre-compile  # Configuration of block specific parameters for the Flash EEPROM Emulation module.
      integer FeeBlockNumber: 1..65534, scope=ECU, set at pre-compile, symbolic-name-value=true, default-value=1  # Block identifier (handle).
      integer FeeQsBlockInstances: 0..256, scope=ECU, origin=INFINEON_AURIX2G, post-build-variant-value=true, set at post-build, default-value=0  # number of Block instances (handle).
      integer FeeQsBlockAddress: 0..1048575, scope=ECU, origin=INFINEON_AURIX2G, post-build-variant-value=true, set at post-build, default-value=0  # Block address in DFlash (handle).
      boolean FeeQuasiStaticManager: scope=ECU, origin=INFINEON_AURIX2G, set at pre-compile, default-value=false  # Indicates whether the Block configures is for NVM or Quasi static data Manager.
      integer FeeBlockSize: 1..65535, scope=ECU, post-build-variant-value=true, set at post-build, default-value=1  # Size of a logical block in bytes.
      boolean FeeImmediateData: scope=ECU, post-build-variant-value=true, set at post-build, default-value=false  # Marker for high priority data.
      integer FeeNumberOfWriteCycles: 0..16777215, post-build-variant-value=true, set at post-build, default-value=0  # Number of write cycles required for this block.
      reference FeeDeviceIndex: set at pre-compile, destination=FlsGeneral  # Reference to the device this block is stored in.
    container FeeGeneral  # Container for general parameters. These parameters are not specific to a block.
      boolean FeeDevErrorDetect: set at pre-compile, default-value=false  # Switches the Default Error Tracer (Det) detection and notification ON or OFF.
      boolean FeeSafetyEnable: origin=INFINEON_AURIX2G, set at pre-compile, default-value=true  # This parameter enables the user to avail the functionality to detect and report the safety errors.
      boolean FeeInitCheckApi: origin=INFINEON_AURIX2G, set at pre-compile, default-value=false  # This parameter enables the user to avail the functionality to check if FEE initialisation is proper. true: Fee_17_InitCheck() API is enabled for use. false: Fee_17_InitCheck() API is disabled for use.
      float FeeMainFunctionPeriod: 0.001..1.0, scope=ECU, set at pre-compile, default-value=0.01  # The period between successive calls to the main function in seconds.
      function name FeeNvmJobEndNotification [0..1]: multiplicity set at pre-compile, set at pre-compile, default-value=NULL_PTR  # Mapped to the job end notification routine provided by the upper layer module (NvM_JobEndNotification).
      function name FeeNvmJobErrorNotification [0..1]: multiplicity set at pre-compile, set at pre-compile, default-value=NULL_PTR  # Mapped to the job error notification routine provided by the upper layer module (NvM_JobErrorNotification).
      function name FeeQsJobEndNotification [0..1]: multiplicity set at pre-compile, origin=INFINEON_AURIX2G, set at pre-compile, default-value=NULL_PTR  # Mapped to the job end notification routine provided by the upper layer module (Qs_JobEndNotification).
      function name FeeQsJobErrorNotification [0..1]: multiplicity set at pre-compile, origin=INFINEON_AURIX2G, set at pre-compile, default-value=NULL_PTR  # Mapped to the job error notification routine provided by the upper layer module (Qs_JobErrorNotification).
      boolean FeePollingMode: set at pre-compile, default-value=false  # Pre-processor switch to enable and disable the polling mode for this module.
      boolean FeeSetModeSupported: set at pre-compile, default-value=false  # Compiler switch to enable/disable the 'SetMode' functionality of the FEE module.
      boolean FeeVersionInfoApi: set at pre-compile, default-value=false  # Pre-processor switch to enable / disable the API to read out the modules version information.
      integer FeeVirtualPageSize: 8..8, set at pre-compile, default-value=8  # The size in bytes to which logical blocks shall be aligned.
      enumeration FeeBlockTypeConfigured: {FEE_DOUBLE_SECTOR_DATA_ONLY, FEE_DOUBLE_SECTOR_AND_QUASI_STATIC_DATA, FEE_QUASI_STATIC_DATA_ONLY}, origin=INFINEON_AURIX2G, set at pre-compile, default-value=FEE_DOUBLE_SECTOR_DATA_ONLY  # This parameter is used to configure the type of Blocks configured
    container FeePublishedInformation  # Additional published parameters not covered by CommonPublishedInformation container.
      integer FeeBlockOverhead: 17..17, set at published-information, default-value=17  # Management overhead per logical block in bytes. The actual overhead per block is calculated as: (i) If ((FeeBlockSize % 7) == 0): FeeBlockOverhead = ((FeeBlockSize / 7) * 8) + 16 - FeeBlockSize. (ii)If ((FeeBlockSize % 7) != 0): FeeBlockOverhead = (((FeeBlockSize / 7) + 1) * 8) + 16 - FeeBlockSize. Note: Integer arithmetic is used in the above calculation.
      integer FeePageOverhead: 1..1, set at published-information, default-value=1  # Block management overhead per page in bytes. Note: This value is applicable only for the pages containing logical block data bytes (i.e., it is not applicable for the pages which contain only implementation specific management data).
    container FeeIfxSpecificConfig  # This container has IFX specific parameters required for the working of FEE
      integer FeeThresholdValue: 0..522728, origin=INFINEON_AURIX2G, set at pre-compile, default-value=200  # This parameter describes the threshold value (in bytes from the end of FEE sector) for triggering garbage collection/sector change.
      integer FeeMaxBlockCount: 1..21719, origin=INFINEON_AURIX2G, set at pre-compile, default-value=1  # This configuration parameter specifies the total number of blocks throughout all configurations; Note that the blocks which are shared across configurations are counted only once. This parameter decides the cache table size at pre-compile time. The cache table holds the information of both configured and un-configured blocks. Configuration of this parameter shall be carefully done. Higher value implies higher RAM area consumption for cache table. Lower value would result in loss of un-configured block(s) during GC (if FeeUnConfigBlkOverflowHandle is FEE_CONTINUE) or illegal state of FEE (if FeeUnConfigBlkOverflowHandle is FEE_STOP_AT_GC). Example 1: Configuration sets having mutually exclusive blocks: Configuration A: Number of blocks configured is 10. Configuration B: Number of blocks configured is 25. Then, FeeMaxBlockCount = 35. Example 2: 5 blocks are shared/used by both Configuration A and Configuration B: Configuration A: Number of blocks configured is 10. Configuration B: Number of blocks configured is 25. Then, FeeMaxBlockCount = 30 (i.e., shared blocks are counted only once).
      boolean FeeRunTimeErrorDetect: origin=INFINEON_AURIX2G, set at pre-compile, default-value=true  # This parameter enables or disables the Runtime errors reporting. When this parameter is set to TRUE, this enables the runtime errors reporting. The default value of this parameter is set to TRUE to ensure the runtime error detection during the product lifecycle.
      integer FeeBlocksScannedPerCycle: 0..65535, origin=INFINEON_AURIX2G, set at pre-compile, default-value=0  # This configuration parameter specifies the number of blocks initialized in one Fee_Main() cycle.To initialize single block two pages (header and marker)are red and analyzed.So in one Fee_Main() cycle total number of pages red and analyzed = FeeBlockCountPerMainCycle * 2 Default value is 0 this mean initialize all the block in one Fee_Main()cycle.
      boolean FeeUseEraseSuspend: origin=INFINEON_AURIX2G, set at pre-compile, default-value=false  # This parameter specifies the usage of the erase suspend feature provided by the DFLASH hardware. If it is configured as TRUE, then the read/write requests from the user are serviced during the erase operation of the GC. If it is configured as FALSE, then the user request is kept pending till the erase operation is completed. Note: This parameter can be true only if FlsUseEraseSuspend is true.
      string FeeStateVarStructure: origin=INFINEON_AURIX2G, post-build-variant-value=true, set at post-build, default-value=Fee_StateVar  # This parameter is the name of the structure, which would contain all the global variables of FEE. Using this user can allocate the space for the variables at his behest to avoid any possible linking problems.
      enumeration FeeUnConfigBlock: {FEE_UNCONFIG_BLOCK_IGNORE, FEE_UNCONFIG_BLOCK_KEEP}, origin=INFINEON_AURIX2G, set at pre-compile, default-value=FEE_UNCONFIG_BLOCK_IGNORE  # This parameter is used to configure if unconfigured blocks should be copied or not during GC operation
      enumeration FeeUnConfigBlkOverflowHandle: {FEE_CONTINUE, FEE_STOP_AT_GC}, origin=INFINEON_AURIX2G, set at pre-compile, default-value=FEE_CONTINUE  # This parameter is used to configure the behavior of FEE upon detection of overflow of number of unconfigured blocks. FEE_CONTINUE: Un-configured blocks which could not be accommodated in the cache table, will be lost after the GC. FEE will continue as expected for the currently active configuration. FEE_STOP_AT_GC: During GC, FEE will enter a pseudo illegal state where only read is allowed but write is not allowed.
      enumeration FeeGcRestart: {FEE_GC_RESTART_INIT, FEE_GC_RESTART_WRITE}, origin=INFINEON_AURIX2G, set at pre-compile, default-value=FEE_GC_RESTART_INIT  # This parameter is used to configure Garbage Collection restarting point. FEE_GC_RESTART_INIT: (if GC was interrupted in previous run) Restart GC after FEE Initialization. Hence, internal activities like repairing state pages, building lookup table are done after Fee_Init is called. FEE_GC_RESTART_WRITE: (if GC was interrupted in previous run) Restart GC when the first read/write/invalidate request is issued. Also, other internal activities like repairing state pages, building lookup table are done only after the first Read/write/invalidate request is issued
      boolean FeeGetCycleCountApi: origin=INFINEON_AURIX2G, set at pre-compile, default-value=false  # Pre-processor switch to enable / disable the API to get the block cycle count and erase cycle count.
      boolean FeeEccErrorInfoApi: origin=INFINEON_AURIX2G, set at pre-compile, default-value=false  # Pre-processor switch to enable / disable the API to get the block cycle count and erase cycle count.
      boolean FeeEraseAllEnable: origin=INFINEON_AURIX2G, set at pre-compile, default-value=false  # This parameter allows the user to configure if the sectors should be erased when FEE reaches an illegal state. TRUE: An erase all (DF_EEPROM Erase and Format) is performed. In such a case FEE shall resume back to normal state but previous data (if any) cannot be recovered. FALSE: FEE settles in the illegal state and cannot continue normally. However, data is kept intact in DF_EEPROM and may be recovered.
      boolean FeeGetPrevDataApi: origin=INFINEON_AURIX2G, set at pre-compile, default-value=false  # This parameter allows the user to read old copy (one instance old) of the required block.
      boolean FeeCancelAllApi: origin=INFINEON_AURIX2G, set at pre-compile, default-value=false  # This parameter allows the user to enable cancelling ongoing operation to write high priority quasi static data.
      enumeration FeeMaxBytesPerCycle: {FEE_MAX_BYTES_64, FEE_MAX_BYTES_128, FEE_MAX_BYTES_256, FEE_MAX_BYTES_512}, origin=INFINEON_AURIX2G, set at pre-compile, default-value=FEE_MAX_BYTES_512  # This parameter allows user to configure maximum number of bytes to be processed in one FEE MAIN Function cycle. The value is including the extra FEE overhead like header, consecutive page id etc
      function name FeeNvmIllegalStateNotification: origin=INFINEON_AURIX2G, set at pre-compile, default-value=NULL_PTR  # This parameter is a pointer to a notification API which is called when Fee (NVM part) reaches an Illegal state. Illegal state here means that FEE is not able to proceed and user should do a power-on reset. Illegal notification can also be raised due to HW errors during FEE's internal activities like GC, Initialisation of GC
      function name FeeQsIllegalStateNotification: origin=INFINEON_AURIX2G, set at pre-compile, default-value=NULL_PTR  # This parameter is a pointer to a notification API which is called when Fee (QS part) reaches an Illegal state. Illegal notification is raised If QS area happens to be in virgin state and FeeVirginFlashIllegalState is not set
      function name FeeQsHardenErrorNotification: origin=INFINEON_AURIX2G, set at pre-compile, default-value=NULL_PTR  # This is a pointer to a notification API which is called by Fee when an error is encountered while performing hardening operation.
      boolean FeeVirginFlashIllegalState: origin=INFINEON_AURIX2G, set at pre-compile, default-value=false  # This parameter enables FEE to reach illegal state upon detection of virgin flash (DF_EEPROM). TRUE: Upon detection of virgin flash (DF_EEPROM) - FEE reaches illegal state and calls the configured illegal state notification function. FALSE: Upon detection of virgin flash (DF_EEPROM) - FEE programs the initial state pages and will be available for user requests.
      boolean FeeOngoingWriteCancelSupport: origin=INFINEON_AURIX2G, set at pre-compile, default-value=false  # This parameter allows the user to enable cancelling ongoing write operation
    container FeeDemEventParameterRefs [0..1]: multiplicity set at pre-compile  # This container contains the references to DemEventParameter elements.
      reference FEE_E_GC_INIT [0..1]: multiplicity set at pre-compile, origin=INFINEON_AURIX2G, set at pre-compile, requires-symbolic-name-value=true, destination=DemEventParameter  # Reference to DemEventParameter for the production error FEE_E_GC_INIT.
      reference FEE_E_WRITE [0..1]: multiplicity set at pre-compile, origin=INFINEON_AURIX2G, set at pre-compile, requires-symbolic-name-value=true, destination=DemEventParameter  # Reference to DemEventParameter for the production error FEE_E_WRITE.
      reference FEE_E_READ [0..1]: multiplicity set at pre-compile, origin=INFINEON_AURIX2G, set at pre-compile, requires-symbolic-name-value=true, destination=DemEventParameter  # Reference to DemEventParameter for the production error FEE_E_READ.
      reference FEE_E_GC_READ [0..1]: multiplicity set at pre-compile, origin=INFINEON_AURIX2G, set at pre-compile, requires-symbolic-name-value=true, destination=DemEventParameter  # Reference to DemEventParameter for the production error FEE_E_GC_READ.
      reference FEE_E_GC_WRITE [0..1]: multiplicity set at pre-compile, origin=INFINEON_AURIX2G, set at pre-compile, requires-symbolic-name-value=true, destination=DemEventParameter  # Reference to DemEventParameter for the production error FEE_E_GC_WRITE.
      reference FEE_E_GC_ERASE [0..1]: multiplicity set at pre-compile, origin=INFINEON_AURIX2G, set at pre-compile, requires-symbolic-name-value=true, destination=DemEventParameter  # Reference to DemEventParameter for the production error FEE_E_GC_ERASE.
      reference FEE_E_INVALIDATE [0..1]: multiplicity set at pre-compile, origin=INFINEON_AURIX2G, set at pre-compile, requires-symbolic-name-value=true, destination=DemEventParameter  # Reference to DemEventParameter for the production error FEE_E_INVALIDATE.
      reference FEE_E_WRITE_CYCLES_EXHAUSTED [0..1]: multiplicity set at pre-compile, origin=INFINEON_AURIX2G, set at pre-compile, requires-symbolic-name-value=true, destination=DemEventParameter  # Reference to DemEventParameter for the production error FEE_E_WRITE_CYCLES_EXHAUSTED.
      reference FEE_E_GC_TRIG [0..1]: multiplicity set at pre-compile, origin=INFINEON_AURIX2G, set at pre-compile, requires-symbolic-name-value=true, destination=DemEventParameter  # Reference to DemEventParameter for the production error FEE_E_GC_TRIG.
      reference FEE_E_UNCONFIG_BLK_EXCEEDED [0..1]: multiplicity set at pre-compile, origin=INFINEON_AURIX2G, set at pre-compile, requires-symbolic-name-value=true, destination=DemEventParameter  # Reference to DemEventParameter for the production error FEE_E_UNCONFIG_BLK_EXCEEDED.
    container CommonPublishedInformation  # Common container, aggregated by all modules. It contains published information about vendor and versions.
      integer ArMajorVersion: 0..255, origin=INFINEON_AURIX2G, set at published-information, default-value=4  # Major version number of AUTOSAR specification on which the appropriate implementation is based on.
      integer ArMinorVersion: 0..255, origin=INFINEON_AURIX2G, set at published-information, default-value=4  # Minor version number of AUTOSAR specification on which the appropriate implementation is based on.
      integer ArPatchVersion: 0..255, origin=INFINEON_AURIX2G, set at published-information, default-value=0  # Patch level version number of AUTOSAR specification on which the appropriate implementation is based on.
      integer SwMajorVersion: 0..255, origin=INFINEON_AURIX2G, set at published-information, default-value=20  # Major version number of the vendor specific implementation of the module. The numbering is vendor specific.
      integer SwMinorVersion: 0..255, origin=INFINEON_AURIX2G, set at published-information, default-value=30  # Minor version number of the vendor specific implementation of the module. The numbering is vendor specific.
      integer SwPatchVersion: 0..255, origin=INFINEON_AURIX2G, set at published-information, default-value=0  # Patch level version number of the vendor specific implementation of the module. The numbering is vendor specific.
      integer ModuleId: 0..65535, origin=INFINEON_AURIX2G, set at published-information, default-value=21  # Module ID of this module from Module List
      integer VendorId: 0..65535, origin=INFINEON_AURIX2G, set at published-information, default-value=17  # Vendor ID of the dedicated implementation of this module according to the AUTOSAR vendor list
      string Release: origin=INFINEON_AURIX2G, set at published-information, default-value=_TRICORE_TC397_ADAS  # Aurix2G derivative used for the implementation
