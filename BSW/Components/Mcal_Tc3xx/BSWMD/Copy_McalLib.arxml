AUTOSAR XML (schema 00046)
package /AURIX2G/EcucDefs
  module definition McalLib [0..1]: variants pre-compile  # Published information of Mcal Library.
    container McalLibPublishedInformation  # This is the general container that contains the pre-build configuration parameters
      integer McalLibMcalAvailableCores: 6..6, origin=INFINEON_AURIX2G, set at published-information, default-value=6  # Mentions the number of cores available on the current variant of Aurix2G HW.
      integer McalLibDsprCore0StartAddr: 1879048192..1879048192, origin=INFINEON_AURIX2G, set at published-information, default-value=1879048192  # Mentions the DSPR start address for Core 0 of the current variant of Aurix2G HW.
      integer McalLibDsprCore0EndAddr: 1879293951..1879293951, origin=INFINEON_AURIX2G, set at published-information, default-value=1879293951  # Mentions the DSPR end address for Core 0 of the current variant of Aurix2G HW.
      integer McalLibDsprCore1StartAddr: 1610612736..1610612736, origin=INFINEON_AURIX2G, set at published-information, default-value=1610612736  # Mentions the DSPR start address for Core 1 of the current variant of Aurix2G HW.
      integer McalLibDsprCore1EndAddr: 1610858495..1610858495, origin=INFINEON_AURIX2G, set at published-information, default-value=1610858495  # Mentions the DSPR end address for Core 1 of the current variant of Aurix2G HW.
      integer McalLibDsprCore2StartAddr: 1342177280..1342177280, origin=INFINEON_AURIX2G, set at published-information, default-value=1342177280  # Mentions the DSPR start address for Core 2 of the current variant of Aurix2G HW.
      integer McalLibDsprCore2EndAddr: 1342275583..1342275583, origin=INFINEON_AURIX2G, set at published-information, default-value=1342275583  # Mentions the DSPR end address for Core 2 of the current variant of Aurix2G HW.
      integer McalLibDsprCore3StartAddr: 1073741824..1073741824, origin=INFINEON_AURIX2G, set at published-information, default-value=1073741824  # Mentions the DSPR start address for Core 3 of the current variant of Aurix2G HW.
      integer McalLibDsprCore3EndAddr: 1073840127..1073840127, origin=INFINEON_AURIX2G, set at published-information, default-value=1073840127  # Mentions the DSPR end address for Core 3 of the current variant of Aurix2G HW.
      integer McalLibDsprCore4StartAddr: 805306368..805306368, origin=INFINEON_AURIX2G, set at published-information, default-value=805306368  # Mentions the DSPR start address for Core 4 of the current variant of Aurix2G HW.
      integer McalLibDsprCore4EndAddr: 805404671..805404671, origin=INFINEON_AURIX2G, set at published-information, default-value=805404671  # Mentions the DSPR end address for Core 4 of the current variant of Aurix2G HW.
      integer McalLibDsprCore5StartAddr: 268435456..268435456, origin=INFINEON_AURIX2G, set at published-information, default-value=268435456  # Mentions the DSPR start address for Core 5 of the current variant of Aurix2G HW.
      integer McalLibDsprCore5EndAddr: 268533759..268533759, origin=INFINEON_AURIX2G, set at published-information, default-value=268533759  # Mentions the DSPR end address for Core 5 of the current variant of Aurix2G HW.
      integer McalLibPsprCore0StartAddr: 1880096768..1880096768, origin=INFINEON_AURIX2G, set at published-information, default-value=1880096768  # Mentions the PSPR start address for Core 0 of the current variant of Aurix2G HW.
      integer McalLibPsprCore0EndAddr: 1880162303..1880162303, origin=INFINEON_AURIX2G, set at published-information, default-value=1880162303  # Mentions the PSPR end address for Core 0 of the current variant of Aurix2G HW.
      integer McalLibPsprCore1StartAddr: 1611661312..1611661312, origin=INFINEON_AURIX2G, set at published-information, default-value=1611661312  # Mentions the PSPR start address for Core 1 of the current variant of Aurix2G HW.
      integer McalLibPsprCore1EndAddr: 1611726847..1611726847, origin=INFINEON_AURIX2G, set at published-information, default-value=1611726847  # Mentions the PSPR end address for Core 1 of the current variant of Aurix2G HW.
      integer McalLibPsprCore2StartAddr: 1343225856..1343225856, origin=INFINEON_AURIX2G, set at published-information, default-value=1343225856  # Mentions the PSPR start address for Core 2 of the current variant of Aurix2G HW.
      integer McalLibPsprCore2EndAddr: 1343291391..1343291391, origin=INFINEON_AURIX2G, set at published-information, default-value=1343291391  # Mentions the PSPR end address for Core 2 of the current variant of Aurix2G HW.
      integer McalLibPsprCore3StartAddr: 1074790400..1074790400, origin=INFINEON_AURIX2G, set at published-information, default-value=1074790400  # Mentions the PSPR start address for Core 3 of the current variant of Aurix2G HW.
      integer McalLibPsprCore3EndAddr: 1074855935..1074855935, origin=INFINEON_AURIX2G, set at published-information, default-value=1074855935  # Mentions the PSPR end address for Core 3 of the current variant of Aurix2G HW.
      integer McalLibPsprCore4StartAddr: 806354944..806354944, origin=INFINEON_AURIX2G, set at published-information, default-value=806354944  # Mentions the PSPR start address for Core 4 of the current variant of Aurix2G HW.
      integer McalLibPsprCore4EndAddr: 806420479..806420479, origin=INFINEON_AURIX2G, set at published-information, default-value=806420479  # Mentions the PSPR end address for Core 4 of the current variant of Aurix2G HW.
      integer McalLibPsprCore5StartAddr: 269484032..269484032, origin=INFINEON_AURIX2G, set at published-information, default-value=269484032  # Mentions the PSPR start address for Core 5 of the current variant of Aurix2G HW.
      integer McalLibPsprCore5EndAddr: 269549567..269549567, origin=INFINEON_AURIX2G, set at published-information, default-value=269549567  # Mentions the PSPR end address for Core 5 of the current variant of Aurix2G HW.
      integer McalLibBackUpClockFreq: 100..100, origin=INFINEON_AURIX2G, set at published-information, default-value=100  # Mentions the backup clock frequency of the current variant of Aurix2G HW.
    container CommonPublishedInformation  # This container contains the published information of the Mcal Library.
      integer ArMajorVersion: 0..255, origin=INFINEON_AURIX2G, set at published-information, default-value=4  # Major version number of AUTOSAR specification on which the appropriate implementation is based on.
      integer ArMinorVersion: 0..255, origin=INFINEON_AURIX2G, set at published-information, default-value=4  # Minor version number of AUTOSAR specification on which the appropriate implementation is based on.
      integer ArPatchVersion: 0..255, origin=INFINEON_AURIX2G, set at published-information, default-value=0  # Revision version number of AUTOSAR specification on which the appropriate implementation is based on.
      integer SwMajorVersion: 0..255, origin=INFINEON_AURIX2G, set at published-information, default-value=20  # Major version number of the vendor specific implementation of the module. The numbering is vendor specific.
      integer SwMinorVersion: 0..255, origin=INFINEON_AURIX2G, set at published-information, default-value=25  # Minor version number of the vendor specific implementation of the module. The numbering is vendor specific.
      integer SwPatchVersion: 0..255, origin=INFINEON_AURIX2G, set at published-information, default-value=0  # Patch level version number of the vendor specific implementation of the module. The numbering is vendor specific.
      integer ModuleId: 0..65535, origin=INFINEON_AURIX2G, set at published-information, default-value=255  # Module ID of this module from Module List
      integer VendorId: 0..65535, origin=INFINEON_AURIX2G, set at published-information, default-value=17  # Vendor ID of the dedicated implementation of this module according to the AUTOSAR vendor list
      string Release: origin=INFINEON_AURIX2G, set at published-information, default-value=_TRICORE_TC397_ADAS  # Aurix2G derivative used for the implementation
    container McalLibGeneral  # Module wide configuration parameters of the McalLib driver.
      boolean McalLibSafetyEnable: origin=INFINEON_AURIX2G, set at pre-compile, default-value=true  # Enable/Disable the Safety check and all associated notifications.
