AUTOSAR XML (schema 00046)
package /AURIX2G/EcucDefs
  module definition Gpt [0..1]: post-build-variant-support=true, refined-module-def=Gpt, variants post-build  # Configuration of the Gpt (General Purpose Timer) module.
    container GptChannelConfigSet  # This container is the base of a Configuration Set which contains the configured GPT channels. This way, different configuration sets can be defined for post-build process.
      container GptChannelConfiguration [1..197]: multiplicity set at pre-compile  # Configuration of an individual GPT channel.
        integer GptChannelId: 0..196, scope=ECU, set at pre-compile, symbolic-name-value=true, default-value=0  # Channel Id of the GPT channel. This value will be assigned to the symbolic name derived of the GptChannelConfiguration container short name.
        enumeration GptAssignedHwUnit: {GPT12, GTM}, scope=ECU, origin=INFINEON_AURIX2G, set at post-build, default-value=GPT12  # Specifies the timer hardware used for this Gpt channel.
        enumeration GptChannelMode: {GPT_CH_MODE_CONTINUOUS, GPT_CH_MODE_ONESHOT}, scope=ECU, post-build-variant-value=true, set at post-build, default-value=GPT_CH_MODE_CONTINUOUS  # Specifies the behavior of the timer channel after the target time is reached.
        enumeration GptTimerChannelUsage: {GPT_PREDEF_TIMERCH_1US_16BIT_ENABLED, GPT_PREDEF_TIMERCH_1US_16_24BIT_ENABLED, GPT_PREDEF_TIMERCH_1US_16_24_32BIT_ENABLED, GPT_PREDEF_TIMERCH_100US_32BIT_ENABLED, GPT_TIMER_CHANNEL_NORMAL}, origin=INFINEON_AURIX2G, set at pre-compile, default-value=GPT_TIMER_CHANNEL_NORMAL  # Specifies the grade of enabling the GPT Predef Timers for this channel.
        float GptChannelTickFrequency: 0.0..65535.0, scope=ECU, post-build-variant-value=true, set at post-build, default-value=1.0  # Specifies the tick frequency of the timer channel in Hz.
        integer GptChannelTickValueMax: 0..16777215, scope=ECU, post-build-variant-value=true, set at post-build, default-value=65535  # Maximum value in ticks, the timer channel is able to count. With the next tick, the timer rolls over to zero.
        boolean GptEnableWakeup: post-build-variant-value=true, set at post-build, default-value=false  # Enables wakeup capability of MCU for a channel. Enabled only if GptReportWakeupSource is True.
        function name GptNotification [0..1]: multiplicity set at post-build, post-build-variant-multiplicity=true, post-build-variant-value=true, set at post-build, default-value=IoHwAb_GptNotification0  # Function pointer to callback function (for non-wakeup notification)
        reference GptChannelClkSrcRef: post-build-variant-value=true, set at post-build, destination=GptClockReferencePoint  # Reference to the GptClockReferencePoint from which the channel clock is derived.
        reference GptChannelEcucPartitionRef [0..*]: scope=ECU, multiplicity set at pre-compile, post-build-variant-multiplicity=true, post-build-variant-value=true, set at pre-compile, destination=EcucPartition  # Maps a GPT channel to zero or multiple ECUC partitions to limit the access to this channel group. The ECUC partitions referenced are a subset of the ECUC partitions where the GPT driver is mapped to. Tags: atp.Status=draft
        container GptWakeupConfiguration [0..1]: multiplicity set at post-build  # Function pointer to callback function (for wakeup notification).
          reference GptWakeupSourceRef: post-build-variant-value=true, set at post-build, requires-symbolic-name-value=true, destination=EcuMWakeupSource  # In case the wakeup-capability is true this value is transmitted to the Ecu State Manager. Enabled only if GptReportWakeupSource and GptEnableWakeup are True
        container GtmTimerOutputModuleConfiguration [0..3]: multiplicity set at pre-compile  # Choose GTM TOM/ATOM channel which will be used by this GPT Driver. Referred timer channel in MCU should have TomChannelUsage/ AtomChannelUsage as USED_BY_GPT_DRIVER
          enumeration GtmTimerClockSelect: {GTM_FIXED_CLOCK_0, GTM_FIXED_CLOCK_1, GTM_FIXED_CLOCK_2, GTM_FIXED_CLOCK_3, GTM_FIXED_CLOCK_4, GTM_CONFIGURABLE_CLOCK_0, GTM_CONFIGURABLE_CLOCK_1, GTM_CONFIGURABLE_CLOCK_2, GTM_CONFIGURABLE_CLOCK_3, GTM_CONFIGURABLE_CLOCK_4, GTM_CONFIGURABLE_CLOCK_5, GTM_CONFIGURABLE_CLOCK_6, GTM_CONFIGURABLE_CLOCK_7}, origin=INFINEON_AURIX2G, set at post-build, default-value=GTM_FIXED_CLOCK_0  # This parameter decides the Clock Source for TOM/ATOM timer.
          choice reference GtmTimerUsed: scope=ECU, origin=INFINEON_AURIX2G, set at post-build, destination=[McuGtmTomChannelAllocationConf, McuGtmAtomChannelAllocationConf]  # This parameter lists all the GTM timer channels (TOM/ATOM).
        container Gpt12TimerOutputModuleConfiguration [0..2]: multiplicity set at pre-compile  # Choose GPT12 channel which will be used by this GPT Driver. Referred timer channel in MCU should have GPT12Timerblock as USED_BY_GPT_DRIVER
          integer Gpt12ChannelClockDivider: 0..7, origin=INFINEON_AURIX2G, post-build-variant-value=true, set at post-build, default-value=0  # This parameter decides the divider value of this timer channel. This value depends on the prescalar configured in MCU
          choice reference Gpt12TimerUsed: scope=ECU, origin=INFINEON_AURIX2G, set at post-build, destination=McuGpt12ModuleAllocationConf  # This parameter lists all the GTM timer channels (TOM/ATOM).
    container GptConfigurationOfOptApiServices  # This container contains all configuration switches for configuring optional API services of the GPT driver.
      boolean GptDeinitApi: set at pre-compile, default-value=false  # Adds / removes the service Gpt_DeInit() from the code.
      boolean GptEnableDisableNotificationApi: set at pre-compile, default-value=false  # Adds / removes the services Gpt_EnableNotification() and Gpt_DisableNotification from the code.
      boolean GptTimeElapsedApi: set at pre-compile, default-value=false  # Adds / removes the service Gpt_GetTimeElapsed() from the code
      boolean GptTimeRemainingApi: set at pre-compile, default-value=false  # Adds / removes the service Gpt_GetTimeRemaining() from the code.
      boolean GptVersionInfoApi: set at pre-compile, default-value=false  # Adds / removes the service Gpt_GetVersionInfo() from the code.
      boolean GptWakeupFunctionalityApi: set at pre-compile, default-value=false  # Adds / removes the services Gpt_SetMode(), Gpt_EnableWakeup() Gpt_DisableWakeup() and Gpt_CheckWakeup() from the code.
    container GptDriverConfiguration  # This container contains the module-wide configuration (parameters) of the GPT Driver
      boolean GptDevErrorDetect: set at pre-compile, default-value=false  # Switches the Default Error Tracer (Det) detection and notification ON or OFF.
      boolean GptMultiCoreErrorDetect: origin=INFINEON_AURIX2G, set at pre-compile, default-value=false  # Switches the Multicore Default Error Tracer (Det) detection and notification ON or OFF.
      boolean GptRunTimeErrorDetect: origin=INFINEON_AURIX2G, set at pre-compile, default-value=false  # Switches the runtime error detection and notification ON or OFF.
      boolean GptReportWakeupSource: set at pre-compile, default-value=false  # Enables/Disables wakeup source reporting.
      boolean GptPredefTimer100us32bitEnable: scope=ECU, set at pre-compile, default-value=false  # Enables/disables the GPT Predef Timer 100?s32bit.
      enumeration GptPredefTimer1usEnablingGrade: {GPT_PREDEF_TIMER_1US_16BIT_ENABLED, GPT_PREDEF_TIMER_1US_16_24BIT_ENABLED, GPT_PREDEF_TIMER_1US_16_24_32BIT_ENABLED, GPT_PREDEF_TIMER_1US_DISABLED}, scope=ECU, set at pre-compile, default-value=GPT_PREDEF_TIMER_1US_DISABLED  # Specifies the grade of enabling the GPT Predef Timers with 1?s tick duration.
      boolean GptSafetyEnable: origin=INFINEON_AURIX2G, set at pre-compile, default-value=true  # Enable/Disable the Safety check and all associated notifications.
      boolean GptReadAcrossCores: origin=INFINEON_AURIX2G, set at pre-compile, default-value=false  # Enable/Disable reading the timer value from all cores.
      boolean GptInitCheckApi: origin=INFINEON_AURIX2G, set at pre-compile, default-value=false  # Adds / removes the service Gpt_InitCheck() from the code.
      reference GptEcucPartitionRef [0..*]: scope=ECU, multiplicity set at pre-compile, post-build-variant-multiplicity=true, post-build-variant-value=true, set at pre-compile, destination=EcucPartition  # Maps the GPT driver to zero or multiple ECUC partitions to make the driver API available in the according partition. Depending on the addressed timer resource the interfaces operate as follows: Tags: atp.Status=draft
      reference GptKernelEcucPartitionRef [0..1]: scope=ECU, multiplicity set at pre-compile, post-build-variant-multiplicity=true, post-build-variant-value=true, set at pre-compile, destination=EcucPartition  # Maps the GPT kernel to zero or one ECUC partitions to assign the driver kernel to a certain core. The ECUC partition referenced is a subset of the ECUC partitions where the GPT driver is mapped to. Tags: atp.Status=draft
      container GptClockReferencePoint [1..256]: multiplicity set at pre-compile  # This container contains a parameter, which represents a reference to a container of the type McuClockReferencePoint (defined in module MCU).
        reference GptClockReference: set at pre-compile, destination=McuClockReferencePoint  # Reference to a container of the type McuClockReferencePoint, to select an input clock.
        reference GptClockReferenceConfig: origin=INFINEON_AURIX2G, set at pre-compile, destination=McuClockReferencePointConfig  # Reference to a container of the type McuClockReferencePointConfig, to select an input clock.
    container CommonPublishedInformation  # Common container, aggregated by all modules. It contains published information about vendor and versions.
      integer ArMajorVersion: 0..255, origin=INFINEON_AURIX2G, set at published-information, default-value=4  # Major version number of AUTOSAR specification on which the appropriate implementation is based on.
      integer ArMinorVersion: 0..255, origin=INFINEON_AURIX2G, set at published-information, default-value=4  # Minor version number of AUTOSAR specification on which the appropriate implementation is based on.
      integer ArPatchVersion: 0..255, origin=INFINEON_AURIX2G, set at published-information, default-value=0  # Patch level version number of AUTOSAR specification on which the appropriate implementation is based on.
      integer SwMajorVersion: 0..255, origin=INFINEON_AURIX2G, set at published-information, default-value=20  # Major version number of the vendor specific implementation of the module. The numbering is vendor specific.
      integer SwMinorVersion: 0..255, origin=INFINEON_AURIX2G, set at published-information, default-value=25  # Minor version number of the vendor specific implementation of the module. The numbering is vendor specific.
      integer SwPatchVersion: 0..255, origin=INFINEON_AURIX2G, set at published-information, default-value=0  # Patch level version number of the vendor specific implementation of the module. The numbering is vendor specific.
      integer ModuleId: 0..65535, origin=INFINEON_AURIX2G, set at published-information, default-value=100  # Module ID of this module from Module List
      integer VendorId: 0..65535, origin=INFINEON_AURIX2G, set at published-information, default-value=17  # Vendor ID of the dedicated implementation of this module according to the AUTOSAR vendor list
      string Release: origin=INFINEON_AURIX2G, set at published-information, default-value=_TRICORE_TC397_ADAS  # Aurix2G derivative used for the implementation
