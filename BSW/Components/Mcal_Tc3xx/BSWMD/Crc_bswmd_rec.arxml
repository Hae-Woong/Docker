AUTOSAR XML (schema 00046)
package /AURIX2G/EcucDefs
  module config Crc_Rec: definition=Crc
  bsw implementation Crc_Impl: programming-language=C, behavior=CrcBehavior, recommended-configuration=Crc_Rec, vendor-specific-module-def=Crc
