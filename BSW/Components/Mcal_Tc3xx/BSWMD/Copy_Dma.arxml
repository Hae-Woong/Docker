AUTOSAR XML (schema 00046)
package /AURIX2G/EcucDefs
  module definition Dma [0..1]: post-build-variant-support=true, variants post-build  # Configuration of the Dma (Direct Memory Access) module.
    container DmaGeneral  # General configuration
      boolean DmaDevErrorDetect: origin=INFINEON_AURIX2G, set at pre-compile, default-value=false  # Enables/Disables the Development Error Detection in the DMA Driver
      boolean DmaMultiCoreErrorDetect: origin=INFINEON_AURIX2G, set at pre-compile, default-value=false  # If enabled, the multicore error detection will be enabled
      boolean DmaSafetyEnable: origin=INFINEON_AURIX2G, set at pre-compile, default-value=true  # Enables/Disables the Safety checks in the DMA Driver
      boolean DmaInitCheckApi: origin=INFINEON_AURIX2G, set at pre-compile, default-value=false  # This parameter decides the availability of the API Dma_InitCheck in the code
      boolean DmaDeInitApi: origin=INFINEON_AURIX2G, set at pre-compile, default-value=false  # This parameter decides the availability of the API Dma_DeInit in the code
      boolean DmaChDeInitApi: origin=INFINEON_AURIX2G, set at pre-compile, default-value=false  # This parameter decides the availability of the API Dma_ChDeinit in the code
      boolean DmaSuspendApi: origin=INFINEON_AURIX2G, set at pre-compile, default-value=false  # This parameter decides the availability of the API Dma_TransferFreeze and Dma_TransferResume in the code
      boolean DmaTriggerApi: origin=INFINEON_AURIX2G, set at pre-compile, default-value=false  # This parameter decides the availability of the API Dma_EnableHardwareTrigger and Dma_DisableHardwareTrigger in the code
      boolean DmaDataPendingApi: origin=INFINEON_AURIX2G, set at pre-compile, default-value=false  # This parameter decides the availability of the API API Dma_ChGetRemainingData in the code
      boolean DmaBufferSwitchApi: origin=INFINEON_AURIX2G, set at pre-compile, default-value=false  # This parameter decides the availability of the API Dma_ChSwitchBuffer in the code
      boolean DmaGetVersionInfoApi: origin=INFINEON_AURIX2G, set at pre-compile, default-value=false  # This parameter decides the availability of the API Dma_GetVersionInfo in the code
      integer DmaMaxTransactionSetPerChannel: 1..65535, origin=INFINEON_AURIX2G, set at pre-compile, default-value=1  # Specifies how many transaction sets are allowed to be defined per channel
      enumeration DmaInitDeInitApiMode: {DMA_MCAL_USER1MODE, DMA_MCAL_SUPERVISORMODE}, origin=INFINEON_AURIX2G, set at pre-compile, default-value=DMA_MCAL_SUPERVISORMODE  # This option specifies the mode in which the DMA init and deinit function operates
      enumeration DmaRuntimeApiMode: {DMA_MCAL_USER1MODE, DMA_MCAL_SUPERVISORMODE}, origin=INFINEON_AURIX2G, set at pre-compile, default-value=DMA_MCAL_SUPERVISORMODE  # This option specifies the mode in which the DMA runtime functions operate
    container DmaChannelConfig [1..128]: multiplicity set at pre-compile  # DMA channel configuration for this channel
      integer DmaChannelId: 0..127, origin=INFINEON_AURIX2G, post-build-variant-value=true, set at post-build, default-value=0  # DMA channel number
      integer DmaChannelAssignedPartition: 0..3, origin=INFINEON_AURIX2G, post-build-variant-value=true, set at post-build, default-value=0  # Hardware partition to which this channel is allocated to
      integer DmaChannelNumTransactionSet: 1..65535, origin=INFINEON_AURIX2G, set at pre-compile, default-value=1  # No of transaction set for this channel. Linked list feature is offered in Transaction set configuration only if this parameter were enabled. The number of transaction sets is capped at DmaMaxTransactionSetPerChannel
      boolean DmaTcsInterruptTransactionLoss: origin=INFINEON_AURIX2G, post-build-variant-value=true, set at post-build, default-value=false  # Enables/Disables the transaction request lost interrupt
      function name DmaChannelNotification: origin=INFINEON_AURIX2G, post-build-variant-value=true, set at post-build, default-value=NULL_PTR  # User defined Notification Function Pointer of type void NotificationRoutine(uint32_t Channel, Dma_ChEventType_t Event) This notification function will be called by the DMA Driver if there is a channel interrupt.
      function name DmaErrorNotification: origin=INFINEON_AURIX2G, post-build-variant-value=true, set at post-build, default-value=NULL_PTR  # User defined Notification Function Pointer of type void NotificationRoutine(uint32_t Channel, Dma_MoveEngineEventType_t Event) This notification function will be called by the DMA Driver if there is a move engine error.
      enumeration DmaChannelUser: {CRC, HSSL, SPI, Other}, origin=INFINEON_AURIX2G, set at pre-compile, default-value=Other  # This parameter defines the user of this DMA channel. CRC: Channel used by CRC library HSSL: Channel used by HSSL driver SPI: Channel used by SPI driver Other: Channel used by any other module
      container DmaChannelTransactionSet [1..65535]: multiplicity set at pre-compile  # Transaction set setting for this DMA channel
        integer DmaTcsIndex: 0..65535, origin=INFINEON_AURIX2G, post-build-variant-value=true, set at post-build, default-value=0  # DMA Transaction set Index
        string DmaTcsSourceAddress: origin=INFINEON_AURIX2G, set at link, default-value=NULL_PTR  # start address of the source memory
        string DmaTcsDestinationAddress: origin=INFINEON_AURIX2G, set at link, default-value=NULL_PTR  # Destination address of the source memory
        string DmaTcsDoubleBuffer: origin=INFINEON_AURIX2G, set at link, default-value=NULL_PTR  # start address of the second buffer
        string DmaUserHeaderFileWithExternDeclarations: origin=INFINEON_AURIX2G, set at pre-compile, default-value=NULL  # The header file containing the declaration of the variables used for specifying the addresses
        enumeration DmaTcsMoveLength: {DMA_WIDTH_8BITS, DMA_WIDTH_16BITS, DMA_WIDTH_32BITS, DMA_WIDTH_64BITS, DMA_WIDTH_128BITS, DMA_WIDTH_256BITS}, origin=INFINEON_AURIX2G, post-build-variant-value=true, set at post-build, default-value=DMA_WIDTH_8BITS  # DMA move consisting of one read and one write each) moves data of given number of bits from source to destination. This parameter defines number of bits for the DMA move DMA_WIDTH_8BITS : 8-bits per move. DMA_WIDTH_16BITS : 16-bits per move. DMA_WIDTH_32BITS : 32-bits per move. DMA_WIDTH_64BITS : 64-bits per move. DMA_WIDTH_128BITS: 128-bits per move. DMA_WIDTH_256BITS: 256-bits per move.
        enumeration DmaPatternMode: {Pattern_Detection_Disabled, Pattern_Mode_1, Pattern_Mode_2, Pattern_Mode_3, Pattern_Mode_5, Pattern_Mode_6, Pattern_Mode_7}, origin=INFINEON_AURIX2G, post-build-variant-value=true, set at post-build, default-value=Pattern_Detection_Disabled  # This parameter defines the mode used during a pattern match. The user should choose the mode as needed for the 8bit, 16bit or 32bit pattern match. Pattern_Detection_Disabled : Pattern match disabled. Pattern_Mode_1: Pattern match mode 1 Pattern_Mode_2: Pattern match mode 2 Pattern_Mode_3: Pattern match mode 3 Pattern_Mode_5: Pattern match mode 5 Pattern_Mode_6: Pattern match mode 6 Pattern_Mode_7: Pattern match mode 7
        enumeration DmaTcsTransferLength: {DMA_MOVES_1, DMA_MOVES_2, DMA_MOVES_3, DMA_MOVES_4, DMA_MOVES_5, DMA_MOVES_8, DMA_MOVES_9, DMA_MOVES_16}, origin=INFINEON_AURIX2G, post-build-variant-value=true, set at post-build, default-value=DMA_MOVES_1  # This parameter defines the number of moves composed for a DMA transfer. DMA_MOVES_1: 1 DMA move per transfer. DMA_MOVES_2: 2 DMA move per transfer. DMA_MOVES_3: 3 DMA move per transfer. DMA_MOVES_4: 4 DMA move per transfer. DMA_MOVES_5: 5 DMA move per transfer. DMA_MOVES_8: 8 DMA move per transfer. DMA_MOVES_9: 9 DMA move per transfer. DMA_MOVES_16: 16 DMA move per transfer.
        integer DmaTcsTransactionLength: 0..16383, origin=INFINEON_AURIX2G, post-build-variant-value=true, set at post-build, default-value=0  # This parameter defines how many transfers are performed per DMA transaction
        boolean DmaTcsCircularBufferSourceEnable: origin=INFINEON_AURIX2G, post-build-variant-value=true, set at post-build, default-value=false  # This parameter used to enable/disable the source circular buffer
        boolean DmaTcsCircularBufferDestinationEnable: origin=INFINEON_AURIX2G, post-build-variant-value=true, set at post-build, default-value=false  # This parameter used to enable/disable the destination circular buffer
        enumeration DmaTcsCircularBufferSourceLength: {DMA_CIRCULAR_BUFFER_LENGTH_1BYTE, DMA_CIRCULAR_BUFFER_LENGTH_2BYTE, DMA_CIRCULAR_BUFFER_LENGTH_4BYTE, DMA_CIRCULAR_BUFFER_LENGTH_8BYTE, DMA_CIRCULAR_BUFFER_LENGTH_16BYTE, DMA_CIRCULAR_BUFFER_LENGTH_32BYTE, DMA_CIRCULAR_BUFFER_LENGTH_64BYTE, DMA_CIRCULAR_BUFFER_LENGTH_128BYTE, DMA_CIRCULAR_BUFFER_LENGTH_256BYTE, DMA_CIRCULAR_BUFFER_LENGTH_512BYTE, DMA_CIRCULAR_BUFFER_LENGTH_1024BYTE, DMA_CIRCULAR_BUFFER_LENGTH_2048BYTE, DMA_CIRCULAR_BUFFER_LENGTH_4096BYTE, DMA_CIRCULAR_BUFFER_LENGTH_8192BYTE, DMA_CIRCULAR_BUFFER_LENGTH_16384BYTE, DMA_CIRCULAR_BUFFER_LENGTH_32768BYTE}, origin=INFINEON_AURIX2G, post-build-variant-value=true, set at post-build, default-value=DMA_CIRCULAR_BUFFER_LENGTH_1BYTE  # This parameter determines how many bits of the source address of a circular buffer. DMA_CIRCULAR_BUFFER_LENGTH_1BYTE: Source address SADR[31:0] is not updated. DMA_CIRCULAR_BUFFER_LENGTH_2BYTE: Source address SADR[31:1] is not updated. DMA_CIRCULAR_BUFFER_LENGTH_4BYTE: Source address SADR[31:2] is not updated ..... DMA_CIRCULAR_BUFFER_LENGTH_16384BYTE: Source address SADR[31:14] is not updated DMA_CIRCULAR_BUFFER_LENGTH_32768BYTE: Source address SADR[31:15] is not updated
        enumeration DmaTcsCircularBufferDestinationLength: {DMA_CIRCULAR_BUFFER_LENGTH_1BYTE, DMA_CIRCULAR_BUFFER_LENGTH_2BYTE, DMA_CIRCULAR_BUFFER_LENGTH_4BYTE, DMA_CIRCULAR_BUFFER_LENGTH_8BYTE, DMA_CIRCULAR_BUFFER_LENGTH_16BYTE, DMA_CIRCULAR_BUFFER_LENGTH_32BYTE, DMA_CIRCULAR_BUFFER_LENGTH_64BYTE, DMA_CIRCULAR_BUFFER_LENGTH_128BYTE, DMA_CIRCULAR_BUFFER_LENGTH_256BYTE, DMA_CIRCULAR_BUFFER_LENGTH_512BYTE, DMA_CIRCULAR_BUFFER_LENGTH_1024BYTE, DMA_CIRCULAR_BUFFER_LENGTH_2048BYTE, DMA_CIRCULAR_BUFFER_LENGTH_4096BYTE, DMA_CIRCULAR_BUFFER_LENGTH_8192BYTE, DMA_CIRCULAR_BUFFER_LENGTH_16384BYTE, DMA_CIRCULAR_BUFFER_LENGTH_32768BYTE}, origin=INFINEON_AURIX2G, post-build-variant-value=true, set at post-build, default-value=DMA_CIRCULAR_BUFFER_LENGTH_1BYTE  # This parameter determines how many bits of the source address of a circular buffer. DMA_CIRCULAR_BUFFER_LENGTH_1BYTE: Source address SADR[31:0] is not updated. DMA_CIRCULAR_BUFFER_LENGTH_2BYTE: Source address SADR[31:1] is not updated. DMA_CIRCULAR_BUFFER_LENGTH_4BYTE: Source address SADR[31:2] is not updated ..... DMA_CIRCULAR_BUFFER_LENGTH_16384BYTE: Source address SADR[31:14] is not updated DMA_CIRCULAR_BUFFER_LENGTH_32768BYTE: Source address SADR[31:15] is not updated
        enumeration DmaTcsSourceAddressModificationFactor: {DMA_FACTOR_1, DMA_FACTOR_2, DMA_FACTOR_4, DMA_FACTOR_8, DMA_FACTOR_16, DMA_FACTOR_32, DMA_FACTOR_64, DMA_FACTOR_128}, origin=INFINEON_AURIX2G, post-build-variant-value=true, set at post-build, default-value=DMA_FACTOR_1  # This parameter defines how the source address changes after every move operation. DMA_FACTOR_1 : Address offset is 1 x DmaMoveLength. DMA_FACTOR_2 : Address offset is 2 x DmaMoveLength. DMA_FACTOR_4 : Address offset is 4 x DmaMoveLength. DMA_FACTOR_8 : Address offset is 8 x DmaMoveLength. DMA_FACTOR_16 : Address offset is 16 x DmaMoveLength. DMA_FACTOR_32 : Address offset is 32 x DmaMoveLength. DMA_FACTOR_64 : Address offset is 64 x DmaMoveLength. DMA_FACTOR_128 : Address offset is 128 x DmaMoveLength.
        enumeration DmaTcsDestinationAddressModificationFactor: {DMA_FACTOR_1, DMA_FACTOR_2, DMA_FACTOR_4, DMA_FACTOR_8, DMA_FACTOR_16, DMA_FACTOR_32, DMA_FACTOR_64, DMA_FACTOR_128}, origin=INFINEON_AURIX2G, post-build-variant-value=true, set at post-build, default-value=DMA_FACTOR_1  # This parameter defines how the source address changes after every move operation. DMA_FACTOR_1 : Address offset is 1 x DmaMoveLength. DMA_FACTOR_2 : Address offset is 2 x DmaMoveLength. DMA_FACTOR_4 : Address offset is 4 x DmaMoveLength. DMA_FACTOR_8 : Address offset is 8 x DmaMoveLength. DMA_FACTOR_16 : Address offset is 16 x DmaMoveLength. DMA_FACTOR_32 : Address offset is 32 x DmaMoveLength. DMA_FACTOR_64 : Address offset is 64 x DmaMoveLength. DMA_FACTOR_128 : Address offset is 128 x DmaMoveLength.
        boolean DmaTcsAppendTimeStamp: origin=INFINEON_AURIX2G, post-build-variant-value=true, set at post-build, default-value=false  # This parameter determines if time stamp is to be appended after the last DMA move of a transaction
        enumeration DmaTcsSourceAddressMovement: {DMA_INCREASING, DMA_DECREASING}, origin=INFINEON_AURIX2G, post-build-variant-value=true, set at post-build, default-value=DMA_INCREASING  # This parameter determines if the source address after every move operation is to be increased or decreased
        enumeration DmaTcsDestinationAddressMovement: {DMA_INCREASING, DMA_DECREASING}, origin=INFINEON_AURIX2G, post-build-variant-value=true, set at post-build, default-value=DMA_INCREASING  # This parameter determines if the Destinaion address after every move operation is to be increased or decreased
        enumeration DmaTcsShadowRegisterConfiguration: {DMA_SHADOWING_DISABLED, DMA_SOURCE_ADDRESS_BUFFERING_RO, DMA_DEST_ADDRESS_BUFFERING_RO, DMA_SOURCE_ADDRESS_BUFFERING_RW, DMA_DEST_ADDRESS_BUFFERING_RW, DMA_SOURCE_DOUBLE_BUFFERING_SW_SWITCH, DMA_SOURCE_DOUBLE_BUFFERING_HW_SW_SWITCH, DMA_DEST_DOUBLE_BUFFERING_SW_SWITCH, DMA_DEST_DOUBLE_BUFFERING_HW_SW_SWITCH, DMA_LINKED_LIST, DMA_ACCUMULATED_LINKED_LIST, DMA_SAFE_LINKED_LIST, DMA_CONDITIONAL_LINKED_LIST}, origin=INFINEON_AURIX2G, set at pre-compile, default-value=DMA_SHADOWING_DISABLED  # This parameter determines how the shadow register is to be used
        integer DmaCLLNextIndex: 0..65535, origin=INFINEON_AURIX2G, post-build-variant-value=true, set at post-build, default-value=0  # This parameter defines the next TCS node in case of conditional linked list match feature
        integer DmaNextTcsIndex: 0..65535, origin=INFINEON_AURIX2G, post-build-variant-value=true, set at post-build, default-value=0  # This parameter determines the next node of the TCS linked list
        enumeration DmaTcsTriggerFrequency: {DMA_TRANSFER_PER_TRIGGER, DMA_TRANSACTION_PER_TRIGGER}, origin=INFINEON_AURIX2G, post-build-variant-value=true, set at post-build, default-value=DMA_TRANSFER_PER_TRIGGER  # This parameter determines how much of data will the move engine move upon a trigger request [Either hardware or software]. The move engine upon receipt of a trigger request could effectuate a transfer or even a transaction based on the choice made.
        enumeration DmaTcsHardwareTrigger: {DMA_NO_HARDWARE_TRIGGER, DMA_HARDWARE_TRIGGER_SINGLE_MODE, DMA_HARDWARE_TRIGGER_CONTINUOUS_MODE}, origin=INFINEON_AURIX2G, post-build-variant-value=true, set at post-build, default-value=DMA_NO_HARDWARE_TRIGGER  # This parameter defines the triggering mode for the hardware trigger. DMA_NO_HARDWARE_TRIGGER- Hardware trigger is disabled DMA_HARDWARE_TRIGGER_SINGLE_MODE- Hardware requests are disabled by hardware after a transaction DMA_HARDWARE_TRIGGER_CONTINUOUS_MODE- Hardware requests are not disabled by hardware after a transaction
        boolean DmaTcsDaisyChaining: origin=INFINEON_AURIX2G, post-build-variant-value=true, set at post-build, default-value=false  # This parameter determines whether the adjacent lower channel is daisy chained with this channel. If so, after a "transaction" successfully completes on this channel, an internal hardware trigger is forwarded to the adjacent channel
        boolean DmaTcsInterruptSourceAddressWrap: origin=INFINEON_AURIX2G, post-build-variant-value=true, set at post-build, default-value=false  # Enables/Disables the wrap source interrupt
        boolean DmaTcsInterruptDestinationAddressWrap: origin=INFINEON_AURIX2G, post-build-variant-value=true, set at post-build, default-value=false  # Enables/Disables the wrap destination interrupt
        boolean DmaTcsDataTransferInterrupt: origin=INFINEON_AURIX2G, post-build-variant-value=true, set at post-build, default-value=false  # Enables/Disables the data transfer or transaction interrupt
        enumeration DmaTcsInterruptDataTransfer: {DMA_INTERRUPT_PER_TRANSFER, DMA_INTERRUPT_PER_TRANSACTION, DMA_INTERRUPT_AFTER_THRESHOLD}, origin=INFINEON_AURIX2G, post-build-variant-value=true, set at post-build, default-value=DMA_INTERRUPT_PER_TRANSACTION  # Interrupts can be generated either for every transfer or even transaction. Additionally, an interrupt can be generated after a certain number of transfers equaling a threshold have been completed
        integer DmaTcsInterruptDataTransferThreshold: 0..15, origin=INFINEON_AURIX2G, post-build-variant-value=true, set at post-build, default-value=0  # An interrupt can be generated after a certain number of transfers equaling a threshold have been completed.
        boolean DmaTcsSwapDataCRCByteOrder: origin=INFINEON_AURIX2G, post-build-variant-value=true, set at post-build, default-value=false  # Swaps the Data CRC byte order
        boolean DmaTcsAutoStartEnable: origin=INFINEON_AURIX2G, post-build-variant-value=true, set at post-build, default-value=false  # Enables the autostart feature for linked lists
        integer DmaTcsReferenceAddressCrc: 0..4294967295, origin=INFINEON_AURIX2G, post-build-variant-value=true, set at post-build, default-value=0  # Reference CRC value for address CRC
        integer DmaTcsReferenceDataCrc: 0..4294967295, origin=INFINEON_AURIX2G, post-build-variant-value=true, set at post-build, default-value=0  # Reference CRC value for data CRC
    container DmaMoveEngineConfig  # DMA move engine configuration
      boolean DmaMESourceErrorInterrupt: origin=INFINEON_AURIX2G, post-build-variant-value=true, set at post-build, default-value=false  # Enables/Disables the Source error interrupt of a move engine
      boolean DmaMEDestinationErrorInterrupt: origin=INFINEON_AURIX2G, post-build-variant-value=true, set at post-build, default-value=false  # Enables/Disables the Destination error interrupt of a move engine
      boolean DmaMELinkedListErrorInterrupt: origin=INFINEON_AURIX2G, post-build-variant-value=true, set at post-build, default-value=false  # Enables/Disables the Linked List error interrupt of a move engine
    container CommonPublishedInformation  # Common container, aggregated by all modules. It contains published information about vendor and versions.
      integer VendorId: 0..65535, origin=INFINEON_AURIX2G, set at published-information, default-value=17  # DMA Vendor ID
      integer ModuleId: 0..65535, origin=INFINEON_AURIX2G, set at published-information, default-value=255  # DMA Module ID
      integer ArMajorVersion: 0..255, origin=INFINEON_AURIX2G, set at published-information, default-value=4  # DMA Autosar major version
      integer ArMinorVersion: 0..255, origin=INFINEON_AURIX2G, set at published-information, default-value=4  # DMA Autosar mivor version
      integer ArPatchVersion: 0..255, origin=INFINEON_AURIX2G, set at published-information, default-value=0  # DMA Autosar major version
      integer SwMajorVersion: 0..255, origin=INFINEON_AURIX2G, set at published-information, default-value=20  # Major version number of the vendor specific implementation of the module. The numbering is vendor specific
      integer SwMinorVersion: 0..255, origin=INFINEON_AURIX2G, set at published-information, default-value=10  # Minor version number of the vendor specific implementation of the module. The numbering is vendor specific
      integer SwPatchVersion: 0..255, origin=INFINEON_AURIX2G, set at published-information, default-value=0  # Patch level version number of the vendor specific implementation of the module. The numbering is vendor specific
      string Release: origin=INFINEON_AURIX2G, set at published-information, default-value=_TRICORE_TC397_ADAS  # AURIX2G derivative used for the implementation
    container DmaPatternConfig  # DMA pattern matching configuration
      integer DmaPattern0: 0..4294967295, origin=INFINEON_AURIX2G, post-build-variant-value=true, set at post-build, default-value=0  # This parameter is to set the pattern in the PRR0 register.
      integer DmaPattern1: 0..4294967295, origin=INFINEON_AURIX2G, post-build-variant-value=true, set at post-build, default-value=0  # This parameter is to set the pattern in the PRR1 register.
      reference DmaChannelForPattern0 [0..1]: multiplicity set at pre-compile, origin=INFINEON_AURIX2G, set at pre-compile, destination=DmaChannelConfig  # This parameter is to set the channel which uses the PRR0 register.
      reference DmaChannelForPattern1 [0..1]: multiplicity set at pre-compile, origin=INFINEON_AURIX2G, set at pre-compile, destination=DmaChannelConfig  # This parameter is to set the channel which uses the PRR1 register.
    container DmaResourcePartition [4..4]  # Dma hardware access protection configuration.
      enumeration DmaResourcePartitionBusMode: {DMA_RP_USER_MODE, DMA_RP_SUPERVISOR_MODE}, origin=INFINEON_AURIX2G, post-build-variant-value=true, set at post-build, default-value=DMA_RP_SUPERVISOR_MODE  # This parameter controls whether hardware resources access the on chip buses in supervisor mode or user mode.
      integer DmaPermittedBusMaster: 0..4294967295, origin=INFINEON_AURIX2G, post-build-variant-value=true, set at post-build, default-value=4294967295  # permitted bus masters to access this hardware resource. each 32 bit belongs to one master
