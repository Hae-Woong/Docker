AUTOSAR XML (schema 00046)
package /AURIX2G/EcucDefs
  module definition Pwm [0..*]: post-build-variant-support=true, refined-module-def=Pwm, variants post-build  # Configuration of Pwm (Pulse Width Modulation) module.
    container PwmChannelConfigSet  # This container contains the configuration parameters and sub containers of the AUTOSAR Pwm module.
      container PwmChannel [1..*]: multiplicity set at pre-compile  # Configuration of an individual PWM channel.
        enumeration PwmChannelClass [0..1]: {PWM_FIXED_PERIOD, PWM_FIXED_PERIOD_SHIFTED, PWM_VARIABLE_PERIOD, PWM_FIXED_PERIOD_CENTER_ALIGNED}, multiplicity set at post-build, post-build-variant-multiplicity=true, post-build-variant-value=true, set at post-build, default-value=PWM_FIXED_PERIOD  # Class of PWM Channel. ImplementationType: Pwm_17_GtmCcu6_ChannelClassType.
        integer PwmChannelId: 0..255, set at pre-compile, symbolic-name-value=true, default-value=0  # Channel Id of the PWM channel. This value will be assigned to the symbolic name derived of the PwmChannel container short name.
        enumeration PwmAssignedHwUnit: {GTM, CCU6}, origin=INFINEON_AURIX2G, set at pre-compile, default-value=GTM  # The HW resource used for PWM Generation.
        integer PwmDutycycleDefault: 0..16777215, post-build-variant-value=true, set at post-build, default-value=0  # Value of duty cycle used for Initialization Depends on PwmDutyShiftInTicks parameter. When the PwmDutyShiftInTicks is OFF, the Dutycyle should be entered as percentage: 0, represents 0% 0x8000 represents 100% When the PwmDutyShiftInTicks is ON, the Dutycyle should be entered as absolute ticks: 0, represents 0% Same value as Period value represents 100%
        enumeration PwmIdleState: {PWM_HIGH, PWM_LOW}, post-build-variant-value=true, set at post-build, default-value=PWM_LOW  # The parameter PWM_IDLE_STATE represents the output state of the PWM after the signal is stopped (e.g. call of Pwm_SetOutputToIdle).
        function name PwmNotification [0..1]: multiplicity set at post-build, post-build-variant-multiplicity=true, post-build-variant-value=true, set at post-build, default-value=NULL_PTR  # Definition of the Callback function.
        integer PwmPeriodDefault: 0..16777215, post-build-variant-value=true, set at post-build, default-value=0  # Default Period of the channel. Input Value in absolute ticks. This parameter does not impact the channels of class PWM_FIXED_PERIOD_SHIFTED and PWM_FIXED_PERIOD_CENTER_ALIGNED.
        enumeration PwmPolarity: {PWM_HIGH, PWM_LOW}, post-build-variant-value=true, set at post-build, default-value=PWM_LOW  # Defines the starting polarity of each PWM channel.
        integer PwmShiftValue: 0..16777215, origin=INFINEON_AURIX2G, post-build-variant-value=true, set at post-build, default-value=0  # Shift Value for PWM_FIXED_PERIOD_SHIFTED Signal. Valid only when PwmChannelClass is PWM_FIXED_PERIOD_SHIFTED. This depends on PwmDutyShiftInTicks parameter. When the PwmDutyShiftInTicks is OFF, the Shift value should be entered as percentage: 0, represents 0% 0x8000 represents 100% When the PwmDutyShiftInTicks is ON, the Shift value should be entered as absolute ticks: 0, represents 0% Same value as Period value represents 100%
        boolean PwmCoherentUpdate: origin=INFINEON_AURIX2G, post-build-variant-value=true, set at post-build, default-value=false  # Setting this parameter to true determines channel is coherent or not.
        reference PwmMcuClockReferencePoint: scope=ECU, post-build-variant-value=true, set at post-build, destination=McuClockReferencePoint  # This parameter contains reference to the McuClockReferencePoint
        reference PwmReferenceChannel: origin=INFINEON_AURIX2G, post-build-variant-value=true, set at post-build, destination=PwmChannel  # Reference channel for PWM_FIXED_PERIOD_SHIFTED, and PWM_FIXED_PERIOD_CENTER_ALIGNED. Reference should be a channel of PWM_FIXED_PERIOD Only.
        reference PwmChannelEcucPartitionRef [0..*]: scope=ECU, multiplicity set at pre-compile, post-build-variant-multiplicity=true, post-build-variant-value=true, set at pre-compile, destination=EcucPartition  # Maps a PWM channel to zero or multiple ECUC partitions to limit the access to this channe. The ECUC partitions referenced are a subset of the ECUC partitions where the PWM driver is mapped to. Tags: atp.Status=draft
        container GtmTimerOutputModuleConfiguration [0..1]: multiplicity set at pre-compile  # Choose GTM TOM/ATOM channel which will be used by this PWM Channel. Referred timer channel in MCU should have TomChannelUsage/ AtomChannelUsage as USED_BY_PWM_DRIVER
          enumeration GtmTimerClockSelect: {GTM_FIXED_CLOCK_0, GTM_FIXED_CLOCK_1, GTM_FIXED_CLOCK_2, GTM_FIXED_CLOCK_3, GTM_FIXED_CLOCK_4, GTM_CONFIGURABLE_CLOCK_0, GTM_CONFIGURABLE_CLOCK_1, GTM_CONFIGURABLE_CLOCK_2, GTM_CONFIGURABLE_CLOCK_3, GTM_CONFIGURABLE_CLOCK_4, GTM_CONFIGURABLE_CLOCK_5, GTM_CONFIGURABLE_CLOCK_6, GTM_CONFIGURABLE_CLOCK_7}, origin=INFINEON_AURIX2G, post-build-variant-value=true, set at post-build, default-value=GTM_FIXED_CLOCK_0  # This parameter decides the Clock Source for TOM/ATOM timer.
          choice reference GtmTimerUsed: scope=ECU, origin=INFINEON_AURIX2G, post-build-variant-value=true, set at post-build, destination=[McuGtmTomChannelAllocationConf, McuGtmAtomChannelAllocationConf]  # This parameter lists all the GTM timer channels (TOM/ATOM).
        container CCU6CC6Configuration [0..1]: multiplicity set at pre-compile  # Choose CCU6 T12/T13 channel which will be used by this PWM Channel. Referred timer channel in MCU should have CCU6ChannelUsage as USED_BY_PWM_DRIVER
          enumeration CCU6TimerUsed: {T12, T13}, origin=INFINEON_AURIX2G, post-build-variant-value=true, set at post-build, default-value=T12  # Selects Timer T12/T13. Note: Kernel selection is done in parameter CCU6KernelUsed.
          enumeration Cc6xChannel: {Cc60, Cc61, Cc62}, origin=INFINEON_AURIX2G, post-build-variant-value=true, set at post-build, default-value=Cc60  # Cc6 channel selection from the selected kernel
          boolean Cout6xChEnable: origin=INFINEON_AURIX2G, post-build-variant-value=true, set at post-build, default-value=false  # This parameter enables or disables COUT6x channel for the selected CC6x channel in Cc6xChannel parameter. Values for x varies from 0-2. TRUE: Output COUT6x is enabled FALSE: Output COUT6x is disabled
          enumeration Cout6xChPolarity: {PWM_HIGH, PWM_LOW}, origin=INFINEON_AURIX2G, post-build-variant-value=true, set at post-build, default-value=PWM_LOW  # This parameter defines the polarity of COUT6x channel. Values of x varies from 0-2. PWM_LOW: Passive level is LOW PWM_HIGH: Passive level is HIGH
          enumeration CCU6TimerClockSelect: {CCU6_CONFIGURABLE_CLOCK_0, CCU6_CONFIGURABLE_CLOCK_1, CCU6_CONFIGURABLE_CLOCK_2, CCU6_CONFIGURABLE_CLOCK_3, CCU6_CONFIGURABLE_CLOCK_4, CCU6_CONFIGURABLE_CLOCK_6, CCU6_CONFIGURABLE_CLOCK_5, CCU6_CONFIGURABLE_CLOCK_7}, origin=INFINEON_AURIX2G, post-build-variant-value=true, set at post-build, default-value=CCU6_CONFIGURABLE_CLOCK_0  # This parameter decides the Clock Source for T12/T13 timer.
          boolean CCU6TimerPrescalarEnabled: origin=INFINEON_AURIX2G, post-build-variant-value=true, set at post-build, default-value=false  # if CCU6TimerPrescalarEnabled is false then T12/T13 Clock = fcc6 divided by (2 power CCU6TimerClockSelect) if CCU6TimerPrescalarEnabled is false then T12/T13 Clock = fcc6 divided by (2 power (CCU6TimerClockSelect+8) )
          reference CCU6KernelUsed: scope=ECU, origin=INFINEON_AURIX2G, post-build-variant-value=true, set at post-build, destination=McuCcu6ModuleAllocationConf  # This parameter lists all the CCU6 kernels. Note: CCU6 resource allocation is done at kernel level for each module. Once the kernel is allocated to the module, T12 or T13 timer of the kernel can only be assigned to one of the channels within the module.
    container PwmConfigurationOfOptApiServices  # This container has global switches of PWM APIs.
      boolean PwmDeInitApi: set at pre-compile, default-value=false  # Adds / removes the service Pwm_DeInit() from the code.
      boolean PwmGetOutputState: set at pre-compile, default-value=false  # Adds / removes the service Pwm_GetOutputState() from the code.
      boolean PwmSetDutyCycle: set at pre-compile, default-value=false  # Adds / removes the service Pwm_SetDutyCycle() from the code.
      boolean PwmSetOutputToIdle: set at pre-compile, default-value=false  # Adds / removes the service Pwm_SetOutputToIdle() from the code.
      boolean PwmSetPeriodAndDuty: set at pre-compile, default-value=false  # Adds / removes the service Pwm_SetPeriodAndDuty() from the code.
      boolean PwmVersionInfoApi: set at pre-compile, default-value=false  # Switch to indicate that the Pwm_ GetVersionInfo is supported
    container PwmGeneral  # General settings for the PWM driver.
      boolean PwmDevErrorDetect: set at pre-compile, default-value=false  # Switches the Default Error Tracer (Det) detection and notification ON or OFF.
      boolean PwmMultiCoreErrorDetect: origin=INFINEON_AURIX2G, set at pre-compile, default-value=false  # Switches the Multicore error detection and notification ON or OFF.
      boolean PwmDutycycleUpdatedEndperiod: set at pre-compile, default-value=false  # Switch for enabling the update of the duty cycle parameter at the end of the current period. PWM_VARIABLE_PERIOD channel class will not get affected with this parameter setting.
      integer PwmIndex: 0..4294967295, set at pre-compile, default-value=0  # Specifies the InstanceId of this module instance. If only one instance is present it shall have the Id 0.
      boolean PwmLowPowerStatesSupport [0..1]: multiplicity set at pre-compile, set at pre-compile, default-value=false  # Adds / removes all power state management related APIs (PWM_SetPowerState, PWM_GetCurrentPowerState, PWM_GetTargetPowerState, PWM_PreparePowerState, PWM_Main_PowerTransitionManager), indicating if the HW offers low power state management.
      boolean PwmNotificationSupported: set at pre-compile, default-value=false  # Switch to indicate that the notifications are supported
      boolean PwmPeriodUpdatedEndperiod: set at pre-compile, default-value=false  # Switch for enabling the update of the period parameter at the end of the current period. PWM_FIXED_PERIOD, PWM_FIXED_PERIOD_SHIFTED and PWM_FIXED_PERIOD_CENTER_ALIGNED channel class will not get affected with this parameter setting.
      boolean PwmChannelCoherentSelection: origin=INFINEON_AURIX2G, set at pre-compile, default-value=false  # Switch for enabling the update of the period / duty parameter at the end of the current period channel wise. Switching on this parameter obsoletes PwmDutycycleUpdatedEndperiod and PwmPeriodUpdatedEndperiod.
      boolean PwmHandleShiftByOffset: origin=INFINEON_AURIX2G, set at pre-compile, default-value=false  # Switch for enabling Speacial handling for shifted channels.
      boolean PwmDutyShiftInTicks: origin=INFINEON_AURIX2G, set at pre-compile, default-value=false  # Switch for Pwm Duty Cycle type: Disabled - Duty Cycle and Shift value in percentage. Enabled - Duty Cycle and Shift value in timer ticks. User has to take care of entering the right values for PwmDutycycleDefault and PwmShiftValue based on this selection.
      boolean PwmEnable0Or100DutyNotification: origin=INFINEON_AURIX2G, set at pre-compile, default-value=false  # Switch to enable notification for 0% and 100% duty for variable and fixed period channels.
      boolean PwmPowerStateAsynchTransitionMode: set at pre-compile, default-value=false  # Enables / disables support of the PWM Driver to the asynchronous power state transition.
      boolean PwmSafetyEnable: origin=INFINEON_AURIX2G, set at pre-compile, default-value=true  # Enable/Disable the Safety check and all associated notifications.
      boolean PwmInitCheckApi: origin=INFINEON_AURIX2G, set at pre-compile, default-value=true  # Adds / removes the service Pwm_17_GtmCcu6_InitCheck() from the code.
      reference PwmEcucPartitionRef [0..*]: scope=ECU, multiplicity set at pre-compile, post-build-variant-multiplicity=true, post-build-variant-value=true, set at pre-compile, destination=EcucPartition  # Maps the PWM driver to zero or multiple ECUC partitions to make the driver API available in the according partition. Tags: atp.Status=draft
      reference PwmKernelEcucPartitionRef [0..1]: scope=ECU, multiplicity set at pre-compile, post-build-variant-multiplicity=true, post-build-variant-value=true, set at pre-compile, destination=EcucPartition  # Maps the PWM kernel to zero or one ECUC partitions to assign the driver kernel to a certain core. The ECUC partition referenced is a subset of the ECUC partitions where the PWM driver is mapped to. Tags: atp.Status=draft
      container PwmPowerStateConfig [0..*]: multiplicity set at pre-compile  # Each instance of this parameter defines a power state and the callback to be called when this power state is reached.
        integer PwmPowerState: 0..9223372036854775807, set at pre-compile, symbolic-name-value=true, default-value=0  # Each instance of this parameter describes a different power state supported by the PWM HW. It should be defined by the HW supplier and used by the PWMDriver to reference specific HW configurations which set the PWM HW module in the referenced power state.
        function name PwmPowerStateReadyCbkRef: set at pre-compile, default-value=PwmPowerStateCbk  # Each instance of this parameter contains a reference to a power mode callback defined in a CDD or IoHwAbs component.
    container CommonPublishedInformation  # Common container, aggregated by all modules. It contains published information about vendor and versions.
      integer ArMajorVersion: 0..255, origin=INFINEON_AURIX2G, set at pre-compile, default-value=4  # Major version number of AUTOSAR specification on which the appropriate implementation is based on.
      integer ArMinorVersion: 0..255, origin=INFINEON_AURIX2G, set at pre-compile, default-value=4  # Minor version number of AUTOSAR specification on which the appropriate implementation is based on.
      integer ArPatchVersion: 0..255, origin=INFINEON_AURIX2G, set at pre-compile, default-value=0  # Patch level version number of AUTOSAR specification on which the appropriate implementation is based on.
      integer SwMajorVersion: 0..255, origin=INFINEON_AURIX2G, set at pre-compile, default-value=20  # Major version number of the vendor specific implementation of the module. The numbering is vendor specific.
      integer SwMinorVersion: 0..255, origin=INFINEON_AURIX2G, set at pre-compile, default-value=30  # Minor version number of the vendor specific implementation of the module. The numbering is vendor specific.
      integer SwPatchVersion: 0..255, origin=INFINEON_AURIX2G, set at pre-compile, default-value=0  # Patch level version number of the vendor specific implementation of the module. The numbering is vendor specific.
      integer ModuleId: 0..65535, origin=INFINEON_AURIX2G, set at pre-compile, default-value=121  # Module ID of this module from Module List
      integer VendorId: 0..65535, origin=INFINEON_AURIX2G, set at pre-compile, default-value=17  # Vendor ID of the dedicated implementation of this module according to the AUTOSAR vendor list
      string VendorApiInfix: origin=INFINEON_AURIX2G, set at pre-compile, default-value=GtmCcu6  # In driver modules which can be instantiated several times on a single ECU, BSW00347 requires that the name of APIs is extended by the VendorId and a vendor specific name. This parameter is used to specify the vendor specific name. In total, the implementation specific name is generated as follows: <ModuleName>_>VendorId>_<VendorApiInfix><Api name from SWS>. E.g. assuming that the VendorId of the implementor is 123 and the implementer chose a VendorApiInfix of "v11r456" a api name Can_Write defined in the SWS will translate to Can_123_v11r456Write. This parameter is mandatory for all modules with upper multiplicity > 1. It shall not be used for modules with upper multiplicity =1.
      string Release: origin=INFINEON_AURIX2G, set at published-information, default-value=_TRICORE_TC397_ADAS  # Aurix2G derivative used for the implementation
