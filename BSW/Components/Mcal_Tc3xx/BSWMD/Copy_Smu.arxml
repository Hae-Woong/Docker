AUTOSAR XML (schema 00046)
package /AURIX2G/EcucDefs
  module definition Smu [0..1]: post-build-variant-support=true, variants post-build  # Configuration of the Smu (Safety Management Unit) module.
    container SmuConfigSet  # This is the base container that contains the post-build configuration parameters
      container SmuCoreConfig  # This is the base container that contains the post-build configuration parameters for SmuCore
        container SmuCoreRecoveryTimer  # SmuCore Recovery Timer configuration (parameters).
          enumeration SmuCoreEnableRT0: {SMU_RT_DISABLE, SMU_RT_ENABLE}, origin=INFINEON_AURIX2G, post-build-variant-value=true, set at post-build, default-value=SMU_RT_DISABLE  # Defines the Enabling or Disabling of SmuCore Recovery Timer 0.
          enumeration SmuCoreEnableRT1: {SMU_RT_DISABLE, SMU_RT_ENABLE}, origin=INFINEON_AURIX2G, post-build-variant-value=true, set at post-build, default-value=SMU_RT_DISABLE  # Defines the Enabling or Disabling of SmuCore Recovery Timer 1.
          integer SmuCoreRTDuration: 1..16777215, origin=INFINEON_AURIX2G, post-build-variant-value=true, set at post-build, default-value=16383  # Defines the SmuCore Recovery Timer maximum duration.
        container SmuCoreRT0Alarm [4..4]  # Alarms for Recovery Timer 0.
          enumeration SmuCoreRT0AlarmGroupId: {SMU_ALARM_GROUP0, SMU_ALARM_GROUP1, SMU_ALARM_GROUP2, SMU_ALARM_GROUP3, SMU_ALARM_GROUP4, SMU_ALARM_GROUP5, SMU_ALARM_GROUP6, SMU_ALARM_GROUP7, SMU_ALARM_GROUP8, SMU_ALARM_GROUP9, SMU_ALARM_GROUP10, SMU_ALARM_GROUP11}, origin=INFINEON_AURIX2G, post-build-variant-value=true, set at post-build, default-value=SMU_ALARM_GROUP0  # Defines the alarm group that can use the recovery timer 0.
          integer SmuCoreRT0AlarmId: 0..31, origin=INFINEON_AURIX2G, post-build-variant-value=true, set at post-build, default-value=0  # Defines the alarm identifier of the selected group that can use the recovery timer 0.
        container SmuCoreRT1Alarm [4..4]  # Alarms for the Recovery Timer 1.
          enumeration SmuCoreRT1AlarmGroupId: {SMU_ALARM_GROUP0, SMU_ALARM_GROUP1, SMU_ALARM_GROUP2, SMU_ALARM_GROUP3, SMU_ALARM_GROUP4, SMU_ALARM_GROUP5, SMU_ALARM_GROUP6, SMU_ALARM_GROUP7, SMU_ALARM_GROUP8, SMU_ALARM_GROUP9, SMU_ALARM_GROUP10, SMU_ALARM_GROUP11}, origin=INFINEON_AURIX2G, post-build-variant-value=true, set at post-build, default-value=SMU_ALARM_GROUP0  # Defines the alarm group that can use the recovery timer 1.
          integer SmuCoreRT1AlarmId: 0..31, origin=INFINEON_AURIX2G, post-build-variant-value=true, set at post-build, default-value=0  # Defines the alarm identifier of the selected group that can use the recovery timer 1.
        container SmuCoreAlarmGlobalConfig  # SmuCore Alarm Global Configuration .
          enumeration SmuCoreInterruptSet0: {SMU_SELECT_INT_NONE, SMU_SELECT_INT0, SMU_SELECT_INT1, SMU_SELECT_INT2, SMU_SELECT_INT0_INT1, SMU_SELECT_INT0_INT2, SMU_SELECT_INT1_INT2, SMU_SELECT_INT0_INT1_INT2}, origin=INFINEON_AURIX2G, post-build-variant-value=true, set at post-build, default-value=SMU_SELECT_INT_NONE  # Defines the output value of the interrupt request vector when the alarm configuration flag selects the interrupt configuration set 0.
          enumeration SmuCoreInterruptSet1: {SMU_SELECT_INT_NONE, SMU_SELECT_INT0, SMU_SELECT_INT1, SMU_SELECT_INT2, SMU_SELECT_INT0_INT1, SMU_SELECT_INT0_INT2, SMU_SELECT_INT1_INT2, SMU_SELECT_INT0_INT1_INT2}, origin=INFINEON_AURIX2G, post-build-variant-value=true, set at post-build, default-value=SMU_SELECT_INT_NONE  # Defines the output value of the interrupt request vector when the alarm configuration flag selects the interrupt configuration set 1
          enumeration SmuCoreInterruptSet2: {SMU_SELECT_INT_NONE, SMU_SELECT_INT0, SMU_SELECT_INT1, SMU_SELECT_INT2, SMU_SELECT_INT0_INT1, SMU_SELECT_INT0_INT2, SMU_SELECT_INT1_INT2, SMU_SELECT_INT0_INT1_INT2}, origin=INFINEON_AURIX2G, post-build-variant-value=true, set at post-build, default-value=SMU_SELECT_INT_NONE  # Defines the output value of the interrupt request vector when the alarm configuration flag selects the interrupt configuration set 2
          boolean SmuCoreCpu{0..5}ResetRequest: origin=INFINEON_AURIX2G, post-build-variant-value=true, set at post-build, default-value=false  # This parameter defines the Cpu reset request to CPU.
          boolean SmuCoreIGCS{0..2}ActivatePES: origin=INFINEON_AURIX2G, post-build-variant-value=true, set at post-build, default-value=false  # Defines the control of the Port Emergency Stop (PES) feature when IGCS{0..2} configured alarm is active. When an internal action is triggered, the hardware triggers automatically the PES on enabling
          boolean SmuCoreNMIActivatePES: origin=INFINEON_AURIX2G, post-build-variant-value=true, set at post-build, default-value=false  # Defines the control of the Port Emergency Stop (PES) feature when NMI configured alarm is active. When an internal action is triggered, the hardware triggers automatically the PES on enabling
          boolean SmuCoreCpuResetActivatePES: origin=INFINEON_AURIX2G, post-build-variant-value=true, set at post-build, default-value=false  # Defines the control of the Port Emergency Stop (PES) feature when CPU RESET configured alarm is active. When an internal action is triggered, the hardware triggers automatically the PES on enabling
          enumeration SmuCoreEnableFaultToRunState: {SMU_EFRST_ENABLE, SMU_EFRST_DISABLE}, origin=INFINEON_AURIX2G, post-build-variant-value=true, set at post-build, default-value=SMU_EFRST_DISABLE  # Defines the control of Fault State to Fault Free (Run) State transition. The state transition is possible only when this parameter is defined with SMU_EFRST_ENABLE
        container SmuCoreFSPHandling  # SmuCore driver FSP configuration (parameters) .
          enumeration SmuCoreFSPPrescaler1: {SMU_REF_CLK_FRQ_DIV_2, SMU_REF_CLK_FRQ_DIV_4, SMU_REF_CLK_FRQ_DIV_8, SMU_REF_CLK_FRQ_DIV_16, SMU_REF_CLK_FRQ_DIV_32, SMU_REF_CLK_FRQ_DIV_64, SMU_REF_CLK_FRQ_DIV_128, SMU_REF_CLK_FRQ_DIV_256}, origin=INFINEON_AURIX2G, post-build-variant-value=true, set at post-build, default-value=SMU_REF_CLK_FRQ_DIV_2  # Defines the dividing factor to apply to the reference clock FEVR_OSC. The divided clock is used as reference to generate the timing of the FSP fault state
          enumeration SmuCoreFSPPrescaler2: {SMU_REF_CLK_FRQ_DIV_512, SMU_REF_CLK_FRQ_DIV_1024, SMU_REF_CLK_FRQ_DIV_2048, SMU_REF_CLK_FRQ_DIV_4096}, origin=INFINEON_AURIX2G, post-build-variant-value=true, set at post-build, default-value=SMU_REF_CLK_FRQ_DIV_512  # Defines the dividing factor to apply to the reference clock FEVR_OSC in order to generate the timing of the fault free state for the dynamic dual rail and time switching modes of the fault signaling protocol
          enumeration SmuCoreFSPSignalingMode: {SMU_FSP_BISTABLE_PROTOCOL, SMU_FSP_DUAL_RAIL_PROTOCOL, SMU_FSP_TIME_SWITCHING_PROTOCOL}, origin=INFINEON_AURIX2G, post-build-variant-value=true, set at post-build, default-value=SMU_FSP_BISTABLE_PROTOCOL  # Defines the type of signal output for FSP on an alarm event
          enumeration SmuCorePESOnFSP: {SMU_FSP_PES_ENABLE, SMU_FSP_PES_DISABLE}, origin=INFINEON_AURIX2G, post-build-variant-value=true, set at post-build, default-value=SMU_FSP_PES_DISABLE  # Defines the PES to automatically request when an alarm event configured to start the FSP is detected
          integer SmuCoreFSPFaultStateDuration: 0..1023, origin=INFINEON_AURIX2G, post-build-variant-value=true, set at post-build, default-value=1  # This parameter enables the maximum fault state duration of FSP signal. The value is written in TFSP_HIGH bits of SMU_FSP register. It shall be specified as a number of fSMU_FS ticks.
        container SmuCoreAlarmGroup [12..12]  # Container for SmuCore Alarm Group.
          integer SmuCoreAlmGrpId: 0..65535, origin=INFINEON_AURIX2G, set at pre-compile, symbolic-name-value=true, default-value=0  # Group Id of the SMU alarm group. This value will be assigned to the symbolic name derived of the AlarmGroup container short name.
          container SmuCoreAlarmBehavior [32..32]  # Container for SMU Alarm Behavior.
            integer SmuCoreAlmBehaviourId: 0..65535, origin=INFINEON_AURIX2G, set at pre-compile, symbolic-name-value=true, default-value=0  # Alarm Id of the alarm group. This value will be assigned to the symbolic name derived of the AlarmBehaviour container short name.
            enumeration SmuCoreAlarmIntBeh: {SMU_NA_INT_ACTION, SMU_IGCS0_INT_ACTION, SMU_IGCS1_INT_ACTION, SMU_IGCS2_INT_ACTION, SMU_NMI_INT_ACTION, SMU_RESET_INT_ACTION, SMU_CPU_RESET_INT_ACTION}, origin=INFINEON_AURIX2G, post-build-variant-value=true, set at post-build, default-value=SMU_NA_INT_ACTION  # Defines the internal behavior of an alarm event
            enumeration SmuCoreAlarmFSP: {SMU_ALARM_FSP_ENABLED, SMU_ALARM_FSP_DISABLED}, origin=INFINEON_AURIX2G, post-build-variant-value=true, set at post-build, default-value=SMU_ALARM_FSP_DISABLED  # Defines the Fault Signaling of an alarm event
      container SmuStdbyConfig  # This is the base container that contains the post-build configuration parameters for SmuStdby
        container SmuStdbyAlarmGlobalConfig  # SmuStdby Alarm Global Configuration .
          boolean SmuStdbyEnableFSP0: origin=INFINEON_AURIX2G, set at pre-compile, default-value=false  # Defines the error pin 33.8 to be used for FSP
          boolean SmuStdbyEnableFSP1: origin=INFINEON_AURIX2G, set at pre-compile, default-value=false  # Defines the error pin 33.10 to be used for FSP
        container SmuStdbyAlarmGroup [2..2]  # Container for SmuStdby Alarm Group.
          integer SmuStdbyAlmGrpId: 0..65535, origin=INFINEON_AURIX2G, set at pre-compile, symbolic-name-value=true, default-value=0  # Group Id of the SMU alarm group. This value will be assigned to the symbolic name derived of the AlarmGroup container short name.
          container SmuStdbyAlarmBehavior [32..32]  # Container for SmuStdby Alarm Behavior.
            integer SmuStdbyAlmBehaviourId: 0..65535, origin=INFINEON_AURIX2G, set at pre-compile, symbolic-name-value=true, default-value=0  # Alarm Id of the alarm group. This value will be assigned to the symbolic name derived of the AlarmBehaviour container short name.
            enumeration SmuStdbyAlarmFSP: {SMU_ALARM_FSP_ENABLED, SMU_ALARM_FSP_DISABLED}, origin=INFINEON_AURIX2G, post-build-variant-value=true, set at post-build, default-value=SMU_ALARM_FSP_DISABLED  # Defines the Fault Signaling of an alarm event
    container SmuGeneral  # SMU Module related generic configurations.
      boolean SmuStdbyEnable: origin=INFINEON_AURIX2G, set at pre-compile, default-value=false  # This parameter switches the SmuStdby on/off
      boolean SmuDevErrorDetect: origin=INFINEON_AURIX2G, set at pre-compile, default-value=false  # Switches the development error detection and notification on or off.
      boolean SmuSafetyEnable: origin=INFINEON_AURIX2G, set at pre-compile, default-value=true  # Switches the safety Error Checking ON or OFF.
      boolean SmuInitCheckApi: origin=INFINEON_AURIX2G, set at pre-compile, default-value=false  # Switches the Smu_InitCheck detection and notification ON or OFF.
      enumeration SmuRuntimeApiMode: {SMU_MCAL_SUPERVISOR, SMU_MCAL_USER1}, origin=INFINEON_AURIX2G, set at pre-compile, default-value=SMU_MCAL_SUPERVISOR  # Defines the output value of the Runtime API mode
      enumeration SmuInitDeInitApiMode: {SMU_MCAL_SUPERVISOR, SMU_MCAL_USER1}, origin=INFINEON_AURIX2G, set at pre-compile, default-value=SMU_MCAL_SUPERVISOR  # Defines the output value of the Init API mode
      boolean SmuVersionInfoApi: origin=INFINEON_AURIX2G, set at pre-compile, default-value=false  # Adds / removes the service Smu_GetVersionInfo() from the code.
      boolean SmuCoreFSP0OutputEnable: origin=INFINEON_AURIX2G, set at pre-compile, default-value=false  # This parameter sets FSP[0] state to output if TRUE
      boolean SmuCoreFSP1OutputEnable: origin=INFINEON_AURIX2G, set at pre-compile, default-value=false  # This parameter sets FSP[1] state to output if TRUE
      boolean SmuCoreFSP0PortEnable: origin=INFINEON_AURIX2G, set at pre-compile, default-value=false  # This parameter sets FSP[0] PORT enable TRUE
      boolean SmuCoreFSP1PortEnable: origin=INFINEON_AURIX2G, set at pre-compile, default-value=false  # This parameter sets FSP[1] PORT enable TRUE
      boolean SmuCoreGlitchFilterSCU: origin=INFINEON_AURIX2G, set at pre-compile, default-value=false  # This parameter sets glitch filter for SCU enabled
      boolean SmuCoreGlitchFilterSTS: origin=INFINEON_AURIX2G, set at pre-compile, default-value=false  # This parameter sets glitch filter for SMU_STS enabled
    container CommonPublishedInformation  # Common container, aggregated by all modules. It contains published information about vendor and versions.
      integer ArMajorVersion: 0..255, origin=INFINEON_AURIX2G, set at published-information, default-value=4  # Major version number of AUTOSAR specification on which the appropriate implementation is based on.
      integer ArMinorVersion: 0..255, origin=INFINEON_AURIX2G, set at published-information, default-value=4  # Minor version number of AUTOSAR specification on which the appropriate implementation is based on.
      integer ArPatchVersion: 0..255, origin=INFINEON_AURIX2G, set at published-information, default-value=0  # Patch level version number of AUTOSAR specification on which the appropriate implementation is based on.
      integer SwMajorVersion: 0..255, origin=INFINEON_AURIX2G, set at published-information, default-value=20  # Major version number of the vendor specific implementation of the module. The numbering is vendor specific.
      integer SwMinorVersion: 0..255, origin=INFINEON_AURIX2G, set at published-information, default-value=30  # Minor version number of the vendor specific implementation of the module. The numbering is vendor specific.
      integer SwPatchVersion: 0..255, origin=INFINEON_AURIX2G, set at published-information, default-value=0  # Patch level version number of the vendor specific implementation of the module. The numbering is vendor specific.
      integer ModuleId: 0..65535, origin=INFINEON_AURIX2G, set at published-information, default-value=255  # Module ID of this module from Module List
      integer VendorId: 0..65535, origin=INFINEON_AURIX2G, set at published-information, default-value=17  # Vendor ID of the dedicated implementation of this module according to the AUTOSAR vendor list
      string Release: origin=INFINEON_AURIX2G, set at published-information, default-value=_TRICORE_TC397_ADAS  # Aurix derivative used for the implementation
    container SmuDemEventParameterRefsConf [0..1]: multiplicity set at pre-compile  # Container for the references to DemEventParameter elements which shall be invoked using the API Mcal_Wrapper_Dem_SetEventStatus API in case the corresponding error occurs. The EventId is taken from the referenced DemEventParameter's DemEventId symbolic name. The standardized errors are provided in the container and can be extended by vendor specific error references.
      reference SmuActivateRunStateFailureNotification: multiplicity set at pre-compile, origin=INFINEON_AURIX2G, set at pre-compile, requires-symbolic-name-value=true, destination=DemEventParameter  # Reference to configured DEM event to report activate RUN state failure.
      reference SmuClearAlarmStatusFailureNotification: multiplicity set at pre-compile, origin=INFINEON_AURIX2G, set at pre-compile, requires-symbolic-name-value=true, destination=DemEventParameter  # Reference to configured DEM event to report clear alarm status failure.
      reference SmuReleaseFSPFailureNotification: multiplicity set at pre-compile, origin=INFINEON_AURIX2G, set at pre-compile, requires-symbolic-name-value=true, destination=DemEventParameter  # Reference to configured DEM event to report release FSP failure.
      reference SmuCoreAliveFailureNotification: multiplicity set at pre-compile, origin=INFINEON_AURIX2G, set at pre-compile, requires-symbolic-name-value=true, destination=DemEventParameter  # Reference to configured DEM event to report Smu_core_alive test failure.
      reference SmuRTStopFailureNotification: multiplicity set at pre-compile, origin=INFINEON_AURIX2G, set at pre-compile, requires-symbolic-name-value=true, destination=DemEventParameter  # Reference to configured DEM event to report RT stop failure.
      reference SmuActivatePESFailureNotification: multiplicity set at pre-compile, origin=INFINEON_AURIX2G, set at pre-compile, requires-symbolic-name-value=true, destination=DemEventParameter  # Reference to configured DEM event to activate PES failure.
      reference SmuActivateFSPFailureNotification: multiplicity set at pre-compile, origin=INFINEON_AURIX2G, set at pre-compile, requires-symbolic-name-value=true, destination=DemEventParameter  # Reference to configured DEM event to activate FSP failure.
      reference SmuSetAlarmStatusFailureNotification: multiplicity set at pre-compile, origin=INFINEON_AURIX2G, set at pre-compile, requires-symbolic-name-value=true, destination=DemEventParameter  # Reference to configured DEM event to set alarm status failure.
      reference SmuSffFailureNotification: multiplicity set at pre-compile, origin=INFINEON_AURIX2G, set at pre-compile, requires-symbolic-name-value=true, destination=DemEventParameter  # Reference to configured DEM event for SFF test failure.
