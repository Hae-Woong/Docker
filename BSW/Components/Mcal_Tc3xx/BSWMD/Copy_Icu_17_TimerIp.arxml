AUTOSAR XML (schema 00046)
package /AURIX2G/EcucDefs
  module definition Icu [0..1]: post-build-variant-support=true, refined-module-def=Icu, variants post-build  # Configuration of the Icu (Input Capture Unit) module.
    container IcuConfigSet  # This container is the base for a multiple configuration set
      integer IcuMaxChannel: 0..65535, post-build-variant-value=true, set at post-build, derivation=informal-formula=verbatim=l-5=number of configured icu channels, default-value=1  # This parameter contains the number of Channels configured. It will be gathered by tools during the configuration stage. calculation Formula = Number of configured Icu Channels Implementation Type: Icu_ChannelType. This parameter doesn't have any influence on the generated code file
      container IcuChannel [1..*]: multiplicity set at pre-compile  # Configuration of an individual ICU channel.
        integer IcuChannelId: 0..65535, scope=ECU, set at pre-compile, symbolic-name-value=true, default-value=0  # Channel Id of the ICU channel. This value will be assigned to the symbolic name derived of the IcuChannel container short name.
        enumeration IcuDefaultStartEdge: {ICU_BOTH_EDGES, ICU_FALLING_EDGE, ICU_RISING_EDGE}, post-build-variant-value=true, set at post-build, default-value=ICU_RISING_EDGE  # Configures the default-activation-edge which shall be used for this channel if there was no activation-edge configured by the call of service Icu_SetActivationCondition().For PERIOD signal measurement, the configured edge is the start of period. For DUTY measurement, the configured edge is the start of Active time and period. Both Edges can not be configured for PERIOD. For DUTY measurement, BOTH EDGES, First edge seen after call of Icu_StartSignalMeasurement is considered as the start of measurement. The parameter is un-editable for HIGH TIME and LOW TIME measurement. Implementation Type: Icu_ActivationType
        enumeration IcuMeasurementMode: {ICU_MODE_EDGE_COUNTER, ICU_MODE_SIGNAL_EDGE_DETECT, ICU_MODE_SIGNAL_MEASUREMENT, ICU_MODE_TIMESTAMP, ICU_MODE_INCREMENTAL_INTERFACE}, post-build-variant-value=true, set at post-build, default-value=ICU_MODE_SIGNAL_EDGE_DETECT  # Configures the measurement mode of this channel. Implementation Type: Icu_MeasurementModeType
        enumeration IcuTimeoutFeature: {TIMEOUT_DISABLED, TIMEOUT_ONLY, TIMEOUT_MIXED}, origin=IFX, post-build-variant-value=true, set at post-build, default-value=TIMEOUT_DISABLED  # Configures the timeout feature of this channel.
        boolean IcuWakeupCapability: post-build-variant-value=true, set at post-build, default-value=false  # Information about the wakeup-capability of this channel. true: Channel is wakeup capable. false: Channel is not wakeup capable.
        enumeration IcuAssignedHwUnit: {GTM, CCU6, ERU, GPT12}, origin=INFINEON_AURIX2G, set at post-build, default-value=GTM  # The HW resource required for the measurement. TIM, ERU, GPT12 and CCU
        reference IcuChannelEcucPartitionRef [0..*]: scope=ECU, multiplicity set at pre-compile, post-build-variant-multiplicity=true, post-build-variant-value=true, set at pre-compile, destination=EcucPartition  # Maps an ICU channel to zero or multiple ECUC partitions to limit the access to this channel. The ECUC partitions referenced are a subset of the ECUC partitions where the ICU driver is mapped to. Tags: atp.Status=draft
        container IcuSignalEdgeDetection [0..1]: multiplicity set at pre-compile, post-build-variant-multiplicity=true  # This container contains the configuration (parameters) in case the measurement mode is "IcuSignalEdgeDetection"
          function name IcuSignalNotification [0..1]: multiplicity set at post-build, post-build-variant-multiplicity=true, post-build-variant-value=true, set at post-build, default-value=NULL  # Notification function for signal notification.
        container IcuIncrementalInterfaceMode [0..1]: multiplicity set at pre-compile, post-build-variant-multiplicity=true  # This container contains the configuration of the incremental interface notifications
          function name IcuIncrementalModeEdgeNotification [0..1]: multiplicity set at post-build, origin=INFINEON_AURIX2G, post-build-variant-multiplicity=true, post-build-variant-value=true, set at post-build, default-value=NULL  # Notification function for GPT12 incremental interface count edge.
          function name IcuCounterOverflowNotification [0..1]: multiplicity set at post-build, origin=INFINEON_AURIX2G, post-build-variant-multiplicity=true, post-build-variant-value=true, set at post-build, default-value=NULL  # Notification function for GPT12 incremental interface counter overflow.
        container IcuTimeOutDetection [0..1]: multiplicity set at pre-compile, post-build-variant-multiplicity=true  # This container contains the configuration of the time out notification for a GTM channel
          function name IcuTimeOutNotification [0..1]: multiplicity set at post-build, origin=INFINEON_AURIX2G, post-build-variant-multiplicity=true, post-build-variant-value=true, set at post-build, default-value=NULL  # Notification function for Timer out detection.
        container IcuSignalMeasurement [0..1]: multiplicity set at pre-compile, post-build-variant-multiplicity=true  # This container contains the configuration (parameters) in case the measurement mode is "IcuSignalMeasurement"
          enumeration IcuSignalMeasurementProperty: {ICU_DUTY_CYCLE, ICU_HIGH_TIME, ICU_LOW_TIME, ICU_PERIOD_TIME}, post-build-variant-value=true, set at post-build, default-value=ICU_LOW_TIME  # Configures the property that could be measured in case the mode is IcuSignalMeasurement. This property can not be changed during runtime.Implementation Type: Icu_SignalMeasurementPropertyType
        container IcuTimestampMeasurement [0..1]: multiplicity set at pre-compile, post-build-variant-multiplicity=true  # This container contains the configuration (parameters) in case the measurement mode is "IcuTimestamp"
          enumeration IcuTimestampMeasurementProperty: {ICU_CIRCULAR_BUFFER, ICU_LINEAR_BUFFER}, post-build-variant-value=true, set at post-build, default-value=ICU_LINEAR_BUFFER  # Configures the handling of the buffer in case the mode is Timestamp; Implementation Type: Icu_TimestampBufferType
          function name IcuTimestampNotification [0..1]: multiplicity set at post-build, post-build-variant-multiplicity=true, post-build-variant-value=true, set at post-build, default-value=NULL  # Notification function if the number of requested timestamps (Notification interval is greater 0) are acquired.
        container IcuWakeup [0..1]: multiplicity set at pre-compile, post-build-variant-multiplicity=true  # This container contains the configuration (parameters) needed to configure a wakeup capable channel
          reference IcuChannelWakeupInfo [0..1]: multiplicity set at post-build, post-build-variant-multiplicity=true, post-build-variant-value=true, set at post-build, destination=EcuMWakeupSource  # If the wakeup-capability is true the wakeup source referenced is transmitted to the ECU State Manager (EcuM). Implementation Type: reference to EcuM_WakeupSourceType
        container GtmTimerInputConfiguration [0..1]: multiplicity set at pre-compile  # This container contains the TIM Configuration for GTM
          reference GtmTimerUsed: origin=INFINEON_AURIX2G, set at post-build, destination=McuGtmTimChannelAllocationConf  # This parameter lists all the GTM timer channels (TOM/ATOM).
          container TimChannelGeneral  # This container contains the TIM Channel General Configuration
            enumeration TimChannelInputSelect: {INPUT_OF_CURRENT_TIM_CHANNEL, INPUT_OF_PREVIOUS_TIM_CHANNEL}, origin=INFINEON_AURIX2G, post-build-variant-value=true, set at post-build, default-value=INPUT_OF_CURRENT_TIM_CHANNEL  # This decides the Input for the channel INPUT_OF_CURRENT_TIM_CHANNEL: Input to the current TIM Channel will be the input assigned to this channel. INPUT_OF_PREVIOUS_TIM_CHANNEL: Input to the current TIM channel will be the input assigned to the previous channel. Please note, the Port and Pin number applicable in this case is the configuration in TimChannelPortPinSelect for the previous channel and not the Port and Pin configured for this channel.
            enumeration TimChannelClockSelect: {GTM_CONFIGURABLE_CLOCK_0, GTM_CONFIGURABLE_CLOCK_1, GTM_CONFIGURABLE_CLOCK_2, GTM_CONFIGURABLE_CLOCK_3, GTM_CONFIGURABLE_CLOCK_4, GTM_CONFIGURABLE_CLOCK_5, GTM_CONFIGURABLE_CLOCK_6, GTM_CONFIGURABLE_CLOCK_7}, origin=INFINEON_AURIX2G, post-build-variant-value=true, set at post-build, default-value=GTM_CONFIGURABLE_CLOCK_0  # This decides the Clock Source for TIM Channel / GTM_CONFIGURABLE_CLOCK_0: Configurable Clock 0 will be supplied to this channel GTM_CONFIGURABLE_CLOCK_1: Configurable Clock 1 will be supplied to this channel GTM_CONFIGURABLE_CLOCK_2: Configurable Clock 2 will be supplied to this channel GTM_CONFIGURABLE_CLOCK_3: Configurable Clock 3 will be supplied to this channel GTM_CONFIGURABLE_CLOCK_4: Configurable Clock 4 will be supplied to this channel GTM_CONFIGURABLE_CLOCK_5: Configurable Clock 5 will be supplied to this channel GTM_CONFIGURABLE_CLOCK_6: Configurable Clock 6 will be supplied to this channel GTM_CONFIGURABLE_CLOCK_7: Configurable Clock 7 will be supplied to this channel
            enumeration TimChannelGpr0InputSelect: {TIMEBASE_TBU_TS0, TIMEBASE_TBU_TS1, TIMEBASE_TBU_TS2}, origin=INFINEON_AURIX2G, post-build-variant-value=true, set at post-build, default-value=TIMEBASE_TBU_TS0  # This decides the value captured in GPR0 register of TIM Channel. / TIMEBASE_TBU_TS0: TBU_TS0 will be captured in GPR0 TIMEBASE_TBU_TS1: TBU_TS1 will be captured in GPR0 TIMEBASE_TBU_TS2: TBU_TS2 will be captured in GPR0
            enumeration TimInterruptMode: {GTM_INTERRUPT_LEVEL_MODE, GTM_INTERRUPT_PULSE_NOTIFY_MODE, GTM_INTERRUPT_SINGLE_PULSE_MODE}, origin=INFINEON_AURIX2G, post-build-variant-value=true, set at post-build, default-value=GTM_INTERRUPT_LEVEL_MODE  # This decides the Interrupt mode to use.
            integer OverflowISRThreshold: 0..16777215, origin=INFINEON_AURIX2G, post-build-variant-value=true, set at post-build, default-value=0  # The threshold denotes the maximum latency between the actual TIM counter overflow interrupt and execution flow entering ICU ISR. User must configure the threshold to contain the maximum latency and must be lesser than the actual measured time. The threshold will be in the ticks of the CMU_CLK selected for that TIM channel. The threshold should consider interrupt latency, other high priority interrupts and the latency to reach the ICU ISR. The threshold is applicable only for Signal measurement, HIGH TIME and LOW TIME.
          container TimChannelFilterConfig  # This holds the filter specific configurations for the channels.
            boolean TimChannelFilterEnable: origin=INFINEON_AURIX2G, post-build-variant-value=true, set at post-build, default-value=false  # Enables Filter for the Channel. This sets FLT_EN for the channel
            enumeration TimChFilterCounterFreqSelect: {GTM_CONFIGURABLE_CLOCK_0, GTM_CONFIGURABLE_CLOCK_1, GTM_CONFIGURABLE_CLOCK_6, GTM_CONFIGURABLE_CLOCK_7}, origin=INFINEON_AURIX2G, post-build-variant-value=true, set at post-build, default-value=GTM_CONFIGURABLE_CLOCK_0  # This decides the Filter Counter frequency for the TIM Channel. This modifies the FLT_CNT_FRQ for the channel
            enumeration TimChFilterModeForRisingEdge: {IMMEDIATE_EDGE_PROPAGATION_MODE, DEGLITCH_WITH_UPDOWN_COUNTER, DEGLITCH_WITH_HOLD_COUNTER}, origin=INFINEON_AURIX2G, post-build-variant-value=true, set at post-build, default-value=IMMEDIATE_EDGE_PROPAGATION_MODE  # This decides the Filter Mode for Rising Edge of the TIM Channel Input
            enumeration TimChFilterModeForFallingEdge: {IMMEDIATE_EDGE_PROPAGATION_MODE, DEGLITCH_WITH_UPDOWN_COUNTER, DEGLITCH_WITH_HOLD_COUNTER}, origin=INFINEON_AURIX2G, post-build-variant-value=true, set at post-build, default-value=IMMEDIATE_EDGE_PROPAGATION_MODE  # This decides the Filter Mode for Falling Edge of the TIM Channel Input
            integer TimChFilterTimeForRisingEdge: 0..16777215, origin=INFINEON_AURIX2G, post-build-variant-value=true, set at post-build, default-value=0  # This parameter specifies the Filter Time for Rising Edge of the TIM Channel Input
            integer TimChFilterTimeForFallingEdge: 0..16777215, origin=INFINEON_AURIX2G, post-build-variant-value=true, set at post-build, default-value=0  # This parameter specifies the Filter Time for Falling Edge of the TIM Channel Input
          container TimChannelTimeOutConfig  # This holds the time out specific configurations for the channels.
            enumeration TimChTimeOutCounterFreqSelect: {GTM_CONFIGURABLE_CLOCK_0, GTM_CONFIGURABLE_CLOCK_1, GTM_CONFIGURABLE_CLOCK_2, GTM_CONFIGURABLE_CLOCK_3, GTM_CONFIGURABLE_CLOCK_4, GTM_CONFIGURABLE_CLOCK_5, GTM_CONFIGURABLE_CLOCK_6, GTM_CONFIGURABLE_CLOCK_7}, origin=INFINEON_AURIX2G, post-build-variant-value=true, set at post-build, default-value=GTM_CONFIGURABLE_CLOCK_0  # This decides the time out counter frequency for the TIM Channel.
            enumeration TimChTimeOutEdge: {TDU_RISING_EDGE, TDU_FALLING_EDGE, TDU_BOTH_EDGES}, origin=INFINEON_AURIX2G, post-build-variant-value=true, set at post-build, default-value=TDU_RISING_EDGE  # This decides the edge for time out detection
            enumeration TimChannelTimeoutInputSelect: {INPUT_OF_CURRENT_TIM_CHANNEL, INPUT_OF_PREVIOUS_TIM_CHANNEL}, origin=INFINEON_AURIX2G, post-build-variant-value=true, set at post-build, default-value=INPUT_OF_CURRENT_TIM_CHANNEL  # This decides the Input for the channel INPUT_OF_CURRENT_TIM_CHANNEL: Input to the current TIM Channel will be the timeout input assigned to this channel. INPUT_OF_PREVIOUS_TIM_CHANNEL: Input to the current TIM channel will be the timeout input assigned to the previous channel. Please note, the Port and Pin number applicable in this case is the configuration in TimChannelPortPinSelect for the previous TIM channel.
        container CCU6CC6Configuration [0..1]: multiplicity set at pre-compile  # This container contains the TIM Configuration for GTM
          enumeration Cc6xChannel: {Cc60, Cc61, Cc62}, origin=INFINEON_AURIX2G, set at post-build, default-value=Cc60  # Cc6 channel selection from the selected kernel
          enumeration CCChannelInputSelection: {CCINA_PORT2_PIN0, CCINB_PORT0_PIN1, CCINC_PORT2_PIN6, CCIND_EVR_WUT_TRIGGER_O, CCINA_PORT2_PIN2, CCINB_PORT0_PIN3, CCINC_PORT2_PIN7, CCINA_PORT2_PIN4, CCINB_PORT0_PIN5, CCINC_PORT2_PIN8, CCIND_ERU_OGU4_PDOUT4, CCINA_PORT0_PIN1, CCINB_PORT2_PIN0, CCINC_PORT0_PIN7, CCINA_PORT0_PIN3, CCINB_PORT2_PIN2, CCINC_PORT0_PIN8, CCIND_CAN0_INTR12, CCINA_PORT0_PIN5, CCINB_PORT2_PIN4, CCINC_PORT0_PIN9, CCIND_ERU_OGU5_PDOUT5}, origin=INFINEON_AURIX2G, post-build-variant-value=true, set at post-build, default-value=CCINA_PORT2_PIN0  # Input Selection for CCx channel.
          reference CCU6KernelUsed: origin=INFINEON_AURIX2G, set at post-build, destination=McuCcu6ModuleAllocationConf  # This parameter lists all the CCU6 kernels
          container CCU6xParameters  # This holds the filter specific configurations for the channels.
            integer T12ClkSelection: 0..7, origin=INFINEON_AURIX2G, post-build-variant-value=true, set at post-build, default-value=0  # T12 configuration - clock selection if T12PrescalerEnabled -false ft12 = fcc6 divided by (2 power T12ClkSelection) if T12PrescalerEnabled -true ft12 = fcc6 divided by (2 power (T12ClkSelection + 8) ) / Clock divider mode
            boolean T12PrescalerEnabled: origin=INFINEON_AURIX2G, post-build-variant-value=true, set at post-build, default-value=false  # if T12PrescalerEnabled -false ft12 = fcc6 divided by (2 power T12ClkSelection) if T12PrescalerEnabled -true ft12 = fcc6 divided by (2 power (T12ClkSelection + 8) ) / Prescaler enabling for finer clock resolution.
            enumeration CCU6InterruptNode: {NODE_SR0, NODE_SR1, NODE_SR2, NODE_SR3}, origin=INFINEON_AURIX2G, set at post-build, default-value=NODE_SR0  # Interrupt node to be used for the kernel
        container ERUInputConfiguration [0..1]: multiplicity set at pre-compile  # This container contains the ERS and OGU Configuration
          enumeration EruInputPin: {ERU_INPUT0A_PORT15_PIN4, ERU_INPUT0B_CCU60_COUT60, ERU_INPUT0C_PORT10_PIN7, ERU_INPUT0D_MSC0_FCLP, ERU_INPUT0E_STM5_STMIR0, ERU_INPUT1A_PORT14_PIN3, ERU_INPUT1B_CCU61_COUT60, ERU_INPUT1C_PORT10_PIN8, ERU_INPUT1D_STM0_STMIR0, ERU_INPUT2A_PORT10_PIN2, ERU_INPUT2B_PORT02_PIN1, ERU_INPUT2C_PORT00_PIN4, ERU_INPUT2D_ERAY0_MT, ERU_INPUT3A_PORT10_PIN3, ERU_INPUT3B_PORT14_PIN1, ERU_INPUT3C_PORT02_PIN0, ERU_INPUT3D_STM1_STMIR0, ERU_INPUT4A_PORT33_PIN7, ERU_INPUT4B_GTM_TOM0_12, ERU_INPUT4C_GPT120_T3OUT, ERU_INPUT4D_PORT15_PIN5, ERU_INPUT5A_PORT15_PIN8, ERU_INPUT5B_GTM_TOM1_12, ERU_INPUT5C_GPT120_T6OUT, ERU_INPUT5D_STM2_STMIR0, ERU_INPUT6A_PORT20_PIN0, ERU_INPUT6B_ESR0, ERU_INPUT6D_PORT11_PIN10, ERU_INPUT6E_STM3_STMIR0, ERU_INPUT6F_GTM_TOM2_12, ERU_INPUT7A_PORT20_PIN9, ERU_INPUT7B_ESR1, ERU_INPUT7C_PORT15_PIN1, ERU_INPUT7D_ERAY1_MT, ERU_INPUT7E_STM4_STMIR0, ERU_INPUT7F_GTM_TOM3_12}, origin=INFINEON_AURIX2G, post-build-variant-value=true, set at pre-compile, default-value=ERU_INPUT0A_PORT15_PIN4  # Eru Input selection for the ERU unit
          reference EruErsReference: origin=INFINEON_AURIX2G, set at post-build, destination=McuEruChannelInputLineConf  # This parameter lists all the ERU channels (ERS and OGU).
          reference EruOguReference: origin=INFINEON_AURIX2G, set at post-build, destination=McuEruChannelOutputUnitConf  # This parameter lists all the GTM timer channels (TOM/ATOM).
        container GPT12Configuration [0..1]: multiplicity set at pre-compile  # This container contains the GPT12 Configuration for GPT12
          enumeration GPT12InputPortSelection: {GPT12_T2INA_PORT00_PIN7, GPT12_T2INB_PORT33_PIN7, GPT12_T3INA_PORT02_PIN6, GPT12_T3INB_PORT10_PIN4, GPT12_T3INC_SCU_PDOUT4, GPT12_T4INA_PORT02_PIN8, GPT12_T4INB_PORT10_PIN8, GPT12_T5INA_PORT21_PIN7, GPT12_T5INB_PORT10_PIN3, GPT12_T6INA_PORT20_PIN3, GPT12_T6INB_PORT10_PIN2}, origin=INFINEON_AURIX2G, post-build-variant-value=true, set at post-build, default-value=GPT12_T2INA_PORT00_PIN7  # GPT12 Input selection for the GPT12 unit
          enumeration GPT12DirPortSelection: {NONE, GPT12_T2EUDA_PORT00_PIN8, GPT12_T2EUDB_PORT33_PIN6, GPT12_T3EUDA_PORT02_PIN7, GPT12_T3EUDB_PORT10_PIN7, GPT12_T4EUDA_PORT00_PIN9, GPT12_T4EUDB_PORT33_PIN5}, origin=INFINEON_AURIX2G, post-build-variant-value=true, set at post-build, default-value=NONE  # GPT12 Direction Input selection for the GPT12 unit
          enumeration GPT12CounterType: {ICU_1_COUNT_INPUT, ICU_2_COUNT_INPUT}, origin=INFINEON_AURIX2G, post-build-variant-value=true, set at post-build, default-value=ICU_1_COUNT_INPUT  # GPT12 Counting mechanism
          enumeration GPT12TimerClearTrigger: {NONE, GPT12_T4IN, GPT12_T4EUD}, origin=INFINEON_AURIX2G, post-build-variant-value=true, set at post-build, default-value=NONE  # GPT12 counter reset trigger
          reference GPT12BlockReference: origin=INFINEON_AURIX2G, set at post-build, destination=McuGpt12ModuleAllocationConf  # This parameter lists all the GPT12 timer channels Block.
    container IcuGeneral  # Configuration of general ICU parameters.
      boolean IcuDevErrorDetect: set at pre-compile, default-value=false  # Switches the Development Error Detection on or off. true: Enabled. false: Disabled.
      boolean IcuRunTimeErrorDetect: origin=IFX, set at pre-compile, default-value=false  # Switches the Runtime Error Detection on or off. true: Enabled. false: Disabled.
      boolean IcuMultiCoreErrorDetect: origin=INFINEON_AURIX2G, set at pre-compile, default-value=false  # Switches the MultiCore Development Error Detection on or off. true: Enabled. false: Disabled.
      boolean IcuReportWakeupSource: set at pre-compile, default-value=false  # Switch for enabling Wakeup source reporting. true: Report Wakeup source. false: Do not report Wakeup source.
      boolean IcuSafetyEnable: origin=INFINEON_AURIX2G, set at pre-compile, default-value=true  # Switch for enabling/Disabling IcuSafetyEnable
      enumeration IcuRuntimeApiMode: {ICU_MCAL_USER1, ICU_MCAL_SUPERVISOR}, origin=INFINEON_AURIX2G, set at pre-compile, default-value=ICU_MCAL_SUPERVISOR  # IcuRuntimeApiMode for ICU_MCAL_USER1, ICU_MCAL_SUPERVISOR
      enumeration IcuInitDeInitApiMode: {ICU_MCAL_USER1, ICU_MCAL_SUPERVISOR}, origin=INFINEON_AURIX2G, set at pre-compile, default-value=ICU_MCAL_SUPERVISOR  # IcuInitDeInitApiMode for ICU_MCAL_USER1, ICU_MCAL_SUPERVISOR
      reference IcuEcucPartitionRef [0..*]: scope=ECU, multiplicity set at pre-compile, post-build-variant-multiplicity=true, post-build-variant-value=true, set at pre-compile, destination=EcucPartition  # Maps the ICU driver to zero or multiple ECUC partitions to make the driver API available in the according partition. Tags: atp.Status=draft
      reference IcuKernelEcucPartitionRef [0..1]: scope=ECU, multiplicity set at pre-compile, post-build-variant-multiplicity=true, post-build-variant-value=true, set at pre-compile, destination=EcucPartition  # Maps the ICU kernel to zero or one ECUC partitions to assign the driver kernel to a certain core. The ECUC partition referenced is a subset of the ECUC partitions where the ICU driver is mapped to. Tags: atp.Status=draft
    container IcuOptionalApis  # This container contains all configuration switches for configuring optional API services of the ICU driver.
      boolean IcuDeInitApi: set at pre-compile, default-value=false  # Adds / removes the service Icu_17_TimerIp_DeInit() from the code. true: Icu_17_TimerIp_DeInit() can be used. false: Icu_17_TimerIp_DeInit() can not be used.
      boolean IcuInitCheckApi: origin=INFINEON_AURIX2G, set at pre-compile, default-value=true  # Adds / removes the service Icu_17_TimerIp_InitCheck() from the code. true: Icu_17_TimerIp_InitCheck() can be used. false: Icu_17_TimerIp_InitCheck() can not be used.
      boolean IcuDisableWakeupApi: set at pre-compile, default-value=false  # Adds / removes the service Icu_17_TimerIp_DisableWakeup() from the code. true: Icu_17_TimerIp_DisableWakeup() can be used. false: Icu_17_TimerIp_DisableWakeup() can not be used.
      boolean IcuEdgeCountApi: set at pre-compile, default-value=false  # Adds / removes all services related to the edge counting functionality as listed below, from the code: Icu_17_TimerIp_ResetEdgeCount(), Icu_17_TimerIp_EnableEdgeCount(), Icu_17_TimerIp_DisableEdgeCount(), Icu_17_TimerIp_GetEdgeNumbers(). true: The services listed above can be used. false: The services listed above can not be used.
      boolean IcuEdgeDetectApi: set at pre-compile, default-value=false  # Adds / removes all services related to the edge detection functionality as listed below from the code: Icu_17_TimerIp_EnableEdgeDetection(),Icu_17_TimerIp_DisableEdgeDetection(). true: The services listed above can be used. false: The services listed above can not be used.
      boolean IcuEnableWakeupApi: set at pre-compile, default-value=false  # Adds / removes the service Icu_17_TimerIp_EnableWakeup() from the code. true: Icu_17_TimerIp_EnableWakeup() can be used. false: Icu_17_TimerIp_EnableWakeup() can not be used.
      boolean IcuGetDutyCycleValuesApi: set at pre-compile, default-value=false  # Adds / removes the service Icu_17_TimerIp_GetDutyCycleValues() from the code. true: Icu_17_TimerIp_GetDutyCycleValues() can be used. false: Icu_17_TimerIp_GetDutyCycleValues() can not be used.
      boolean IcuGetInputStateApi: set at pre-compile, default-value=false  # Adds / removes the service Icu_17_TimerIp_GetInputState() from the code. true: Icu_17_TimerIp_GetInputState() can be used. false: Icu_17_TimerIp_GetInputState() can not be used.
      boolean IcuGetTimeElapsedApi: set at pre-compile, default-value=false  # Adds / removes the service Icu_17_TimerIp_GetTimeElapsed() from the code. true: Icu_17_TimerIp_GetTimeElapsed() can be used. false: Icu_17_TimerIp_GetTimeElapsed() can not be used.
      boolean IcuGetVersionInfoApi: set at pre-compile, default-value=false  # Adds / removes the service Icu_17_TimerIp_GetVersionInfo() from the code. true: Icu_17_TimerIp_GetVersionInfo() can be used. false: Icu_17_TimerIp_GetVersionInfo() can not be used.
      boolean IcuSetModeApi: set at pre-compile, default-value=false  # Adds / removes the service Icu_17_TimerIp_SetMode() from the code. true: Icu_17_TimerIp_SetMode() can be used. false: Icu_17_TimerIp_SetMode() can not be used.
      boolean IcuSignalMeasurementApi: set at pre-compile, default-value=false  # Adds / removes the services Icu_17_TimerIp_StartSignalMeasurement() and Icu_17_TimerIp_StopSignalMeasurement() from the code. true: Icu_17_TimerIp_StartSignalMeasurement() and Icu_17_TimerIp_StopSignalMeasurement() can be used. false: Icu_17_TimerIp_StartSignalMeasurement() and Icu_17_TimerIp_StopSignalMeasurement() can not be used.
      boolean IcuTimestampApi: set at pre-compile, default-value=false  # Adds / removes all services related to the timestamping functionality as listed below from the code: Icu_17_TimerIp_StartTimestamp(), Icu_17_TimerIp_StopTimestamp(), Icu_17_TimerIp_GetTimestampIndex(). true: The services listed above can be used. false: The services listed above can not be used.
      boolean IcuWakeupFunctionalityApi: set at pre-compile, default-value=false  # Adds / removes the service Icu_17_TimerIp_CheckWakeup() from the code. true: Icu_17_TimerIp_CheckWakeup() can be used. false: Icu_17_TimerIp_CheckWakeup() can not be used.
      boolean IcuIncrementalInterfaceApi: origin=INFINEON_AURIX2G, set at pre-compile, default-value=false  # Adds / removes the services related to incremental interface mode from the code. true: Incremental Interface mode API can be used. false: Incremental Interface mode API can not be used.
      boolean IcuTimeoutDetectionApi: origin=INFINEON_AURIX2G, set at pre-compile, default-value=false  # Adds / removes the service to set the timeout value for a GTM TIM channel. true: Icu_17_TimerIp_SetTimeoutValue API can be used. false: Icu_17_TimerIp_SetTimeoutValue API can not be used.
    container CommonPublishedInformation  # Common container, aggregated by all modules. It contains published information about vendor and versions.
      integer ArMajorVersion: 0..255, origin=INFINEON_AURIX2G, set at published-information, default-value=4  # Major version number of AUTOSAR specification on which the appropriate implementation is based on.
      integer ArMinorVersion: 0..255, origin=INFINEON_AURIX2G, set at published-information, default-value=4  # Minor version number of AUTOSAR specification on which the appropriate implementation is based on.
      integer ArPatchVersion: 0..255, origin=INFINEON_AURIX2G, set at published-information, default-value=0  # Patch level version number of AUTOSAR specification on which the appropriate implementation is based on.
      integer SwMajorVersion: 0..255, origin=INFINEON_AURIX2G, set at published-information, default-value=20  # Major version number of the vendor specific implementation of the module. The numbering is vendor specific.
      integer SwMinorVersion: 0..255, origin=INFINEON_AURIX2G, set at published-information, default-value=30  # Minor version number of the vendor specific implementation of the module. The numbering is vendor specific.
      integer SwPatchVersion: 0..255, origin=INFINEON_AURIX2G, set at published-information, default-value=0  # Patch level version number of the vendor specific implementation of the module. The numbering is vendor specific.
      integer ModuleId: 0..65535, origin=INFINEON_AURIX2G, set at published-information, default-value=122  # Module ID of this module from Module List
      integer VendorId: 0..65535, origin=INFINEON_AURIX2G, set at published-information, default-value=17  # Vendor ID of the dedicated implementation of this module according to the AUTOSAR vendor list
      string VendorApiInfix: origin=INFINEON_AURIX2G, set at published-information, default-value=TimerIp  # In driver modules which can be instantiated several times on a single ECU, BSW00347 requires that the name of APIs is extended by the VendorId and a vendor specific name. This parameter is used to specify the vendor specific name. In total, the implementation specific name is generated as follows: <ModuleName>_>VendorId>_<VendorApiInfix><Api name from SWS>. E.g. assuming that the VendorId of the implementor is 123 and the implementer chose a VendorApiInfix of "v11r456" a api name Can_Write defined in the SWS will translate to Can_123_v11r456Write. This parameter is mandatory for all modules with upper multiplicity > 1. It shall not be used for modules with upper multiplicity =1.
      string Release: origin=INFINEON_AURIX2G, set at published-information, default-value=_TRICORE_TC397_ADAS  # Aurix derivative used for the implementation
