AUTOSAR XML (schema 00046)
package /AURIX2G/EcucDefs
  module definition Crc [0..1]: refined-module-def=Crc, variants pre-compile  # Configuration of the Crc (Crc routines) module.
    container CrcGeneral  # General configuration of CRC module
      enumeration Crc16ARCMode [0..1]: {CRC_16_ARC_HARDWARE, CRC_16_ARC_RUNTIME, CRC_16_ARC_TABLE}, multiplicity set at pre-compile, set at pre-compile, default-value=CRC_16_ARC_HARDWARE  # Switch to select one of the available 16 bits CRC16ARC polynomial methods
      enumeration Crc16Mode [0..1]: {CRC_16_HARDWARE, CRC_16_RUNTIME, CRC_16_TABLE}, multiplicity set at pre-compile, set at pre-compile, default-value=CRC_16_HARDWARE  # Switch to select one of the available CRC 16-bit (CCITT) calculation methods
      enumeration Crc32Mode [0..1]: {CRC_32_HARDWARE, CRC_32_RUNTIME, CRC_32_TABLE}, multiplicity set at pre-compile, set at pre-compile, default-value=CRC_32_HARDWARE  # Switch to select one of the available CRC 32-bit (IEEE-802.3 CRC32 Ethernet Standard) calculation methods
      enumeration Crc32P4Mode [0..1]: {CRC_32P4_RUNTIME, CRC_32P4_TABLE}, multiplicity set at pre-compile, set at pre-compile, default-value=CRC_32P4_TABLE  # Switch to select one of the available CRC 32-bit E2E Profile 4 calculation methods.
      enumeration Crc64Mode [0..1]: {CRC_64_RUNTIME, CRC_64_TABLE}, multiplicity set at pre-compile, set at pre-compile, default-value=CRC_64_TABLE  # Switch to select one of the available CRC 64-bit calculation methods.
      enumeration Crc8H2FMode [0..1]: {CRC_8H2F_HARDWARE, CRC_8H2F_RUNTIME, CRC_8H2F_TABLE}, multiplicity set at pre-compile, set at pre-compile, default-value=CRC_8H2F_HARDWARE  # Switch to select one of the available CRC 8-bit (2Fh polynomial) calculation methods
      enumeration Crc8Mode [0..1]: {CRC_8_HARDWARE, CRC_8_RUNTIME, CRC_8_TABLE}, multiplicity set at pre-compile, set at pre-compile, default-value=CRC_8_HARDWARE  # Switch to select one of the available CRC 8-bit (SAE J1850) calculation methods
      boolean CrcVersionInfoApi: origin=INFINEON_AURIX2G, set at pre-compile, default-value=false  # Pre-processor switch to enable / disable the API to read out the modules version information.
      boolean CrcSafetyEnable: origin=INFINEON_AURIX2G, set at pre-compile, default-value=true  # Pre-processor switch to enable / disable the Safety checks for all APIs
      boolean CrcDma8bitApi: origin=INFINEON_AURIX2G, set at pre-compile, default-value=false  # Switch to enable/disable 8-bit SAE J1850 polynomial for CRC calculation while using the DMA based API.
      boolean CrcDma16bitApi: origin=INFINEON_AURIX2G, set at pre-compile, default-value=false  # Switch to enable/disable 16-bit CCITT-FALSE CRC16 polynomial for CRC calculation while using the DMA based API.
      boolean CrcDma32bitApi: origin=INFINEON_AURIX2G, set at pre-compile, default-value=false  # Switch to enable/disable 32-bit IEEE-802.3 polynomial for CRC calculation while using the DMA based API.
      boolean CrcDma32P4bitApi: origin=INFINEON_AURIX2G, set at pre-compile, default-value=false  # Switch to enable/disable 32-bit (0xF4ACFB13) polynomail for CRC calculation while using the DMA based API.
      enumeration CrcRuntimeApiMode: {CRC_MCAL_SUPERVISOR, CRC_MCAL_USER1}, origin=INFINEON_AURIX2G, set at pre-compile, default-value=CRC_MCAL_SUPERVISOR  # Switch to select one of the available CRC implementation mode
      integer Crc8ReturnErrorValue: 0..255, origin=INFINEON_AURIX2G, set at pre-compile, default-value=0  # Error value that will be returned in case of an invalid input parameter.
      integer Crc8H2FReturnErrorValue: 0..255, origin=INFINEON_AURIX2G, set at pre-compile, default-value=0  # Error value that will be returned in case of an invalid input parameter.
      integer Crc16ReturnErrorValue: 0..65535, origin=INFINEON_AURIX2G, set at pre-compile, default-value=0  # Error value that will be returned in case of an invalid input parameter.
      integer Crc16ARCReturnErrorValue: 0..65535, origin=INFINEON_AURIX2G, set at pre-compile, default-value=0  # Error value that will be returned in case of an invalid input parameter.
      integer Crc32ReturnErrorValue: 0..4294967295, origin=INFINEON_AURIX2G, set at pre-compile, default-value=0  # Error value that will be returned in case of an invalid input parameter.
      integer Crc32P4ReturnErrorValue: 0..4294967295, origin=INFINEON_AURIX2G, set at pre-compile, default-value=0  # Error value that will be returned in case of an invalid input parameter.
      integer Crc64ReturnErrorValue: 0..9223372036854775807, origin=INFINEON_AURIX2G, set at pre-compile, default-value=0  # Error value that will be returned in case of an invalid input parameter.
    container CrcChannelConfig [0..6]: multiplicity set at pre-compile  # CRC Configuration of FCE channels, callback functions and alloctaion of DMA channel
      integer CrcChannelId: 0..7, origin=INFINEON_AURIX2G, set at pre-compile, default-value=0  # CRC Allocation of FCE channels
      function name CrcResultNotification: origin=INFINEON_AURIX2G, set at pre-compile, default-value=NULL_PTR  # User defined result callback function This callback function will be called by the CRC driver on successful CRC calculation
      function name CrcErrorNotification: origin=INFINEON_AURIX2G, set at pre-compile, default-value=NULL_PTR  # User defined error callback functionr This is a callback functio will be called by the CRC driver if an error occured due to move engine
      reference CrcDmaChannel: scope=ECU, origin=INFINEON_AURIX2G, set at pre-compile, destination=DmaChannelConfig  # This parameter contains reference to DMA resource allocated to FCE
    container CrcPublishedInformation  # Additional published parameters not covered by CommonPublishedInformation container. Note that these parameters do not have any configuration class setting, since they are published information.
      integer CrcInitialValue16: 65535..65535, origin=INFINEON_AURIX2G, set at published-information, default-value=65535  # Initial value for the 16-bit CRC calculation.
      integer CrcInitialValue16ARC: 0..0, origin=INFINEON_AURIX2G, set at published-information, default-value=0  # Initial value for the 16-bit CRC16ARC calculation
      integer CrcInitialValue8: 255..255, origin=INFINEON_AURIX2G, set at published-information, default-value=255  # Initial value for the 8-bit CRC calculation.
      integer CrcInitialValue8H2F: 255..255, origin=INFINEON_AURIX2G, set at published-information, default-value=255  # Initial value for the 8-bit CRC8H2F calculation.
      integer CrcInitialValue32: 4294967295..4294967295, origin=INFINEON_AURIX2G, set at published-information, default-value=4294967295  # Initial value for the 32-bit CRC calculation.
      integer CrcInitialValue32P4: 4294967295..4294967295, origin=INFINEON_AURIX2G, set at published-information, default-value=4294967295  # Initial value for the 32-bit CRC32P4 calculation.
      integer CrcInitialValue64: 0..18446744073709551615, origin=INFINEON_AURIX2G, set at published-information, default-value=18446744073709551615  # Initial value for the 64-bit CRC64 calculation.
    container CommonPublishedInformation  # Common container, aggregated by all modules. It contains published information about vendor and versions.
      integer ArMajorVersion: 0..255, origin=INFINEON_AURIX2G, set at published-information, default-value=4  # Major version number of AUTOSAR specification on which the appropriate implementation is based on.
      integer ArMinorVersion: 0..255, origin=INFINEON_AURIX2G, set at published-information, default-value=4  # Minor version number of AUTOSAR specification on which the appropriate implementation is based on.
      integer ArPatchVersion: 0..255, origin=INFINEON_AURIX2G, set at published-information, default-value=0  # Patch level version number of AUTOSAR specification on which the appropriate implementation is based on.
      integer SwMajorVersion: 0..255, origin=INFINEON_AURIX2G, set at published-information, default-value=20  # Major version number of the vendor specific implementation of the module. The numbering is vendor specific.
      integer SwMinorVersion: 0..255, origin=INFINEON_AURIX2G, set at published-information, default-value=20  # Minor version number of the vendor specific implementation of the module. The numbering is vendor specific.
      integer SwPatchVersion: 0..255, origin=INFINEON_AURIX2G, set at published-information, default-value=0  # Patch level version number of the vendor specific implementation of the module. The numbering is vendor specific.
      integer ModuleId: 0..65535, origin=INFINEON_AURIX2G, set at published-information, default-value=201  # Module ID of this module from Module List
      integer VendorId: 0..65535, origin=INFINEON_AURIX2G, set at published-information, default-value=17  # Vendor ID of the dedicated implementation of this module according to the AUTOSAR vendor list
      string Release: origin=INFINEON_AURIX2G, set at published-information, default-value=_TRICORE_TC397_ADAS  # Aurix derivative used for the implementation
