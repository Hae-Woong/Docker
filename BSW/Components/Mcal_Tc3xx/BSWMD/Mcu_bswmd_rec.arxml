AUTOSAR XML (schema 00046)
package /AURIX2G/EcucDefs
  module config Mcu_Rec: definition=Mcu
  bsw implementation Mcu_Impl: programming-language=C, behavior=McuBehavior, recommended-configuration=Mcu_Rec, vendor-specific-module-def=Mcu
