[part 2 of 3: package /MICROSAR]
AUTOSAR XML (schema 4-0-3)
package /MICROSAR  (continued)
  module definition Dcm [0..1]: category=VENDOR_SPECIFIC_MODULE_DEFINITION, refined-module-def=Dcm, variants pre-compile/post-build-loadable/post-build-selectable  (continued)
    container DcmConfigSet  (continued)
      container DcmDsp  (continued)
        container DcmDspDataInfo [0..*]  # This container contains the configuration (parameters) of a Data
          boolean DcmDspDataFixedLength: set at pre-compile, default-value=false  # Specifies whether the data object has a constant (fixed) or variable length. Effect: ------------------------------------ If set to TRUE, the Dcm will use the data length parameter value of a data object directly from the configuration. If set to FALSE, the Dcm will gather the concrete length from the application. Constraints: ------------------------------------ none Dependencies: ------------------------------------ Affects the interpretation of the length parameter "/Dcm/DcmConfigSet/DcmDsp/DcmDspData/DcmDspDataSize". Runtime effects: ------------------------------------ none Code ROM usage effects: ------------------------------------ none Const data ROM usage effects: ------------------------------------ none Global RAM usage effects: ------------------------------------ none Stack RAM usage effects: ------------------------------------ none
          integer DcmDspDataScalingInfoSize [0..1]: 0..65535, set at pre-compile, default-value=0  # If scaling information service is available for this data object, it provides the size of the scaling information in bytes. Effect: ------------------------------------ The Dcm uses this value to put the correct amount of scaling information for service 0x24 (GetScalingInfoByIdentifier). Constraints: ------------------------------------ none Dependencies: ------------------------------------ Has effect only if: - the diagnostic service 0x24 (ReadScalingDataByIdentifier) is supported by Dcm (refer to /Dcm/DcmConfigSet/DcmDsd/DcmDsdServiceTable/DcmDsdService) - the DID to which the data object is mapped to support scaling info access (refer to /Dcm/DcmConfigSet/DcmDsp/DcmDspDidInfo/DcmDspDidAccess/DcmDspDidScaling) Runtime effects: ------------------------------------ none Code ROM usage effects: ------------------------------------ none Const data ROM usage effects: ------------------------------------ none Global RAM usage effects: ------------------------------------ none Stack RAM usage effects: ------------------------------------ none
        container DcmDspDid [0..*]  # This container contains the configuration (parameters) of the DID.
          integer DcmDspDidIdentifier: 0..65535, set at pre-compile  # Specifies the identifier value of a DID. Effect: ------------------------------------ The Dcm only recognizes DIDs with the value specified in this parameter. Constraints: ------------------------------------ The DID value must be unique within a DcmConfigset. Dependencies: ------------------------------------ none Runtime effects: ------------------------------------ none Code ROM usage effects: ------------------------------------ none Const data ROM usage effects: ------------------------------------ none Global RAM usage effects: ------------------------------------ none Stack RAM usage effects: ------------------------------------ none
          boolean DcmDspDidRoeQueueEnabled [0..0]: set at pre-compile, default-value=false  # NOT USED
          boolean DcmDspDidUsed: set at pre-compile in variant post-build-loadable+pre-compile / post-build in variant post-build-selectable, default-value=true  # Allows to activate or deactivate the usage of a DID for multi purpose ECUs. In a single configurations the parameter can be used to temporarily disable a complete DID in the Dcm configuration without the need to delete all its configuration parameters. Effect: ------------------------------------ If set to FALSE, the DID and all its signals will not be used in the Dcm generated code. Constraints: ------------------------------------ none Dependencies: ------------------------------------ none Runtime effects: ------------------------------------ none Code ROM usage effects: ------------------------------------ none Const data ROM usage effects: ------------------------------------ If set to FALSE, no data ROM for this DID will be used in the Dcm configuration sources. Global RAM usage effects: ------------------------------------ none Stack RAM usage effects: ------------------------------------ none
          enumeration DcmDspDidUsePort: {USE_DATA_ELEMENT_SPECIFIC_INTERFACES, USE_ATOMIC_SENDER_RECEIVER_INTERFACE_AS_SERVICE, USE_ATOMIC_NV_DATA_INTERFACE}, set at pre-compile, origin=Vector Informatik, default-value=USE_DATA_ELEMENT_SPECIFIC_INTERFACES  # Allows to combine the signals of this DID to a struct data type, and provides corresponding ports. Effect: ------------------------------------ If set to USE_ATOMIC_SENDER_RECEIVER_INTERFACE_AS_SERVICE (resp. USE_ATOMIC_NV_DATA_INTERFACE), Sender-Receiver-Ports (resp. NvData-Ports) are created for (a) the struct, in addition to a Data-Transformation-Set, (b) a uint8-byte-stream of size equal to the combined signal. If set to USE_DATA_ELEMENT_SPECIFIC_INTERFACES (default), a separate port is created for each signal of the DID. The type of the port is determined by the configuration of the signal DspData. Constraints: ------------------------------------ If set to USE_ATOMIC_NV_DATA_INTERFACE then DID does not support IO-Control-Operation. Dependencies: ------------------------------------ none Runtime effects: ------------------------------------ If value other than the USE_DATA_ELEMENT_SPECIFIC_INTERFACES selected, DCM will have only single data element DID access. This will reduce the runtime usage for DID access services (e.g. 0x22, 0x2A, 0x2E) when requested especially if no other multiple data element DIDs are configured. Code ROM usage effects: ------------------------------------ If value other than the USE_DATA_ELEMENT_SPECIFIC_INTERFACES selected, DCM will have only single data element DID access, which may reduce the code ROM usage if no other multiple data element DID still exists. Const data ROM usage effects: ------------------------------------ If value other than the USE_DATA_ELEMENT_SPECIFIC_INTERFACES selected, DCM will have only single data element DID access, which will slightly reduce the ROM data usage per DID. Global RAM usage effects: ------------------------------------ none Stack RAM usage effects: ------------------------------------ none
          reference DcmDspDidInfoRef: set at pre-compile, destination=DcmDspDidInfo  # Reference to DcmDspDidInfo containing information on this DID. Effect: ------------------------------------ Provides additional configuration information for the DID. Constraints: ------------------------------------ none Dependencies: ------------------------------------ See "destination ref". Runtime effects: ------------------------------------ none Code ROM usage effects: ------------------------------------ none Const data ROM usage effects: ------------------------------------ none Global RAM usage effects: ------------------------------------ none Stack RAM usage effects: ------------------------------------ none
          reference DcmDspDidRef [0..0]: set at pre-compile, destination=DcmDspDid  # NOT USED
          foreign reference DcmDspDidSystemTemplateDiagnosticDataIdentifierRef [0..1]: set at pre-compile in variant post-build-loadable+pre-compile / post-build in variant post-build-selectable, origin=Vector Informatik, destination-type=DIAGNOSTIC-DATA-IDENTIFIER  # Reference to the DiagnosticDataIdentifier which is represented by this DcmDspDid.
          container DcmDspDidSignal [0..*]  # This container defines the reference to 1 DcmDspData container and position relevant for this DID.
            integer DcmDspDidDataPos: 0..524280, set at pre-compile, default-value=0  # Specifies the position of the signal in the DID. Effect: ------------------------------------ Affects the call out/service call function calling order. Constraints: ------------------------------------ none Dependencies: ------------------------------------ none Runtime effects: ------------------------------------ none Code ROM usage effects: ------------------------------------ none Const data ROM usage effects: ------------------------------------ none Global RAM usage effects: ------------------------------------ none Stack RAM usage effects: ------------------------------------ none
            reference DcmDspDidDataRef: set at pre-compile, destination=DcmDspData  # Specifies the signal the DID contains at a certain position. Effect: ------------------------------------ The Dcm will invoke the corresponding signal call out/service call functions. Constraints: ------------------------------------ none Dependencies: ------------------------------------ See "destination ref". Runtime effects: ------------------------------------ none Code ROM usage effects: ------------------------------------ none Const data ROM usage effects: ------------------------------------ none Global RAM usage effects: ------------------------------------ none Stack RAM usage effects: ------------------------------------ none
        container DcmDspDidInfo [0..*]  # This container contains the configuration (parameters) of the DID's Info
          boolean DcmDspDidDynamicallyDefined [0..1]: set at pre-compile, default-value=false  # Specifies whether the DID shall be treated as a dynamically defined DID (DDID). Effect: ------------------------------------ If set to TRUE, the DID this setting belongs to will be treated as a DDID with the constraints described below. Constraints: ------------------------------------ A DID specified to be DDID by this parameter: - has no data signals specified at configuration time: "/Dcm/DcmConfigSet/DcmDsp/DcmDspDid/DcmDspDidSignal" shall not exist. - is only readable (no scaling, IO and write operations are allowed). Dependencies: ------------------------------------ The following parameters have to be considered too: -"/Dcm/DcmConfigSet/DcmDsp/DcmDspDidInfo/DcmDspDidAccess/DcmDspDidDefine/DcmDspDDDidMaxElements" -"/Dcm/DcmConfigSet/DcmDsp/DcmDspDDDidCheckPerSourceDid" -"/Dcm/DcmConfigSet/DcmDsp/DcmDspDDDidCheckConditionReadPerSourceDid" -"/Dcm/DcmConfigSet/DcmDsd/DcmDsdServiceTable/DcmDsdService" is defined for service 0x2C. -"/Dcm/DcmConfigSet/DcmDsd/DcmDsdServiceTable/DcmDsdService/DcmDsdSubService" is defined for sub-service 0x2C 0x01. Runtime effects: ------------------------------------ Due to the nature of a DDID (container of multiple other DID or memory sources) the processing of a DDID (reading, validating) increases the DCM main-function run-time. The worst case of this effect is while processing only synchronous source DIDs/memory ranges, since in this case the complete definition list of the DDID will be processed within the same DCM main-function activation. Code ROM usage effects: ------------------------------------ The DDID management requires a significant amount of ROM code. The actual usage does not depend on the amount of DDID in the ECU configuration, but depends on a complex relationship among multiple configuration parameters. Const data ROM usage effects: ------------------------------------ If no DDID are to be supported, the Dcm configuration ROM usage will be reduced significantly (depends on the total number of DIDs in the configuration). Global RAM usage effects: ------------------------------------ none Stack RAM usage effects: ------------------------------------ Since the processing of a DDID (reading, validating it) is performed within a running DCM main function service processor context, the stack usage will increase significantly. The actual stack usage depends mostly on the stack usage of the application DID and memory range read access implementations.
          container DcmDspDidAccess  # This container contains the configuration (parameters) of the DID access
            container DcmDspDidControl [0..1]  # Specifies whether the DID shall support IO control operation. Effect: ------------------------------------ If set to TRUE, Dcm will accept a IO control operation request on this DID. Otherwise, the Dcm will reject the request with a NRC 0x31 (RequestOutOfRange). Constraints: ------------------------------------ none Dependencies: ------------------------------------ Has effect only if the diagnostic service 0x2F (IOControlByDataIdentifier) is supported by Dcm (refer to /Dcm/DcmConfigSet/DcmDsd/DcmDsdServiceTable/DcmDsdService). Runtime effects: ------------------------------------ none Code ROM usage effects: ------------------------------------ If no DID supports IO control operation the Dcm code ROM usage will decrease due to the removed functionality. Const data ROM usage effects: ------------------------------------ If set to TRUE, the Dcm configuration data ROM usage will increase due to the additional data to be hold for this operation. Global RAM usage effects: ------------------------------------ none Stack RAM usage effects: ------------------------------------ none
              boolean DcmDspDidFreezeCurrentState [0..1]: set at pre-compile  # Specifies whether the DID shall support IO control freeze current state operation. Effect: ------------------------------------ If set to TRUE, Dcm will accept a IO control freeze current state operation request on this DID. Otherwise, the Dcm will reject the request with a NRC 0x31 (RequestOutOfRange). Constraints: ------------------------------------ none Dependencies: ------------------------------------ Has effect only if the diagnostic service 0x2F (IOControlByDataIdentifier) is supported by Dcm (refer to /Dcm/DcmConfigSet/DcmDsd/DcmDsdServiceTable/DcmDsdService). Runtime effects: ------------------------------------ none Code ROM usage effects: ------------------------------------ If no DID supports IO control freeze current state operation the Dcm code ROM usage will decrease due to the removed functionality. Const data ROM usage effects: ------------------------------------ If set to TRUE, the Dcm configuration data ROM usage will increase due to the additional data to be hold for this operation. Global RAM usage effects: ------------------------------------ none Stack RAM usage effects: ------------------------------------ none
              boolean DcmDspDidResetToDefault [0..1]: set at pre-compile  # Specifies whether the DID shall support IO control reset to default state operation. Effect: ------------------------------------ If set to TRUE, Dcm will accept a IO control reset to default state operation request on this DID. Otherwise, the Dcm will reject the request with a NRC 0x31 (RequestOutOfRange). Constraints: ------------------------------------ none Dependencies: ------------------------------------ Has effect only if the diagnostic service 0x2F (IOControlByDataIdentifier) is supported by Dcm (refer to /Dcm/DcmConfigSet/DcmDsd/DcmDsdServiceTable/DcmDsdService). Runtime effects: ------------------------------------ none Code ROM usage effects: ------------------------------------ If no DID supports IO control reset to default state operation the Dcm code ROM usage will decrease due to the removed functionality. Const data ROM usage effects: ------------------------------------ If set to TRUE, the Dcm configuration data ROM usage will increase due to the additional data to be hold for this operation. Global RAM usage effects: ------------------------------------ none Stack RAM usage effects: ------------------------------------ none
              boolean DcmDspDidReturnControlToEcu [0..1]: set at pre-compile  # Specifies whether the DID shall support IO control return control to ECU operation. Effect: ------------------------------------ If set to TRUE, Dcm will accept a IO control return control to ECU operation request on this DID. Otherwise, the Dcm will reject the request with a NRC 0x31 (RequestOutOfRange). Constraints: ------------------------------------ none Dependencies: ------------------------------------ Has effect only if the diagnostic service 0x2F (IOControlByDataIdentifier) is supported by Dcm (refer to /Dcm/DcmConfigSet/DcmDsd/DcmDsdServiceTable/DcmDsdService). Runtime effects: ------------------------------------ none Code ROM usage effects: ------------------------------------ If no DID supports IO control return control to ECU operation the Dcm code ROM usage will decrease due to the removed functionality. Const data ROM usage effects: ------------------------------------ If set to TRUE, the Dcm configuration data ROM usage will increase due to the additional data to be hold for this operation. Global RAM usage effects: ------------------------------------ none Stack RAM usage effects: ------------------------------------ none
              boolean DcmDspDidShortTermAdjustment [0..1]: set at pre-compile  # Specifies whether the DID shall support IO control short term adjustment to ECU operation. Effect: ------------------------------------ If set to TRUE, Dcm will accept a IO control short term adjustment operation request on this DID. Otherwise, the Dcm will reject the request with a NRC 0x31 (RequestOutOfRange). Constraints: ------------------------------------ none Dependencies: ------------------------------------ Has effect only if the diagnostic service 0x2F (IOControlByDataIdentifier) is supported by Dcm (refer to /Dcm/DcmConfigSet/DcmDsd/DcmDsdServiceTable/DcmDsdService). Runtime effects: ------------------------------------ none Code ROM usage effects: ------------------------------------ If no DID supports IO control short term adjustment operation the Dcm code ROM usage will decrease due to the removed functionality. Const data ROM usage effects: ------------------------------------ If set to TRUE, the Dcm configuration data ROM usage will increase due to the additional data to be hold for this operation. Global RAM usage effects: ------------------------------------ none Stack RAM usage effects: ------------------------------------ none
              enumeration DcmDspDidControlMask: {DCM_CONTROLMASK_EXTERNAL, DCM_CONTROLMASK_INTERNAL, DCM_CONTROLMASK_NO}, set at pre-compile, origin=Vector Informatik, default-value=DCM_CONTROLMASK_INTERNAL  # Specifies the type of an IO DID control enable mask record handling. Effect: ------------------------------------ If set to "INTERNAL", DCM will automatically calculate the required CEMR size depending on the amount of IODID data elements. If a single data element is defined - no CEMR will be used. If set to "NO", DCM will not expect any CEMR for this IO DID in its request, and will reject any CEMR sent along with this IO DID. If set to "EXTERNAL", DCM will forward the requested CEMR to the application function associated with only data element allowed to be configured. Constraints: ------------------------------------ If set to "EXTERNAL", the IO DID must have only single data element that covers all IO signals to be controlled by service 0x2F. Dependencies: ------------------------------------ Has effect only if the diagnostic service 0x2F (IOControlByDataIdentifier) is supported by Dcm (refer to /Dcm/DcmConfigSet/DcmDsd/DcmDsdServiceTable/DcmDsdService). Runtime effects: ------------------------------------ IO DIDs using external CEMR does have only single signal and thus less run-time overhead in DCM, but in the application. Code ROM usage effects: ------------------------------------ If no IO controlled DID supports the IO CEM record, the Dcm code ROM usage will be reduced. Const data ROM usage effects: ------------------------------------ If no IO controlled DID supports the IO control enable mask record, the Dcm configuration ROM usage will be reduced significantly (depends on the total number of DIDs in the configuration). Global RAM usage effects: ------------------------------------ For external CEMRs with more than four bytes, additional global RAM buffer is allocated for a diagnostic session change in order to reset all states under control properly. Stack RAM usage effects: ------------------------------------ none
              integer DcmDspDidControlMaskSize [0..1]: 0..65535, set at pre-compile, origin=Vector Informatik, default-value=1  # Specifies the size of the IO DID control enable mask record in bytes. Effect: ------------------------------------ DCM automatically calculates the CEM (Control Enable Mask) if an IO DID refers to more than one DcmDspData object. In cases where a single DcmDspData covers multiple IO signals (i.e. bit-mapped signals), the CEM shall be overridden using this parameter. The Dcm will use the value of this parameter in order to validate the diagnostic request length properly. Constraints: ------------------------------------ This setting is required to be set only if an IO DID shall support the enable mask record in the diagnostic request. Otherwise DCM will not be able to evaluate the request length correctly. Dependencies: ------------------------------------ Has effect only if - the diagnostic service 0x2F (IOControlByDataIdentifier) is supported by Dcm (refer to /Dcm/DcmConfigSet/DcmDsd/DcmDsdServiceTable/DcmDsdService). - Parameter /Dcm/DcmConfigSet/DcmDsp/DcmDspDidInfo/DcmDspDidAccess/DcmDspDidControl/DcmDspDidControlMask is set to "EXTERNAL". Runtime effects: ------------------------------------ IO DIDs using external CEMR does have only single signal and thus less run-time overhead in DCM, but in the application. Code ROM usage effects: ------------------------------------ If no IO controlled DID supports the IO CEM record, the Dcm code ROM usage will be reduced. Const data ROM usage effects: ------------------------------------ If no IO controlled DID supports the IO control enable mask record, the Dcm configuration ROM usage will be reduced significantly (depends on the total number of DIDs in the configuration). Global RAM usage effects: ------------------------------------ For external CEMRs with more than four bytes, additional global RAM buffer is allocated for a diagnostic session change in order to reset all states under control properly. Stack RAM usage effects: ------------------------------------ none
              reference DcmDspDidControlModeRuleRef [0..1]: set at pre-compile, destination=DcmModeRule  # Defines DID specific IO Control access dependency on a specific ECU mode rule (i.e. ECU run-time condition). Effect: ------------------------------------ If any mode rule is referred here, the Dcm will automatically reject any request of this service received while the mode rule condition is not satisfied. Constraints: ------------------------------------ none Dependencies: ------------------------------------ See "destination ref". Runtime effects: ------------------------------------ If a mode rule is used, the Dcm task will have a slightly longer run time at reception of a request. The mode rule evaluation time depends on the complexity of the modeled mode rule condition. Code ROM usage effects: ------------------------------------ If at least one DID has mode rule dependency, the code usage will increase slightly. Const data ROM usage effects: ------------------------------------ Refer to DcmDspModeRule description. Global RAM usage effects: ------------------------------------ none Stack RAM usage effects: ------------------------------------ During the mode rule evaluation the stack usage will slightly increase. The more complex and deep rule condition expression nesting, the more stack will be needed.
              reference DcmDspDidControlSecurityLevelRef [0..*]: set at pre-compile in variant post-build-loadable+pre-compile / post-build in variant post-build-selectable, destination=DcmDspSecurityRow  # Defines DID IO Control execution dependency to a specific security level. Effect: ------------------------------------ If any security access level is referred here, the Dcm will automatically reject any request of this service received while the security level is not unlocked. Constraints: ------------------------------------ none Dependencies: ------------------------------------ See "destination ref". Runtime effects: ------------------------------------ If at least one DID has security access level dependency, the Dcm task will have a slightly longer run time at reception of a request. Code ROM usage effects: ------------------------------------ If at least one DID has security access level dependency, the code usage will increase slightly. Const data ROM usage effects: ------------------------------------ Refer to DcmDspSecurityRow description. Global RAM usage effects: ------------------------------------ none Stack RAM usage effects: ------------------------------------ none
              reference DcmDspDidControlSessionRef [0..*]: set at pre-compile in variant post-build-loadable+pre-compile / post-build in variant post-build-selectable, destination=DcmDspSessionRow  # Defines DID IO Control access dependency to a specific session level. Effect: ------------------------------------ If any session level is referred here, the Dcm will automatically reject any request of this service received while the session level is not active. Constraints: ------------------------------------ none Dependencies: ------------------------------------ See "destination ref". Runtime effects: ------------------------------------ none Code ROM usage effects: ------------------------------------ none Const data ROM usage effects: ------------------------------------ Refer to DcmDspSessionRow description. Global RAM usage effects: ------------------------------------ none Stack RAM usage effects: ------------------------------------ none
              reference DcmDspDidControlVehicleSystemGroupRef [0..*]: set at pre-compile, origin=Vector Informatik, destination=DcmDspVehicleSystemGroupRow  # Defines DID IO Control operation availability dependency to a specific VSG. Effect: ------------------------------------ If any VSG is referred here, the Dcm will automatically reject any request of this service received while the VSG is not active. If no VSG reference is defined, Dcm assumes that this service belongs to the base-VSG (i.e. always available). Constraints: ------------------------------------ none Dependencies: ------------------------------------ Reference to a "/Dcm/DcmConfigSet/DcmDsp/DcmDspVehicleSystemGroups/DcmDspVehicleSystemGroupRow" Runtime effects: ------------------------------------ none Code ROM usage effects: ------------------------------------ none Const data ROM usage effects: ------------------------------------ Refer to "/Dcm/DcmConfigSet/DcmDsp/DcmDspVehicleSystemGroups/DcmDspVehicleSystemGroupRow" description. Global RAM usage effects: ------------------------------------ none Stack RAM usage effects: ------------------------------------ none
              reference DcmDspDidControlRoleRef [0..32]: set at pre-compile, origin=Vector Informatik, destination=DcmDspAuthenticationRow  # Reference to DcmDspAuthenticationRow that defines a role in that DID IO Control access is granted. Effect: ------------------------------------ If a role is specified here, the Dcm will automatically reject any request of this service received while the role is not active. Constraints: ------------------------------------ The value has only an effect if '/Dcm/DcmConfigSet/DcmDsd/DcmDsdServiceTable/DcmDsdService' is defined for service 0x29. Dependencies: ------------------------------------ none Runtime effects: ------------------------------------ none Code ROM usage effects: ------------------------------------ none Const data ROM usage effects: ------------------------------------ none Global RAM usage effects: ------------------------------------ none Stack RAM usage effects: ------------------------------------ none
              reference DcmDspDidControlProtocolRef [0..*]: set at pre-compile in variant post-build-loadable+pre-compile / post-build in variant post-build-selectable, origin=Vector Informatik, destination=DcmDslProtocolRow  # Defines DID IO Control execution dependency to a specific protocol. This can be used to optimize/reduce the overall RAM usage (buffer sizes) for protocols not requiring this DID, by explicitly excluding it. Effect: ------------------------------------ If any protocol row is referred here, the Dcm will automatically reject any request of this service received while the protocol of the requesting tester is not the referred one. Constraints: ------------------------------------ This parameter cannot be used in a configuration supporting PBL. Dependencies: ------------------------------------ See "destination ref". Runtime effects: ------------------------------------ If at least one DID has a protocol row dependency, the Dcm task will have a slightly longer run time at reception of a request. Code ROM usage effects: ------------------------------------ If at least one DID has a protocol row dependency, the code usage will increase slightly. Const data ROM usage effects: ------------------------------------ none Global RAM usage effects: ------------------------------------ If protocol specific buffers are used: The global RAM buffer consumption can decrease significantly, if DIDs with large buffer consumption are not used in every protocol. Stack RAM usage effects: ------------------------------------ none
            container DcmDspDidRead [0..1]  # Specifies whether the DID shall support read operation. Effect: ------------------------------------ If set to TRUE, Dcm will accept a read operation request on this DID. Otherwise, the Dcm will reject the request with a NRC 0x31 (RequestOutOfRange). Constraints: ------------------------------------ none Dependencies: ------------------------------------ Has effect only if the diagnostic service 0x22 (ReadDataByIdentifier) is supported by Dcm (refer to /Dcm/DcmConfigSet/DcmDsd/DcmDsdServiceTable/DcmDsdService). Runtime effects: ------------------------------------ none Code ROM usage effects: ------------------------------------ If no DID supports read operation the Dcm code ROM usage will decrease due to the removed functionality. Const data ROM usage effects: ------------------------------------ If set to TRUE, the Dcm configuration data ROM usage will increase due to the additional data to be hold for this operation. Global RAM usage effects: ------------------------------------ none Stack RAM usage effects: ------------------------------------ none
              reference DcmDspDidReadModeRuleRef [0..1]: set at pre-compile, destination=DcmModeRule  # Defines DID specific read access dependency on a specific ECU mode rule (i.e. ECU run-time condition). Effect: ------------------------------------ If any mode rule is referred here, the Dcm will automatically reject any request of this service received while the mode rule condition is not satisfied. Constraints: ------------------------------------ none Dependencies: ------------------------------------ See "destination ref". Runtime effects: ------------------------------------ If a mode rule is used, the Dcm task will have a slightly longer run time at reception of a request. The mode rule evaluation time depends on the complexity of the modeled mode rule condition. Code ROM usage effects: ------------------------------------ If at least one DID has mode rule dependency, the code usage will increase slightly. Const data ROM usage effects: ------------------------------------ Refer to DcmDspModeRule description. Global RAM usage effects: ------------------------------------ none Stack RAM usage effects: ------------------------------------ During the mode rule evaluation the stack usage will slightly increase. The more complex and deep rule condition expression nesting, the more stack will be needed.
              reference DcmDspDidReadSecurityLevelRef [0..*]: set at pre-compile in variant post-build-loadable+pre-compile / post-build in variant post-build-selectable, destination=DcmDspSecurityRow  # Defines DID read execution dependency to a specific security level. Effect: ------------------------------------ If any security access level is referred here, the Dcm will automatically reject any request of this service received while the security level is not unlocked. Constraints: ------------------------------------ none Dependencies: ------------------------------------ See "destination ref". Runtime effects: ------------------------------------ If at least one DID has security access level dependency, the Dcm task will have a slightly longer run time at reception of a request. Code ROM usage effects: ------------------------------------ If at least one DID has security access level dependency, the code usage will increase slightly. Const data ROM usage effects: ------------------------------------ Refer to DcmDspSecurityRow description. Global RAM usage effects: ------------------------------------ none Stack RAM usage effects: ------------------------------------ none
              reference DcmDspDidReadSessionRef [0..*]: set at pre-compile in variant post-build-loadable+pre-compile / post-build in variant post-build-selectable, destination=DcmDspSessionRow  # Defines DID read access dependency to a specific session level. Effect: ------------------------------------ If any session level is referred here, the Dcm will automatically reject any request of this service received while the session level is not active. Constraints: ------------------------------------ none Dependencies: ------------------------------------ See "destination ref". Runtime effects: ------------------------------------ none Code ROM usage effects: ------------------------------------ none Const data ROM usage effects: ------------------------------------ Refer to DcmDspSessionRow description. Global RAM usage effects: ------------------------------------ none Stack RAM usage effects: ------------------------------------ none
              reference DcmDspDidReadVehicleSystemGroupRef [0..*]: set at pre-compile, origin=Vector Informatik, destination=DcmDspVehicleSystemGroupRow  # Defines DID read operation availability dependency to a specific VSG. Effect: ------------------------------------ If any VSG is referred here, the Dcm will automatically reject any request of this service received while the VSG is not active. If no VSG reference is defined, Dcm assumes that this service belongs to the base-VSG (i.e. always available). Constraints: ------------------------------------ none Dependencies: ------------------------------------ Reference to a "/Dcm/DcmConfigSet/DcmDsp/DcmDspVehicleSystemGroups/DcmDspVehicleSystemGroupRow" Runtime effects: ------------------------------------ none Code ROM usage effects: ------------------------------------ none Const data ROM usage effects: ------------------------------------ Refer to "/Dcm/DcmConfigSet/DcmDsp/DcmDspVehicleSystemGroups/DcmDspVehicleSystemGroupRow" description. Global RAM usage effects: ------------------------------------ none Stack RAM usage effects: ------------------------------------ none
              reference DcmDspDidReadRoleRef [0..32]: set at pre-compile, origin=Vector Informatik, destination=DcmDspAuthenticationRow  # Reference to DcmDspAuthenticationRow that defines a role in that this DID can be read. Effect: ------------------------------------ If a role is specified here, the Dcm will automatically reject any request of this service received while the role is not active. Constraints: ------------------------------------ The value has only an effect if '/Dcm/DcmConfigSet/DcmDsd/DcmDsdServiceTable/DcmDsdService' is defined for service 0x29. Dependencies: ------------------------------------ none Runtime effects: ------------------------------------ none Code ROM usage effects: ------------------------------------ none Const data ROM usage effects: ------------------------------------ none Global RAM usage effects: ------------------------------------ none Stack RAM usage effects: ------------------------------------ none
              reference DcmDspDidReadProtocolRef [0..*]: set at pre-compile in variant post-build-loadable+pre-compile / post-build in variant post-build-selectable, origin=Vector Informatik, destination=DcmDslProtocolRow  # Defines DID read access dependency to a specific protocol. This can be used to optimize/reduce the overall RAM usage (buffer sizes) for protocols not requiring this DID, by explicitly excluding it. Effect: ------------------------------------ If any protocol row is referred here, the Dcm will automatically reject any request of this service received while protocol of the requesting tester is not the referred one. Constraints: ------------------------------------ This parameter cannot be used in a configuration supporting PBL. Dependencies: ------------------------------------ See "destination ref". Runtime effects: ------------------------------------ If at least one DID has a protocol row dependency, the Dcm task will have a slightly longer run time at reception of a request. Code ROM usage effects: ------------------------------------ If at least one DID has a protocol row dependency, the code usage will increase slightly. Const data ROM usage effects: ------------------------------------ none Global RAM usage effects: ------------------------------------ If protocol specific buffers are used: The global RAM buffer consumption can decrease significantly, if DIDs with large buffer consumption are not used in every protocol. Stack RAM usage effects: ------------------------------------ none
            container DcmDspDidWrite [0..1]  # Specifies whether the DID shall support write operation. Effect: ------------------------------------ If set to TRUE, Dcm will accept a write operation request on this DID. Otherwise, the Dcm will reject the request with a NRC 0x31 (RequestOutOfRange). Constraints: ------------------------------------ none Dependencies: ------------------------------------ Has effect only if the diagnostic service 0x2E (WriteDataByIdentifier) is supported by Dcm (refer to /Dcm/DcmConfigSet/DcmDsd/DcmDsdServiceTable/DcmDsdService). Runtime effects: ------------------------------------ none Code ROM usage effects: ------------------------------------ If no DID supports write operation the Dcm code ROM usage will decrease due to the removed functionality. Const data ROM usage effects: ------------------------------------ If set to TRUE, the Dcm configuration data ROM usage will increase due to the additional data to be hold for this operation. Global RAM usage effects: ------------------------------------ none Stack RAM usage effects: ------------------------------------ none
              reference DcmDspDidWriteModeRuleRef [0..1]: set at pre-compile, destination=DcmModeRule  # Defines DID specific write access dependency on a specific ECU mode rule (i.e. ECU run-time condition). Effect: ------------------------------------ If any mode rule is referred here, the Dcm will automatically reject any request of this service received while the mode rule condition is not satisfied. Constraints: ------------------------------------ none Dependencies: ------------------------------------ See "destination ref". Runtime effects: ------------------------------------ If a mode rule is used, the Dcm task will have a slightly longer run time at reception of a request. The mode rule evaluation time depends on the complexity of the modeled mode rule condition. Code ROM usage effects: ------------------------------------ If at least one DID has mode rule dependency, the code usage will increase slightly. Const data ROM usage effects: ------------------------------------ Refer to DcmDspModeRule description. Global RAM usage effects: ------------------------------------ none Stack RAM usage effects: ------------------------------------ During the mode rule evaluation the stack usage will slightly increase. The more complex and deep rule condition expression nesting, the more stack will be needed.
              reference DcmDspDidWriteSecurityLevelRef [0..*]: set at pre-compile in variant post-build-loadable+pre-compile / post-build in variant post-build-selectable, destination=DcmDspSecurityRow  # Defines DID write execution dependency to a specific security level. Effect: ------------------------------------ If any security access level is referred here, the Dcm will automatically reject any request of this service received while the security level is not unlocked. Constraints: ------------------------------------ none Dependencies: ------------------------------------ See "destination ref". Runtime effects: ------------------------------------ If at least one DID has security access level dependency, the Dcm task will have a slightly longer run time at reception of a request. Code ROM usage effects: ------------------------------------ If at least one DID has security access level dependency, the code usage will increase slightly. Const data ROM usage effects: ------------------------------------ Refer to DcmDspSecurityRow description. Global RAM usage effects: ------------------------------------ none Stack RAM usage effects: ------------------------------------ none
              reference DcmDspDidWriteSessionRef [0..*]: set at pre-compile in variant post-build-loadable+pre-compile / post-build in variant post-build-selectable, destination=DcmDspSessionRow  # Defines DID write access dependency to a specific session level. Effect: ------------------------------------ If any session level is referred here, the Dcm will automatically reject any request of this service received while the session level is not active. Constraints: ------------------------------------ none Dependencies: ------------------------------------ See "destination ref". Runtime effects: ------------------------------------ none Code ROM usage effects: ------------------------------------ none Const data ROM usage effects: ------------------------------------ Refer to DcmDspSessionRow description. Global RAM usage effects: ------------------------------------ none Stack RAM usage effects: ------------------------------------ none
              reference DcmDspDidWriteVehicleSystemGroupRef [0..*]: set at pre-compile, origin=Vector Informatik, destination=DcmDspVehicleSystemGroupRow  # Defines DID write operation availability dependency to a specific VSG. Effect: ------------------------------------ If any VSG is referred here, the Dcm will automatically reject any request of this service received while the VSG is not active. If no VSG reference is defined, Dcm assumes that this service belongs to the base-VSG (i.e. always available). Constraints: ------------------------------------ none Dependencies: ------------------------------------ Reference to a "/Dcm/DcmConfigSet/DcmDsp/DcmDspVehicleSystemGroups/DcmDspVehicleSystemGroupRow" Runtime effects: ------------------------------------ none Code ROM usage effects: ------------------------------------ none Const data ROM usage effects: ------------------------------------ Refer to "/Dcm/DcmConfigSet/DcmDsp/DcmDspVehicleSystemGroups/DcmDspVehicleSystemGroupRow" description. Global RAM usage effects: ------------------------------------ none Stack RAM usage effects: ------------------------------------ none
              reference DcmDspDidWriteRoleRef [0..32]: set at pre-compile, origin=Vector Informatik, destination=DcmDspAuthenticationRow  # Reference to DcmDspAuthenticationRow that defines a role in that this DID can be written. Effect: ------------------------------------ If a role is specified here, the Dcm will automatically reject any request of this service received while the role is not active. Constraints: ------------------------------------ The value has only an effect if '/Dcm/DcmConfigSet/DcmDsd/DcmDsdServiceTable/DcmDsdService' is defined for service 0x29. Dependencies: ------------------------------------ none Runtime effects: ------------------------------------ none Code ROM usage effects: ------------------------------------ none Const data ROM usage effects: ------------------------------------ none Global RAM usage effects: ------------------------------------ none Stack RAM usage effects: ------------------------------------ none
              reference DcmDspDidWriteProtocolRef [0..*]: set at pre-compile in variant post-build-loadable+pre-compile / post-build in variant post-build-selectable, origin=Vector Informatik, destination=DcmDslProtocolRow  # Defines DID write access dependency to a specific protocol. This can be used to optimize/reduce the overall RAM usage (buffer sizes) for protocols not requiring this DID, by explicitly excluding it. Effect: ------------------------------------ If any protocol row is referred here, the Dcm will automatically reject any request of this service received while protocol of the requesting tester is not the referred one. Constraints: ------------------------------------ This parameter cannot be used in a configuration supporting PBL. Dependencies: ------------------------------------ See "destination ref". Runtime effects: ------------------------------------ If at least one DID has a protocol row dependency, the Dcm task will have a slightly longer run time at reception of a request. Code ROM usage effects: ------------------------------------ If at least one DID has a protocol row dependency, the code usage will increase slightly. Const data ROM usage effects: ------------------------------------ none Global RAM usage effects: ------------------------------------ If protocol specific buffers are used: The global RAM buffer consumption can decrease significantly, if DIDs with large buffer consumption are not used in every protocol. Stack RAM usage effects: ------------------------------------ none
            container DcmDspDidDefine [0..1]  # Specifies whether the DID shall support define operation.
              integer DcmDspDDDidMaxElements: 1..255, set at pre-compile, origin=Vector Informatik, default-value=1  # Dsp Dynamically Defined Did Max Number of Elements | Maximum number of source elements of a DDDID.
        container DcmDspDidRange [0..*]  # This container defines the DID Range.
          boolean DcmDspDidRangeHasGaps: set at pre-compile, default-value=false  # Parameter specifies whether there are gaps in the DID range or not. Effect: ------------------------------------ If set to TRUE, Dcm will call the IsDidAvailable operation for any requested DID from within this range in order to get additional information whether the concrete DID is supported or not. If set to FALSE, Dcm will accept any requested DID from within this range and call the corresponding operation (Read/Write) over the data. Constraints: ------------------------------------ none Dependencies: ------------------------------------ none Runtime effects: ------------------------------------ Slightly increased run time at request time due to the additional function call. Code ROM usage effects: ------------------------------------ Slightly increased code usage due to the additional function call. Const data ROM usage effects: ------------------------------------ Slightly increased ROM usage due to the additional function call. Global RAM usage effects: ------------------------------------ none Stack RAM usage effects: ------------------------------------ Might be slightly increased run time at request time due to the additional function call. It depends on its implementation stack usage.
          integer DcmDspDidRangeIdentifierLowerLimit: 0..65535, set at pre-compile  # Specifies the first DID of a range that will be accepted by DCM. Effect: ------------------------------------ DCM uses this value to determine the start of a valid DID range. Constraints: ------------------------------------ This value shall be lower or equal to the corresponding "/Dcm/DcmConfigSet/DcmDsp/DcmDspDidRange/DcmDspDidRangeIdentifierUpperLimit" Dependencies: ------------------------------------ "/Dcm/DcmConfigSet/DcmDsp/DcmDspDidRange/DcmDspDidRangeIdentifierUpperLimit" Runtime effects: ------------------------------------ none Code ROM usage effects: ------------------------------------ none Const data ROM usage effects: ------------------------------------ none Global RAM usage effects: ------------------------------------ none Stack RAM usage effects: ------------------------------------ none
          integer DcmDspDidRangeIdentifierUpperLimit: 0..65535, set at pre-compile  # Specifies the last DID of a range that will be accepted by DCM. Effect: ------------------------------------ DCM uses this value to determine the end of a valid DID range. Constraints: ------------------------------------ This value shall be higher or equal to the corresponding "/Dcm/DcmConfigSet/DcmDsp/DcmDspDidRange/DcmDspDidRangeIdentifierLowerLimit" Dependencies: ------------------------------------ "/Dcm/DcmConfigSet/DcmDsp/DcmDspDidRange/DcmDspDidRangeIdentifierLowerLimit" Runtime effects: ------------------------------------ none Code ROM usage effects: ------------------------------------ none Const data ROM usage effects: ------------------------------------ none Global RAM usage effects: ------------------------------------ none Stack RAM usage effects: ------------------------------------ none
          function name DcmDspDidRangeIsDidAvailableFnc [0..1]: set at pre-compile  # Function name to request from application if a specific DID is available within the range or not.
          integer DcmDspDidRangeMaxDataLength: 1..65535, set at pre-compile  # Specifies the maximum length over all DIDs of a range in bytes. Effect: ------------------------------------ For the write range operation this value will be validated at request reception for a valid length (top value only). The concrete request/response length shall be validated/returned by the implementation of the DIDrange port/callback. Constraints: ------------------------------------ none Dependencies: ------------------------------------ The size parameter is either the concrete or maximum data object size, depending on the DcmDspDataFixedLength parameter value (refer to /Dcm/DcmConfigSet/DcmDsp/DcmDspDataInfo/DcmDspDataFixedLength). Runtime effects: ------------------------------------ none Code ROM usage effects: ------------------------------------ none Const data ROM usage effects: ------------------------------------ none Global RAM usage effects: ------------------------------------ none Stack RAM usage effects: ------------------------------------ none
          function name DcmDspDidRangeReadDidFnc [0..1]: set at pre-compile  # Specifies the call out function name for reading the data of a DID from this range. Effect: ------------------------------------ If this parameter is not empty, the Dcm will call the specified function on DID range reading data diagnostic request. Constraints: ------------------------------------ none Dependencies: ------------------------------------ Has effect only if: - the diagnostic service 0x22 (ReadDataByIdentifier) is supported by Dcm (refer to /Dcm/DcmConfigSet/DcmDsd/DcmDsdServiceTable/DcmDsdService) - the DID to which the data object is mapped to, supports read access (refer to /Dcm/DcmConfigSet/DcmDsp/DcmDspDidInfo/DcmDspDidAccess/DcmDspDidRead) - the DcmDspDidRangeUsePort is set to FALSE (e.g. call out) (refer to /Dcm/DcmConfigSet/DcmDsp/DcmDspDidRange/DcmDspDidRangeUsePort) Runtime effects: ------------------------------------ none Code ROM usage effects: ------------------------------------ none Const data ROM usage effects: ------------------------------------ none Global RAM usage effects: ------------------------------------ none Stack RAM usage effects: ------------------------------------ none
          boolean DcmDspDidRangeUsePort: set at pre-compile, default-value=true  # Defines which kind of interface shall be used to access the data. Effect: ------------------------------------ If set to TRUE: the Dcm application has to provide an a RTE R-Port implementation If set to FALSE: the Dcm application has to implement a call out. Constraints: ------------------------------------ none Dependencies: ------------------------------------ none Runtime effects: ------------------------------------ none Code ROM usage effects: ------------------------------------ none Const data ROM usage effects: ------------------------------------ none Global RAM usage effects: ------------------------------------ none Stack RAM usage effects: ------------------------------------ none
          function name DcmDspDidRangeWriteDidFnc [0..1]: set at pre-compile  # Specifies the call out function name for writing the data of a DID from this range. Effect: ------------------------------------ If this parameter is not empty, the Dcm will call the specified function on DID range writing data diagnostic request. Constraints: ------------------------------------ none Dependencies: ------------------------------------ Has effect only if: - the diagnostic service 0x2E (WriteDataByIdentifier) is supported by Dcm (refer to /Dcm/DcmConfigSet/DcmDsd/DcmDsdServiceTable/DcmDsdService) - the DID to which the data object is mapped to, supports read access (refer to /Dcm/DcmConfigSet/DcmDsp/DcmDspDidInfo/DcmDspDidAccess/DcmDspDidWrite) - the DcmDspDidRangeUsePort is set to FALSE (e.g. call out) (refer to /Dcm/DcmConfigSet/DcmDsp/DcmDspDidRange/DcmDspDidRangeUsePort) Runtime effects: ------------------------------------ none Code ROM usage effects: ------------------------------------ none Const data ROM usage effects: ------------------------------------ none Global RAM usage effects: ------------------------------------ none Stack RAM usage effects: ------------------------------------ none
          reference DcmDspDidRangeInfoRef: set at pre-compile, destination=DcmDspDidInfo  # Reference to DcmDspDidInfo containing information on this DID Range. Effect: ------------------------------------ Provides additional configuration information for the DID. Constraints: ------------------------------------ Within the target DIDInfo the following constraints do apply: - Only Read/Write DcmDspDidAccess is allowed. - No other parameters shall be used. Their values will be ignored. Dependencies: ------------------------------------ See "destination ref". Runtime effects: ------------------------------------ none Code ROM usage effects: ------------------------------------ none Const data ROM usage effects: ------------------------------------ none Global RAM usage effects: ------------------------------------ none Stack RAM usage effects: ------------------------------------ none
        container DcmDspEcuReset [0..1]  # This container contains the configuration for DcmDspEcuReset service.
          container DcmDspEcuResetRow [1..*]  # This container contains the configuration for each DcmDspEcuReset subservice.
            integer DcmDspEcuResetId: 0..127, set at pre-compile, origin=Vector Informatik, default-value=0  # Specifies the value of the corresponding sub-service of service 0x11 (EcuReset). Effect: ------------------------------------ none Constraints: ------------------------------------ For each EcuReset sub-service, there can be a EcuResetRow. Dependencies: ------------------------------------ Refer to "Dcm/DcmConfigSet/DcmDsd/DcmDsdServiceTable/DcmDsdService/DcmDsdSubService/DcmDsdSubServiceId". Runtime effects: ------------------------------------ none Code ROM usage effects: ------------------------------------ none Const data ROM usage effects: ------------------------------------ none Global RAM usage effects: ------------------------------------ none Stack RAM usage effects: ------------------------------------ none
            enumeration DcmResponseToEcuReset: {AFTER_RESET, BEFORE_RESET}, set at pre-compile, origin=Vector Informatik, default-value=BEFORE_RESET  # This parameter defines whether the answer to EcuReset service should be sent before or after the reset. Effect: ------------------------------------ On receiving the corresponding EcuReset sub-service request, the Dcm will send the answer depending on the selection. Constraints: ------------------------------------ This parameter has only an effect, if the corresponding sub-service Id is 0x01, 0x02 or 0x03 and it is internally handled. Dependencies: ------------------------------------ none Runtime effects: ------------------------------------ none Code ROM usage effects: ------------------------------------ If all of the EcuReset sub-services specify for this parameter "BEFORE_RESET", the Dcm code ROM usage will be reduced. Const data ROM usage effects: ------------------------------------ none Global RAM usage effects: ------------------------------------ If all of the EcuReset sub-services specify for this parameter "BEFORE_RESET", the Dcm code RAM usage will be reduced. Stack RAM usage effects: ------------------------------------ none
        container DcmDspFaultMemory [0..1]  # This container contains the configuration for the DCM fault memory related information. This container exists only if the UDS Service ReadDTCInformation (0x19) is configured.
          container DcmDspFaultMemoryUserMemoryIdInfo [0..1]  # Specifies the a supported user memory id for services 0x19 0x17,0x18 and 0x19.
            integer DcmDspFaultMemoryUserMemoryId: 0..255, set at pre-compile, origin=Vector Informatik, default-value=0  # Specifies the a supported user memory id for services 0x19 0x17,0x18 and 0x19. Effect: ------------------------------------ If specified a user memory identifier, DCM will accept only these user memory IDs that are configured here and address the secondary fault memory. If no user memory identifier specified, DCM will accept any value in the request, and address with it the fault memory. Constraints: ------------------------------------ - Dependencies: ------------------------------------ Will be used only if one of the diagnostic services 0x19 0x17,0x18 and 0x19 is to be supported by DCM. Runtime effects: ------------------------------------ If any user memory id specified, the DCM will check any related request upon this value and this leads to an insignificantly increased run time usage. Code ROM usage effects: ------------------------------------ If any user memory id specified, the DCM will check any related request upon this value and this leads to an insignificantly increased code ROM usage. Const data ROM usage effects: ------------------------------------ none Global RAM usage effects: ------------------------------------ none Stack RAM usage effects: ------------------------------------ none
            reference DcmDspReadDTCInformationUserDefinedFaultMemoryRoleRef [0..32]: set at pre-compile, origin=Vector Informatik, destination=DcmDspAuthenticationRow  # Reference to DcmDspAuthenticationRow that defines a role in that this user defined memory can be accessed. Effect: ------------------------------------ If a role is specified here, the Dcm will automatically reject any request of this service received while the role is not active. Constraints: ------------------------------------ The value has only an effect if '/Dcm/DcmConfigSet/DcmDsd/DcmDsdServiceTable/DcmDsdService' is defined for service 0x29'. Dependencies: ------------------------------------ none Runtime effects: ------------------------------------ none Code ROM usage effects: ------------------------------------ none Const data ROM usage effects: ------------------------------------ none Global RAM usage effects: ------------------------------------ none Stack RAM usage effects: ------------------------------------ none
          container DcmDspFaultMemoryRecords [0..1]  # Specifies all supported fault memory environment data records (extended data and snapshot). All of the sub-containers here are derived from the detected DEM configuration located in this ECU project. Import: If no DEM configuration has been detected, the DCM will respond to all SID 0x19 related sub-functions with empty report lists. If no DEM related configuration has been detected or you need to add additional record ranges, you can change the sub-containers.
            container DcmDspFaultMemoryFFRecord [0..256]  # Specifies a supported fault memory snapshot record ID range.
              integer DcmDspFaultMemoryFFRecordNumberLower: 0..255, set at pre-compile, origin=Vector Informatik, default-value=1  # Specifies the first record ID of a range. Effect: ------------------------------------ DCM uses this value to determine the start of a valid record ID range. Constraints: ------------------------------------ - This value shall be lower or equal to the corresponding "/Dcm/DcmConfigSet/DcmDsp/DcmDspFaultMemory/DcmDspFaultMemoryRecords/DcmDspFaultMemoryFFRecord/DcmDspFaultMemoryFFRecordNumberUpper" - If a single value is required to be specified, this parameter will specify it. The "DcmDspFaultMemoryFFRecordNumberUpper" shall not be used. Dependencies: ------------------------------------ "/Dcm/DcmConfigSet/DcmDsp/DcmDspFaultMemory/DcmDspFaultMemoryRecords/DcmDspFaultMemoryFFRecord/DcmDspFaultMemoryFFRecordNumberUpper" Runtime effects: ------------------------------------ none Code ROM usage effects: ------------------------------------ none Const data ROM usage effects: ------------------------------------ none Global RAM usage effects: ------------------------------------ none
              integer DcmDspFaultMemoryFFRecordNumberUpper [0..1]: 1..255, set at pre-compile, origin=Vector Informatik, default-value=1  # Specifies the last record ID of a range. Effect: ------------------------------------ DCM uses this value to determine the end of a valid record ID range. Constraints: ------------------------------------ - This value shall be greater or equal to the corresponding "/Dcm/DcmConfigSet/DcmDsp/DcmDspFaultMemory/DcmDspFaultMemoryRecords/DcmDspFaultMemoryFFRecord/DcmDspFaultMemoryFFRecordNumberLower" - If a single value is required to be specified, this parameter can be removed. Then "DcmDspFaultMemoryFFRecordNumberLower" will determine the record ID. Dependencies: ------------------------------------ "/Dcm/DcmConfigSet/DcmDsp/DcmDspFaultMemory/DcmDspFaultMemoryRecords/DcmDspFaultMemoryFFRecord/DcmDspFaultMemoryFFRecordNumberLower" Runtime effects: ------------------------------------ The run time (number of DEM iterations) usage is proportional to the number of record IDs determined by the record ID range. Code ROM usage effects: ------------------------------------ none Const data ROM usage effects: ------------------------------------ The ROM usage is proportional to the number of record IDs determined by the record ID range. Global RAM usage effects: ------------------------------------ none Stack RAM usage effects: ------------------------------------ none
            container DcmDspFaultMemoryExtDataRecord [0..253]  # Specifies a supported fault memory extended data record ID range.
              integer DcmDspFaultMemoryExtDataRecordNumberLower: 0..253, set at pre-compile, origin=Vector Informatik, default-value=1  # Specifies the first record ID of a range. Effect: ------------------------------------ DCM uses this value to determine the start of a valid record ID range. Constraints: ------------------------------------ - This value shall be lower or equal to the corresponding "/Dcm/DcmConfigSet/DcmDsp/DcmDspFaultMemory/DcmDspFaultMemoryRecords/DcmDspFaultMemoryFFRecord/DcmDspFaultMemoryFFRecordNumberUpper" - If a single value is required to be specified, this parameter will specify it. The "DcmDspFaultMemoryFFRecordNumberUpper" shall not be used. Dependencies: ------------------------------------ "/Dcm/DcmConfigSet/DcmDsp/DcmDspFaultMemory/DcmDspFaultMemoryRecords/DcmDspFaultMemoryFFRecord/DcmDspFaultMemoryFFRecordNumberUpper" Runtime effects: ------------------------------------ none Code ROM usage effects: ------------------------------------ none Const data ROM usage effects: ------------------------------------ none Global RAM usage effects: ------------------------------------ none
              integer DcmDspFaultMemoryExtDataRecordNumberUpper [0..1]: 1..253, set at pre-compile, origin=Vector Informatik, default-value=1  # Specifies the last record ID of a range. Effect: ------------------------------------ DCM uses this value to determine the end of a valid record ID range. Constraints: ------------------------------------ - This value shall be greater or equal to the corresponding "/Dcm/DcmConfigSet/DcmDsp/DcmDspFaultMemory/DcmDspFaultMemoryRecords/DcmDspFaultMemoryFFRecord/DcmDspFaultMemoryFFRecordNumberLower" - If a single value is required to be specified, this parameter can be removed. Then "DcmDspFaultMemoryFFRecordNumberLower" will determine the record ID. Dependencies: ------------------------------------ "/Dcm/DcmConfigSet/DcmDsp/DcmDspFaultMemory/DcmDspFaultMemoryRecords/DcmDspFaultMemoryFFRecord/DcmDspFaultMemoryFFRecordNumberLower" Runtime effects: ------------------------------------ The run time (number of DEM iterations) usage is proportional to the number of record IDs determined by the record ID range. Code ROM usage effects: ------------------------------------ none Const data ROM usage effects: ------------------------------------ The ROM usage is proportional to the number of record IDs determined by the record ID range. Global RAM usage effects: ------------------------------------ none Stack RAM usage effects: ------------------------------------ none
        container DcmDspMemory [0..1]  # This container includes all ECU memory area access information Effect: ------------------------------------ For each memory area that shall be accessible via diagnostics there shall a range defined under this container. Constraints: ------------------------------------ none Dependencies: ------------------------------------ This container makes only sense if one of the direct memory access diagnostic services (0x23 or 0x3D) is configured under "Dcm/DcmConfigSet/DcmDsd/DcmDsdServiceTable/DcmDsdService". Runtime effects: ------------------------------------ none Code ROM usage effects: ------------------------------------ none Const data ROM usage effects: ------------------------------------ The Dcm configuration data ROM usage scales straight proportionally to the number of memory ranges defined. Global RAM usage effects: ------------------------------------ none Stack RAM usage effects: ------------------------------------ none
          boolean DcmDspUseMemoryId: set at pre-compile, default-value=false  # Specifies whether the requested memory access service will contain a memory identifier byte or not. Effect: ------------------------------------ If set to TRUE, DCM will treat the first byte of the requested memory address as a memory identifier (MID). If set to FALSE, the whole byte stream specified by the address and length format identifier (ALFID) byte will be treated as a physical memory address. Constraints: ------------------------------------ This setting affects the global view of DCM to the ECU's memory organization. Each diagnostic service that uses memory addresses will be affected by this setting. Dependencies: ------------------------------------ If "/Dcm/DcmConfigSet/DcmDsd/DcmDsdServiceTable/DcmDsdService" is defined for service 0x23 or 0x3D. If enabled, the "/Dcm/DcmConfigSet/DcmDsp/DcmDspMemory/DcmDspMemoryIdInfo/DcmDspMemoryIdValue" must be defined. Runtime effects: ------------------------------------ No significant run time effects. Code ROM usage effects: ------------------------------------ Due to the additional MID management, the code ROM usage will slightly increase. Const data ROM usage effects: ------------------------------------ If enable, the data ROM usage will be slightly increased, but will not scale with the number of memory ranges in the ECU. Global RAM usage effects: ------------------------------------ none Stack RAM usage effects: ------------------------------------ none
          integer DcmDspMemoryMaxGapSizeBetweenTwoBlocks [0..1]: 0..65535, set at pre-compile, origin=Vector Informatik, default-value=0  # Specifies the maximum gap size in bytes between two memory blocks that shall be ignored during memory block layout optimization Effect: ------------------------------------ During the DCM code generation, all memory ranges (blocks) will be optimized for faster lookup and low ROM data usage. In this process consecutive ranges (gap size between then is zero) with the same properties will be merged to a single memory range. The gap size specified by this parameter allows to concatenate memory ranges with some gap bytes in between, which are irrelevant and were caused by the CPU data alignment. Constraints: ------------------------------------ This parameter affects only "Dcm/DcmConfigSet/DcmDsp/DcmDspMemory/DcmDspMemoryIdInfo" containers, which use address values and not labels. Dependencies: ------------------------------------ If "/Dcm/DcmConfigSet/DcmDsd/DcmDsdServiceTable/DcmDsdService" is defined for service 0x23 or 0x3D. Runtime effects: ------------------------------------ The bigger the gap the better the chance to merge more blocks together into a single memory block. This reduces run time usage of the memory block lookup engine in DCM's code. Code ROM usage effects: ------------------------------------ none Const data ROM usage effects: ------------------------------------ The bigger the gap size the better the chance to have less memory blocks to be described in the DCM configuration data tables. Global RAM usage effects: ------------------------------------ none Stack RAM usage effects: ------------------------------------ none
          container DcmDspMemoryIdInfo [1..*]  # Provides a memory identifier (MID) specific memory map. Effect: ------------------------------------ For each MID there shall be specified a list of memory ranges for reading and/or writing. Constraints: ------------------------------------ none Dependencies: ------------------------------------ If "/Dcm/DcmConfigSet/DcmDsd/DcmDsdServiceTable/DcmDsdService" is defined for service 0x23 or 0x3D. Runtime effects: ------------------------------------ The more memory range are specified, the longer the run time needed to validate the diagnostic memory access request. Code ROM usage effects: ------------------------------------ none Const data ROM usage effects: ------------------------------------ The more ranges you specify the more data ROM could be required to store them in the DCM configuration. The DCM generator tries to optimize all configured memory ranges into as less as possible memory areas within the DCM's internal configuration memory layout map. Global RAM usage effects: ------------------------------------ none Stack RAM usage effects: ------------------------------------ none
            integer DcmDspMemoryIdValue [0..1]: 0..255, set at pre-compile, default-value=0  # Value of the memory device identifier used. This parameter is only relevant if the memory Id parameter use is enabled. (DcmDspUseMemoryId = TRUE)
            container DcmDspReadMemoryRangeInfo [0..*]  # Provides the range of memory address allowed for reading.
              integer DcmDspReadMemoryRangeHigh: 0..4294967294, set at pre-compile  # Specifies the last memory address of a range allowed for reading. Effect: ------------------------------------ DCM uses this value to determine the end of a valid memory range. Constraints: ------------------------------------ This value shall be greater or equal to the corresponding "/Dcm/DcmConfigSet/DcmDsp/DcmDspMemory/DcmDspMemoryIdInfo/DcmDspReadMemoryRangeInfo/DcmDspReadMemoryRangeLow" Dependencies: ------------------------------------ "/Dcm/DcmConfigSet/DcmDsp/DcmDspMemory/DcmDspMemoryIdInfo/DcmDspReadMemoryRangeInfo/DcmDspReadMemoryRangeLow" Runtime effects: ------------------------------------ none Code ROM usage effects: ------------------------------------ none Const data ROM usage effects: ------------------------------------ none Global RAM usage effects: ------------------------------------ none Stack RAM usage effects: ------------------------------------ none
              integer DcmDspReadMemoryRangeLow: 0..4294967294, set at pre-compile  # Specifies the first memory address of a range allowed for reading. Effect: ------------------------------------ DCM uses this value to determine the beginning of a valid memory range. Constraints: ------------------------------------ This value shall be lower or equal to the corresponding "/Dcm/DcmConfigSet/DcmDsp/DcmDspMemory/DcmDspMemoryIdInfo/DcmDspReadMemoryRangeInfo/DcmDspReadMemoryRangeHigh" Dependencies: ------------------------------------ "/Dcm/DcmConfigSet/DcmDsp/DcmDspMemory/DcmDspMemoryIdInfo/DcmDspReadMemoryRangeInfo/DcmDspReadMemoryRangeHigh" Runtime effects: ------------------------------------ none Code ROM usage effects: ------------------------------------ none Const data ROM usage effects: ------------------------------------ none Global RAM usage effects: ------------------------------------ none Stack RAM usage effects: ------------------------------------ none
              reference DcmDspReadMemoryRangeModeRuleRef [0..1]: set at pre-compile, destination=DcmModeRule  # Defines the read memory access dependency on a specific ECU mode rule (i.e. ECU run-time condition). Effect: ------------------------------------ If any mode rule is referred here, the Dcm will automatically reject any request of this service received while the mode rule condition is not satisfied. Constraints: ------------------------------------ none Dependencies: ------------------------------------ See "destination ref". Runtime effects: ------------------------------------ If a mode rule is used, the Dcm task will have a slightly longer run time at reception of a request. The mode rule evaluation time depends on the complexity of the modeled mode rule condition. Code ROM usage effects: ------------------------------------ If at least one service has mode rule dependency, the code usage will increase slightly. Const data ROM usage effects: ------------------------------------ Refer to DcmDspModeRule description. Global RAM usage effects: ------------------------------------ none Stack RAM usage effects: ------------------------------------ During the mode rule evaluation the stack usage will slightly increase. The more complex and deep rule condition expression nesting, the more stack will be needed.
              reference DcmDspReadMemoryRangeSecurityLevelRef [0..*]: set at pre-compile in variant post-build-loadable+pre-compile / post-build in variant post-build-selectable, destination=DcmDspSecurityRow  # Defines read memory access dependency to a specific security level. Effect: ------------------------------------ If any security access level is referred here, the Dcm will automatically reject any request of this service received while the security level is not unlocked. Constraints: ------------------------------------ none Dependencies: ------------------------------------ See "destination ref". Runtime effects: ------------------------------------ If at least one sub-service has security access level dependency, the Dcm task will have a slightly longer run time at reception of a request. Code ROM usage effects: ------------------------------------ If at least one sub-service has security access level dependency, the code usage will increase slightly. Const data ROM usage effects: ------------------------------------ Refer to DcmDspSecurityRow description. Global RAM usage effects: ------------------------------------ none Stack RAM usage effects: ------------------------------------ none
              reference DcmDspReadMemoryRangeVehicleSystemGroupRef [0..*]: set at pre-compile, origin=Vector Informatik, destination=DcmDspVehicleSystemGroupRow  # Defines read memory access availability dependency to a specific VSG. Effect: ------------------------------------ If any VSG is referred here, the Dcm will automatically reject any request of this service received while the VSG is not active. If no VSG reference is defined, Dcm assumes that this service belongs to the base-VSG (i.e. always available). Constraints: ------------------------------------ none Dependencies: ------------------------------------ Reference to a "/Dcm/DcmConfigSet/DcmDsp/DcmDspVehicleSystemGroups/DcmDspVehicleSystemGroupRow" Runtime effects: ------------------------------------ none Code ROM usage effects: ------------------------------------ none Const data ROM usage effects: ------------------------------------ Refer to "/Dcm/DcmConfigSet/DcmDsp/DcmDspVehicleSystemGroups/DcmDspVehicleSystemGroupRow" description. Global RAM usage effects: ------------------------------------ none Stack RAM usage effects: ------------------------------------ none
            container DcmDspWriteMemoryRangeInfo [0..*]  # Provides the range of memory address allowed for writing.
              integer DcmDspWriteMemoryRangeHigh: 0..4294967294, set at pre-compile  # Specifies the last memory address of a range allowed for writing. Effect: ------------------------------------ DCM uses this value to determine the end of a valid memory range. Constraints: ------------------------------------ This value shall be greater or equal to the corresponding "/Dcm/DcmConfigSet/DcmDsp/DcmDspMemory/DcmDspMemoryIdInfo/DcmDspWriteMemoryRangeInfo/DcmDspWriteMemoryRangeLow" Dependencies: ------------------------------------ "/Dcm/DcmConfigSet/DcmDsp/DcmDspMemory/DcmDspMemoryIdInfo/DcmDspWriteMemoryRangeInfo/DcmDspWriteMemoryRangeLow" Runtime effects: ------------------------------------ none Code ROM usage effects: ------------------------------------ none Const data ROM usage effects: ------------------------------------ none Global RAM usage effects: ------------------------------------ none Stack RAM usage effects: ------------------------------------ none
              integer DcmDspWriteMemoryRangeLow: 0..4294967294, set at pre-compile  # Specifies the first memory address of a range allowed for writing. Effect: ------------------------------------ DCM uses this value to determine the beginning of a valid memory range. Constraints: ------------------------------------ This value shall be lower or equal to the corresponding "/Dcm/DcmConfigSet/DcmDsp/DcmDspMemory/DcmDspMemoryIdInfo/DcmDspWriteMemoryRangeInfo/DcmDspWriteMemoryRangeHigh" Dependencies: ------------------------------------ "/Dcm/DcmConfigSet/DcmDsp/DcmDspMemory/DcmDspMemoryIdInfo/DcmDspWriteMemoryRangeInfo/DcmDspWriteMemoryRangeHigh" Runtime effects: ------------------------------------ none Code ROM usage effects: ------------------------------------ none Const data ROM usage effects: ------------------------------------ none Global RAM usage effects: ------------------------------------ none Stack RAM usage effects: ------------------------------------ none
              reference DcmDspWriteMemoryRangeModeRuleRef [0..1]: set at pre-compile, destination=DcmModeRule  # Defines the write memory access dependency on a specific ECU mode rule (i.e. ECU run-time condition). Effect: ------------------------------------ If any mode rule is referred here, the Dcm will automatically reject any request of this service received while the mode rule condition is not satisfied. Constraints: ------------------------------------ none Dependencies: ------------------------------------ See "destination ref". Runtime effects: ------------------------------------ If a mode rule is used, the Dcm task will have a slightly longer run time at reception of a request. The mode rule evaluation time depends on the complexity of the modeled mode rule condition. Code ROM usage effects: ------------------------------------ If at least one service has mode rule dependency, the code usage will increase slightly. Const data ROM usage effects: ------------------------------------ Refer to DcmDspModeRule description. Global RAM usage effects: ------------------------------------ none Stack RAM usage effects: ------------------------------------ During the mode rule evaluation the stack usage will slightly increase. The more complex and deep rule condition expression nesting, the more stack will be needed.
              reference DcmDspWriteMemoryRangeSecurityLevelRef [0..*]: set at pre-compile in variant post-build-loadable+pre-compile / post-build in variant post-build-selectable, destination=DcmDspSecurityRow  # Defines write memory access dependency to a specific security level. Effect: ------------------------------------ If any security access level is referred here, the Dcm will automatically reject any request of this service received while the security level is not unlocked. Constraints: ------------------------------------ none Dependencies: ------------------------------------ See "destination ref". Runtime effects: ------------------------------------ If at least one sub-service has security access level dependency, the Dcm task will have a slightly longer run time at reception of a request. Code ROM usage effects: ------------------------------------ If at least one sub-service has security access level dependency, the code usage will increase slightly. Const data ROM usage effects: ------------------------------------ Refer to DcmDspSecurityRow description. Global RAM usage effects: ------------------------------------ none Stack RAM usage effects: ------------------------------------ none
              reference DcmDspWriteMemoryRangeVehicleSystemGroupRef [0..*]: set at pre-compile, origin=Vector Informatik, destination=DcmDspVehicleSystemGroupRow  # Defines write memory access availability dependency to a specific VSG. Effect: ------------------------------------ If any VSG is referred here, the Dcm will automatically reject any request of this service received while the VSG is not active. If no VSG reference is defined, Dcm assumes that this service belongs to the base-VSG (i.e. always available). Constraints: ------------------------------------ none Dependencies: ------------------------------------ Reference to a "/Dcm/DcmConfigSet/DcmDsp/DcmDspVehicleSystemGroups/DcmDspVehicleSystemGroupRow" Runtime effects: ------------------------------------ none Code ROM usage effects: ------------------------------------ none Const data ROM usage effects: ------------------------------------ Refer to "/Dcm/DcmConfigSet/DcmDsp/DcmDspVehicleSystemGroups/DcmDspVehicleSystemGroupRow" description. Global RAM usage effects: ------------------------------------ none Stack RAM usage effects: ------------------------------------ none
            container DcmDspReadMemoryRangeByLabelInfo [0..*]  # Provides a memory range allowed for reading via labels (lower and higher address configured as strings).
              string DcmDspReadMemoryRangeByLabelHigh: set at pre-compile, origin=Vector Informatik  # Specifies the last memory address as label (string) of a range allowed for reading. Effect: ------------------------------------ DCM uses this value to determine the end of a valid memory range. Constraints: ------------------------------------ This value shall be greater or equal to the corresponding "/Dcm/DcmConfigSet/DcmDsp/DcmDspMemory/DcmDspMemoryIdInfo/DcmDspReadMemoryRangeByLabelInfo/DcmDspReadMemoryRangeByLabelLow" Dependencies: ------------------------------------ "/Dcm/DcmConfigSet/DcmDsp/DcmDspMemory/DcmDspMemoryIdInfo/DcmDspReadMemoryRangeByLabelInfo/DcmDspReadMemoryRangeByLabelLow" Runtime effects: ------------------------------------ none Code ROM usage effects: ------------------------------------ none Const data ROM usage effects: ------------------------------------ none Global RAM usage effects: ------------------------------------ none Stack RAM usage effects: ------------------------------------ none
              string DcmDspReadMemoryRangeByLabelLow: set at pre-compile, origin=Vector Informatik  # Specifies the first memory address as label (string) of a range allowed for reading. Effect: ------------------------------------ DCM uses this value to determine the beginning of a valid memory range. Constraints: ------------------------------------ This value shall be lower or equal to the corresponding "/Dcm/DcmConfigSet/DcmDsp/DcmDspMemory/DcmDspMemoryIdInfo/DcmDspReadMemoryRangeByLabelInfo/DcmDspReadMemoryRangeByLabelHigh" Dependencies: ------------------------------------ "/Dcm/DcmConfigSet/DcmDsp/DcmDspMemory/DcmDspMemoryIdInfo/DcmDspReadMemoryRangeByLabelInfo/DcmDspReadMemoryRangeByLabelHigh" Runtime effects: ------------------------------------ none Code ROM usage effects: ------------------------------------ none Const data ROM usage effects: ------------------------------------ none Global RAM usage effects: ------------------------------------ none Stack RAM usage effects: ------------------------------------ none
              reference DcmDspReadMemoryRangeModeRuleRef [0..1]: set at pre-compile, origin=Vector Informatik, destination=DcmModeRule  # Defines the read memory access dependency on a specific ECU mode rule (i.e. ECU run-time condition). Effect: ------------------------------------ If any mode rule is referred here, the Dcm will automatically reject any request of this service received while the mode rule condition is not satisfied. Constraints: ------------------------------------ none Dependencies: ------------------------------------ See "destination ref". Runtime effects: ------------------------------------ If a mode rule is used, the Dcm task will have a slightly longer run time at reception of a request. The mode rule evaluation time depends on the complexity of the modeled mode rule condition. Code ROM usage effects: ------------------------------------ If at least one service has mode rule dependency, the code usage will increase slightly. Const data ROM usage effects: ------------------------------------ Refer to DcmDspModeRule description. Global RAM usage effects: ------------------------------------ none Stack RAM usage effects: ------------------------------------ During the mode rule evaluation the stack usage will slightly increase. The more complex and deep rule condition expression nesting, the more stack will be needed.
              reference DcmDspReadMemoryRangeSecurityLevelRef [0..*]: set at pre-compile in variant post-build-loadable+pre-compile / post-build in variant post-build-selectable, origin=Vector Informatik, destination=DcmDspSecurityRow  # Defines read memory access dependency to a specific security level. Effect: ------------------------------------ If any security access level is referred here, the Dcm will automatically reject any request of this service received while the security level is not unlocked. Constraints: ------------------------------------ none Dependencies: ------------------------------------ See "destination ref". Runtime effects: ------------------------------------ If at least one sub-service has security access level dependency, the Dcm task will have a slightly longer run time at reception of a request. Code ROM usage effects: ------------------------------------ If at least one sub-service has security access level dependency, the code usage will increase slightly. Const data ROM usage effects: ------------------------------------ Refer to DcmDspSecurityRow description. Global RAM usage effects: ------------------------------------ none Stack RAM usage effects: ------------------------------------ none
              reference DcmDspReadMemoryRangeVehicleSystemGroupRef [0..*]: set at pre-compile, origin=Vector Informatik, destination=DcmDspVehicleSystemGroupRow  # Defines read memory access availability dependency to a specific VSG. Effect: ------------------------------------ If any VSG is referred here, the Dcm will automatically reject any request of this service received while the VSG is not active. If no VSG reference is defined, Dcm assumes that this service belongs to the base-VSG (i.e. always available). Constraints: ------------------------------------ none Dependencies: ------------------------------------ Reference to a "/Dcm/DcmConfigSet/DcmDsp/DcmDspVehicleSystemGroups/DcmDspVehicleSystemGroupRow" Runtime effects: ------------------------------------ none Code ROM usage effects: ------------------------------------ none Const data ROM usage effects: ------------------------------------ Refer to "/Dcm/DcmConfigSet/DcmDsp/DcmDspVehicleSystemGroups/DcmDspVehicleSystemGroupRow" description. Global RAM usage effects: ------------------------------------ none Stack RAM usage effects: ------------------------------------ none
            container DcmDspWriteMemoryRangeByLabelInfo [0..*]  # Provides a memory range allowed for writing via labels (lower and higher address configured as strings).
              string DcmDspWriteMemoryRangeByLabelHigh: set at pre-compile, origin=Vector Informatik  # Specifies the last memory address as label (string) of a range allowed for writing. Effect: ------------------------------------ DCM uses this value to determine the end of a valid memory range. Constraints: ------------------------------------ This value shall be greater or equal to the corresponding "/Dcm/DcmConfigSet/DcmDsp/DcmDspMemory/DcmDspMemoryIdInfo/DcmDspWriteMemoryRangeByLabelInfo/DcmDspWriteMemoryRangeByLabelLow" Dependencies: ------------------------------------ "/Dcm/DcmConfigSet/DcmDsp/DcmDspMemory/DcmDspMemoryIdInfo/DcmDspWriteMemoryRangeByLabelInfo/DcmDspWriteMemoryRangeByLabelLow" Runtime effects: ------------------------------------ none Code ROM usage effects: ------------------------------------ none Const data ROM usage effects: ------------------------------------ none Global RAM usage effects: ------------------------------------ none Stack RAM usage effects: ------------------------------------ none
              string DcmDspWriteMemoryRangeByLabelLow: set at pre-compile, origin=Vector Informatik  # Specifies the first memory address as label (string) of a range allowed for writing. Effect: ------------------------------------ DCM uses this value to determine the beginning of a valid memory range. Constraints: ------------------------------------ This value shall be lower or equal to the corresponding "/Dcm/DcmConfigSet/DcmDsp/DcmDspMemory/DcmDspMemoryIdInfo/DcmDspWriteMemoryRangeByLabelInfo/DcmDspWriteMemoryRangeByLabelHigh" Dependencies: ------------------------------------ "/Dcm/DcmConfigSet/DcmDsp/DcmDspMemory/DcmDspMemoryIdInfo/DcmDspWriteMemoryRangeByLabelInfo/DcmDspWriteMemoryRangeByLabelHigh" Runtime effects: ------------------------------------ none Code ROM usage effects: ------------------------------------ none Const data ROM usage effects: ------------------------------------ none Global RAM usage effects: ------------------------------------ none Stack RAM usage effects: ------------------------------------ none
              reference DcmDspWriteMemoryRangeModeRuleRef [0..1]: set at pre-compile, origin=Vector Informatik, destination=DcmModeRule  # Defines the write memory access dependency on a specific ECU mode rule (i.e. ECU run-time condition). Effect: ------------------------------------ If any mode rule is referred here, the Dcm will automatically reject any request of this service received while the mode rule condition is not satisfied. Constraints: ------------------------------------ none Dependencies: ------------------------------------ See "destination ref". Runtime effects: ------------------------------------ If a mode rule is used, the Dcm task will have a slightly longer run time at reception of a request. The mode rule evaluation time depends on the complexity of the modeled mode rule condition. Code ROM usage effects: ------------------------------------ If at least one service has mode rule dependency, the code usage will increase slightly. Const data ROM usage effects: ------------------------------------ Refer to DcmDspModeRule description. Global RAM usage effects: ------------------------------------ none Stack RAM usage effects: ------------------------------------ During the mode rule evaluation the stack usage will slightly increase. The more complex and deep rule condition expression nesting, the more stack will be needed.
              reference DcmDspWriteMemoryRangeSecurityLevelRef [0..*]: set at pre-compile in variant post-build-loadable+pre-compile / post-build in variant post-build-selectable, origin=Vector Informatik, destination=DcmDspSecurityRow  # Defines write memory access dependency to a specific security level. Effect: ------------------------------------ If any security access level is referred here, the Dcm will automatically reject any request of this service received while the security level is not unlocked. Constraints: ------------------------------------ none Dependencies: ------------------------------------ See "destination ref". Runtime effects: ------------------------------------ If at least one sub-service has security access level dependency, the Dcm task will have a slightly longer run time at reception of a request. Code ROM usage effects: ------------------------------------ If at least one sub-service has security access level dependency, the code usage will increase slightly. Const data ROM usage effects: ------------------------------------ Refer to DcmDspSecurityRow description. Global RAM usage effects: ------------------------------------ none Stack RAM usage effects: ------------------------------------ none
              reference DcmDspWriteMemoryRangeVehicleSystemGroupRef [0..*]: set at pre-compile, origin=Vector Informatik, destination=DcmDspVehicleSystemGroupRow  # Defines write memory access availability dependency to a specific VSG. Effect: ------------------------------------ If any VSG is referred here, the Dcm will automatically reject any request of this service received while the VSG is not active. If no VSG reference is defined, Dcm assumes that this service belongs to the base-VSG (i.e. always available). Constraints: ------------------------------------ none Dependencies: ------------------------------------ Reference to a "/Dcm/DcmConfigSet/DcmDsp/DcmDspVehicleSystemGroups/DcmDspVehicleSystemGroupRow" Runtime effects: ------------------------------------ none Code ROM usage effects: ------------------------------------ none Const data ROM usage effects: ------------------------------------ Refer to "/Dcm/DcmConfigSet/DcmDsp/DcmDspVehicleSystemGroups/DcmDspVehicleSystemGroupRow" description. Global RAM usage effects: ------------------------------------ none Stack RAM usage effects: ------------------------------------ none
          container DcmDspMemoryAddressAndLengthFormatIdentifier [0..1]  # Specifies whether only specific ALFID(s) shall only be supported by the ECU or any valid by UDS. Effect: ------------------------------------ If this container is missing, then DCM will accept any requested ALFID value in the range [0x11-0x45] (the valid byte nibble values are 1-4 for memory size and address in case of no memory ID usage and 2-5 for memory address in case memory ID shall be supported!). If the container persists, DCM will only accept the values specified by the parameters within this container. Constraints: ------------------------------------ none Dependencies: ------------------------------------ If "/Dcm/DcmConfigSet/DcmDsd/DcmDsdServiceTable/DcmDsdService" is defined for service 0x23 or 0x3D. You have to specify all valid ALFID values: "/Dcm/DcmConfigSet/DcmDsp/DcmDspMemory/DcmDspMemoryAddressAndLengthFormatIdentifier/DcmDspMemorySupportedAddressAndLengthFormatIdentifier" Runtime effects: ------------------------------------ If the container exists, the DCM will use a lookup engine to determine the validity of the requested ALFID which can increase the run time. If any UDS valid ALFID is to be supported, the DCM run time at validating a memory access service is constant. Code ROM usage effects: ------------------------------------ If the container exists, the DCM will use a lookup engine to determine the validity of the requested ALFID which can increase the code ROM usage insignificantly. Const data ROM usage effects: ------------------------------------ The data ROM usage scales with the amount of ALFIDs to be supported (1 byte per ALFID). Global RAM usage effects: ------------------------------------ none Stack RAM usage effects: ------------------------------------ A slightly increased stack usage may occur due to the fact that the ALFID look up engine runs within the diagnostic service processor context.
            integer DcmDspMemorySupportedAddressAndLengthFormatIdentifier [1..*]: 0..255, set at pre-compile, origin=Vector Informatik, default-value=36  # Specifies a concrete ALFID value to be only supported by the ECU. Effect: ------------------------------------ The DCM will accept only those ALFIDs of a memory access diagnostic request that are defined by this parameter. Constraints: ------------------------------------ none Dependencies: ------------------------------------ If "/Dcm/DcmConfigSet/DcmDsd/DcmDsdServiceTable/DcmDsdService" is defined for service 0x23 or 0x3D. Runtime effects: ------------------------------------ The more ALFIDs the longer the run time of the ALFID look up engine in DCM. Code ROM usage effects: ------------------------------------ none Const data ROM usage effects: ------------------------------------ The data ROM usage scales with the amount of ALFIDs to be supported (1 byte per ALFID). Global RAM usage effects: ------------------------------------ none Stack RAM usage effects: ------------------------------------ A slightly increased stack usage may occur due to the fact that the ALFID look up engine runs within the diagnostic service processor context.
        container DcmDspMemoryTransfer [0..1]  # This container contains the configuration of the memory transfer.
          boolean DcmDspMemoryTransferUsePort: set at pre-compile, origin=Vector Informatik, default-value=false  # Defines which kind of interface shall be used to transfer the data. Effect: ------------------------------------ If set to TRUE, a RTE call will be required to be implemented in the Dcm application. If set to FALSE - a call out will be required to be implemented in the Dcm application. Constraints: ------------------------------------ none Dependencies: ------------------------------------ none Runtime effects: ------------------------------------ none Code ROM usage effects: ------------------------------------ none Const data ROM usage effects: ------------------------------------ none Global RAM usage effects: ------------------------------------ none Stack RAM usage effects: ------------------------------------ none
          container DcmDspMemoryTransferIdInfo [1..*]  # Provides a list of memory identifier (MID). Effect: ------------------------------------ For each MID there shall be specified a list of memory ranges for reading and/or writing. Constraints: ------------------------------------ none Dependencies: ------------------------------------ If "/Dcm/DcmConfigSet/DcmDsd/DcmDsdServiceTable/DcmDsdService" is defined for service 0x34, 0x35, 0x36 or 0x37. Runtime effects: ------------------------------------ none Code ROM usage effects: ------------------------------------ none Const data ROM usage effects: ------------------------------------ The more ranges you specify the more data ROM could be required to store them in the DCM configuration. The DCM generator tries to optimize all configured memory ranges into as less as possible memory areas within the DCM's internal configuration memory layout map. Global RAM usage effects: ------------------------------------ none Stack RAM usage effects: ------------------------------------ noneferExit
            integer DcmDspMemoryIdValue [0..1]: 0..255, set at pre-compile, origin=Vector Informatik, default-value=0  # Value of the memory transfer device identifier used.
          container DcmDspAddressAndLengthFormatIdentifier [0..1]  # Specifies whether only specific ALFID(s) shall only be supported by the ECU or any valid by UDS. Effect: ------------------------------------ If this container is missing, then DCM will accept any requested ALFID value in the range [0x11-0x45] (the valid byte nibble values are 1-4 for memory size and address in case of no memory ID usage and 2-5 for memory address in case memory ID shall be supported!). If the container exists, DCM will only accept the values specified by the parameters within this container. Constraints: ------------------------------------ none Dependencies: ------------------------------------ If "/Dcm/DcmConfigSet/DcmDsd/DcmDsdServiceTable/DcmDsdService" is defined for service 0x34, 0x35, 0x36 or 0x37. Specify all valid ALFID values: "/Dcm/DcmConfigSet/DcmDsp/DcmDspMemoryTransfer/DcmDspAddressAndLengthFormatIdentifier/DcmDspAddressAndLengthFormatIdentifier" Runtime effects: ------------------------------------ If the container exists, the DCM will use a lookup engine to determine the validity of the requested ALFID which can increase the run time. If any UDS valid ALFID is to be supported, the DCM run time at validating a memory transfer service is constant. Code ROM usage effects: ------------------------------------ If the container exists, the DCM will use a lookup engine to determine the validity of the requested ALFID which can increase the code ROM usage insignificantly. Const data ROM usage effects: ------------------------------------ The data ROM usage scales with the amount of ALFIDs to be supported (1 byte per ALFID). Global RAM usage effects: ------------------------------------ none Stack RAM usage effects: ------------------------------------ A slightly increased stack usage may occur due to the fact that the ALFID look up engine runs within the diagnostic service processor context.
            integer DcmDspAddressAndLengthFormatIdentifier [1..*]: 0..255, set at pre-compile, origin=Vector Informatik, default-value=36  # Specifies a concrete ALFID value to be only supported by the ECU. Effect: ------------------------------------ The DCM will accept only those ALFIDs of a memory transfer diagnostic request that are defined by this parameter. Constraints: ------------------------------------ none Dependencies: ------------------------------------ If "/Dcm/DcmConfigSet/DcmDsd/DcmDsdServiceTable/DcmDsdService" is defined for service 0x34, 0x35, 0x36 or 0x37. Runtime effects: ------------------------------------ The more ALFIDs the longer the run time of the ALFID look up engine in DCM. Code ROM usage effects: ------------------------------------ none Const data ROM usage effects: ------------------------------------ The data ROM usage scales with the amount of ALFIDs to be supported (1 byte per ALFID). Global RAM usage effects: ------------------------------------ none Stack RAM usage effects: ------------------------------------ A slightly increased stack usage may occur due to the fact that the ALFID look up engine runs within the diagnostic service processor context.
        container DcmDspPeriodicDidTransmission [0..1]  # This container contains the configuration for the Periodic DID transmission. This container exists only if the UDS Service ReadDataByPeriodicIdentifier(0x2A) is configured.
          integer DcmDspMaxPeriodicDidScheduler: 1..255, set at pre-compile, origin=Vector Informatik, default-value=5  # Defines the maximum number of periodicDataIdentifiers that can be scheduled concurrently. Effect: ------------------------------------ Any diagnostic request for service 0x2A with DIDs that do not (no more) fit into the scheduler table will be rejected by a negative response. Constraints: ------------------------------------ Has any effect only if service 0x2A is supported. Dependencies: ------------------------------------ If "/Dcm/DcmConfigSet/DcmDsd/DcmDsdServiceTable/DcmDsdService" is defined for service 0x2A. Runtime effects: ------------------------------------ The larger number of DIDs in the scheduler, the longer the Dcm task execution time, since in the worst case (scheduler fully utilized and all DID timers are in timeout) all requested DIDs may be processed within the same Dcm task activation. Code ROM usage effects: ------------------------------------ If more than one DID is specified to be scheduled, the Dcm code usage will increase due to the iteration loops. Const data ROM usage effects: ------------------------------------ none Global RAM usage effects: ------------------------------------ The RAM usage can increase with increasing the value of this parameter. Stack RAM usage effects: ------------------------------------ If more than one DID is specified to be scheduled, the Dcm task stack usage may insignificantly increase due to the additional local variables for the iteration loops.
          boolean DcmDspPeriodicDidStopOnStateChange [0..1]: set at pre-compile, origin=Vector Informatik, default-value=false  # Dsp Periodic Did Stop On State Change | Specifies whether DCM module shall stop a PDID when a session/security level change occurs and the PDID is no longer accessible in the new state. Effect: ------------------------------------ If set to TRUE, DCM will verify whether any scheduled PDID is still accessible under the new DCM session/security/mode condition states. If not, it will be removed from the scheduler. Note: If the PDID is also a DDID, then it will depend on "/Dcm/DcmConfigSet/DcmDsp/DcmDspDDDidCheckPerSourceDid" whether only the DDID configured execution preconditions will only be considered or its content too. If set to FALSE, DCM will not automatically stop any affected PDID transmission. This saves resources (ROM, stack, run-time), but can be a security backdoor. Note: If option "/Dcm/DcmConfigSet/DcmDsp/DcmDspDDDidClearOnStateChange" is enabled, then any PDID that is also a DDID, will be removed from the scheduler independently of the state of this parameter. Constraints: ------------------------------------ none Dependencies: ------------------------------------ If "/Dcm/DcmConfigSet/DcmDsd/DcmDsdServiceTable/DcmDsdService" is defined for service 0x2A. The "/Dcm/DcmConfigSet/DcmDsp/DcmDspPeriodicDidTransmission/DcmDspMaxPeriodicDidScheduler" parameter determines the run time usage. Runtime effects: ------------------------------------ The larger number of simultaneously scheduled PDIDs, the longer the Dcm task execution time, since all contained sources will be processed within the same Dcm task activation. Code ROM usage effects: ------------------------------------ If set to TRUE, the code usage will increase by a constant amount, independent of the number of number of PDIDs or their number of sources. Const data ROM usage effects: ------------------------------------ none Global RAM usage effects: ------------------------------------ none Stack RAM usage effects: ------------------------------------ If set to TRUE, the stack usage will be increased slightly due to the additional checks performed in the context of an ongoing diagnostic service processor. The more complex and deep mode rule condition expression nesting, the more stack will be needed.
        container DcmDspPeriodicTransmission [0..1]  # This container contains the configuration (parameters) for Periodic Transmission Processing.
          float DcmDspPeriodicTransmissionSlowRate [0..1]: 0..1000, set at pre-compile, origin=Vector Informatik, default-value=1  # This parameter give the transmission rate of the requested periodicDataIdentifiers to be used if the parameter transmissionMode given in the ReadDataByPeriodicID request is equal to 0x01 ("sendAtSlowRate"). Effect: ------------------------------------ If the parameter is missing or its value is zero: this scheduling rate will not be supported in service 0x2A (ReadDataByPeriodicID). If the parameter value is > 0: If periodic DID is scheduled with the rate this parameter defines, the DCM will send a periodic response message for this DID at least with the period of this time parameter. The transmission can be slowed down due to different reasons, like high bus load, scheduler overload (too many DIDs to be processed and responded over the same response message). Constraints: ------------------------------------ This parameter value in seconds have to be configured as a multiple of DcmTaskTime. Dependencies: ------------------------------------ Refer to: "/Dcm/DcmConfigSet/DcmGeneral/DcmTaskTime". Runtime effects: ------------------------------------ none Code ROM usage effects: ------------------------------------ If this is the only scheduling rate to be supported, the Dcm code usage for service 0x2A will be significantly reduced. Const data ROM usage effects: ------------------------------------ none Global RAM usage effects: ------------------------------------ If this is the only scheduling rate to be supported, the Dcm RAM usage for service 0x2A will be slightly reduced. Stack RAM usage effects: ------------------------------------ If this is the only scheduling rate to be supported, the Dcm RAM usage for service 0x2A may be slightly reduced.
          float DcmDspPeriodicTransmissionMediumRate [0..1]: 0..1000, set at pre-compile, origin=Vector Informatik, default-value=0.1  # This parameter give the transmission rate of the requested periodicDataIdentifiers to be used if the parameter transmissionMode given in the ReadDataByPeriodicID request is equal to 0x02 ("sendAtMediumRate"). Effect: ------------------------------------ If the parameter is missing or its value is zero: this scheduling rate will not be supported in service 0x2A (ReadDataByPeriodicID). If the parameter value is > 0: If periodic DID is scheduled with the rate this parameter defines, the DCM will send a periodic response message for this DID at least with the period of this time parameter. The transmission can be slowed down due to different reasons, like high bus load, scheduler overload (too many DIDs to be processed and responded over the same response message). Constraints: ------------------------------------ This parameter value in seconds have to be configured as a multiple of DcmTaskTime. Dependencies: ------------------------------------ Refer to: "/Dcm/DcmConfigSet/DcmGeneral/DcmTaskTime". Runtime effects: ------------------------------------ none Code ROM usage effects: ------------------------------------ If this is the only scheduling rate to be supported, the Dcm code usage for service 0x2A will be significantly reduced. Const data ROM usage effects: ------------------------------------ none Global RAM usage effects: ------------------------------------ If this is the only scheduling rate to be supported, the Dcm RAM usage for service 0x2A will be slightly reduced. Stack RAM usage effects: ------------------------------------ If this is the only scheduling rate to be supported, the Dcm RAM usage for service 0x2A may be slightly reduced.
          float DcmDspPeriodicTransmissionFastRate [0..1]: 0..1000, set at pre-compile, origin=Vector Informatik, default-value=0.05  # This parameter give the transmission rate of the requested periodicDataIdentifiers to be used if the parameter transmissionMode given in the ReadDataByPeriodicID request is equal to 0x03 ("sendAtFastRate"). Effect: ------------------------------------ If the parameter is missing or its value is zero: this scheduling rate will not be supported in service 0x2A (ReadDataByPeriodicID). If the parameter value is > 0: If periodic DID is scheduled with the rate this parameter defines, the DCM will send a periodic response message for this DID at least with the period of this time parameter. The transmission can be slowed down due to different reasons, like high bus load, scheduler overload (too many DIDs to be processed and responded over the same response message). Constraints: ------------------------------------ This parameter value in seconds have to be configured as a multiple of DcmTaskTime. Dependencies: ------------------------------------ Refer to: "/Dcm/DcmConfigSet/DcmGeneral/DcmTaskTime". Runtime effects: ------------------------------------ none Code ROM usage effects: ------------------------------------ If this is the only scheduling rate to be supported, the Dcm code usage for service 0x2A will be significantly reduced. Const data ROM usage effects: ------------------------------------ none Global RAM usage effects: ------------------------------------ If this is the only scheduling rate to be supported, the Dcm RAM usage for service 0x2A will be slightly reduced. Stack RAM usage effects: ------------------------------------ If this is the only scheduling rate to be supported, the Dcm RAM usage for service 0x2A may be slightly reduced.
          float DcmDspPeriodicTransmissionDelaySlowRate [0..1]: 0..1000, set at pre-compile, origin=Vector Informatik, default-value=1  # This parameter specifies the time in which at most two periodic messages can be sent when the fastest transmissionMode given in any active ReadDataByPeriodicID request is equal to 0x01 ("sendAtSlowRate"). Effect: ------------------------------------ If the parameter is missing or its value is zero: the periodic responses of service 0x2A are sent as soon as possible. If the parameter value is > 0: If the fastest scheduled periodic DID is to be sent at "Slow Rate", at most two periodic response messages are sent within the delay time configured by this parameter. Constraints: ------------------------------------ This parameter value is in seconds and has to be configured as a multiple of DcmTaskTime. It is effective only if DcmDspPeriodicTransmissionSlowRate is > 0. Dependencies: ------------------------------------ Refer to: "/Dcm/DcmConfigSet/DcmDsp/DcmDspPeriodicTransmission/DcmDspPeriodicTransmissionSlowRate", "/Dcm/DcmConfigSet/DcmGeneral/DcmTaskTime". Additionally, if applicable: "/Dcm/DcmConfigSet/DcmDsp/DcmDspPeriodicTransmission/DcmDspPeriodicTransmissionDelayMediumRate" and "/Dcm/DcmConfigSet/DcmDsp/DcmDspPeriodicTransmission/DcmDspPeriodicTransmissionDelayFastRate". Runtime effects: ------------------------------------ Due to the additional management code required for this feature, the runtime will increase slightly. Code ROM usage effects: ------------------------------------ Due to the additional management code required for this feature, the code ROM usage will increase. Const data ROM usage effects: ------------------------------------ Due to the additional parameters required for this feature, the data ROM usage will increase insignificantly. Global RAM usage effects: ------------------------------------ Due to the additional timers required for this feature, the global RAM usage will increase insignificantly. Stack RAM usage effects: ------------------------------------ none
          float DcmDspPeriodicTransmissionDelayMediumRate [0..1]: 0..1000, set at pre-compile, origin=Vector Informatik, default-value=0.1  # This parameter specifies the time in which at most two periodic messages can be sent when the fastest transmissionMode given in any active ReadDataByPeriodicID request is equal to 0x02 ("sendAtMediumRate"). Effect: ------------------------------------ If the parameter is missing or its value is zero: the periodic responses of service 0x2A are sent as soon as possible. If the parameter value is > 0: If the fastest scheduled periodic DID is to be sent at "Medium Rate", at most two periodic response messages are sent within the delay time configured by this parameter. Constraints: ------------------------------------ This parameter value is in seconds and has to be configured as a multiple of DcmTaskTime. It is effective only if DcmDspPeriodicTransmissionMediumRate is > 0. Dependencies: ------------------------------------ Refer to: "/Dcm/DcmConfigSet/DcmDsp/DcmDspPeriodicTransmission/DcmDspPeriodicTransmissionMediumRate", "/Dcm/DcmConfigSet/DcmGeneral/DcmTaskTime". Additionally, if applicable: "/Dcm/DcmConfigSet/DcmDsp/DcmDspPeriodicTransmission/DcmDspPeriodicTransmissionDelaySlowRate" and "/Dcm/DcmConfigSet/DcmDsp/DcmDspPeriodicTransmission/DcmDspPeriodicTransmissionDelayFastRate". Runtime effects: ------------------------------------ Due to the additional management code required for this feature, the runtime will increase slightly. Code ROM usage effects: ------------------------------------ Due to the additional management code required for this feature, the code ROM usage will increase. Const data ROM usage effects: ------------------------------------ Due to the additional parameters required for this feature, the data ROM usage will increase insignificantly. Global RAM usage effects: ------------------------------------ Due to the additional timers required for this feature, the global RAM usage will increase insignificantly. Stack RAM usage effects: ------------------------------------ none
          float DcmDspPeriodicTransmissionDelayFastRate [0..1]: 0..1000, set at pre-compile, origin=Vector Informatik, default-value=0.05  # This parameter specifies the time in which at most two periodic messages can be sent when the fastest transmissionMode given in any active ReadDataByPeriodicID request is equal to 0x03 ("sendAtFastRate"). Effect: ------------------------------------ If the parameter is missing or its value is zero: the periodic responses of service 0x2A are sent as soon as possible. If the parameter value is > 0: If the fastest scheduled periodic DID is to be sent at "Fast Rate", at most two periodic response messages are sent within the delay time configured by this parameter. Constraints: ------------------------------------ This parameter value is in seconds and has to be configured as a multiple of DcmTaskTime. It is effective only if DcmDspPeriodicTransmissionFastRate is > 0. Dependencies: ------------------------------------ Refer to: "/Dcm/DcmConfigSet/DcmDsp/DcmDspPeriodicTransmission/DcmDspPeriodicTransmissionFastRate", "/Dcm/DcmConfigSet/DcmGeneral/DcmTaskTime". Additionally, if applicable: "/Dcm/DcmConfigSet/DcmDsp/DcmDspPeriodicTransmission/DcmDspPeriodicTransmissionDelaySlowRate" and "/Dcm/DcmConfigSet/DcmDsp/DcmDspPeriodicTransmission/DcmDspPeriodicTransmissionDelayMediumRate". Runtime effects: ------------------------------------ Due to the additional management code required for this feature, the runtime will increase slightly. Code ROM usage effects: ------------------------------------ Due to the additional management code required for this feature, the code ROM usage will increase. Const data ROM usage effects: ------------------------------------ Due to the additional parameters required for this feature, the data ROM usage will increase insignificantly. Global RAM usage effects: ------------------------------------ Due to the additional timers required for this feature, the global RAM usage will increase insignificantly. Stack RAM usage effects: ------------------------------------ none
        container DcmDspPid [0..*]  # This container defines the availability of a PID to the DCM.
          integer DcmDspPidIdentifier: 0..255, set at pre-compile  # Specifies the identifier value of a PID. Effect: ------------------------------------ The Dcm only recognizes PIDs with the value specified in this parameter. Constraints: ------------------------------------ The PID value must be unique within a DcmConfigset. Dependencies: ------------------------------------ none Runtime effects: ------------------------------------ none Code ROM usage effects: ------------------------------------ none Const data ROM usage effects: ------------------------------------ none Global RAM usage effects: ------------------------------------ none Stack RAM usage effects: ------------------------------------ none
          enumeration DcmDspPidService: {DCM_SERVICE_01, DCM_SERVICE_01_02, DCM_SERVICE_02}, set at pre-compile, default-value=DCM_SERVICE_01  # Allow to indicate if this PID is used for service $01 or/and $02.
          integer DcmDspPidSize: 0..255, set at pre-compile, default-value=0  # NOT USED The PID size is defined by the DcmDspPidDataSize as long as the whole PID data is provided through a single DcmDspPidData element.
          boolean DcmDspPidUsed: set at pre-compile in variant post-build-loadable+pre-compile / post-build in variant post-build-selectable, default-value=true  # Allows to activate or deactivate the usage of a PID, for multi purpose ECUs. In a single configurations the parameter can be used to temporarily disable a complete PID in the Dcm configuration without the need to delete all its configuration parameters. Effect: ------------------------------------ If set to FALSE, the PID and all its signals will not be used in the Dcm generated code. Constraints: ------------------------------------ none Dependencies: ------------------------------------ none Runtime effects: ------------------------------------ none Code ROM usage effects: ------------------------------------ none Const data ROM usage effects: ------------------------------------ If set to FALSE, no data ROM for this PID will be used in the Dcm configuration sources. Global RAM usage effects: ------------------------------------ none Stack RAM usage effects: ------------------------------------ none
          reference DcmDspPidSvc01VehicleSystemGroupRef [0..*]: set at pre-compile, origin=Vector Informatik, destination=DcmDspVehicleSystemGroupRow  # Defines OBD PID availability in service 0x01 dependency to a specific VSG. Effect: ------------------------------------ If any VSG is referred here, the Dcm will automatically reject any request of this service received while the VSG is not active. If no VSG reference is defined, Dcm assumes that this service belongs to the base-VSG (i.e. always available). Constraints: ------------------------------------ none Dependencies: ------------------------------------ Reference to a "/Dcm/DcmConfigSet/DcmDsp/DcmDspVehicleSystemGroups/DcmDspVehicleSystemGroupRow" Runtime effects: ------------------------------------ none Code ROM usage effects: ------------------------------------ none Const data ROM usage effects: ------------------------------------ Refer to "/Dcm/DcmConfigSet/DcmDsp/DcmDspVehicleSystemGroups/DcmDspVehicleSystemGroupRow" description. Global RAM usage effects: ------------------------------------ none Stack RAM usage effects: ------------------------------------ none
          reference DcmDspPidSvc02VehicleSystemGroupRef [0..*]: set at pre-compile, origin=Vector Informatik, destination=DcmDspVehicleSystemGroupRow  # Defines OBD PID availability in service 0x02 dependency to a specific VSG. Effect: ------------------------------------ If any VSG is referred here, the Dcm will automatically reject any request of this service received while the VSG is not active. If no VSG reference is defined, Dcm assumes that this service belongs to the base-VSG (i.e. always available). Constraints: ------------------------------------ none Dependencies: ------------------------------------ Reference to a "/Dcm/DcmConfigSet/DcmDsp/DcmDspVehicleSystemGroups/DcmDspVehicleSystemGroupRow" Runtime effects: ------------------------------------ none Code ROM usage effects: ------------------------------------ none Const data ROM usage effects: ------------------------------------ Refer to "/Dcm/DcmConfigSet/DcmDsp/DcmDspVehicleSystemGroups/DcmDspVehicleSystemGroupRow" description. Global RAM usage effects: ------------------------------------ none Stack RAM usage effects: ------------------------------------ none
          container DcmDspPidData  # This container defines the parameter for a Signal in the PID.
            integer DcmDspPidDataPos: 0..0, set at pre-compile, default-value=0  # Specifies the position of the signal in the PID in bytes. Effect: ------------------------------------ Affects the call out/service call function calling order. Constraints: ------------------------------------ Shall be always zero, since only single data object configurations are supported. Dependencies: ------------------------------------ none Runtime effects: ------------------------------------ none Code ROM usage effects: ------------------------------------ none Const data ROM usage effects: ------------------------------------ none Global RAM usage effects: ------------------------------------ none Stack RAM usage effects: ------------------------------------ none
            integer DcmDspPidDataSize: 0..524280, set at pre-compile, default-value=65535  # Specifies the length of PID data in bits. Effect: ------------------------------------ The sum of all data object lengths of a PID specifies the total PID length which will be used for response composition. Constraints: ------------------------------------ The size shall always be a multiple of 8 (byte borders). Dependencies: ------------------------------------ none Runtime effects: ------------------------------------ none Code ROM usage effects: ------------------------------------ none Const data ROM usage effects: ------------------------------------ none Global RAM usage effects: ------------------------------------ none Stack RAM usage effects: ------------------------------------ none
            container DcmDspPidDataSupportInfo [0..0]  # NOT USED
              integer DcmDspPidDataSupportInfoBit: 0..255, set at pre-compile  # referenced Bit of the SupportInfo
              reference DcmDspPidDataSupportInfoRef: set at pre-compile, destination=DcmDspPidSupportInfo  # Reference to DcmDspPidSupportInfo
            container DcmDspPidService01 [0..1]  # Contains specific configuration parameter of PID for service $01. This container exists only if DcmDspPidService is set to DCM_SERVICE_01 or DCM_SERVICE_01_02.
              function name DcmDspPidDataReadFnc [0..1]: set at pre-compile  # Specifies the call out function name for reading the data object content. Effect: ------------------------------------ If this parameter is not empty, the Dcm will call the specified function on PID reading diagnostic request. Constraints: ------------------------------------ none Dependencies: ------------------------------------ Has effect only if: - the diagnostic service 0x01 (RequestCurrentDowertrainDiagnosticData) is supported by Dcm (refer to /Dcm/DcmConfigSet/DcmDsd/DcmDsdServiceTable/DcmDsdService) - the DcmDspDataUsePort is set to one of the FNC (e.g. call out) types (refer to /Dcm/DcmConfigSet/DcmDsp/DcmDspPid/DcmDspPidData/DcmDspPidService01/DcmDspPidDataUsePort) Runtime effects: ------------------------------------ none Code ROM usage effects: ------------------------------------ none Const data ROM usage effects: ------------------------------------ none Global RAM usage effects: ------------------------------------ none Stack RAM usage effects: ------------------------------------ none
              enumeration DcmDspPidDataUsePort: {USE_DATA_SYNCH_CLIENT_SERVER, USE_DATA_SYNCH_FNC}, set at pre-compile, default-value=USE_DATA_SYNCH_CLIENT_SERVER  # Defines which kind of interface shall be used to access the data. Effect: ------------------------------------ Depending on the selected type, either a RTE call or a call out will be required to be implemented in the Dcm application. Constraints: ------------------------------------ none Dependencies: ------------------------------------ none Runtime effects: ------------------------------------ none Code ROM usage effects: ------------------------------------ none Const data ROM usage effects: ------------------------------------ none Global RAM usage effects: ------------------------------------ none Stack RAM usage effects: ------------------------------------ none
            container DcmDspPidService02 [0..0]  # NOT USED
              reference DcmDspPidDataDemRef [0..1]: set at pre-compile, destination=DemPidDataElement  # Reference to DemPidDataElement in DEM configuration. Allows to link the DCM PID and DEM PID configuration for Mode $02.
          container DcmDspPidSupportInfo [0..0]  # NOT USED
            integer DcmDspPidSupportInfoLen: 0..255, set at pre-compile  # Length of the supported information in bytes.
            integer DcmDspPidSupportInfoPos: 0..255, set at pre-compile  # Position of the supported information in bytes.
        container DcmDspRequestControl [0..*]  # This container contains the configuration (parameters) of the "Request control of on-board system, test or component" service (Service $08).
          integer DcmDspRequestControlInBufferSize: 0..4294967295, set at pre-compile, default-value=0  # Specifies the request length of TID data in bytes. Effect: ------------------------------------ The value of this parameter will be used to validated the request length. Constraints: ------------------------------------ none Dependencies: ------------------------------------ none Runtime effects: ------------------------------------ none Code ROM usage effects: ------------------------------------ none Const data ROM usage effects: ------------------------------------ none Global RAM usage effects: ------------------------------------ none Stack RAM usage effects: ------------------------------------ none
          integer DcmDspRequestControlOutBufferSize: 0..4294967295, set at pre-compile, default-value=0  # Specifies the response length of TID data in bytes. Effect: ------------------------------------ The value of this parameter will be used to compose the response length. Constraints: ------------------------------------ none Dependencies: ------------------------------------ none Runtime effects: ------------------------------------ none Code ROM usage effects: ------------------------------------ none Const data ROM usage effects: ------------------------------------ none Global RAM usage effects: ------------------------------------ none Stack RAM usage effects: ------------------------------------ none
          integer DcmDspRequestControlTestId: 0..255, set at pre-compile  # Specifies the identifier value of a TID. Effect: ------------------------------------ The Dcm only recognizes TIDs with the value specified in this parameter. Constraints: ------------------------------------ The TID value must be unique within a DcmConfigset. Dependencies: ------------------------------------ none Runtime effects: ------------------------------------ none Code ROM usage effects: ------------------------------------ none Const data ROM usage effects: ------------------------------------ none Global RAM usage effects: ------------------------------------ none Stack RAM usage effects: ------------------------------------ none
          function name DcmDspRequestControlFnc [0..1]: set at pre-compile, origin=Vector Informatik  # Specifies the call out function name for control. Effect: ------------------------------------ If this parameter is not empty, the Dcm will call the specified function on TID reading diagnostic request. Constraints: ------------------------------------ none Dependencies: ------------------------------------ Has effect only if: - the diagnostic service 0x08 (RequestControlOfOnBoardDevice) is supported by Dcm (refer to /Dcm/DcmConfigSet/DcmDsd/DcmDsdServiceTable/DcmDsdService) - the DcmDspDataUsePort is set to one of the FNC (e.g. call out) types (refer to /Dcm/DcmConfigSet/DcmDsp/DcmDspRequestControl/DcmDspRequestControlUsePort) Runtime effects: ------------------------------------ none Code ROM usage effects: ------------------------------------ none Const data ROM usage effects: ------------------------------------ none Global RAM usage effects: ------------------------------------ none Stack RAM usage effects: ------------------------------------ none
          boolean DcmDspRequestControlUsePort [0..1]: set at pre-compile, origin=Vector Informatik, default-value=true  # Defines which kind of interface shall be used to control. Effect: ------------------------------------ If set to TRUE, a RTE call will be required to be implemented in the Dcm application. If set to FALSE - a call out will be required to be implemented in the Dcm application. Constraints: ------------------------------------ none Dependencies: ------------------------------------ none Runtime effects: ------------------------------------ none Code ROM usage effects: ------------------------------------ none Const data ROM usage effects: ------------------------------------ none Global RAM usage effects: ------------------------------------ none Stack RAM usage effects: ------------------------------------ none
          reference DcmDspRequestControlVehicleSystemGroupRef [0..*]: set at pre-compile, origin=Vector Informatik, destination=DcmDspVehicleSystemGroupRow  # Defines OBD RequestControl ID availability dependency to a specific VSG. Effect: ------------------------------------ If any VSG is referred here, the Dcm will automatically reject any request of this service received while the VSG is not active. If no VSG reference is defined, Dcm assumes that this service belongs to the base-VSG (i.e. always available). Constraints: ------------------------------------ none Dependencies: ------------------------------------ Reference to a "/Dcm/DcmConfigSet/DcmDsp/DcmDspVehicleSystemGroups/DcmDspVehicleSystemGroupRow" Runtime effects: ------------------------------------ none Code ROM usage effects: ------------------------------------ none Const data ROM usage effects: ------------------------------------ Refer to "/Dcm/DcmConfigSet/DcmDsp/DcmDspVehicleSystemGroups/DcmDspVehicleSystemGroupRow" description. Global RAM usage effects: ------------------------------------ none Stack RAM usage effects: ------------------------------------ none
        container DcmDspRoe [0..1]  # Provide the configuration of the ResponseOnEvent mechanism.
          integer DcmDspRoeBufSize [0..0]: 0..65535, set at pre-compile  # NOT USED
          function name DcmDspRoeInitFnc [0..0]: set at pre-compile  # NOT USED
          boolean DcmDspRoeInitOnDSC: set at pre-compile, default-value=false  # Specifies whether the RoE shall be deactivated on each diagnostic session transition: either caused by reception of SID 0x10 (DiagnosticSessionControl) or S3 timeout. Effect: ------------------------------------ If set to TRUE, an activated RoE will be deactivated on each diagnostic session transition. If set to FALSE diagnostic session transitions will not affect any running RoE task. Constraints: ------------------------------------ Supported only for some OEMs. Refer to the DCM technical reference to see whether this setting is supported for your project. Dependencies: ------------------------------------ Has effect only if the diagnostic service 0x86 (ResponseOnEvent) is supported by Dcm (refer to /Dcm/DcmConfigSet/DcmDsd/DcmDsdServiceTable/DcmDsdService). Runtime effects: ------------------------------------ Since this feature activates additional functionality implemented in DCM, the runtime usage will slightly increase on any diagnostic session transition. Code ROM usage effects: ------------------------------------ Since this feature activates additional functionality implemented in DCM, the code usage will slightly increase. Const data ROM usage effects: ------------------------------------ none Global RAM usage effects: ------------------------------------ none Stack RAM usage effects: ------------------------------------ none
          float DcmDspRoeInterMessageTime: 0..5, set at pre-compile, default-value=0  # Specifies the minimum time period in seconds in which the RoE responses will be sent. Effect: ------------------------------------ This parameter is used for both: - RoE response message intermediate time; and - DEM polling rate time for monitoring changed number of DTCs for "onDtcStatusChange" event type. Constraints: ------------------------------------ Supported only for some OEMs. Refer to the DCM technical reference to see whether this setting is supported for your project. Dependencies: ------------------------------------ Has effect only if the diagnostic service 0x86 (ResponseOnEvent) is supported by Dcm (refer to /Dcm/DcmConfigSet/DcmDsd/DcmDsdServiceTable/DcmDsdService). Runtime effects: ------------------------------------ none Code ROM usage effects: ------------------------------------ none Const data ROM usage effects: ------------------------------------ none Global RAM usage effects: ------------------------------------ none Stack RAM usage effects: ------------------------------------ none
          integer DcmDspRoeMaxEventLength [0..0]: 1..65535, set at pre-compile  # NOT USED
          integer DcmDspRoeMaxNumberOfRetry: 0..255, set at pre-compile, default-value=0  # NOT USED
          integer DcmDspRoeMaxQueueLength [0..0]: 1..65535, set at pre-compile  # NOT USED
          boolean DcmDspRoeQueueEnabled: set at pre-compile, default-value=false  # NOT USED
          function name DcmDspRoeStopFnc [0..0]: set at pre-compile  # NOT USED
          integer DcmDspRoeSTRTMaxLength [0..1]: 1..65535, set at pre-compile, origin=Vector Informatik, default-value=3  # NOT USED
          float DcmDspRoeSchedulerRate [0..1]: 0..1000, set at pre-compile, origin=Vector Informatik, default-value=0.01  # Specifies the call rate of the periodic scheduler in ms to compare the values of the Dids or to detect DTC status changes. Effect: ------------------------------------ Polling rate time for monitoring Dids or changed number of DTCs to trigger an event when the conditions met. Constraints: ------------------------------------ The "periodic RoE scheduler" feature is only available and/or mandatory for certain customers. For all others this option will not have any effect. Please refer to the technical reference to find out whether this option is applicable for your project or not (if not documented). This parameter value in milliseconds has to be configured as a multiple of DcmTaskTime. Dependencies: ------------------------------------ Has effect only if the diagnostic service 0x86 (ResponseOnEvent) is supported by Dcm (refer to /Dcm/DcmConfigSet/DcmDsd/DcmDsdServiceTable/DcmDsdService). Runtime effects: ------------------------------------ none Code ROM usage effects: ------------------------------------ none Const data ROM usage effects: ------------------------------------ none Global RAM usage effects: ------------------------------------ none Stack RAM usage effects: ------------------------------------ none
          integer DcmDspRoeMaxSupportedDidLength [0..1]: 1..65535, set at pre-compile, origin=Vector Informatik, default-value=1  # Specifies the maximum number of measurable data bytes allowed for each DID that is used for subfunction onChangeOfDataIdentifier(0x03) or onComparisonOfValues (0x07). Effect: ------------------------------------ Maximum legth of a DID that can be stored. Constraints: ------------------------------------ This parameter is only available and/or mandatory for certain customers. For all others this option will not have any effect. Please refer to the technical reference to find out whether this option is applicable for your project or not (if not documented). Dependencies: ------------------------------------ Has effect only if the diagnostic service 0x86 (ResponseOnEvent) is supported by Dcm (refer to /Dcm/DcmConfigSet/DcmDsd/DcmDsdServiceTable/DcmDsdService). Runtime effects: ------------------------------------ Increased runtime depending on the configured DID length. Code ROM usage effects: ------------------------------------ none Const data ROM usage effects: ------------------------------------ none Global RAM usage effects: ------------------------------------ Increased RAM usage depending on the configured DID length. Stack RAM usage effects: ------------------------------------ none
          integer DcmDspRoeMaxNumChangeOfDidEvents [0..1]: 1..255, set at pre-compile, origin=Vector Informatik, default-value=1  # Specifies the maximum number of events that can be simultaneously configured with subfunction onChangeOfDataIdentifier (0x03). Effect: ------------------------------------ Number of events that can be monitored at a time. Constraints: ------------------------------------ This parameter is only available and/or mandatory for certain customers. For all others this option will not have any effect. Please refer to the technical reference to find out whether this option is applicable for your project or not (if not documented). Dependencies: ------------------------------------ Has effect only if the diagnostic service 0x86 (ResponseOnEvent) is supported by Dcm (refer to /Dcm/DcmConfigSet/DcmDsd/DcmDsdServiceTable/DcmDsdService). Runtime effects: ------------------------------------ Increased runtime depending on the number of events configured. Code ROM usage effects: ------------------------------------ none Const data ROM usage effects: ------------------------------------ none Global RAM usage effects: ------------------------------------ Increased RAM usage depending on the number of events configured. Stack RAM usage effects: ------------------------------------ none
          integer DcmDspRoeMaxNumComparisonOfValueEvents [0..1]: 1..255, set at pre-compile, origin=Vector Informatik, default-value=1  # Specifies the maximum number of events that can be simultaneously configured with subfunction onComparisonOfValues (0x07). Effect: ------------------------------------ Number of events that can be monitored at a time. Constraints: ------------------------------------ This parameter is only available and/or mandatory for certain customers. For all others this option will not have any effect. Please refer to the technical reference to find out whether this option is applicable for your project or not (if not documented). Dependencies: ------------------------------------ Has effect only if the diagnostic service 0x86 (ResponseOnEvent) is supported by Dcm (refer to /Dcm/DcmConfigSet/DcmDsd/DcmDsdServiceTable/DcmDsdService). Runtime effects: ------------------------------------ Increased runtime depending on the number of events configured. Code ROM usage effects: ------------------------------------ none Const data ROM usage effects: ------------------------------------ none Global RAM usage effects: ------------------------------------ Increased RAM usage depending on the number of events configured. Stack RAM usage effects: ------------------------------------ none
          integer DcmDspRoeMaxNumStoredDTCStatusChangedEvents [0..1]: 1..255, set at pre-compile, origin=Vector Informatik, default-value=1  # Specifies the event queue size for subfunction reportDTCRecordInformationOnDtcStatusChange (0x09). Effect: ------------------------------------ Number of DTC status change events which can be queued. Constraints: ------------------------------------ This parameter is only available and/or mandatory for certain customers. For all others this option will not have any effect. Please refer to the technical reference to find out whether this option is applicable for your project or not (if not documented). Dependencies: ------------------------------------ Has effect only if the diagnostic service 0x86 (ResponseOnEvent) is supported by Dcm (refer to /Dcm/DcmConfigSet/DcmDsd/DcmDsdServiceTable/DcmDsdService). Runtime effects: ------------------------------------ none Code ROM usage effects: ------------------------------------ none Const data ROM usage effects: ------------------------------------ none Global RAM usage effects: ------------------------------------ none Stack RAM usage effects: ------------------------------------ none
          boolean DcmDspRoeStorageStateStoreEventEnabled [0..1]: set at pre-compile, origin=Vector Informatik, default-value=false  # Specifies whether the storeEvent for subfunction 0x05 (startResponseOnEvent) of service 0x86 is supported or not. Effect: ------------------------------------ If set to TRUE, the subfunction 0x05 with storeEvent set is allowed. If set to FALSE, the subfunction 0x05 with storeEvent set will be rejected with a NRC. Constraints: ------------------------------------ Supported only for some OEMs. Refer to the DCM technical reference to see whether this setting is supported for your project. Dependencies: ------------------------------------ Has effect only if the diagnostic service 0x86 (ResponseOnEvent) is supported by Dcm (refer to /Dcm/DcmConfigSet/DcmDsd/DcmDsdServiceTable/DcmDsdService). Runtime effects: ------------------------------------ Since this feature activates additional functionality implemented in DCM, the runtime usage will slightly increase. Code ROM usage effects: ------------------------------------ Since this feature activates additional functionality implemented in DCM, the code usage will slightly increase. Const data ROM usage effects: ------------------------------------ none Global RAM usage effects: ------------------------------------ none Stack RAM usage effects: ------------------------------------ none
          symbolic name reference DcmDspRoeBlockIdRef [0..1]: set at pre-compile, origin=Vector Informatik, destination=NvMBlockDescriptor  # Specifies the Block ID of the NvM for storing RoE event status. Effect: ------------------------------------ Will be used by Dcm when the diagnostic client has requested to store the new RoE operation. Constraints: ------------------------------------ none Dependencies: ------------------------------------ Has effect only if the diagnostic service 0x86 (ResponseOnEvent) is supported by Dcm (refer to /Dcm/DcmConfigSet/DcmDsd/DcmDsdServiceTable/DcmDsdService). Runtime effects: ------------------------------------ none Code ROM usage effects: ------------------------------------ none Const data ROM usage effects: ------------------------------------ none Global RAM usage effects: ------------------------------------ none Stack RAM usage effects: ------------------------------------ none
          container DcmDspRoeEvent [0..255]  # This container contains a list of all supported Roe eventTypeRecords which are accepted by this ECU. At most one DcmDspRoeEvent container is allowed to define a DcmDspRoeEventProperties container with the choice DcmDspRoeOnDTCStatusChange. | At most one DcmDspRoeEvent container is allowed to define a DcmDspRoeEventProperties container with the choice DcmDspRoeOnDTCStatusChange.
            integer DcmDspRoeEventId: 0..254, set at pre-compile, origin=Vector Informatik, symbolic-name-value=true, default-value=0  # Specifies the EventId for a global identification of this ROE event. Effect: ------------------------------------ The EventId is used within APIs Dcm_TriggerOnEvent() and the ModeDeclarationGroup. Constraints: ------------------------------------ Supported only for some OEMs. Refer to the DCM technical reference to see whether this setting is supported for your project. Dependencies: ------------------------------------ Has effect only if: - the diagnostic service 0x86 (ResponseOnEvent) is supported by Dcm (refer to /Dcm/DcmConfigSet/DcmDsd/DcmDsdServiceTable/DcmDsdService). - AR 4.2.1 RoE API is licensed Runtime effects: ------------------------------------ none Code ROM usage effects: ------------------------------------ none Const data ROM usage effects: ------------------------------------ none Global RAM usage effects: ------------------------------------ none Stack RAM usage effects: ------------------------------------ none | The ratio Ids should be sequentially ordered beginning with 0 and no gaps in between.
            choice container DcmDspRoeEventProperties  # This container contains the properties of Roe eventTypeRecords. In one DcmDspRoeEventProperties container one DcmDspRoeOnDTCStatusChange or DcmDspRoeOnChangeOfDataIdentifier container shall be defined.
              container DcmDspRoeOnChangeOfDataIdentifier [0..1]  # This container contains configuration of a eventTypeRecord onChangeOfDataIdentifier accepted by this ECU.
                reference DcmDspRoeDidRef: set at pre-compile, origin=Vector Informatik, destination=DcmDspDid  # Specifies the DID to be associated with this RoE event for monitoring. Effect: ------------------------------------ The DID that shall be monitored via RoE for value change shall be referenced by this parameter. All other DIDs will be rejected when used within an RoE request. Constraints: ------------------------------------ Not all DIDs are suitable for RoE usage. Refer to the DCM technical reference to see whether this setting is supported for your project. Dependencies: ------------------------------------ Has effect only if: - The diagnostic service 0x86 (ResponseOnEvent) with sub-function 0x03/0x04 (OnChangeOfDataIdentifier) is supported by Dcm (refer to /Dcm/DcmConfigSet/DcmDsd/DcmDsdServiceTable/DcmDsdService). Runtime effects: ------------------------------------ none Code ROM usage effects: ------------------------------------ none Const data ROM usage effects: ------------------------------------ none Global RAM usage effects: ------------------------------------ none Stack RAM usage effects: ------------------------------------ none
              container DcmDspRoeOnDTCStatusChange [0..1]  # This container contains configuration of aeventTypeRecord onDTCStatusChange accepted by this ECU. Please note that currently are no additional parameters for DcmDspRoeOnDTCStatusChange are defined. Therefore the existence of the container denotes the choice.
          container DcmDspRoeEventWindowTime [0..*]  # This container configures the available EventWindowTime in this ECU. This container contains a sub-set of EventWindowTimes supported by the Dcm, to limit the ECU resources.
            enumeration DcmDspRoeEventWindowTime: {DCM_ROE_EVENT_WINDOW_INFINITE, DCM_ROE_EVENT_WINDOW_CURRENT_CYCLE}, set at pre-compile, origin=Vector Informatik  # Specifies the value of the EventWindowTime. Effect: ------------------------------------ If a RoE request is received with a EWT value not specified here, DCM will reject it with NRC 0x31. Constraints: ------------------------------------ Supported only for some OEMs. Refer to the DCM technical reference to see whether this setting is supported for your project. Dependencies: ------------------------------------ Has effect only if the diagnostic service 0x86 (ResponseOnEvent) is supported by Dcm (refer to /Dcm/DcmConfigSet/DcmDsd/DcmDsdServiceTable/DcmDsdService). Runtime effects: ------------------------------------ Depending on the defined count of EWT to be supported a RoE service request can take insignificantly longer time. Code ROM usage effects: ------------------------------------ none Const data ROM usage effects: ------------------------------------ Depending on the defined count of EWT to be supported, the used amount of ROM data will insignificantly change. Global RAM usage effects: ------------------------------------ none Stack RAM usage effects: ------------------------------------ none
        container DcmDspRoutine [0..*]  # This container contains the configuration (parameters) for Routines.
          function name DcmDspRequestResultsRoutineFnc [0..1]: set at pre-compile  # Specifies the call out function name for requesting RID results. Effect: ------------------------------------ If this parameter is not empty, the Dcm will call the specified function on RID request results diagnostic request. Constraints: ------------------------------------ none Dependencies: ------------------------------------ Has effect only if: - the diagnostic service 0x31 (RoutineControlByIdentifier) is supported by Dcm (refer to /Dcm/DcmConfigSet/DcmDsd/DcmDsdServiceTable/DcmDsdService) - the RID supports the operation request routine results (refer to /Dcm/DcmConfigSet/DcmDsp/DcmDspRoutine/DcmDspRequestResultsRoutineSupported) - the DcmDspRoutineUsePort is set to FALSE (i.e. call out) types (refer to /Dcm/DcmConfigSet/DcmDsp/DcmDspRoutine/DcmDspRoutineUsePort) Runtime effects: ------------------------------------ none Code ROM usage effects: ------------------------------------ none Const data ROM usage effects: ------------------------------------ none Global RAM usage effects: ------------------------------------ none Stack RAM usage effects: ------------------------------------ none
          boolean DcmDspRequestResultsRoutineSupported: set at pre-compile  # Specifies whether the RID shall support request result operation. Effect: ------------------------------------ If set to TRUE, Dcm will accept a request result operation request on this RID. Otherwise, the Dcm will reject the request with a NRC 0x12 (SubFunctionNotSupported). Constraints: ------------------------------------ none Dependencies: ------------------------------------ none Runtime effects: ------------------------------------ none Code ROM usage effects: ------------------------------------ none Const data ROM usage effects: ------------------------------------ If set to TRUE, the Dcm configuration data ROM usage will increase due to the additional data to be hold for this operation. Global RAM usage effects: ------------------------------------ none Stack RAM usage effects: ------------------------------------ none
          boolean DcmDspRoutineFixedLength: set at pre-compile, default-value=false  # NOT USED Instead, the corresponding routine operation request/response data type specifies whether a signal has fixed/variable length. Example: /Dcm/DcmConfigSet/DcmDsp/DcmDspRoutineInfo/DcmDspRoutineRequestResOut/DcmDspRoutineRequestResOutSignal/DcmDspRoutineSignalType
          integer DcmDspRoutineIdentifier: 0..65535, set at pre-compile  # 2 bytes Identifier of the RID
          boolean DcmDspRoutineUsePort: set at pre-compile, default-value=true  # If this parameter is set to true, the DCM uses a port requiring a PortInterface RoutineServices_<ROUTINENAME>.
          boolean DcmDspRoutineUsed: set at pre-compile, default-value=true  # Allow to activate or deactivate the usage of a Routine, for multi purpose ECUs In a single configurations the parameter can be used to temporarily disable a complete RID in the Dcm configuration without the need to delete all its configuration parameters. Effect: ------------------------------------ If set to FALSE, the RID and all its signals will not be used in the Dcm generated code. Constraints: ------------------------------------ none Dependencies: ------------------------------------ none Runtime effects: ------------------------------------ none Code ROM usage effects: ------------------------------------ none Const data ROM usage effects: ------------------------------------ If set to FALSE, no data ROM for this RID will be used in the Dcm configuration sources. Global RAM usage effects: ------------------------------------ none Stack RAM usage effects: ------------------------------------ none
          function name DcmDspStartRoutineFnc [0..1]: set at pre-compile  # Specifies the call out function name for starting a RID. Effect: ------------------------------------ If this parameter is not empty, the Dcm will call the specified function on RID start diagnostic request. Constraints: ------------------------------------ none Dependencies: ------------------------------------ Has effect only if: - the diagnostic service 0x31 (RoutineControlByIdentifier) is supported by Dcm (refer to /Dcm/DcmConfigSet/DcmDsd/DcmDsdServiceTable/DcmDsdService) - the DcmDspRoutineUsePort is set to FALSE (i.e. call out) types (refer to /Dcm/DcmConfigSet/DcmDsp/DcmDspRoutine/DcmDspRoutineUsePort) Runtime effects: ------------------------------------ none Code ROM usage effects: ------------------------------------ none Const data ROM usage effects: ------------------------------------ none Global RAM usage effects: ------------------------------------ none Stack RAM usage effects: ------------------------------------ none
          function name DcmDspStopRoutineFnc [0..1]: set at pre-compile  # Specifies the call out function name for stopping a RID. Effect: ------------------------------------ If this parameter is not empty, the Dcm will call the specified function on RID stop diagnostic request. Constraints: ------------------------------------ none Dependencies: ------------------------------------ Has effect only if: - the diagnostic service 0x31 (RoutineControlByIdentifier) is supported by Dcm (refer to /Dcm/DcmConfigSet/DcmDsd/DcmDsdServiceTable/DcmDsdService) - the RID supports the operation request routine results (refer to /Dcm/DcmConfigSet/DcmDsp/DcmDspRoutine/DcmDspStopRoutineSupported) - the DcmDspRoutineUsePort is set to FALSE (i.e. call out) types (refer to /Dcm/DcmConfigSet/DcmDsp/DcmDspRoutine/DcmDspRoutineUsePort) Runtime effects: ------------------------------------ none Code ROM usage effects: ------------------------------------ none Const data ROM usage effects: ------------------------------------ none Global RAM usage effects: ------------------------------------ none Stack RAM usage effects: ------------------------------------ none
          boolean DcmDspStopRoutineSupported: set at pre-compile  # Specifies whether the RID shall support stop operation. Effect: ------------------------------------ If set to TRUE, Dcm will accept a stop operation request on this RID. Otherwise, the Dcm will reject the request with a NRC 0x12 (SubFunctionNotSupported). Constraints: ------------------------------------ none Dependencies: ------------------------------------ none Runtime effects: ------------------------------------ none Code ROM usage effects: ------------------------------------ none Const data ROM usage effects: ------------------------------------ If set to TRUE, the Dcm configuration data ROM usage will increase due to the additional data to be hold for this operation. Global RAM usage effects: ------------------------------------ none Stack RAM usage effects: ------------------------------------ none
          integer DcmDspRoutineInfoByte [0..1]: 0..255, set at pre-compile, origin=Vector Informatik, default-value=1  # Manufacturer specific value reported to the tester for the record identifiers. (OBD use cases) Effect: ------------------------------------ If this parameter exists, DCM will report it automatically to the client, without the need of application intervention. If this parameter does not exist (default), the application shall provide the RIB value if needed. Constraints: ------------------------------------ none Dependencies: ------------------------------------ none Runtime effects: ------------------------------------ If exists, the additional byte copy functionality will insignificantly increase the DCM run time usage. Code ROM usage effects: ------------------------------------ If exists, the additional byte copy functionality will insignificantly increase the DCM code ROM usage. Const data ROM usage effects: ------------------------------------ If exists, the additional configuration data is stored to each routine identifier which will slightly increase the const data ROM usage. Global RAM usage effects: ------------------------------------ none Stack RAM usage effects: ------------------------------------ none
          boolean DcmDspStopRoutineInterfaceArgumentIntegrity [0..1]: set at pre-compile, origin=Vector Informatik, default-value=false  # If this parameter is set to TRUE, the integrity of the stop routine operation parameters is ensured. Effect: ------------------------------------ Defines the value of ClientServerOperation.diagArgIntegrity for the created C/S interface respectively the callout function of the stop routine operation. Constraints: ------------------------------------ none Dependencies: ------------------------------------ Has effect only if: - the diagnostic service 0x31 (RoutineControlByIdentifier) is supported by Dcm (refer to /Dcm/DcmConfigSet/DcmDsd/DcmDsdServiceTable/DcmDsdService) Runtime effects: ------------------------------------ Enabling this feature will slightly increase the Dcm task time during the stop routine operation due to the parameter copying. Code ROM usage effects: ------------------------------------ none Const data ROM usage effects: ------------------------------------ none Global RAM usage effects: ------------------------------------ Enabling this feature leads to an increase of the Dcm static code RAM usage (depending on the size of the stop routine operation parameters). Stack RAM usage effects: ------------------------------------ none
          boolean DcmDspStartRoutineInterfaceArgumentIntegrity [0..1]: set at pre-compile, origin=Vector Informatik, default-value=false  # If this parameter is set to TRUE, the integrity of the start routine operation parameters is ensured. Effect: ------------------------------------ Defines the value of ClientServerOperation.diagArgIntegrity for the created C/S interface respectively the callout function of the start routine operation. Constraints: ------------------------------------ none Dependencies: ------------------------------------ Has effect only if: - the diagnostic service 0x31 (RoutineControlByIdentifier) is supported by Dcm (refer to /Dcm/DcmConfigSet/DcmDsd/DcmDsdServiceTable/DcmDsdService) Runtime effects: ------------------------------------ Enabling this feature will slightly increase the Dcm task time during the start routine operation due to the parameter copying. Code ROM usage effects: ------------------------------------ none Const data ROM usage effects: ------------------------------------ none Global RAM usage effects: ------------------------------------ Enabling this feature leads to an increase of the Dcm static code RAM usage (depending on the size of the start routine operation parameters). Stack RAM usage effects: ------------------------------------ none
          boolean DcmDspRequestResultsRoutineInterfaceArgumentIntegrity [0..1]: set at pre-compile, origin=Vector Informatik, default-value=false  # If this parameter is set to TRUE, the integrity of the request result routine operation parameters is ensured. Effect: ------------------------------------ Defines the value of ClientServerOperation.diagArgIntegrity for the created C/S interface respectively the callout function of the request result routine operation. Constraints: ------------------------------------ none Dependencies: ------------------------------------ Has effect only if: - the diagnostic service 0x31 (RoutineControlByIdentifier) is supported by Dcm (refer to /Dcm/DcmConfigSet/DcmDsd/DcmDsdServiceTable/DcmDsdService) Runtime effects: ------------------------------------ Enabling this feature will slightly increase the Dcm task time during the request result routine operation due to the parameter copying. Code ROM usage effects: ------------------------------------ none Const data ROM usage effects: ------------------------------------ none Global RAM usage effects: ------------------------------------ Enabling this feature leads to an increase of the Dcm static code RAM usage (depending on the size of the request result routine operation parameters). Stack RAM usage effects: ------------------------------------ none
          reference DcmDspRoutineInfoRef: set at pre-compile, destination=DcmDspRoutineInfo  # Reference to DcmDspRoutineInfo containing information on this routine.
          foreign reference DcmDspRoutineSystemTemplateDiagnosticRoutineRef [0..1]: set at pre-compile in variant post-build-loadable+pre-compile / post-build in variant post-build-selectable, origin=Vector Informatik, destination-type=DIAGNOSTIC-ROUTINE  # Reference to the DiagnosticRoutine which is represented by this DcmDspRoutine.
