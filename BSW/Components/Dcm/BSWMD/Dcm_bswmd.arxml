[part 1 of 3: package /MICROSAR]
AUTOSAR XML (schema 4-0-3)
# COPYRIGHT
# Copyright (c) 2024 by Vector Informatik GmbH. All rights reserved.
# This software is copyright protected and proprietary to Vector Informatik GmbH.
# Vector Informatik GmbH grants to you only those rights as set out in the license conditions.
package /MICROSAR
  bsw implementation Dcm_Impl: programming-language=C, sw-version=21.05.00, used-code-generator=DaVinci Configurator, vendor-id=30, ar-release-version=4.00.03, behavior=DcmBehavior, preconfigured-configuration=Dcm_Pre, recommended-configuration=Dcm_Rec, vendor-specific-module-def=Dcm
  module definition Dcm [0..1]: category=VENDOR_SPECIFIC_MODULE_DEFINITION, refined-module-def=Dcm, variants pre-compile/post-build-loadable/post-build-selectable  # Diagnostic Communication Manager. Handles the diagnostic communication between the tester and the application of the ECU. Implements UDS and (WWH-)OBD services providing abstract interfaces to the application. #Diag #UDS #OBD #WWHOBD #AUTOSAR #ServiceComponent
    container DcmConfigSet  # This container contains the configuration parameters and sub containers of the Dcm module supporting multiple configuration sets.
      container DcmDsd  # These parameters apply to Diagnostic Service Dispatcher. All parameters for all service dispatchers are included in this one configuration container.
        container DcmDsdServiceTable [1..256]  # This container contains the configuration (DSD parameters) for Service Identifier Table. Effect: ------------------------------------ If a certain diagnostic services shall be supported, it has to be declared within this container with all of its properties. Any received diagnostic request with a service ID not declared here, will be rejected by Dcm. Constraints: ------------------------------------ Some services are required and must exist, other are optional or no allowed at all. During the configuration the Configurator 5 validators will notify you about wrongly configured or missing service declaration. Dependencies: ------------------------------------ Depending on the service identifier, some "/Dcm/DcmConfigSet/DcmDsp" sub-containers/parameters will be required additionally. Refer to any "/Dcm/DcmConfigSet/DcmDsp" sub-container/parameter for dependencies to this container type. Runtime effects: ------------------------------------ The Dcm service identification runtime will scale linearly with the amount of services specified here. Code ROM usage effects: ------------------------------------ none Const data ROM usage effects: ------------------------------------ The ROM usage of the configuration part of Dcm will scale linearly with the amount of services specified here. Global RAM usage effects: ------------------------------------ none Stack RAM usage effects: ------------------------------------ none
          integer DcmDsdSidTabId [0..1]: 0..255, set at pre-compile, default-value=0  # NOT USED
          container DcmDsdService [1..256]  # This container defines a single diagnostic service. Effect: ------------------------------------ If a certain diagnostic services shall be supported, it has to be declared within this container with all of its properties. Any received diagnostic request with a service ID not declared here, will be rejected by Dcm. Constraints: ------------------------------------ Some services are required and must exist, other are optional or no allowed at all. During the configuration the Configurator 5 validators will notify you about wrongly configured or missing service declaration. Dependencies: ------------------------------------ Depending on the service identifier, some "/Dcm/DcmConfigSet/DcmDsp" sub-containers/parameters will be required additionally. Refer to any "/Dcm/DcmConfigSet/DcmDsp" sub-container/parameter for dependencies to this container type. Runtime effects: ------------------------------------ The Dcm service identification runtime will scale linearly with the amount of services specified here. Code ROM usage effects: ------------------------------------ none Const data ROM usage effects: ------------------------------------ The ROM usage of the configuration part of Dcm will scale linearly with the amount of services specified here. Global RAM usage effects: ------------------------------------ none Stack RAM usage effects: ------------------------------------ none
            function name DcmDsdSidTabFnc [0..1]: set at pre-compile  # Optional callback function of the ECU supplier specific component for the particular DcmDsdSidTabServiceId. Effect: ------------------------------------ Dcm implements internally only some specific diagnostic services. For all other valid services an application function name shall be entered here that will be called by Dcm to handle the concrete diagnostic service. Constraints: ------------------------------------ The Configurator 5 validators will notify you for any invalid setting on this parameter. Dependencies: ------------------------------------ none Runtime effects: ------------------------------------ none Code ROM usage effects: ------------------------------------ Only application code will be affected. Const data ROM usage effects: ------------------------------------ none Global RAM usage effects: ------------------------------------ none Stack RAM usage effects: ------------------------------------ The required stack size by the Dcm task may increase depending on the implementation of the specified application function.
            integer DcmDsdSidTabServiceId: 0..255, set at pre-compile  # Specifies the value of the diagnostic service identifier. The possible parameter values are predefined in the ISO 14229-1, ISO 15031-5 and can be restricted by the OEM. Effect: ------------------------------------ Dcm will identify only those sub-services of the corresponding diagnostic service that are defined here. Constraints: ------------------------------------ All allowed and supported service identifiers are validated during the configuration time. The valid values are diagnostic protocol, diagnostic service and OEM specific. Dependencies: ------------------------------------ none Runtime effects: ------------------------------------ none Code ROM usage effects: ------------------------------------ none Const data ROM usage effects: ------------------------------------ none Global RAM usage effects: ------------------------------------ none Stack RAM usage effects: ------------------------------------ none
            boolean DcmDsdSidTabSubfuncAvail: set at pre-compile  # Information whether the DcmDsdSidTabServiceId includes Sub functions or not. Used for the Handling of "suppressPosRspMsgIndicationBit" ISO14229-1 can be referenced here, as this specification gives fix definition, if an SID includes sub-function or not. Effect: ------------------------------------ If this option is set to TRUE, any received sub-function byte of the diagnostic service will be evaluated for the SPRMIB (bit 7). This bit will be masked out, so the later service and sub-service processors will not need to consider it any more. If the SPRMIB information is still needed, it will be accessible through the Dcm_MessageContextType. Constraints: ------------------------------------ Only services with a sub-function shall set this option to TRUE. The Configurator 5 will validate for inappropriate setting of this option, depending on its SID. Dependencies: ------------------------------------ none Runtime effects: ------------------------------------ none Code ROM usage effects: ------------------------------------ none Const data ROM usage effects: ------------------------------------ none Global RAM usage effects: ------------------------------------ none Stack RAM usage effects: ------------------------------------ none
            boolean DcmDsdSidTabServiceDispatcher [0..1]: set at pre-compile, origin=Vector Informatik, default-value=false  # Specifies whether the Dcm shall dispatch between internal and external service handler. Effect: ------------------------------------ If this option is set to TRUE, any received request of the diagnostic service will be dispatched via a call-out. The service processing will then be handled either internally or externally. Constraints: ------------------------------------ Only services that can be externally defined and have an internal service processor shall set this option to TRUE. Dependencies: ------------------------------------ none Runtime effects: ------------------------------------ The Dcm task will have a slightly longer run time at reception of a request, since application call-out is done. This time depends on the complexity of the modeled application service dispatching. Code ROM usage effects: ------------------------------------ The code usage will increase slightly. Const data ROM usage effects: ------------------------------------ The code usage will increase slightly. Global RAM usage effects: ------------------------------------ The RAM usage will increase slightly. Stack RAM usage effects: ------------------------------------ During the service dispatching the stack usage will slightly increase. It will depend on the implementation of the application callback.
            boolean DcmDsdSidTabUsed: set at pre-compile, origin=Vector Informatik, default-value=true  # The parameter can be used to temporarily disable a complete Service in the Dcm configuration without the need to delete all its configuration parameters. Effect: ------------------------------------ If set to FALSE, the Service and all its dependent objects will not be used in the Dcm generated code. Constraints: ------------------------------------ none Dependencies: ------------------------------------ none Runtime effects: ------------------------------------ none Code ROM usage effects: ------------------------------------ If set to FALSE, no data ROM for this Service will be used. Const data ROM usage effects: ------------------------------------ If set to FALSE, no data ROM for this Service will be used in the Dcm configuration sources. Global RAM usage effects: ------------------------------------ none Stack RAM usage effects: ------------------------------------ none
            function name DcmDsdSidTabPreHandler [0..1]: set at pre-compile, origin=Vector Informatik  # Specifies the call out function name for service pre-processing. Effect: ------------------------------------ If this parameter is not empty, the Dcm will call the specified function before processing the service. Constraints: ------------------------------------ none Dependencies: ------------------------------------ none Runtime effects: ------------------------------------ The Dcm task will have a slightly longer run time during the processing of a service, since an application call-out is done. This time depends on the complexity of the modelled application call-out. Code ROM usage effects: ------------------------------------ The code usage will increase slightly. Const data ROM usage effects: ------------------------------------ The code usage will increase slightly. Global RAM usage effects: ------------------------------------ The RAM usage will increase slightly. Stack RAM usage effects: ------------------------------------ During the service processing the stack usage will slightly increase. It will depend on the implementation of the application callback.
            function name DcmDsdSidTabPostHandler [0..1]: set at pre-compile, origin=Vector Informatik  # Specifies the call out function name for service post-processing. Effect: ------------------------------------ If this parameter is not empty, the Dcm will call the specified function after processing the service. Constraints: ------------------------------------ This feature is not allowed for services 0x19 (ReadDTCInformation) and 0x22 (ReadDataByIdentifier) with enabled paged buffer. Dependencies: ------------------------------------ none Runtime effects: ------------------------------------ The Dcm task will have a slightly longer run time during the processing of a service, since an application call-out is done. This time depends on the complexity of the modelled application call-out. Code ROM usage effects: ------------------------------------ The code usage will increase slightly. Const data ROM usage effects: ------------------------------------ The code usage will increase slightly. Global RAM usage effects: ------------------------------------ The RAM usage will increase slightly. Stack RAM usage effects: ------------------------------------ During the service processing the stack usage will slightly increase. It will depend on the implementation of the application callback.
            reference DcmDsdSidTabModeRuleRef [0..1]: set at pre-compile, destination=DcmModeRule  # Defines diagnostic service execution dependency on a specific ECU mode rule (i.e. ECU run-time condition). Effect: ------------------------------------ If any mode rule is referred here, the Dcm will automatically reject any request of this service received while the mode rule condition is not satisfied. Constraints: ------------------------------------ none Dependencies: ------------------------------------ See "destination ref". Runtime effects: ------------------------------------ If a mode rule is used, the Dcm task will have a slightly longer run time at reception of a request. The mode rule evaluation time depends on the complexity of the modeled mode rule condition. Code ROM usage effects: ------------------------------------ If at least one service has mode rule dependency, the code usage will increase slightly. Const data ROM usage effects: ------------------------------------ Refer to DcmDspModeRule description. Global RAM usage effects: ------------------------------------ none Stack RAM usage effects: ------------------------------------ During the mode rule evaluation the stack usage will slightly increase. The more complex and deep rule condition expression nesting, the more stack will be needed.
            reference DcmDsdSidTabSecurityLevelRef [0..*]: set at pre-compile in variant post-build-loadable+pre-compile / post-build in variant post-build-selectable, destination=DcmDspSecurityRow  # Defines diagnostic service execution dependency to a specific security level. Effect: ------------------------------------ If any security access level is referred here, the Dcm will automatically reject any request of this service received while the security level is not unlocked. Constraints: ------------------------------------ none Dependencies: ------------------------------------ See "destination ref". Runtime effects: ------------------------------------ If at least one sub-service has security access level dependency, the Dcm task will have a slightly longer run time at reception of a request. Code ROM usage effects: ------------------------------------ If at least one sub-service has security access level dependency, the code usage will increase slightly. Const data ROM usage effects: ------------------------------------ Refer to DcmDspSecurityRow description. Global RAM usage effects: ------------------------------------ none Stack RAM usage effects: ------------------------------------ none
            reference DcmDsdSidTabSessionLevelRef [0..*]: set at pre-compile in variant post-build-loadable+pre-compile / post-build in variant post-build-selectable, destination=DcmDspSessionRow  # Defines diagnostic service execution dependency to a specific session level. Effect: ------------------------------------ If any session level is referred here, the Dcm will automatically reject any request of this service received while the session level is not active. Constraints: ------------------------------------ none Dependencies: ------------------------------------ See "destination ref". Runtime effects: ------------------------------------ none Code ROM usage effects: ------------------------------------ none Const data ROM usage effects: ------------------------------------ Refer to DcmDspSessionRow description. Global RAM usage effects: ------------------------------------ none Stack RAM usage effects: ------------------------------------ none
            reference DcmDsdSidTabVehicleSystemGroupRef [0..*]: set at pre-compile, origin=Vector Informatik, destination=DcmDspVehicleSystemGroupRow  # Defines diagnostic service availability dependency to a specific VSG. Effect: ------------------------------------ If any VSG is referred here, the Dcm will automatically reject any request of this service received while the VSG is not active. If no VSG reference is defined, Dcm assumes that this service belongs to the base-VSG (i.e. always available). Constraints: ------------------------------------ none Dependencies: ------------------------------------ Reference to a "/Dcm/DcmConfigSet/DcmDsp/DcmDspVehicleSystemGroups/DcmDspVehicleSystemGroupRow" Runtime effects: ------------------------------------ none Code ROM usage effects: ------------------------------------ none Const data ROM usage effects: ------------------------------------ Refer to "/Dcm/DcmConfigSet/DcmDsp/DcmDspVehicleSystemGroups/DcmDspVehicleSystemGroupRow" description. Global RAM usage effects: ------------------------------------ none Stack RAM usage effects: ------------------------------------ none
            reference DcmDsdServiceRoleRef [0..32]: set at pre-compile, origin=Vector Informatik, destination=DcmDspAuthenticationRow  # Reference to DcmDspAuthenticationRow that defines a role in that the service is allowed to be executed. Effect: ------------------------------------ If a role is specified here, the Dcm will automatically reject any request of this service received while the role is not active. Constraints: ------------------------------------ The value has only an effect if '/Dcm/DcmConfigSet/DcmDsd/DcmDsdServiceTable/DcmDsdService' is defined for service 0x29. Dependencies: ------------------------------------ none Runtime effects: ------------------------------------ none Code ROM usage effects: ------------------------------------ none Const data ROM usage effects: ------------------------------------ none Global RAM usage effects: ------------------------------------ none Stack RAM usage effects: ------------------------------------ none
            container DcmDsdSubService [0..*]  # This container contains the configuration (DSD parameters) for sub-services of a diagnostic service. Effect: ------------------------------------ If a certain diagnostic sub-services of a service shall be supported, it has to be declared within this container with all of its properties. Any received diagnostic request with a sub-service ID not declared here, will be rejected by Dcm. Constraints: ------------------------------------ This container exists only if parameter DcmDsdSidTabSubfuncAvail, of this service, is set to TRUE and the parameter DcmDsdSidTabFnc is not existing. Some services are required and must exist, other are optional or no allowed at all. During the configuration the Configurator 5 validators will notify you about wrongly configured or missing service declaration. Dependencies: ------------------------------------ Depending on the service identifier, some "/Dcm/DcmConfigSet/DcmDsp" sub-containers/parameters will be required additionally. Refer to any "/Dcm/DcmConfigSet/DcmDsp" sub-container/parameter for dependencies to this container type. Runtime effects: ------------------------------------ The Dcm sub-service identification runtime will scale linearly with the amount of services specified here. Code ROM usage effects: ------------------------------------ none Const data ROM usage effects: ------------------------------------ The ROM usage of the configuration part of Dcm will scale linearly with the amount of sub-services specified here. Global RAM usage effects: ------------------------------------ none Stack RAM usage effects: ------------------------------------ none
              function name DcmDsdSubServiceFnc [0..1]: set at pre-compile  # Optional callback function of the ECU Supplier specific component. This parameter is related to the interface <Module>_<DiagnosticService>_<SubService>. Effect: ------------------------------------ Dcm implements internally for specific diagnostic services, some specific sub-services. For all other valid sub-services an application function name shall be entered here that will be called by Dcm to handle the concrete sub-service. Constraints: ------------------------------------ The Configurator 5 validators will notify you for any invalid setting on this parameter. Dependencies: ------------------------------------ none Runtime effects: ------------------------------------ none Code ROM usage effects: ------------------------------------ Only application code will be affected. Const data ROM usage effects: ------------------------------------ none Global RAM usage effects: ------------------------------------ none Stack RAM usage effects: ------------------------------------ The required stack size by the Dcm task may increase depending on the implementation of the specified application function.
              integer DcmDsdSubServiceId: 0..255, set at pre-compile  # Specifies the value of the sub-service identifier. The possible sub-function parameter value are predefined in the ISO 14229-1, ISO 15031-5 and can be restricted OEM. Effect: ------------------------------------ Dcm will identify only those sub-services of the corresponding diagnostic service that are defined here. Constraints: ------------------------------------ All allowed and supported sub-function identifiers are validated during the configuration time. The valid values are diagnostic protocol, diagnostic service and OEM specific. Dependencies: ------------------------------------ none Runtime effects: ------------------------------------ none Code ROM usage effects: ------------------------------------ none Const data ROM usage effects: ------------------------------------ none Global RAM usage effects: ------------------------------------ none Stack RAM usage effects: ------------------------------------ none
              reference DcmDsdSubServiceModeRuleRef [0..1]: set at pre-compile, destination=DcmModeRule  # Defines diagnostic sub-service execution dependency on a specific ECU mode rule (i.e. ECU run-time condition). Effect: ------------------------------------ If any mode rule is referred here, the Dcm will automatically reject any request of this sub-service received while the mode rule condition is not satisfied. Constraints: ------------------------------------ none Dependencies: ------------------------------------ Reference to a DcmDspModeRule. Runtime effects: ------------------------------------ If a mode rule is used, the Dcm task will have a slightly longer run time at reception of a request. The mode rule evaluation time depends on the complexity of the modeled mode rule condition. Code ROM usage effects: ------------------------------------ If at least one sub-service has mode rule dependency, the code usage will increase slightly. Const data ROM usage effects: ------------------------------------ Refer to DcmDspModeRule description. Global RAM usage effects: ------------------------------------ none Stack RAM usage effects: ------------------------------------ During the mode rule evaluation the stack usage will slightly increase. The more complex and deep rule condition expression nesting, the more stack will be needed.
              reference DcmDsdSubServiceSecurityLevelRef [0..*]: set at pre-compile in variant post-build-loadable+pre-compile / post-build in variant post-build-selectable, destination=DcmDspSecurityRow  # Defines diagnostic sub-service execution dependency to a specific security level. Effect: ------------------------------------ If any security access level is referred here, the Dcm will automatically reject any request of this sub-service received while the security level is not unlocked. Constraints: ------------------------------------ none Dependencies: ------------------------------------ Reference to a DcmDspSecurityRow. Runtime effects: ------------------------------------ If at least one sub-service has security access level dependency, the Dcm task will have a slightly longer run time at reception of a request. Code ROM usage effects: ------------------------------------ If at least one sub-service has security access level dependency, the code usage will increase slightly. Const data ROM usage effects: ------------------------------------ Refer to DcmDspSecurityRow description. Global RAM usage effects: ------------------------------------ none Stack RAM usage effects: ------------------------------------ none
              reference DcmDsdSubServiceSessionLevelRef [0..*]: set at pre-compile in variant post-build-loadable+pre-compile / post-build in variant post-build-selectable, destination=DcmDspSessionRow  # Defines diagnostic sub-service execution dependency to a specific session level. Effect: ------------------------------------ If any session level is referred here, the Dcm will automatically reject any request of this sub-service received while the session level is not active. Constraints: ------------------------------------ none Dependencies: ------------------------------------ Reference to a DcmDspSessionRow. Runtime effects: ------------------------------------ none Code ROM usage effects: ------------------------------------ none Const data ROM usage effects: ------------------------------------ Refer to DcmDspSessionRow description. Global RAM usage effects: ------------------------------------ none Stack RAM usage effects: ------------------------------------ none
              reference DcmDsdSubServiceVehicleSystemGroupRef [0..*]: set at pre-compile, origin=Vector Informatik, destination=DcmDspVehicleSystemGroupRow  # Defines diagnostic sub-service availability dependency to a specific VSG. Effect: ------------------------------------ If any VSG is referred here, the Dcm will automatically reject any request of this sub-service received while the VSG is not active. If no VSG reference is defined, Dcm assumes that this sub-service belongs to the base-VSG (i.e. always available). Constraints: ------------------------------------ none Dependencies: ------------------------------------ Reference to a "/Dcm/DcmConfigSet/DcmDsp/DcmDspVehicleSystemGroups/DcmDspVehicleSystemGroupRow" Runtime effects: ------------------------------------ none Code ROM usage effects: ------------------------------------ none Const data ROM usage effects: ------------------------------------ Refer to "/Dcm/DcmConfigSet/DcmDsp/DcmDspVehicleSystemGroups/DcmDspVehicleSystemGroupRow" description. Global RAM usage effects: ------------------------------------ none Stack RAM usage effects: ------------------------------------ none
              reference DcmDsdSubServiceRoleRef [0..32]: set at pre-compile, origin=Vector Informatik, destination=DcmDspAuthenticationRow  # Reference to DcmDspAuthenticationRow that defines a role in that the service with this subfunction is allowed to be executed. Effect: ------------------------------------ If a role is specified here, the Dcm will automatically reject any request of this sub-service received while the role is not active. Constraints: ------------------------------------ The value has only an effect if '/Dcm/DcmConfigSet/DcmDsd/DcmDsdServiceTable/DcmDsdService' is defined for service 0x29. Dependencies: ------------------------------------ none Runtime effects: ------------------------------------ none Code ROM usage effects: ------------------------------------ none Const data ROM usage effects: ------------------------------------ none Global RAM usage effects: ------------------------------------ none Stack RAM usage effects: ------------------------------------ none
      container DcmDsl  # These parameters apply to a Diagnostic Session Layer. There may be a parameter set (DSL Configuration) per protocol.
        container DcmDslBuffer [1..256]  # This container contains the configuration (parameters) for the diagnostic buffer.
          integer DcmDslBufferSize: 8..4294967294, set at pre-compile, default-value=50  # Specifies the size of a diagnostic buffer (in Bytes). Effect: ------------------------------------ Determines the longest request and in some cases - response the Dcm will be able to receive, resp. transmit. Constraints: ------------------------------------ It depends on the communication bus system how much buffer shall be reserved. Dependencies: ------------------------------------ In case of Paged Buffer usage (refer to DcmPageBufferCfg), the buffer size shall be chosen such that at least the longest snapshot record/extended data record of the Dem plus some additional bytes (i.e. in case of CAN -> 6 additional bytes) will fit it. Runtime effects: ------------------------------------ none Code ROM usage effects: ------------------------------------ none Const data ROM usage effects: ------------------------------------ none Global RAM usage effects: ------------------------------------ The greater the buffer the more RAM will be required. Stack RAM usage effects: ------------------------------------ none
        container DcmDslCallbackDCMRequestService [0..*]  # The name of the container will specify the SWC name of the "StartProtocol" notification function. Effect: ----------------------------------------- For each available container of this type, there will be a notification call into the corresponding SWC for getting permission of received protocol start/switch. Constraints: ----------------------------------------- Has effect only if there are more than one protocols configured in DCM. Dependencies: ----------------------------------------- Configuration parameters: /Dcm/DcmConfigSet/DcmDsl/DcmDslProtocol/DcmDslProtocolRow" Runtime effects: ----------------------------------------- Enabling this feature will increase the Dcm task time at any protocol switch (e.g. no protocol-> UDS -> OBD, etc.). Code ROM usage effects: ------------------------------------ Enabling this feature leads to a minor increase of the Dcm static code ROM usage. Const data ROM usage effects: ----------------------------------------- Enabling this feature increases the Dcm configuration ROM usage. The usage scales linearly with the amount of SWCs to be notified. Global RAM usage effects: ----------------------------------------- none Stack RAM usage effects: ----------------------------------------- Enabling this feature can lead to a insignificant increased stack size required by the Dcm_MainFunction.
          boolean DcmDslCallbackDCMRequestServiceUsePort [0..1]: set at pre-compile, origin=Vector Informatik, default-value=true  # Defines which kind of interface shall be used to access the application. Effect: ------------------------------------ Depending on the selected type, either a RTE call or a call out will be required to be implemented in the Dcm application. Constraints: ------------------------------------ none Dependencies: ------------------------------------ The function names generated in case of FALSE will depend on the function name parameter. Runtime effects: ------------------------------------ none Code ROM usage effects: ------------------------------------ none Const data ROM usage effects: ------------------------------------ none Global RAM usage effects: ------------------------------------ none Stack RAM usage effects: ------------------------------------ none
          function name DcmDslCallbackDCMRequestServiceStartFnc [0..1]: set at pre-compile, origin=Vector Informatik  # Specifies the call out function name for notification call. Effect: ------------------------------------ If this parameter is not empty, the Dcm will call the specified function on each received diagnostic request. Constraints: ------------------------------------ none Dependencies: ------------------------------------ Has effect only if: - the DcmDslCallbackDCMRequestServiceUsePort is set to FALSE. Runtime effects: ------------------------------------ none Code ROM usage effects: ------------------------------------ none Const data ROM usage effects: ------------------------------------ none Global RAM usage effects: ------------------------------------ none Stack RAM usage effects: ------------------------------------ none
        container DcmDslDiagResp  # This container contains the configuration (parameters) for the ResponsePending handling
          integer DcmDslDiagRespMaxNumRespPend: 0..255, set at pre-compile, default-value=0  # Specifies the maximum number of negative responses with response code 0x78 (requestCorrectlyReceived-ResponsePending) allowed per request. Effect: ------------------------------------ If set to a value > 0: Dcm will cancel any ongoing diagnostic service processing and send a negative response with response code 0x10 (generalReject), in case the limit value gets reached. If set to 0: no limitation will apply. The DCM will wait endlessly for the application to finish its job. Constraints: ------------------------------------ none Dependencies: ------------------------------------ none Runtime effects: ------------------------------------ none Code ROM usage effects: ------------------------------------ If the limitation is enabled (value > 0), the Dcm code usage will slightly increase due to the additional functionality. Const data ROM usage effects: ------------------------------------ none Global RAM usage effects: ------------------------------------ If the limitation is enabled (value > 0), the Dcm RAM usage will insignificantly increase due to the additional functionality. Stack RAM usage effects: ------------------------------------ none
          boolean DcmDslDiagRespOnSecondDeclinedRequest: set at pre-compile, default-value=false  # Defines the reaction upon a second request (ClientB) that can not be processed (e.g. due to priority assessment). Effect: ------------------------------------ If enabled, the Dcm will reject any nested diagnostic request by NRC 0x21 (BusyRepeatRequest). Constraints: ------------------------------------ For optimization reasons not all Dcm managed connection will support this feature by default. It is configurable how many parallel (nested) request to be handled at a time to save RAM and run time resources. Dependencies: ------------------------------------ Refer to DcmDslDiagRespMaxNumOfDeclinedRequests. Runtime effects: ------------------------------------ If enabled the Dcm diagnostic request reception functionality will have slightly increased run time usage. Code ROM usage effects: ------------------------------------ If enabled the Dcm will have slightly increased code ROM usage. Const data ROM usage effects: ------------------------------------ none Global RAM usage effects: ------------------------------------ If enabled the Dcm will have slightly increased RAM usage. Stack RAM usage effects: ------------------------------------ If enabled the Dcm will have insignificantly increased stack usage within the Rx ISRs.
          integer DcmDslDiagRespMaxNumOfDeclinedRequests: 1..255, set at pre-compile, origin=Vector Informatik, default-value=3  # Defines the maximum number of reactions upon a second request (ClientB) that can not be processed (e.g. due to priority assessment). Effect: ------------------------------------ The Dcm will calculate the required amount of resources upon the specified by this option resource for parallel client processing. Constraints: ------------------------------------ If the amount of configured requests exceeds the total number of Dcm connections, during the code generation the resource usage optimization will be disabled and only as many as available diagnostic connection objects will be allocated. This will also shorten the run time usage (see below). Dependencies: ------------------------------------ Has any effect only if DcmDslDiagRespOnSecondDeclinedRequest is enabled. Runtime effects: ------------------------------------ The more clients to be handled the longer the run time for looking up for free resources. If the number of declined requests matches the total number of Dcm connection, no look up will be necessary, and the run time will be minimal. Code ROM usage effects: ------------------------------------ If the number of declined requests matches the total number of Dcm connection, no look up will be necessary, and the code ROM will be minimal. Const data ROM usage effects: ------------------------------------ none Global RAM usage effects: ------------------------------------ The more clients to be handled the more RAM will be required for handling them. Stack RAM usage effects: ------------------------------------ If the number of declined requests matches the total number of Dcm connection, no look up will be necessary, and the stack usage will be minimal.
          integer DcmDslDiagRespPeriodicMsgPaddingPattern [0..1]: 0..255, set at pre-compile, origin=Vector Informatik, default-value=0  # Determines the padding byte value for the unused data bytes in the periodic message Effect: ------------------------------------ If this parameter does not exist, no padding will apply, and the periodic message will have the length of the data to be sent. If this parameter exists, the periodic message will always have the maximum length of the UUDT CAN frame (8 bytes). All unused data will be filled with the pattern specified by this parameter value. Constraints: ------------------------------------ none Dependencies: ------------------------------------ If "/Dcm/DcmConfigSet/DcmDsd/DcmDsdServiceTable/DcmDsdService" is defined for service 0x2A. Runtime effects: ------------------------------------ If padding is to be supported the periodic message transmission will always take constant run time for copying the data. Due to the additional loop needed for filling up the data, the run time usage will be increased insignificantly. Code ROM usage effects: ------------------------------------ If padding is to be supported additional loop will be executed to fill up the unused data bytes with the pattern value. This increases insignificantly the code ROM usage. Const data ROM usage effects: ------------------------------------ none Global RAM usage effects: ------------------------------------ none Stack RAM usage effects: ------------------------------------ none
        container DcmDslProtocol  # This container contains the configuration (parameters) for the protocol configuration (for each protocol) The following parameters needs to be configured per protocol.
          container DcmDslProtocolRow [1..*]: post-build-changeable=true  # Definition of a single Row of configuration for the protocol configuration (for each protocol)
            boolean DcmDslProtocolEndiannessConvEnabled: set at pre-compile, default-value=false  # NOT USED
            enumeration DcmDslProtocolID: {DCM_OBD_ON_CAN, DCM_OBD_ON_FLEXRAY, DCM_OBD_ON_IP, DCM_PERIODICTRANS_ON_IP, DCM_PERIODIC_ON_CAN, DCM_PERIODIC_ON_FLEXRAY, DCM_ROE_ON_CAN, DCM_ROE_ON_FLEXRAY, DCM_ROE_ON_IP, DCM_SUPPLIER_1, DCM_SUPPLIER_10, DCM_SUPPLIER_11, DCM_SUPPLIER_12, DCM_SUPPLIER_13, DCM_SUPPLIER_14, DCM_SUPPLIER_15, DCM_SUPPLIER_2, DCM_SUPPLIER_3, DCM_SUPPLIER_4, DCM_SUPPLIER_5, DCM_SUPPLIER_6, DCM_SUPPLIER_7, DCM_SUPPLIER_8, DCM_SUPPLIER_9, DCM_UDS_ON_CAN, DCM_UDS_ON_FLEXRAY, DCM_UDS_ON_IP}, set at post-build in variant post-build-loadable+post-build-selectable / pre-compile in variant pre-compile, symbolic-name-value=true, default-value=DCM_UDS_ON_CAN  # Specifies the diagnostic protocol type the Dcm shall manage. Effect: ------------------------------------ On a multi protocol configuration Dcm will be able to distinguish among different protocols and notify the application for activation/deactivation of a concrete protocol, specified by this parameter. Constraints: ------------------------------------ none Dependencies: ------------------------------------ Has any effect only if multi protocol configuration is used. Runtime effects: ------------------------------------ none Code ROM usage effects: ------------------------------------ none Const data ROM usage effects: ------------------------------------ none Global RAM usage effects: ------------------------------------ none Stack RAM usage effects: ------------------------------------ none
            integer DcmDslProtocolMaximumResponseSize [0..1]: 1..65535, set at post-build in variant post-build-loadable+post-build-selectable / pre-compile in variant pre-compile, origin=Vector Informatik, default-value=4095  # This parameter is mandatory and defines the maximum length of the response message if a PagedBuffer (/MICROSAR/Dcm/DcmConfigSet/DcmDsp/DcmDspReadPagedDataPageSize) is configured. Note: The maximum length of the response is not checked in case of a ReadDTCInformation request
            float DcmDslProtocolPreemptTimeout: 0..1000, set at post-build in variant post-build-loadable+post-build-selectable / pre-compile in variant pre-compile, default-value=0  # NOT USED
            integer DcmDslProtocolPriority: 0..255, set at post-build in variant post-build-loadable+post-build-selectable / pre-compile in variant pre-compile, default-value=0  # Specifies the diagnostic protocol priority the Dcm shall manage. Effect: ------------------------------------ On a multi protocol configuration Dcm will be able to distinguish among different protocols and preempt lower priority protocols by higher priority ones (e.g. interrupt UDS protocol by an OBD request). Values: 0 - highest priority protocol 1..Max-1 - lower priority protocol Max - lowest priority protocol Constraints: ------------------------------------ none Dependencies: ------------------------------------ Has any effect only if multi protocol configuration is used. Runtime effects: ------------------------------------ On multi protocol configurations additional code for the protocol arbitration will be enabled in DCM. This will slightly increase the run time of the first Dcm_MainFunction call each time a new request is received, Code ROM usage effects: ------------------------------------ On multi protocol configurations additional code for the protocol arbitration will be enabled in DCM. This will increase the code ROM usage, Const data ROM usage effects: ------------------------------------ none Global RAM usage effects: ------------------------------------ On multi protocol configurations usually there are multiple buffers configured and assigned to each protocol. This increases the global RAM usage, Stack RAM usage effects: ------------------------------------ none
            enumeration DcmDslProtocolTransType [0..1]: {TYPE1, TYPE2}, set at post-build in variant post-build-loadable+post-build-selectable / pre-compile in variant pre-compile, default-value=TYPE1  # NOT USED
            boolean DcmSendRespPendOnTransToBoot: set at post-build in variant post-build-loadable+post-build-selectable / pre-compile in variant pre-compile, default-value=true  # NOT USED Replaced by parameter DcmSendRespPendOnRestart.
            float DcmTimStrP2ServerAdjust: 0..1000, set at post-build in variant post-build-loadable+post-build-selectable / pre-compile in variant pre-compile, default-value=0  # This parameter is used to guarantee that the DCM response is available on the bus before reaching P2.This parameter value in seconds has to be configured as a multiple of DcmTaskTime. Effect: ------------------------------------ The time specified here will be subtracted from the P2server time of the currently active session. The result will be used by Dcm for triggering the first RCR-RP response after a successful diagnostic request reception. Constraints: ------------------------------------ This time shall not be greater than the minimum P2server time of any diagnostic session. Dependencies: ------------------------------------ - refer to the: "/Dcm/DcmConfigSet/DcmDsp/DcmDspSession/DcmDspSessionRow/DcmDspSessionP2ServerMax" Runtime effects: ------------------------------------ none Code ROM usage effects: ------------------------------------ none Const data ROM usage effects: ------------------------------------ none Global RAM usage effects: ------------------------------------ none Stack RAM usage effects: ------------------------------------ none
            float DcmTimStrP2StarServerAdjust: 0..5000, set at post-build in variant post-build-loadable+post-build-selectable / pre-compile in variant pre-compile, default-value=0  # This parameter is used to guarantee that the DCM response is available on the bus before reaching P2*.This parameter value in seconds has to be configured as multiple of DcmTaskTime and is minimum in the timing handling of P2*. Effect: ------------------------------------ The time specified here will be subtracted from the P2StarServer time of the currently active session. The result will be used by Dcm for triggering the second and further RCR-RP responses. Constraints: ------------------------------------ This time shall not be greater than the minimum P2StarServer time of any diagnostic session. Dependencies: ------------------------------------ - refer to the: "/Dcm/DcmConfigSet/DcmDsp/DcmDspSession/DcmDspSessionRow/DcmDspSessionP2StarServerMax" Runtime effects: ------------------------------------ none Code ROM usage effects: ------------------------------------ none Const data ROM usage effects: ------------------------------------ none Global RAM usage effects: ------------------------------------ none Stack RAM usage effects: ------------------------------------ none
            boolean DcmSendRespPendOnRestart: set at post-build in variant post-build-loadable+post-build-selectable / pre-compile in variant pre-compile, origin=Vector Informatik, default-value=true  # Specifies whether the Dcm shall send a RCR-RP response prior jumping to the boot loader/restarting the Ecu or not. Effect: ------------------------------------ If set to TRUE, the Dcm will send a RCR-RP response prior jumping to the boot loader on diagnostic service 0x10 0x02 (enter programming session) or prior to an Ecu reset on diagnostic service 0x11 (0x01 - 0x03). Constraints: ------------------------------------ none Dependencies: ------------------------------------ Service 0x10: This parameter has no effect if none of the diagnostic session specified in DcmDspSessionRow has any boot type other than NO_BOOT. Refer to /Dcm/DcmConfigSet/DcmDsp/DcmDspSession/DcmDspSessionRow/DcmDspSessionForBoot. Service 0x11: This parameter has no effect if none of the sub-services 0x01 - 0x03 of diagnostic service 0x11 (EcuReset) are configured. Runtime effects: ------------------------------------ none Code ROM usage effects: ------------------------------------ none Const data ROM usage effects: ------------------------------------ none Global RAM usage effects: ------------------------------------ none Stack RAM usage effects: ------------------------------------ none
            reference DcmDslProtocolRxBufferID: set at post-build in variant post-build-loadable+post-build-selectable / pre-compile in variant pre-compile, destination=DcmDslBuffer  # Link to buffer configuration for configuration of protocol buffer used for request receptions. Effect: ------------------------------------ The Dcm will use this buffer for writing the request data. Constraints: ------------------------------------ This reference target must be the same buffer used for the diagnostic responses (refer to DcmDslProtocolTxBufferID); Dependencies: ------------------------------------ Refer to DcmDslBuffer. Runtime effects: ------------------------------------ none Code ROM usage effects: ------------------------------------ none Const data ROM usage effects: ------------------------------------ none Global RAM usage effects: ------------------------------------ none Stack RAM usage effects: ------------------------------------ none
            reference DcmDslProtocolSIDTable: set at post-build in variant post-build-loadable+post-build-selectable / pre-compile in variant pre-compile, destination=DcmDsdServiceTable  # Specifies the diagnostic services that a diagnostic protocol may address. Effect: ------------------------------------ On a multi protocol configuration Dcm will be able to distinguish among different protocols and provide a firewall functionality for the diagnostic clients assigned to these protocols. With this configuration parameter, you can assign all services that the clients using this protocol shall be able to address. E.g. an OBD tester shall only be able to access the OBD services, but not the UDS ones. Then the OBD protocol row shall refer with this parameter the service table that contains only the OBD services. A UDS tester might need to address both UDS and OBD services. Then the UDS protocol row shall refer to a service table that contains both OBD and UDS services. Constraints: ------------------------------------ none Dependencies: ------------------------------------ Refers to a specific /Dcm/DcmConfigSet/DcmDsd/DcmDsdServiceTable. Runtime effects: ------------------------------------ If there is only one service table in the configuration, there will be no run-time overhead in comparison to a single protocol configuration. If there are multiple diagnostic service tables used, then the Dcm_MainFunction runtime will slightly increase each time a protocol switch takes place, Code ROM usage effects: ------------------------------------ If there is only one service table in the configuration, there will be no additional code ROM needed in comparison to a single protocol configuration. If there are multiple diagnostic service tables used, then the DCM code ROM usage will slightly increase. Const data ROM usage effects: ------------------------------------ If there is only one service table in the configuration, there will be no additional constant ROM needed in comparison to a single protocol configuration. If there are multiple diagnostic service tables used, then the DCM configuration ROM usage will slightly increase. Global RAM usage effects: ------------------------------------ If there is only one service table in the configuration, there will be no additional RAM needed in comparison to a single protocol configuration. If there are multiple diagnostic service tables used, then the DCM global RAM usage will slightly increase. Stack RAM usage effects: ------------------------------------ none
            reference DcmDslProtocolSessionRef [0..0]: set at post-build in variant post-build-loadable+post-build-selectable / pre-compile in variant pre-compile, destination=DcmDspSession  # NOT USED
            reference DcmDslProtocolTxBufferID: set at post-build in variant post-build-loadable+post-build-selectable / pre-compile in variant pre-compile, destination=DcmDslBuffer  # Link to buffer configuration for configuration of protocol buffer used for response transmissions. Effect: ------------------------------------ The Dcm will use this buffer for writing the response data. Constraints: ------------------------------------ This reference target must be the same buffer used for the diagnostic requests (refer to DcmDslProtocolRxBufferID); Dependencies: ------------------------------------ Refer to DcmDslBuffer. Runtime effects: ------------------------------------ none Code ROM usage effects: ------------------------------------ none Const data ROM usage effects: ------------------------------------ none Global RAM usage effects: ------------------------------------ none Stack RAM usage effects: ------------------------------------ none
            symbolic name reference DcmDemClientRef [0..1]: set at pre-compile, origin=Vector Informatik, destination=DemClient  # The DcmDemClientRef is a uniqe identifier that is assigned to every instance that uses DEM APIs. Effect: ------------------------------------ The identifier refers to a communication with a specific DEM API instance and is used to associate consecutive requests. Constraints: ------------------------------------ This parameter is only required if DEM version, specified in /Dcm/DcmConfigSet/DcmGeneral/DcmDemApiVersion, is 4.3.0 or later. Dependencies: ------------------------------------ - refers to: "Dem/DemGeneral/DemClient" - requires DEM version 4.3.0 or later (specified in /Dcm/DcmConfigSet/DcmGeneral/DcmDemApiVersion) Runtime effects: ------------------------------------ none Code ROM usage effects: ------------------------------------ none Const data ROM usage effects: ------------------------------------ none Global RAM usage effects: ------------------------------------ none Stack RAM usage effects: ------------------------------------ none
            choice container DcmDslConnection [1..*]: post-build-changeable=true  # This container contains links between Diagnostic Protocol (=DcmDslProtocolRow) and the according Rx or Tx channel.
              container DcmDslMainConnection [0..1]: post-build-changeable=true  # This container contains configuration for Diagnostic Main Connection
                integer DcmDslProtocolRxTesterSourceAddr: 0..65535, set at post-build in variant post-build-loadable+post-build-selectable / pre-compile in variant pre-compile  # Specifies a unique identifier of a diagnostic client connection. This value is an abstract identifier and does not need to be a real source address. Effect: ------------------------------------ The Dcm is able to identify different clients or the same client on multiple channels using this identifier. Constraints: ------------------------------------ For each DcmDslConnection there shall be a unique value assigned to this parameter. Dependencies: ------------------------------------ none Runtime effects: ------------------------------------ none Code ROM usage effects: ------------------------------------ none Const data ROM usage effects: ------------------------------------ none Global RAM usage effects: ------------------------------------ none Stack RAM usage effects: ------------------------------------ none
                integer DcmDslPhysicalEcuAddress [0..1]: 0..65535, set at post-build in variant post-build-loadable+post-build-selectable / pre-compile in variant pre-compile, origin=Vector Informatik, default-value=0  # Specifies the ECU address from the concrete client connection. Effect: ------------------------------------ The Dcm is able to identify different multiple ECUs addressed from a diagnostic client. Constraints: ------------------------------------ For single ECU use case: For each DcmDslConnection there shall be the same value assigned to this parameter. For virtual ECU use case: For each DcmDslConnection there shall be set the appropriate value of the concrete virtual ECU. Dependencies: ------------------------------------ none Runtime effects: ------------------------------------ For virtual ECU use case the number of supported ECUs will determine the run time during diagnostic client request reception. Code ROM usage effects: ------------------------------------ For virtual ECU use case the code ROM usage is slightly increased. Const data ROM usage effects: ------------------------------------ For virtual ECU use case the data ROM usage is slightly increased. Global RAM usage effects: ------------------------------------ none Stack RAM usage effects: ------------------------------------ none
                enumeration DcmDslAddressingType [0..1]: {DCM_NET_ADDR_NORMAL, DCM_NET_ADDR_EXTENDED, DCM_NET_ADDR_MIXED_11, DCM_NET_ADDR_NORMAL_FIXED}, set at post-build in variant post-build-loadable+post-build-selectable / pre-compile in variant pre-compile, origin=Vector Informatik, default-value=DCM_NET_ADDR_NORMAL  # Specifies the address type for a concrete diagnostic client connection. Effect: ------------------------------------ The Dcm is able to identify the addressing type of a certain diagnostic connection. Constraints: ------------------------------------ none Dependencies: ------------------------------------ none Runtime effects: ------------------------------------ It depends on the addressing type and the concrete implementation in DCM. Code ROM usage effects: ------------------------------------ It depends on the addressing type and the concrete implementation in DCM. Const data ROM usage effects: ------------------------------------ It depends on the addressing type and the concrete implementation in DCM. Global RAM usage effects: ------------------------------------ none Stack RAM usage effects: ------------------------------------ none
                integer DcmDslProtocolRxConnectionId: 0..65535, set at post-build in variant post-build-loadable+post-build-selectable / pre-compile in variant pre-compile, origin=Vector Informatik  # Unique identifier of the tester which uses this connection for diagnostic communication. Effect: ------------------------------------ Using this value Dcm is able to distinguish the different main connections. Constraints: ------------------------------------ The connection Id value must be unique within a DcmConfigset. Dependencies: ------------------------------------ none Runtime effects: ------------------------------------ none Code ROM usage effects: ------------------------------------ none Const data ROM usage effects: ------------------------------------ none Global RAM usage effects: ------------------------------------ none Stack RAM usage effects: ------------------------------------ none
                boolean DcmDslChannelReadyIndicationEnabled [0..1]: set at post-build in variant post-build-loadable+post-build-selectable / pre-compile in variant pre-compile, origin=Vector Informatik, default-value=false  # Choose whether Dcm shall use a callout to determine the readiness of the current connection for message transmission or not. Effect: ------------------------------------ By using this value, Dcm will wait for DoIP until notified about an established connection before sending a final response after reset. Constraints: ------------------------------------ none Dependencies: ------------------------------------ none Runtime effects: ------------------------------------ The Dcm task will have a slightly longer run time at transmission of a response, since call-out is done. Code ROM usage effects: ------------------------------------ none Const data ROM usage effects: ------------------------------------ none Global RAM usage effects: ------------------------------------ none Stack RAM usage effects: ------------------------------------ none
                reference DcmDslPeriodicTranmissionConRef [0..1]: set at post-build in variant post-build-loadable+post-build-selectable / pre-compile in variant pre-compile, destination=DcmDslPeriodicTransmission  # Refers to the client specific periodic message transmission connection pool. Effect: ------------------------------------ If this parameter exists, the DCM will be able to send periodic responses to the client identified by the main connection. Constraints: ------------------------------------ This parameter shall be used only if service 0x2A (ReadDataByPeriodicIdentifier) is to be supported. Dependencies: ------------------------------------ The diagnostic service 0x2A (ReadDataByPeriodicIdentifier) must be supported by Dcm (refer to /Dcm/DcmConfigSet/DcmDsd/DcmDsdServiceTable/DcmDsdService) Runtime effects: ------------------------------------ none Code ROM usage effects: ------------------------------------ Due to the additional functionality to be supported by Dcm, the code ROM usage will increase slightly. Const data ROM usage effects: ------------------------------------ Due to the additional information to be stored the Dcm configuration ROM usage will increase. Global RAM usage effects: ------------------------------------ none Stack RAM usage effects: ------------------------------------ none
                reference DcmDslROEConnectionRef [0..0]: set at post-build in variant post-build-loadable+post-build-selectable / pre-compile in variant pre-compile, destination=DcmDslResponseOnEvent  # NOT USED
                container DcmDslProtocolRx [1..*]: post-build-changeable=true  # This container describes a single Dcm logical receive PDU. Effect: ------------------------------------ For each defined DcmDslProtocolRx, the Dcm will be able to receive a diagnostic request. Constraints: ------------------------------------ none Dependencies: ------------------------------------ none Runtime effects: ------------------------------------ none Code ROM usage effects: ------------------------------------ none Const data ROM usage effects: ------------------------------------ The Dcm configuration ROM usage scales straight proportionally with the number of Dcm receive PDUs. Global RAM usage effects: ------------------------------------ none Stack RAM usage effects: ------------------------------------ none
                  enumeration DcmDslProtocolRxAddrType: {DCM_FUNCTIONAL_TYPE, DCM_PHYSICAL_TYPE}, set at post-build in variant post-build-loadable+post-build-selectable / pre-compile in variant pre-compile  # Specifies the request addressing type on a concrete receive Dcm PduId. Effect: ------------------------------------ Depending on the request type specified here, the Dcm will be able to react correctly according to the ISO14229-1. Constraints: ------------------------------------ none Dependencies: ------------------------------------ none Runtime effects: ------------------------------------ none Code ROM usage effects: ------------------------------------ none Const data ROM usage effects: ------------------------------------ none Global RAM usage effects: ------------------------------------ none Stack RAM usage effects: ------------------------------------ none
                  integer DcmDslProtocolRxChannelId: 0..255, set at post-build in variant post-build-loadable+post-build-selectable / pre-compile in variant pre-compile, default-value=0  # NOT USED
                  integer DcmDslProtocolRxPduId: 0..65535, set at pre-compile, symbolic-name-value=true, default-value=0  # Specifies the logical handle value of a concrete Dcm receive PDU. NOTE: This value is generated automatically by the Configurator 5 tool. Effect: ------------------------------------ Using this value Dcm is able to distinguish the different transport layer connections. Constraints: ------------------------------------ none Dependencies: ------------------------------------ none Runtime effects: ------------------------------------ none Code ROM usage effects: ------------------------------------ none Const data ROM usage effects: ------------------------------------ none Global RAM usage effects: ------------------------------------ none Stack RAM usage effects: ------------------------------------ none
                  integer DcmDslProtocolRxTpRxPduId [0..1]: 0..65535, set at post-build in variant post-build-loadable+post-build-selectable / pre-compile in variant pre-compile, origin=Vector Informatik, default-value=0  # Specifies the corresponding TP RxPduId for a concrete client connection request message. Effect: ------------------------------------ In some situations DCM shall be able to convert TpRxPduIds to DcmRxPduIds. Constraints: ------------------------------------ Use case driven parameter usage. See technical reference if or when this parameter is required in your project. Dependencies: ------------------------------------ Project specific. Runtime effects: ------------------------------------ Project specific. Code ROM usage effects: ------------------------------------ If this parameter values are used, the code ROM usage will slightly increase. Const data ROM usage effects: ------------------------------------ If this parameter values are used, the data ROM usage will slightly increase. Global RAM usage effects: ------------------------------------ none Stack RAM usage effects: ------------------------------------ none
                  integer DcmDslProtocolRxGlobalEcuAddress [0..1]: 0..65535, set at pre-compile in variant post-build-loadable+pre-compile / post-build in variant post-build-selectable, origin=Vector Informatik, default-value=0  # NOT USED
                  reference DcmDslProtocolRxPduRef: set at post-build in variant post-build-loadable+post-build-selectable / pre-compile in variant pre-compile, destination=Pdu  # Links a logical Dcm receive PduId with a concrete Dcm receive PDU. Effect: ------------------------------------ This setting connects the Dcm to the outside world. Constraints: ------------------------------------ Only receive PDUs for the ECU diagnostics shall be assigned here. The same receive PDU shall not be used again in other Dcm connections. Dependencies: ------------------------------------ none Runtime effects: ------------------------------------ none Code ROM usage effects: ------------------------------------ none Const data ROM usage effects: ------------------------------------ none Global RAM usage effects: ------------------------------------ none Stack RAM usage effects: ------------------------------------ none
                  symbolic name reference DcmDslProtocolRxComMChannelRef: set at post-build in variant post-build-loadable+post-build-selectable / pre-compile in variant pre-compile, destination=ComMChannel  # Dsl Protocol Rx ComM Channel Ref | Links a specific ComMChannel with a Dcm logical receive PduId. Effect: ------------------------------------ With this parameter the Dcm will be able to keep the communication on the specified ComMChannel awake as required by AR 4 DCM SWS. Constraints: ------------------------------------ The ComMChannel shall be exactly the one that corresponds to the communication channel on which the PDU linked in DcmDslProtocolRxPduRef is to be received. Dependencies: ------------------------------------ Refer to: /Dcm/DcmConfigSet/DcmDsl/DcmDslProtocol/DcmDslProtocolRow/DcmDslConnection/DcmDslMainConnection/DcmDslProtocolRx/DcmDslProtocolRxPduRef Runtime effects: ------------------------------------ none Code ROM usage effects: ------------------------------------ none Const data ROM usage effects: ------------------------------------ none Global RAM usage effects: ------------------------------------ none Stack RAM usage effects: ------------------------------------ none
                container DcmDslProtocolTx [0..1]: post-build-changeable=true  # This container describes a single Dcm logical transmit PDU. Effect: ------------------------------------ If DcmDslProtocolTx is defined, the Dcm will be able to respond to a diagnostic request on the associated main-connection. Constraints: ------------------------------------ none Dependencies: ------------------------------------ none Runtime effects: ------------------------------------ none Code ROM usage effects: ------------------------------------ none Const data ROM usage effects: ------------------------------------ The Dcm configuration ROM usage scales straight proportionally with the number of Dcm transmit PDUs. Global RAM usage effects: ------------------------------------ none Stack RAM usage effects: ------------------------------------ none
                  integer DcmDslTxConfirmationPduId: 0..65535, set at pre-compile, symbolic-name-value=true, default-value=0  # Specifies the logical handle value of a concrete Dcm transmit PDU. NOTE: This value is generated automatically by the Configurator 5 tool. Effect: ------------------------------------ Using this value Dcm is able to distinguish the different transport layer connections at response confirmation time. Constraints: ------------------------------------ none Dependencies: ------------------------------------ none Runtime effects: ------------------------------------ none Code ROM usage effects: ------------------------------------ none Const data ROM usage effects: ------------------------------------ none Global RAM usage effects: ------------------------------------ none Stack RAM usage effects: ------------------------------------ none
                  reference DcmDslProtocolTxPduRef: set at post-build in variant post-build-loadable+post-build-selectable / pre-compile in variant pre-compile, destination=Pdu  # Links a logical Dcm transmit PDU with a concrete Dcm transmit PDU, that will be used for diagnostic response transmission. Effect: ------------------------------------ This setting connects the Dcm to the outside world. Constraints: ------------------------------------ Only transmit PDUs for the ECU diagnostics shall be assigned here. The same transmit PDU shall not be used again in other Dcm connections. Dependencies: ------------------------------------ none Runtime effects: ------------------------------------ none Code ROM usage effects: ------------------------------------ none Const data ROM usage effects: ------------------------------------ none Global RAM usage effects: ------------------------------------ none Stack RAM usage effects: ------------------------------------ none
              container DcmDslPeriodicTransmission [0..1]: post-build-changeable=true  # Defines periodic messages for the corresponding client main connection. Effect: ------------------------------------ If this parameter exists, the DCM will be able to send periodic responses to the client identified by the main connection that refers to this container. Constraints: ------------------------------------ This parameter shall be used only if service 0x2A (ReadDataByPeriodicIdentifier) is to be supported. Dependencies: ------------------------------------ - The diagnostic service 0x2A (ReadDataByPeriodicIdentifier) must be supported by Dcm (refer to /Dcm/DcmConfigSet/DcmDsd/DcmDsdServiceTable/DcmDsdService) - The main connection for the given client shall refer to this container (see /Dcm/DcmConfigSet/DcmDsl/DcmDslProtocol/DcmDslProtocolRow/DcmDslConnection/DcmDslMainConnection/DcmDslPeriodicTranmissionConRef). Runtime effects: ------------------------------------ none Code ROM usage effects: ------------------------------------ none Const data ROM usage effects: ------------------------------------ Due to the additional information to be stored the Dcm configuration ROM usage will increase. Global RAM usage effects: ------------------------------------ none Stack RAM usage effects: ------------------------------------ none
                float DcmDslPeriodicTxConfirmationTimeout: 0..1000, set at post-build in variant post-build-loadable+post-build-selectable / pre-compile in variant pre-compile, origin=Vector Informatik, default-value=0.1  # This parameter is used to specify the Dcm periodic response message TTL (time to live). This is required in case the network layer interface does not support own message TTL monitoring (e.g. on CAN). Effect: ------------------------------------ The time specified here will be used by Dcm for canceling an ongoing periodic message transmission that take too long. In that way deadlocks in Dcm will be avoided when the network interface never calls the Dcm_TxConfirmation function (e.g. in case of communication bus errors). Constraints: ------------------------------------ This parameter shall never be zero. Dependencies: ------------------------------------ none Runtime effects: ------------------------------------ none Code ROM usage effects: ------------------------------------ none Const data ROM usage effects: ------------------------------------ none Global RAM usage effects: ------------------------------------ none Stack RAM usage effects: ------------------------------------ none
                container DcmDslPeriodicConnection [1..*]: post-build-changeable=true  # Holding the TxPduId configuration for PeriodicTransmission.
                  integer DcmDslPeriodicTxConfirmationPduId: 0..65535, set at pre-compile, symbolic-name-value=true, default-value=0  # Specifies the logical handle value of a concrete Dcm periodic transmit PDU. NOTE: This value is generated automatically by the Configurator 5 tool. Effect: ------------------------------------ Using this value Dcm is able to distinguish the different transport layer connections at response confirmation time. Constraints: ------------------------------------ none Dependencies: ------------------------------------ none Runtime effects: ------------------------------------ none Code ROM usage effects: ------------------------------------ none Const data ROM usage effects: ------------------------------------ none Global RAM usage effects: ------------------------------------ none Stack RAM usage effects: ------------------------------------ none
                  reference DcmDslPeriodicTxPduRef: set at post-build in variant post-build-loadable+post-build-selectable / pre-compile in variant pre-compile, destination=Pdu  # Links a logical Dcm transmit PDU with a concrete Dcm transmit PDU, that will be used for diagnostic periodic response transmission. Effect: ------------------------------------ This setting connects the Dcm to the outside world. Constraints: ------------------------------------ Only transmit PDUs for the ECU diagnostics shall be assigned here. The same transmit PDU shall not be used again in other Dcm connections. Dependencies: ------------------------------------ none Runtime effects: ------------------------------------ none Code ROM usage effects: ------------------------------------ none Const data ROM usage effects: ------------------------------------ none Global RAM usage effects: ------------------------------------ none Stack RAM usage effects: ------------------------------------ none
              container DcmDslResponseOnEvent [0..0]  # NOT USED
                integer DcmDslRoeTxConfirmationPduId [0..1]: 0..65535, set at pre-compile, symbolic-name-value=true, default-value=0  # Handle Id to be used by the Lower Layer to confirm the transmission of the DcmDslRoeTxPdu to the LowerLayer.
                reference DcmDslRoeTxPduRef [0..1]: set at post-build in variant post-build-loadable+post-build-selectable / pre-compile in variant pre-compile, destination=Pdu  # Reference to the PDU for transmission of ROE response (only needed for ROE Transmission Type is TYPE2)
        container DcmDslServiceRequestManufacturerNotification [0..*]  # The name of this container is used to define the name of the R-Port through which the DCM accesses the interface ServiceRequestNotification. Effect: ------------------------------------ If used, the Dcm will ask the application for permission to start the diagnostic service evaluation. Constraints: ------------------------------------ none Dependencies: ------------------------------------ none Runtime effects: ------------------------------------ The more notifications configured, the more run time will be needed to process them. Also the run time usage of each notification call affects the Dcm task run time. Code ROM usage effects: ------------------------------------ If used, the Dcm will have slightly increased code ROM usage. Const data ROM usage effects: ------------------------------------ If used, the Dcm will have slightly increased constant data ROM usage. The usage linearly scales with the amount of notification. Global RAM usage effects: ------------------------------------ none Stack RAM usage effects: ------------------------------------ If used, the Dcm will have slightly increased stack usage, executing all of the notification calls. The callee's stack usage directly affects the Dcm task stack usage.
          boolean DcmDslServiceRequestManufacturerNotificationUsePort [0..1]: set at pre-compile, origin=Vector Informatik, default-value=true  # Defines which kind of interface shall be used to access the application. Effect: ------------------------------------ Depending on the selected type, either a RTE call or a call out will be required to be implemented in the Dcm application. Constraints: ------------------------------------ none Dependencies: ------------------------------------ The function names generated in case of FALSE will depend on the function name parameter. Runtime effects: ------------------------------------ none Code ROM usage effects: ------------------------------------ none Const data ROM usage effects: ------------------------------------ none Global RAM usage effects: ------------------------------------ none Stack RAM usage effects: ------------------------------------ none
          function name DcmDslServiceRequestManufacturerNotificationIndicationFnc [0..1]: set at pre-compile, origin=Vector Informatik  # Specifies the call out function name for notification call. Effect: ------------------------------------ If this parameter is not empty, the Dcm will call the specified function on each received diagnostic request. Constraints: ------------------------------------ none Dependencies: ------------------------------------ Has effect only if: - the DcmDslServiceRequestManufacturerNotificationUsePort is set to FALSE. Runtime effects: ------------------------------------ none Code ROM usage effects: ------------------------------------ none Const data ROM usage effects: ------------------------------------ none Global RAM usage effects: ------------------------------------ none Stack RAM usage effects: ------------------------------------ none
          function name DcmDslServiceRequestManufacturerNotificationConfirmationFnc [0..1]: set at pre-compile, origin=Vector Informatik  # Specifies the call out function name for notification call. Effect: ------------------------------------ If this parameter is not empty, the Dcm will call the specified function on each received diagnostic request. Constraints: ------------------------------------ none Dependencies: ------------------------------------ Has effect only if: - the DcmDslServiceRequestManufacturerNotificationUsePort is set to FALSE. Runtime effects: ------------------------------------ none Code ROM usage effects: ------------------------------------ none Const data ROM usage effects: ------------------------------------ none Global RAM usage effects: ------------------------------------ none Stack RAM usage effects: ------------------------------------ none
        container DcmDslServiceRequestSupplierNotification [0..*]  # The name of this container is used to define the name of the R-Port through which the DCM accesses the interface ServiceRequestNotification. Effect: ------------------------------------ If used, the Dcm will ask the application for permission to start the diagnostic service evaluation. Constraints: ------------------------------------ none Dependencies: ------------------------------------ none Runtime effects: ------------------------------------ The more notifications configured, the more run time will be needed to process them. Also the run time usage of each notification call affects the Dcm task run time. Code ROM usage effects: ------------------------------------ If used, the Dcm will have slightly increased code ROM usage. Const data ROM usage effects: ------------------------------------ If used, the Dcm will have slightly increased constant data ROM usage. The usage linearly scales with the amount of notification. Global RAM usage effects: ------------------------------------ none Stack RAM usage effects: ------------------------------------ If used, the Dcm will have slightly increased stack usage, executing all of the notification calls. The callee's stack usage directly affects the Dcm task stack usage.
          boolean DcmDslServiceRequestSupplierNotificationUsePort [0..1]: set at pre-compile, origin=Vector Informatik, default-value=true  # Defines which kind of interface shall be used to access the application. Effect: ------------------------------------ Depending on the selected type, either a RTE call or a call out will be required to be implemented in the Dcm application. Constraints: ------------------------------------ none Dependencies: ------------------------------------ The function names generated in case of FALSE will depend on the function name parameter. Runtime effects: ------------------------------------ none Code ROM usage effects: ------------------------------------ none Const data ROM usage effects: ------------------------------------ none Global RAM usage effects: ------------------------------------ none Stack RAM usage effects: ------------------------------------ none
          function name DcmDslServiceRequestSupplierNotificationIndicationFnc [0..1]: set at pre-compile, origin=Vector Informatik  # Specifies the call out function name for notification call. Effect: ------------------------------------ If this parameter is not empty, the Dcm will call the specified function on each received diagnostic request. Constraints: ------------------------------------ none Dependencies: ------------------------------------ Has effect only if: - the DcmDslServiceRequestSupplierNotificationUsePort is set to FALSE. Runtime effects: ------------------------------------ none Code ROM usage effects: ------------------------------------ none Const data ROM usage effects: ------------------------------------ none Global RAM usage effects: ------------------------------------ none Stack RAM usage effects: ------------------------------------ none
          function name DcmDslServiceRequestSupplierNotificationConfirmationFnc [0..1]: set at pre-compile, origin=Vector Informatik  # Specifies the call out function name for notification call. Effect: ------------------------------------ If this parameter is not empty, the Dcm will call the specified function on each received diagnostic request. Constraints: ------------------------------------ none Dependencies: ------------------------------------ Has effect only if: - the DcmDslServiceRequestSupplierNotificationUsePort is set to FALSE. Runtime effects: ------------------------------------ none Code ROM usage effects: ------------------------------------ none Const data ROM usage effects: ------------------------------------ none Global RAM usage effects: ------------------------------------ none Stack RAM usage effects: ------------------------------------ none
      container DcmDsp  # These parameters apply to Diagnostic Service Processing. There will always be one set of these parameters per DCM.
        integer DcmDspMaxDidToRead [0..1]: 1..65535, set at pre-compile in variant post-build-loadable+pre-compile / post-build in variant post-build-selectable, default-value=1  # Indicates the maximum allowed DIDs in a single "ReadDataByIdentifier" request. Effect: ------------------------------------ Any diagnostic request for service 0x22 with more DIDs as specified by this parameter will be rejected by a negative response. Constraints: ------------------------------------ none Dependencies: ------------------------------------ If "/Dcm/DcmConfigSet/DcmDsd/DcmDsdServiceTable/DcmDsdService" is defined for service 0x22. Runtime effects: ------------------------------------ The larger number of DIDs per request, the longer the Dcm task execution time, since in the worst case (all DIDs are synchronous) all requested DIDs will be processed within the same Dcm task activation. Code ROM usage effects: ------------------------------------ If more than one DID is specified to be allowed, the Dcm code usage may slightly increase due to the iteration loops. Const data ROM usage effects: ------------------------------------ none Global RAM usage effects: ------------------------------------ The RAM usage can increase with increasing the value of this parameter. Stack RAM usage effects: ------------------------------------ none
        integer DcmDspPowerDownTime [0..1]: 0..255, set at pre-compile in variant post-build-loadable+pre-compile / post-build in variant post-build-selectable, default-value=255  # This parameter indicates to the client the minimum time of the stand-by sequence the server will remain in the power-down sequence. Effect: ------------------------------------ The value specified in this parameter will be returned by Dcm on the positive response of diagnostic service 0x11 0x04. Note: If this parameter is missing, but service 0x11 0x04 is supported, the value used by Dcm will be 0xFF. Constraints: ------------------------------------ Makes sense to be specified only if diagnostic service 0x11 0x04 shall be supported by the ECU and Dcm will handle it. Dependencies: ------------------------------------ If "/Dcm/DcmConfigSet/DcmDsd/DcmDsdServiceTable/DcmDsdService" is defined for service 0x11 and "/Dcm/DcmConfigSet/DcmDsd/DcmDsdServiceTable/DcmDsdService/DcmDsdSubService" for sub-service 0x04. Both shall not be overridden by an callout function name. Runtime effects: ------------------------------------ none Code ROM usage effects: ------------------------------------ none Const data ROM usage effects: ------------------------------------ none Global RAM usage effects: ------------------------------------ none Stack RAM usage effects: ------------------------------------ none
        boolean DcmDspDDDidCheckPerSourceDid [0..1]: set at pre-compile, origin=Vector Informatik, default-value=false  # Dsp Dynamically Defined Did Check Per Source Did | Specifies whether DCM module shall check the session, security and mode dependencies per source DIDs/MemoryRanges with a ReadDataByIdentifier (0x22) with DID in the range 0xF200 to 0xF3FF or with a ReadDataByPeriodicIdentifier (0x2A) in the range 0xF200-0xF2FF. Effect: ------------------------------------ If set to TRUE, DCM will check additionally to the DDID's execution preconditions also these of the included items (DIDs or memory blocks). This will ensure that if the DDID contains any secured sources, in case of losing the security access level relevant to these sources, the protected information will not be accessible. If set to FALSE, DCM will only consider the DDID's execution preconditions. This saves resources (ROM, stack, run-time), but can be a security backdoor if the DDID itself is not secured, but includes secured sources. Constraints: ------------------------------------ none Dependencies: ------------------------------------ If "/Dcm/DcmConfigSet/DcmDsd/DcmDsdServiceTable/DcmDsdService" is defined for service 0x2C. The "/Dcm/DcmConfigSet/DcmDsp/DcmDspDidInfo/DcmDspDidAccess/DcmDspDidDefine/DcmDspDDDidMaxElements" parameter determines the run time usage. Runtime effects: ------------------------------------ The larger number of DDID's source list, the longer the Dcm task execution time, since all contained sources will be processed within the same Dcm task activation. Code ROM usage effects: ------------------------------------ If set to TRUE, the code usage will increase by a constant amount, independent of the number of number of DDIDs or their number of sources. Const data ROM usage effects: ------------------------------------ none Global RAM usage effects: ------------------------------------ none Stack RAM usage effects: ------------------------------------ If set to TRUE, the stack usage will be increased slightly due to the additional checks performed in the context of an ongoing diagnostic service processor. The more complex and deep mode rule condition expression nesting, the more stack will be needed.
        boolean DcmDspDDDidCheckConditionReadPerSourceDid [0..1]: set at pre-compile, origin=Vector Informatik, default-value=false  # Dsp Dynamically Defined Did Check Condition Read Per Source Did | Specifies whether DCM module shall call the "CheckConditionRead" per source DIDs with a ReadDataByIdentifier (0x22) with DID in the range 0xF200 to 0xF3FF or with a ReadDataByPeriodicIdentifier (0x2A) in the range 0xF200-0xF2FF. Effect: ------------------------------------ If set to TRUE, DCM will call the DDID's included DID "ConditionCheckRead" operations of the corresponding port interface. This can be useful if any static DIDs do really use the condition check read API for accepting an external read request. If set to FALSE, DCM will not perform any condition check call on the source DIDs. This saves resources (ROM, stack, run-time). Constraints: ------------------------------------ Since the memory blocks do not have such a functionality, this setting does not affect any include in a DDID memory ranges. Dependencies: ------------------------------------ If "/Dcm/DcmConfigSet/DcmDsd/DcmDsdServiceTable/DcmDsdService" is defined for service 0x2C. If "/Dcm/DcmConfigSet/DcmDsd/DcmDsdServiceTable/DcmDsdService/DcmDsdSubService" is defined for sub-service 0x2C 0x01. The "/Dcm/DcmConfigSet/DcmDsp/DcmDspDidInfo/DcmDspDidAccess/DcmDspDidDefine/DcmDspDDDidMaxElements" parameter determines the run time usage. Runtime effects: ------------------------------------ The larger number of DDID's source list, the longer the Dcm task execution time, since in the worst case (all DIDs are synchronous) all contained DID sources will be processed within the same Dcm task activation. Code ROM usage effects: ------------------------------------ If set to TRUE, the code usage will increase by a constant amount, independent of the number of number of DDIDs or their number of sources. Const data ROM usage effects: ------------------------------------ none Global RAM usage effects: ------------------------------------ none Stack RAM usage effects: ------------------------------------ If set to TRUE, the stack usage will be increased due to the additional checks performed in the context of an ongoing diagnostic service processor. The actual stack usage depends on the implementation of the corresponding application "ConditionCheckRead" stack usage.
        integer DcmDspMaxPeriodicDidToRead [0..1]: 1..65535, set at pre-compile in variant post-build-loadable+pre-compile / post-build in variant post-build-selectable, origin=Vector Informatik, default-value=1  # Indicates the maximum allowed DIDs in a single "ReadDataByPeriodicIdentifier" request. Effect: ------------------------------------ Any diagnostic request for service 0x2A with more DIDs as specified by this parameter will be rejected by a negative response. Constraints: ------------------------------------ none Dependencies: ------------------------------------ If "/Dcm/DcmConfigSet/DcmDsd/DcmDsdServiceTable/DcmDsdService" is defined for service 0x2A. Runtime effects: ------------------------------------ The larger number of DIDs per request, the longer the Dcm task execution time, since in the worst case (all DIDs are synchronous) all requested DIDs will be processed within the same Dcm task activation. Code ROM usage effects: ------------------------------------ If more than one DID is specified to be allowed, the Dcm code usage may slightly increase due to the iteration loops. Const data ROM usage effects: ------------------------------------ none Global RAM usage effects: ------------------------------------ The RAM usage can increase with increasing the value of this parameter. Stack RAM usage effects: ------------------------------------ none
        boolean DcmDspDDDidClearOnStateChange [0..1]: set at pre-compile, origin=Vector Informatik, default-value=false  # Dsp Dynamically Defined Did Clear On State Change | Specifies whether DCM module shall clear a DDID when a session/security level change occurs and the DDID (or its content) is no longer accessible in the new state. Effect: ------------------------------------ If set to TRUE, DCM will verify whether any defined DDID (or its content) is still accessible under the new DCM session/security/mode condition states. Note: If the DDID is also a periodic DID, then it will be removed from the scheduler too. If set to FALSE, DCM will not automatically clear any affected DDID. This saves resources (ROM, stack, run-time), but can be a security backdoor if the DDID itself is not secured, but includes secured sources and the option: /Dcm/DcmConfigSet/DcmDsp/DcmDspDDDidCheckPerSourceDid is not turned on. Constraints: ------------------------------------ none Dependencies: ------------------------------------ If "/Dcm/DcmConfigSet/DcmDsd/DcmDsdServiceTable/DcmDsdService" is defined for service 0x2C. The "/Dcm/DcmConfigSet/DcmDsp/DcmDspDidInfo/DcmDspDidAccess/DcmDspDidDefine/DcmDspDDDidMaxElements" parameter determines the run time usage. Runtime effects: ------------------------------------ The larger number of DDID's source list, the longer the Dcm task execution time, since all contained sources will be processed within the same Dcm task activation. Code ROM usage effects: ------------------------------------ If set to TRUE, the code usage will increase by a constant amount, independent of the number of number of DDIDs or their number of sources. Const data ROM usage effects: ------------------------------------ If set to TRUE, the code usage will increase by a amount, dependent of the number of number of DDIDs. Global RAM usage effects: ------------------------------------ none Stack RAM usage effects: ------------------------------------ If set to TRUE, the stack usage will be increased slightly due to the additional checks performed in the context of an ongoing diagnostic service processor. The more complex and deep mode rule condition expression nesting, the more stack will be needed.
        boolean DcmDspDidLookUpFilterEnabled [0..1]: set at pre-compile, origin=Vector Informatik, default-value=false  # Specifies whether external DID look up filtering will be supported. Effect: ----------------------------------------- If enabled, Dcm will call an application function that can classify a valid DID as (temporarily) not supported. This is useful in case of variant handling. If disabled, Dcm uses only the internal look-up engine result and accepts any valid DID configured in ECUC. Constraints: ----------------------------------------- This option has any effect only if at least one DID diagnostic service is handled within DCM. Dependencies: ----------------------------------------- There must be at least one DcmDsdService related to DIDs that is internally handled by DCM. Runtime effects: ----------------------------------------- Enabling this feature will slightly increase the Dcm task time during any DID request validation operation. Code ROM usage effects: ------------------------------------ Enabling this feature leads to a minor increase of the Dcm static code ROM usage. Const data ROM usage effects: ----------------------------------------- none Global RAM usage effects: ----------------------------------------- Enabling this feature may lead to a minor increase of the Dcm static code RAM usage. Stack RAM usage effects: ------------------------------------ Due to the additional calls done from within the Dcm_MainFunction for gathering the DID filtering, the stack usage may increase. It will depend on the implementation of the application callback.
        boolean DcmDspRidLookUpFilterEnabled [0..1]: set at pre-compile, origin=Vector Informatik, default-value=false  # Specifies whether external RID look up filtering will be supported. Effect: ----------------------------------------- If enabled, Dcm will call an application function that can classify a valid RID as (temporarily) not supported. This is useful in case of variant handling. If disabled, Dcm uses only the internal look-up engine result and accepts any valid RID configured in ECUC. Constraints: ----------------------------------------- This option has any effect only if service 0x31 (RoutineControl) is handled within DCM. Dependencies: ----------------------------------------- A DcmDsdService with SID 0x31 must be handled internally by DCM. Runtime effects: ----------------------------------------- Enabling this feature will slightly increase the Dcm task time during any request for SID 0x31. Code ROM usage effects: ------------------------------------ Enabling this feature leads to a minor increase of the Dcm static code ROM usage. Const data ROM usage effects: ----------------------------------------- none Global RAM usage effects: ----------------------------------------- none Stack RAM usage effects: ------------------------------------ Due to the additional calls done from within the Dcm_MainFunction for gathering the DID filtering, the stack usage may increase. It will depend on the implementation of the application callback.
        boolean DcmDspReadDIDReportsNODIByte: set at pre-compile, origin=Vector Informatik, default-value=false  # Specifies whether the NODI byte of an OBD VID shall be reported when reading the corresponding OBD DID (0xF801-0xF8FF). Effect: ----------------------------------------- If enabled, Dcm will completely mirror the OBD2 VID data, including the NODI byte in the corresponding DID. If disabled, Dcm will comply with the ISO27145-3 (WWH-OBD) and AR 4.2.2 SWS omitting the NODI byte in the DID data. Constraints: ----------------------------------------- This option has any effect only if: - Service 0x09 (RequestVehicleInformation) is handled within DCM. AND - Service 0x22 (ReadDataByIdentifier) is handled within DCM. AND - There are any DIDs in the range 0xF8XX that overlap with any VIDs of SID 0x09. Dependencies: ----------------------------------------- A DcmDsdService with SID 0x22 must be handled internally by DCM. There shall be at least one DID in range 0xF8XX that overlaps with an OBD2 VID, so the automatic OBD mirroring is enabled. Runtime effects: ----------------------------------------- Enabling this feature will slightly decrease the Dcm task time during any request for SID 0x22 of 0xF8XX. Code ROM usage effects: ------------------------------------ Enabling this feature leads to a minor decrease of the Dcm generated code ROM usage. Const data ROM usage effects: ----------------------------------------- none Global RAM usage effects: ----------------------------------------- none Stack RAM usage effects: ------------------------------------ Due to the additional calls done from within the Dcm_MainFunction for gathering the DID filtering, the stack usage may increase. It will depend on the implementation of the application callback.
        boolean DcmDspRteImplicitComEnabled [0..1]: set at pre-compile, origin=Vector Informatik, default-value=true  # Specifies whether an intermediate buffer is used for paged read operations or when reading a linear signal with a variable length. Note: This feature is only required if the RTE has to copy data between SW-C and DCM. Effect: ----------------------------------------- If enabled, a dedicated buffer shall be established to copy data from the RTE. Constraints: ----------------------------------------- This option has an effect only if: - Service 0x22 (ReadDataByIdentifier) is handled within DCM. AND - There is at least one static DID with a paged signal or with variable length. AND - The variable length/paged signal of that DID uses a C/S interface. Dependencies: ----------------------------------------- none Runtime effects: ----------------------------------------- Enabling this feature will slightly increase the Dcm task time during any request for SID 0x22. Code ROM usage effects: ------------------------------------ Enabling this feature leads to a minor increase of the Dcm generated code ROM usage. Const data ROM usage effects: ----------------------------------------- none Global RAM usage effects: ----------------------------------------- Enabling this feature leads to an increase of global RAM usage. The amount depends on the configuration. Stack RAM usage effects: ------------------------------------ none
        integer DcmDspReadPagedDataPageSize [0..1]: 1..4294967294, set at pre-compile, origin=Vector Informatik, default-value=7  # Specifies the size of the paged buffer. Effect: ----------------------------------------- If enabled, that value shall be used as the buffer size for paged read operations. Constraints: ----------------------------------------- This option has an effect only if: - /MICROSAR/Dcm/DcmConfigSet/DcmDsp/DcmDspRteImplicitComEnabled is enabled. AND - Service 0x22 (ReadDataByIdentifier) is handled within DCM. AND - There is at least one static DID with a paged signal. AND - That paged signal uses a C/S interface. Dependencies: ----------------------------------------- none Runtime effects: ----------------------------------------- Runtime efficiency depends on the configured size. Code ROM usage effects: ------------------------------------ none Const data ROM usage effects: ----------------------------------------- none Global RAM usage effects: ----------------------------------------- RAM usage depends on the configured size. Stack RAM usage effects: ------------------------------------ none
        container DcmDspAuthentication [0..1]  # This container contains the configuration for the UDS service Authentication (0x29).
          integer DcmDspAuthenticationRoleSize: 1..4, set at pre-compile, origin=Vector Informatik, default-value=1  # Defines the size in bytes for the role element within a certificate. Effect: ------------------------------------ Dcm expects a role of this size within the certificate. Constraints: ------------------------------------ All role parameters (e.g. DcmDspServiceRole) shall have a size smaller or equal to this parameter. Dependencies: ------------------------------------ none Runtime effects: ------------------------------------ none Code ROM usage effects: ------------------------------------ none Const data ROM usage effects: ------------------------------------ none Global RAM usage effects: ------------------------------------ none Stack RAM usage effects: ------------------------------------ none
          integer DcmDspAuthenticationWhiteListDIDMaxSize [0..1]: 1..255, set at pre-compile, origin=Vector Informatik  # Defines the maximum size in bytes for a DID white list element within a certificate. Effect: ------------------------------------ Any DID white list within a certificate with more bytes as specified by this parameter will be rejected with a negative response. Constraints: ------------------------------------ none Dependencies: ------------------------------------ none Runtime effects: ------------------------------------ Increasing this value will increase the Dcm task time depending on the actual size of the white list during authentication verification of any request and request processing of SID 0x29 with subfunction 0x03. Code ROM usage effects: ------------------------------------ none Const data ROM usage effects: ------------------------------------ none Global RAM usage effects: ------------------------------------ The RAM usage increases with increasing the value of this parameter. Stack RAM usage effects: ------------------------------------ none
          integer DcmDspAuthenticationWhiteListMemorySelectionMaxSize [0..1]: 1..255, set at pre-compile, origin=Vector Informatik  # Defines the maximum size in bytes for a memory selection white list element within a certificate. Effect: ------------------------------------ Any memory selection white list within a certificate with more bytes as specified by this parameter will be rejected with a negative response. Constraints: ------------------------------------ none Dependencies: ------------------------------------ If "/Dcm/DcmConfigSet/DcmDsd/DcmDsdServiceTable/DcmDsdService" is defined for service 0x19 with "/Dcm/DcmConfigSet/DcmDsd/DcmDsdServiceTable/DcmDsdService/DcmDsdSubService" equal to 0x17, 0x18 or 0x19. Runtime effects: ------------------------------------ Increasing this value will increase the Dcm task time depending on the actual size of the white list during authentication verification of any request and request processing of SID 0x29 with subfunction 0x03. Code ROM usage effects: ------------------------------------ none Const data ROM usage effects: ------------------------------------ none Global RAM usage effects: ------------------------------------ The RAM usage increases with increasing the value of this parameter. Stack RAM usage effects: ------------------------------------ none
          integer DcmDspAuthenticationWhiteListRIDMaxSize [0..1]: 1..255, set at pre-compile, origin=Vector Informatik  # Defines the maximum size in bytes for a RID white list element within a certificate. Effect: ------------------------------------ Any RID white list within a certificate with more bytes as specified by this parameter will be rejected with a negative response. Constraints: ------------------------------------ none Dependencies: ------------------------------------ If "/Dcm/DcmConfigSet/DcmDsd/DcmDsdServiceTable/DcmDsdService" is defined for service 0x31. Runtime effects: ------------------------------------ Increasing this value will increase the Dcm task time depending on the actual size of the white list during authentication verification of any request and request processing of SID 0x29 with subfunction 0x03. Code ROM usage effects: ------------------------------------ none Const data ROM usage effects: ------------------------------------ none Global RAM usage effects: ------------------------------------ The RAM usage increases with increasing the value of this parameter. Stack RAM usage effects: ------------------------------------ none
          integer DcmDspAuthenticationWhiteListServicesMaxSize [0..1]: 1..255, set at pre-compile, origin=Vector Informatik  # Defines the maximum size in bytes for a services white list element within a certificate. Effect: ------------------------------------ Any services white list within a certificate with more bytes as specified by this parameter will be rejected with a negative response. Constraints: ------------------------------------ none Dependencies: ------------------------------------ none Runtime effects: ------------------------------------ Increasing this value will increase the Dcm task time depending on the actual size of the white list during authentication verification of any request and request processing of SID 0x29 with subfunction 0x03. Code ROM usage effects: ------------------------------------ none Const data ROM usage effects: ------------------------------------ none Global RAM usage effects: ------------------------------------ The RAM usage increases with increasing the value of this parameter. Stack RAM usage effects: ------------------------------------ none
          integer DcmDspAuthenticationChallengeClientMaxSize [0..1]: 1..65535, set at pre-compile, origin=Vector Informatik  # Defines the maximum size in bytes for the client challenge. Effect: ------------------------------------ If this parameter exists, Dcm will consider this value for the buffer size validation during configuration time. Constraints: ------------------------------------ The buffer size validation will only be exact if all dependent parameters exist. Dependencies: ------------------------------------ - /Dcm/DcmConfigSet/DcmDsp/DcmDspAuthentication/DcmDspAuthenticationCertificateClientMaxSize - /Dcm/DcmConfigSet/DcmDsp/DcmDspAuthentication/DcmDspAuthenticationProofOfOwnershipClientMaxSize - /Dcm/DcmConfigSet/DcmDsp/DcmDspAuthentication/DcmDspAuthenticationCertificateEcuMaxSize - /Dcm/DcmConfigSet/DcmDsp/DcmDspAuthentication/DcmDspAuthenticationProofOfOwnershipEcuMaxSize - /Dcm/DcmConfigSet/DcmDsp/DcmDspAuthentication/DcmDspAuthenticationCertificateDataMaxSize Runtime effects: ------------------------------------ none Code ROM usage effects: ------------------------------------ none Const data ROM usage effects: ------------------------------------ none Global RAM usage effects: ------------------------------------ none Stack RAM usage effects: ------------------------------------ none
          integer DcmDspAuthenticationCertificateClientMaxSize [0..1]: 1..65535, set at pre-compile, origin=Vector Informatik  # Defines the maximum size in bytes for the client certificate. Effect: ------------------------------------ If this parameter exists, Dcm will consider this value for the buffer size validation during configuration time. Constraints: ------------------------------------ The buffer size validation will only be exact if all dependent parameters exist. Dependencies: ------------------------------------ - /Dcm/DcmConfigSet/DcmDsp/DcmDspAuthentication/DcmDspAuthenticationChallengeClientMaxSize - /Dcm/DcmConfigSet/DcmDsp/DcmDspAuthentication/DcmDspAuthenticationProofOfOwnershipClientMaxSize - /Dcm/DcmConfigSet/DcmDsp/DcmDspAuthentication/DcmDspAuthenticationCertificateEcuMaxSize - /Dcm/DcmConfigSet/DcmDsp/DcmDspAuthentication/DcmDspAuthenticationProofOfOwnershipEcuMaxSize - /Dcm/DcmConfigSet/DcmDsp/DcmDspAuthentication/DcmDspAuthenticationCertificateDataMaxSize Runtime effects: ------------------------------------ none Code ROM usage effects: ------------------------------------ none Const data ROM usage effects: ------------------------------------ none Global RAM usage effects: ------------------------------------ none Stack RAM usage effects: ------------------------------------ none
          integer DcmDspAuthenticationProofOfOwnershipClientMaxSize [0..1]: 1..65535, set at pre-compile, origin=Vector Informatik  # Defines the maximum size in bytes for the client proof of ownership. Effect: ------------------------------------ If this parameter exists, Dcm will consider this value for the buffer size validation during configuration time. Constraints: ------------------------------------ The buffer size validation will only be exact if all dependent parameters exist. Dependencies: ------------------------------------ - /Dcm/DcmConfigSet/DcmDsp/DcmDspAuthentication/DcmDspAuthenticationChallengeClientMaxSize - /Dcm/DcmConfigSet/DcmDsp/DcmDspAuthentication/DcmDspAuthenticationCertificateClientMaxSize - /Dcm/DcmConfigSet/DcmDsp/DcmDspAuthentication/DcmDspAuthenticationCertificateEcuMaxSize - /Dcm/DcmConfigSet/DcmDsp/DcmDspAuthentication/DcmDspAuthenticationProofOfOwnershipEcuMaxSize - /Dcm/DcmConfigSet/DcmDsp/DcmDspAuthentication/DcmDspAuthenticationCertificateDataMaxSize Runtime effects: ------------------------------------ none Code ROM usage effects: ------------------------------------ none Const data ROM usage effects: ------------------------------------ none Global RAM usage effects: ------------------------------------ none Stack RAM usage effects: ------------------------------------ none
          integer DcmDspAuthenticationCertificateEcuMaxSize [0..1]: 1..65535, set at pre-compile, origin=Vector Informatik  # Defines the maximum size in bytes for the Ecu certificate. Effect: ------------------------------------ If this parameter exists, Dcm will consider this value for the buffer size validation during configuration time. Constraints: ------------------------------------ The buffer size validation will only be exact if all dependent parameters exist. Dependencies: ------------------------------------ - /Dcm/DcmConfigSet/DcmDsp/DcmDspAuthentication/DcmDspAuthenticationChallengeClientMaxSize - /Dcm/DcmConfigSet/DcmDsp/DcmDspAuthentication/DcmDspAuthenticationCertificateClientMaxSize - /Dcm/DcmConfigSet/DcmDsp/DcmDspAuthentication/DcmDspAuthenticationProofOfOwnershipClientMaxSize - /Dcm/DcmConfigSet/DcmDsp/DcmDspAuthentication/DcmDspAuthenticationProofOfOwnershipEcuMaxSize - /Dcm/DcmConfigSet/DcmDsp/DcmDspAuthentication/DcmDspAuthenticationCertificateDataMaxSize Runtime effects: ------------------------------------ none Code ROM usage effects: ------------------------------------ none Const data ROM usage effects: ------------------------------------ none Global RAM usage effects: ------------------------------------ none Stack RAM usage effects: ------------------------------------ none
          integer DcmDspAuthenticationProofOfOwnershipEcuMaxSize [0..1]: 1..65535, set at pre-compile, origin=Vector Informatik  # Defines the maximum size in bytes for the Ecu proof of ownership. Effect: ------------------------------------ If this parameter exists, Dcm will consider this value for the buffer size validation during configuration time. Constraints: ------------------------------------ The buffer size validation will only be exact if all dependent parameters exist. Dependencies: ------------------------------------ - /Dcm/DcmConfigSet/DcmDsp/DcmDspAuthentication/DcmDspAuthenticationChallengeClientMaxSize - /Dcm/DcmConfigSet/DcmDsp/DcmDspAuthentication/DcmDspAuthenticationCertificateClientMaxSize - /Dcm/DcmConfigSet/DcmDsp/DcmDspAuthentication/DcmDspAuthenticationProofOfOwnershipClientMaxSize - /Dcm/DcmConfigSet/DcmDsp/DcmDspAuthentication/DcmDspAuthenticationCertificateEcuMaxSize - /Dcm/DcmConfigSet/DcmDsp/DcmDspAuthentication/DcmDspAuthenticationCertificateDataMaxSize Runtime effects: ------------------------------------ none Code ROM usage effects: ------------------------------------ none Const data ROM usage effects: ------------------------------------ none Global RAM usage effects: ------------------------------------ none Stack RAM usage effects: ------------------------------------ none
          integer DcmDspAuthenticationGeneralNRC [0..1]: 0..255, set at pre-compile, origin=Vector Informatik  # Defines the NRC that shall be sent as replacement of all ISO 14229-1 defined NRCs in case of invalid certificate or content. Effect: ------------------------------------ If the mode rule "DcmDspAuthenticationGeneralNRCModeRuleRef" is evaluated to true, Dcm will send this general NRC instead of the specific NRC codes for the cases whenever a "Certificate verification failed" NRC is returned. Constraints: ------------------------------------ Has an effect during runtime only if "DcmDspAuthenticationGeneralNRCModeRuleRef" is evaluated to true. Dependencies: ------------------------------------ - /Dcm/DcmConfigSet/DcmDsp/DcmDspAuthentication/DcmDspAuthenticationGeneralNRCModeRuleRef Runtime effects: ------------------------------------ none Code ROM usage effects: ------------------------------------ none Const data ROM usage effects: ------------------------------------ none Global RAM usage effects: ------------------------------------ none Stack RAM usage effects: ------------------------------------ none
          float DcmDspAuthenticationDefaultSessionTimeOut [0..1]: 0..65535, set at pre-compile, origin=Vector Informatik, default-value=0  # Defines the number of seconds after which the Dcm makes a transition to deauthenticated state, in case of no active communication in default session. Effect: ------------------------------------ Dcm will start the configured time after request processing in default session. Constraints: ------------------------------------ none Dependencies: ------------------------------------ none Runtime effects: ------------------------------------ none Code ROM usage effects: ------------------------------------ none Const data ROM usage effects: ------------------------------------ none Global RAM usage effects: ------------------------------------ none Stack RAM usage effects: ------------------------------------ none
          boolean DcmDspAuthenticationSetDeauthenticatedRoleApi: set at pre-compile, origin=Vector Informatik, default-value=false  # Specifies whether Dcm shall provide setting Deauthenticated Role or not. Effect: ----------------------------------------- By enabling this feature, the Dcm will provide an API "Dcm_SetDeauthenticatedRole" for setting a Deauthenticated Role. If this information is not needed within the ECU project, leave this feature disabled for minimum ROM usage. Constraints: ----------------------------------------- none Dependencies: ----------------------------------------- none Runtime effects: ----------------------------------------- Enabling this feature leads to an insignificant increase of the Runtime, caused by handling the API in the mainfunction. Code ROM usage effects: ------------------------------------ Enabling this feature leads to a minor increase of the Dcm static code ROM usage. Const data ROM usage effects: ----------------------------------------- Enabling this feature leads to an insignificant increase of the ROM usage, caused by the API function implementation. Global RAM usage effects: ----------------------------------------- none Stack RAM usage effects: ----------------------------------------- none
          integer DcmDspAuthenticationCertificateDataMaxSize [0..1]: 1..65535, set at pre-compile, origin=Vector Informatik, default-value=1  # Defines the maximum size in bytes for the certificate data for subfunction trasmitCertificate (0x04). Effect: ------------------------------------ If this parameter exists, Dcm will consider this value for the buffer size validation during configuration time. Constraints: ------------------------------------ The buffer size validation will only be exact if all dependent parameters exist. Dependencies: ------------------------------------ - /Dcm/DcmConfigSet/DcmDsp/DcmDspAuthentication/DcmDspAuthenticationCertificateClientMaxSize - /Dcm/DcmConfigSet/DcmDsp/DcmDspAuthentication/DcmDspAuthenticationChallengeClientMaxSize - /Dcm/DcmConfigSet/DcmDsp/DcmDspAuthentication/DcmDspAuthenticationProofOfOwnershipClientMaxSize - /Dcm/DcmConfigSet/DcmDsp/DcmDspAuthentication/DcmDspAuthenticationCertificateEcuMaxSize - /Dcm/DcmConfigSet/DcmDsp/DcmDspAuthentication/DcmDspAuthenticationProofOfOwnershipEcuMaxSize Runtime effects: ------------------------------------ none Code ROM usage effects: ------------------------------------ none Const data ROM usage effects: ------------------------------------ none Global RAM usage effects: ------------------------------------ none Stack RAM usage effects: ------------------------------------ none
          boolean DcmDspAuthenticationUserSpecificRoles [0..1]: set at pre-compile, origin=Vector Informatik, default-value=false  # Defines whether Dcm shall use the standard KeyM_CertElementGet() interface to read the authentication roles from the certificate during processing of sub-function 0x03, or to call Dcm_GetAuthenticationRole() to read them from the application one by one. Effect: ------------------------------------ Enables the Dcm_GetAuthenticationRole() callback. Constraints: ------------------------------------ none Dependencies: ------------------------------------ none Runtime effects: ------------------------------------ none Code ROM usage effects: ------------------------------------ none Const data ROM usage effects: ------------------------------------ none Global RAM usage effects: ------------------------------------ none Stack RAM usage effects: ------------------------------------ none
          boolean DcmDspAuthenticationBypassEnabled [0..1]: set at pre-compile, origin=Vector Informatik, default-value=false  # Specifies whether DCM module shall support a bypass mode for precondition checks related to authentication or not. Effect: ------------------------------------ If set to TRUE, DCM will support a bypass mode for precondition checks for Authentication. Constraints: ------------------------------------ This attribute is enabled only when Service 0x29 is implemented completely externally or completely internally. Dependencies: ------------------------------------ If "/Dcm/DcmConfigSet/DcmDsd/DcmDsdServiceTable/DcmDsdService" is defined for service 0x29. Runtime effects: ------------------------------------ Enabling this feature will slightly increase the Dcm task time. Code ROM usage effects: ------------------------------------ none Const data ROM usage effects: ------------------------------------ none Global RAM usage effects: ------------------------------------ none Stack RAM usage effects: ------------------------------------ none
          reference DcmDspAuthenticationGeneralNRCModeRuleRef [0..1]: set at pre-compile, origin=Vector Informatik, destination=DcmModeRule  # Mode rule that defines if the general NRC shall be sent for all failures due to invalid certificate or content. Effect: ------------------------------------ If this mode rule is evaluated to true, Dcm will send the NRC configured in "DcmDspAuthenticationGeneralNRC" instead of the specific NRC codes for the cases whenever a "Certificate verification failed" NRC is returned. Constraints: ------------------------------------ none Dependencies: ------------------------------------ - /Dcm/DcmConfigSet/DcmDsp/DcmDspAuthentication/DcmDspAuthenticationGeneralNRC - See "destination ref". Runtime effects: ------------------------------------ If a mode rule is used, the Dcm task will have a slightly longer run time in case of a certificate verification failed NRC needs to be sent. The mode rule evaluation time depends on the complexity of the modeled mode rule condition. Code ROM usage effects: ------------------------------------ The code usage will increase slightly. Const data ROM usage effects: ------------------------------------ Refer to DcmDspModeRule description. Global RAM usage effects: ------------------------------------ none Stack RAM usage effects: ------------------------------------ During the mode rule evaluation the stack usage will slightly increase. The more complex and deep rule condition expression nesting, the more stack will be needed.
          reference DcmDspAuthenticationPersistStateModeRuleRef [0..1]: set at pre-compile, origin=Vector Informatik, destination=DcmModeRule  # Mode rule that defines if the authentication state shall be persisted in non-volatile memory. Effect: ------------------------------------ If this mode rule is evaluated to true, Dcm will persist authentication state and whitelists and role related to that connection. Constraints: ------------------------------------ none Dependencies: ------------------------------------ non Runtime effects: ------------------------------------ non
          reference DcmDspAuthenticationDeauthenticatedRoleRef [0..32]: set at pre-compile, origin=Vector Informatik, destination=DcmDspAuthenticationRow  # Reference to DcmDspAuthenticationRow that defines a role that is used as deauthenticated role. Effect: ------------------------------------ Role used for service authentication verification in the deauthenticated state. Constraints: ------------------------------------ none Dependencies: ------------------------------------ none Runtime effects: ------------------------------------ none Code ROM usage effects: ------------------------------------ none Const data ROM usage effects: ------------------------------------ none Global RAM usage effects: ------------------------------------ none Stack RAM usage effects: ------------------------------------ none
          container DcmDspAuthenticationConnection [0..*]: post-build-changeable=true  # This container contains the authentication configuration used for a dsl connection.
            integer DcmDspAuthenticationEcuChallengeLength [0..1]: 1..65535, set at pre-compile, origin=Vector Informatik  # Specifies the length of the server challenge. Effect: ------------------------------------ Dcm will send a server challenge of this length for authentication to the client. Constraints: ------------------------------------ none Dependencies: ------------------------------------ none Runtime effects: ------------------------------------ Increasing this value will slightly increase the Dcm task time during request processing for SID 0x29 with subfunction 0x01 or 0x02. Code ROM usage effects: ------------------------------------ none Const data ROM usage effects: ------------------------------------ none Global RAM usage effects: ------------------------------------ The RAM usage increases with increasing the value of this parameter. Stack RAM usage effects: ------------------------------------ none
            symbolic name reference DcmDspAuthenticationClientChallengeSignJobRef [0..1]: set at pre-compile, origin=Vector Informatik, destination=CsmJob  # Reference to a CsmJob used to sign the client challenge.
            symbolic name reference DcmDspAuthenticationConnectionCertificateRef [0..1]: set at pre-compile, origin=Vector Informatik, destination=KeyMCertificate  # Reference to a KeyMCertificate used to store the certificate within the KeyM.
            symbolic name reference DcmDspAuthenticationECUCertificateRef [0..1]: set at pre-compile, origin=Vector Informatik, destination=KeyMCertificate  # Reference to a KeyMCertificate with the server certificate for bi-directional authentication.
            symbolic name reference DcmDspAuthenticationRandomJobRef [0..1]: set at pre-compile, origin=Vector Informatik, destination=CsmJob  # Reference to a CsmJob used to generate the server challenge.
            symbolic name reference DcmDspAuthenticationRoleElementRef [0..1]: set at pre-compile, origin=Vector Informatik, destination=KeyMCertificateElement  # Reference to a certificate data element with the role in the certificate.
            symbolic name reference DcmDspAuthenticationVerifyProofOfOwnerShipClientJobRef [0..1]: set at pre-compile, origin=Vector Informatik, destination=CsmJob  # Dsp AuthenticationVerify Proof Of Ownership Client Job Ref | Reference to a CsmJob used to verify the proof of ownership client in the Csm.
            symbolic name reference DcmDspAuthenticationWhiteListDIDElementRef [0..1]: set at pre-compile, origin=Vector Informatik, destination=KeyMCertificateElement  # Reference to a certificate data element with the white list for data identifiers in the certificate.
            symbolic name reference DcmDspAuthenticationWhiteListMemorySelectionElementRef [0..1]: set at pre-compile, origin=Vector Informatik, destination=KeyMCertificateElement  # Reference to a certificate data element with the white list for user defined memory selection in the certificate.
            symbolic name reference DcmDspAuthenticationWhiteListRIDElementRef [0..1]: set at pre-compile, origin=Vector Informatik, destination=KeyMCertificateElement  # Reference to a certificate data element with the white list for routine identifiers in the certificate.
            symbolic name reference DcmDspAuthenticationWhiteListServicesElementRef [0..1]: set at pre-compile, origin=Vector Informatik, destination=KeyMCertificateElement  # Reference to a certificate data element with the white list for services in the certificate.
            reference DcmDspAuthenticationConnectionMainConnectionRef: set at pre-compile, origin=Vector Informatik, destination=DcmDslMainConnection  # Reference to the dsl diagnostic connection that uses this authentication configuration. Effect: ------------------------------------ Dcm uses this authentication configuration to process service 0x29 requests received on this diagnostic connection. Constraints: ------------------------------------ A diagnostic connection must be uniquely referenced by an authentication configuration. Dependencies: ------------------------------------ none Runtime effects: ------------------------------------ none Code ROM usage effects: ------------------------------------ none Const data ROM usage effects: ------------------------------------ none Global RAM usage effects: ------------------------------------ none Stack RAM usage effects: ------------------------------------ none
            symbolic name reference DcmDspAuthenticationPersistStateBlockIdRef [0..1]: set at pre-compile, origin=Vector Informatik, destination=NvMBlockDescriptor  # Reference to a NvM block that shall be directly accessed by DCM to persist the connection specific authentication state. Effect: ------------------------------------ Dcm uses this block data for persisting the Authentication from service 0x29. Constraints: ------------------------------------ non Dependencies: ------------------------------------ none Runtime effects: ------------------------------------ none Code ROM usage effects: ------------------------------------ none Const data ROM usage effects: ------------------------------------ none Global RAM usage effects: ------------------------------------ none Stack RAM usage effects: ------------------------------------ none
          container DcmDspAuthenticationRow [1..32]  # This container contains the configuration for each DcmDspAuthentication role.
            integer DcmDspAuthenticationRoleBitPosition: 0..31, set at pre-compile, origin=Vector Informatik, default-value=1  # Role that can be referenced by certain elements. Effect: ------------------------------------ Defines the bit number that represents the role in the authentication bit field. The bit mask is aligned with the logical bit calculations: 2^DcmDspAuthenticationRoleBitPosition. Constraints: ------------------------------------ The value must be in the range of '/Dcm/DcmConfigSet/DcmDsp/DcmDspAuthentication/DcmDspAuthenticationRoleSize'. Dependencies: ------------------------------------ - /Dcm/DcmConfigSet/DcmDsp/DcmDspAuthentication/DcmDspAuthenticationRoleSize Runtime effects: ------------------------------------ none Code ROM usage effects: ------------------------------------ none Const data ROM usage effects: ------------------------------------ none Global RAM usage effects: ------------------------------------ none Stack RAM usage effects: ------------------------------------ none
          container DcmDspAuthenticationTransmitCertificate [0..*]  # This container contains the authentication configuration for the subfunction trasnmitCertificate.
            integer DcmDspAuthenticationTransmitCertificateEvaluationId: 0..65535, set at pre-compile, origin=Vector Informatik, default-value=0  # Certificate evaluation id. Effect: ------------------------------------ This parameter is used to define the evaluation id used for sub-function transmitCertificate (0x04). The value is not standardized by either the ISO 14229-1 or AUTOSAR and therefore has an OEM-specific meaning. Constraints: ------------------------------------ none Dependencies: ------------------------------------ non Runtime effects: ------------------------------------ none Code ROM usage effects: ------------------------------------ none Const data ROM usage effects: ------------------------------------ none Global RAM usage effects: ------------------------------------ none Stack RAM usage effects: ------------------------------------ none
            enumeration DcmDspAuthenticationTransmitCertificateFunction [0..1]: {SECURE_CODING}, set at pre-compile, origin=Vector Informatik, default-value=SECURE_CODING  # Provides a fixed semantics to this certificate that will lead to predefined actions in the Dcm.
            symbolic name reference DcmDspAuthenticationTransmitCertificateRef: set at pre-compile, origin=Vector Informatik, destination=KeyMCertificate  # Reference to a KeyMCertificate used to handle the certificate.
        container DcmDspClearDTC [0..1]  # This container contains the configuration for the DCM DTC memory related information. This container exists only if the UDS Service ClearDiagnosticInformation (0x14) is configured.
          boolean DcmDspClearDTCMemorySelectionEnabled [0..1]: set at pre-compile, origin=Vector Informatik, default-value=false  # Specifies whether UserDefined Memory selection for diagnostic service 0x14 is supported or not. Effect: ------------------------------------ If enabled, Dcm accepts diagnostic service 0x14 requests with a byte for the memory selection. Constraints: ------------------------------------ - Dependencies: ------------------------------------ Will be used only if the diagnostic service 0x14 is to be supported by DCM and DEM API version 4.3.0 or newer is selected. Runtime effects: ------------------------------------ none Code ROM usage effects: ------------------------------------ none Const data ROM usage effects: ------------------------------------ none Global RAM usage effects: ------------------------------------ none Stack RAM usage effects: ------------------------------------ none
          integer DcmDspClearDTCMemoryUserMemoryId [0..1]: 0..255, set at pre-compile, origin=Vector Informatik, default-value=0  # Specifies the supported user memory id for service 0x14. Effect: ------------------------------------ If specified a user memory identifier, DCM will accept only the user memory ID that is configured here. If no user memory identifier specified, DCM will accept any value in the request. Constraints: ------------------------------------ none Dependencies: ------------------------------------ Will be used only if DcmDspClearDTCMemorySelectionEnabled is set to true. Runtime effects: ------------------------------------ If any user memory id specified, the DCM will check any related request upon this value and this leads to an insignificantly increased run time usage. Code ROM usage effects: ------------------------------------ If any user memory id specified, the DCM will check any related request upon this value and this leads to an insignificantly increased code ROM usage. Const data ROM usage effects: ------------------------------------ none Global RAM usage effects: ------------------------------------ none Stack RAM usage effects: ------------------------------------ none
          reference DcmDspClearDTCInformationUserDefinedMemoryRoleRef [0..32]: set at pre-compile, origin=Vector Informatik, destination=DcmDspAuthenticationRow  # Reference to DcmDspAuthenticationRow that defines a role in that this user defined memory can be accessed. Effect: ------------------------------------ If a role is specified here, the Dcm will automatically reject any request of this service received while the role is not active. Constraints: ------------------------------------ The value has only an effect if '/Dcm/DcmConfigSet/DcmDsd/DcmDsdServiceTable/DcmDsdService' is defined for service 0x29'. Dependencies: ------------------------------------ none Runtime effects: ------------------------------------ none Code ROM usage effects: ------------------------------------ none Const data ROM usage effects: ------------------------------------ none Global RAM usage effects: ------------------------------------ none Stack RAM usage effects: ------------------------------------ none
        container DcmDspComControl [0..1]  # This container provides configuration parameters for service 0x28 (CommunciationControl).
          container DcmDspComControlAllChannel [0..*]: post-build-changeable=true  # Collection of ComM channels which shall be controlled if all networks are addressed. Effect: ------------------------------------ Each container of this type will specify a ComM channel to be controlled if all networks are addressed. Constraints: ------------------------------------ none Dependencies: ------------------------------------ none Runtime effects: ------------------------------------ The more channels to be managed by Dcm the longer the processing time during execution of communication control over all channels. Code ROM usage effects: ------------------------------------ The minimum ROM usage is on a single channel systems. For two or more channels there is no overhead. Const data ROM usage effects: ------------------------------------ The data ROM usage in the Dcm configuration scales with the number of references specified by this setting. Global RAM usage effects: ------------------------------------ none Stack RAM usage effects: ------------------------------------ If more than one channel is specified here, the Dcm stack usage will insignificantly increase during the all network communication control command execution.
            symbolic name reference DcmDspAllComMChannelRef: set at post-build in variant post-build-loadable+post-build-selectable / pre-compile in variant pre-compile, destination=ComMChannel  # Dsp All ComM Channel Ref | Reference to ComM channel. Effect: ------------------------------------ Each reference of this type will specify a ComM channel to be controlled if all networks are addressed. Constraints: ------------------------------------ none Dependencies: ------------------------------------ See "destination ref". Runtime effects: ------------------------------------ The more channels to be managed by Dcm the longer the processing time during execution of communication control over all channels. Code ROM usage effects: ------------------------------------ The minimum ROM usage is on a single channel systems. For two or more channels there is no overhead. Const data ROM usage effects: ------------------------------------ The data ROM usage in the Dcm configuration scales with the number of references specified by this setting. Global RAM usage effects: ------------------------------------ none Stack RAM usage effects: ------------------------------------ If more than one channel is specified here, the Dcm stack usage will insignificantly increase during the all network communication control command execution.
          container DcmDspComControlSetting [0..1]  # Provide the configuration of the Communication control.
            reference DcmDspComControlCommunicationReEnableModeRuleRef [0..1]: set at pre-compile, destination=DcmModeRule  # Reference to DcmDspModeRule Mode rule which controls re-enabling the communication of any type on all networks. Effect: ------------------------------------ If a reference to a re-enable mode rule is specified here, the Dcm will start monitor (poll) this rule on any communication control request requesting any disabling functionality. Once the referenced rule conditions are no more fulfilled, the Dcm enables the communication on all networks for any message type. Constraints: ------------------------------------ none Dependencies: ------------------------------------ See "destination ref". Runtime effects: ------------------------------------ Once the Dcm starts polling the rule, the Dcm main function will take slightly longer time on each its activation. The run time depends on the complexity of the rule. Code ROM usage effects: ------------------------------------ If a mode rule is referenced here, the code ROM usage of Dcm will slightly increase. Const data ROM usage effects: ------------------------------------ none Global RAM usage effects: ------------------------------------ none Stack RAM usage effects: ------------------------------------ If mode rule is referenced, during its polling the Dcm main function may need more stack. The usage depends primarily on the nesting depth of the referenced rule.
          container DcmDspComControlSpecificChannel [0..0]  # NOT USED
            integer DcmDspSubnetNumber: 1..14, set at post-build in variant post-build-loadable+post-build-selectable / pre-compile in variant pre-compile  # Subnet Number which controls the specific ComMChannel.
            symbolic name reference DcmDspSpecificComMChannelRef: set at post-build in variant post-build-loadable+post-build-selectable / pre-compile in variant pre-compile, destination=ComMChannel  # Dsp Specific ComM Channel Ref | Reference to ComM channel.
        container DcmDspControlDTCSetting [0..1]  # Provide the configuration of the ControlDTCSetting mechanism.
          boolean DcmSupportDTCSettingControlOptionRecord [0..1]: set at pre-compile, origin=Vector Informatik, default-value=false  # This configuration switch defines if the DTCSettingControlOptionRecord is in general supported in the request message or not. Effect: ------------------------------------ If enabled, the Dcm will expect a DTC group to be specified in the request message for service 0x85 (ControlDTCSetting). If disabled, Dcm will reject any request of this service if sent with a DTC group parameter. Constraints: ------------------------------------ none Dependencies: ------------------------------------ Has effect only if: - Service 0x85 is supported by Dcm; Runtime effects: ------------------------------------ If enabled, the DTC group extraction from the request will increase insignificantly the Dcm main function run time on processing service 0x85. Code ROM usage effects: ------------------------------------ If enabled, the DTC group extraction from the request will increase insignificantly the Dcm code ROM usage. Const data ROM usage effects: ------------------------------------ none Global RAM usage effects: ------------------------------------ none Stack RAM usage effects: ------------------------------------ If enabled, the DTC group extraction from the request may increase insignificantly the Dcm main function stack usage.
          reference DcmDspControlDTCSettingReEnableModeRuleRef [0..1]: set at pre-compile, destination=DcmModeRule  # Reference to DcmDspModeRule Mode rule which controls re-enabling the DTC setting. Effect: ------------------------------------ If a reference to a re-enable mode rule is specified here, the Dcm will start monitor (poll) this rule on any DisableDTCSetting request. Once the referenced rule conditions are no more fulfilled, the Dcm enables the DTC setting automatically. Constraints: ------------------------------------ none Dependencies: ------------------------------------ See "destination ref". Runtime effects: ------------------------------------ Once the Dcm starts polling the rule, the Dcm main function will take slightly longer time on each its activation. The run time depends on the complexity of the rule. Code ROM usage effects: ------------------------------------ If a mode rule is referenced here, the code ROM usage of Dcm will slightly increase. Const data ROM usage effects: ------------------------------------ none Global RAM usage effects: ------------------------------------ none Stack RAM usage effects: ------------------------------------ If mode rule is referenced, during its polling the Dcm main function may need more stack. The usage depends primarily on the nesting depth of the referenced rule.
        container DcmDspData [0..*]  # This container contains the configuration (parameters) of a Data belonging to a DID.
          function name DcmDspDataConditionCheckReadFnc [0..1]: set at pre-compile  # Specifies the call out function name for checking DID reading conditions. Effect: ------------------------------------ If this parameter is not empty, the Dcm will call the specified function on DID reading diagnostic request. Constraints: ------------------------------------ none Dependencies: ------------------------------------ Has effect only if: - the diagnostic service 0x22 (ReadDataByIdentifier) is supported by Dcm (refer to /Dcm/DcmConfigSet/DcmDsd/DcmDsdServiceTable/DcmDsdService) - the DID to which the data object is mapped to support read access (refer to /Dcm/DcmConfigSet/DcmDsp/DcmDspDidInfo/DcmDspDidAccess/DcmDspDidRead) - the DcmDspDataUsePort is set to one of the FNC (e.g. call out) types (refer to /Dcm/DcmConfigSet/DcmDsp/DcmDspData/DcmDspDataUsePort) Runtime effects: ------------------------------------ none Code ROM usage effects: ------------------------------------ none Const data ROM usage effects: ------------------------------------ none Global RAM usage effects: ------------------------------------ none Stack RAM usage effects: ------------------------------------ none
          function name DcmDspDataEcuSignal [0..0]: set at pre-compile  # Specifies the function name for control access of a certain ECU Signal by the Dcm. Effect: ------------------------------------ The Dcm will use the name specified by this parameter to call the corresponding IoHwAb function: IoHwAb_Dcm_<EcuSignalName>. Constraints: ------------------------------------ none Dependencies: ------------------------------------ Has effect only if: - the diagnostic service 0x2F (IOControlByDataIdentifier) is supported by Dcm (refer to /Dcm/DcmConfigSet/DcmDsd/DcmDsdServiceTable/DcmDsdService) - the DID to which the data object is mapped to, supports IO control access (refer to Dcm/DcmConfigSet/DcmDsp/DcmDspDidInfo/DcmDspDidAccess/DcmDspDidControl) - the DcmDspDataUsePort is set to one of the USE_ECU_SIGNAL (e.g. call out) types (refer to /Dcm/DcmConfigSet/DcmDsp/DcmDspData/DcmDspDataUsePort) Runtime effects: ------------------------------------ none Code ROM usage effects: ------------------------------------ none Const data ROM usage effects: ------------------------------------ none Global RAM usage effects: ------------------------------------ none Stack RAM usage effects: ------------------------------------ none
          function name DcmDspDataFreezeCurrentStateFnc [0..1]: set at pre-compile  # Specifies the call out function name for freezing the current IO state. Effect: ------------------------------------ If this parameter is not empty, the Dcm will call the specified function on DID IO control diagnostic request. Constraints: ------------------------------------ none Dependencies: ------------------------------------ Has effect only if: - the diagnostic service 0x2F (IOControlByDataIdentifier) is supported by Dcm (refer to /Dcm/DcmConfigSet/DcmDsd/DcmDsdServiceTable/DcmDsdService) - the DID to which the data object is mapped to support IO control access (refer to /Dcm/DcmConfigSet/DcmDsp/DcmDspDidInfo/DcmDspDidAccess/DcmDspDidControl/DcmDspDidFreezeCurrentState) - the DcmDspDataUsePort is set to one of the FNC (e.g. call out) types (refer to /Dcm/DcmConfigSet/DcmDsp/DcmDspData/DcmDspDataUsePort) Runtime effects: ------------------------------------ none Code ROM usage effects: ------------------------------------ none Const data ROM usage effects: ------------------------------------ none Global RAM usage effects: ------------------------------------ none Stack RAM usage effects: ------------------------------------ none
          function name DcmDspDataGetScalingInfoFnc [0..1]: set at pre-compile  # Specifies the call out function name for reading the DID data object scaling information. Effect: ------------------------------------ If this parameter is not empty, the Dcm will call the specified function on DID reading scaling information diagnostic request. Constraints: ------------------------------------ none Dependencies: ------------------------------------ Has effect only if: - the diagnostic service 0x24 (ReadScalingDataByIdentifier) is supported by Dcm (refer to /Dcm/DcmConfigSet/DcmDsd/DcmDsdServiceTable/DcmDsdService) - the DcmDspDataUsePort is set to one of the FNC (e.g. call out) types (refer to /Dcm/DcmConfigSet/DcmDsp/DcmDspData/DcmDspDataUsePort) Runtime effects: ------------------------------------ none Code ROM usage effects: ------------------------------------ none Const data ROM usage effects: ------------------------------------ For each DID signal that has scaling information additional information will be stored. This leads to an additional small ROM data usage. Global RAM usage effects: ------------------------------------ none Stack RAM usage effects: ------------------------------------ none
          function name DcmDspDataReadDataLengthFnc [0..1]: set at pre-compile  # Specifies the call out function name for reading the DID data object length. Effect: ------------------------------------ If this parameter is not empty, the Dcm will call the specified function on DID reading diagnostic request. Constraints: ------------------------------------ none Dependencies: ------------------------------------ Has effect only if: - the diagnostic service 0x22 (ReadDataByIdentifier) is supported by Dcm (refer to /Dcm/DcmConfigSet/DcmDsd/DcmDsdServiceTable/DcmDsdService); - the DID to which the data object is mapped to support read access (refer to /Dcm/DcmConfigSet/DcmDsp/DcmDspDidInfo/DcmDspDidAccess/DcmDspDidRead); - the DcmDspDataUsePort is set to one of the FNC (e.g. call out) types (refer to /Dcm/DcmConfigSet/DcmDsp/DcmDspData/DcmDspDataUsePort); - the data object has variable length (refer /Dcm/DcmConfigSet/DcmDsp/DcmDspDataInfo/DcmDspDataFixedLength). Runtime effects: ------------------------------------ none Code ROM usage effects: ------------------------------------ none Const data ROM usage effects: ------------------------------------ none Global RAM usage effects: ------------------------------------ none Stack RAM usage effects: ------------------------------------ none
          function name DcmDspDataReadEcuSignal [0..0]: set at pre-compile  # Specifies the function name for read access of a certain ECU Signal by the Dcm. Effect: ------------------------------------ The Dcm will use the name specified by this parameter to call the corresponding IoHwAb function: IoHwAb_Dcm_Read<EcuSignalName>. Constraints: ------------------------------------ none Dependencies: ------------------------------------ Has effect only if: - the diagnostic service 0x22 (ReadDataByIdentifier) is supported by Dcm (refer to /Dcm/DcmConfigSet/DcmDsd/DcmDsdServiceTable/DcmDsdService) - the DID to which the data object is mapped to, supports IO control access (refer to Dcm/DcmConfigSet/DcmDsp/DcmDspDidInfo/DcmDspDidAccess/DcmDspDidControl) - the DcmDspDataUsePort is set to one of the USE_ECU_SIGNAL (e.g. call out) types (refer to /Dcm/DcmConfigSet/DcmDsp/DcmDspData/DcmDspDataUsePort) Runtime effects: ------------------------------------ none Code ROM usage effects: ------------------------------------ none Const data ROM usage effects: ------------------------------------ none Global RAM usage effects: ------------------------------------ none Stack RAM usage effects: ------------------------------------ none
          function name DcmDspDataReadFnc [0..1]: set at pre-compile  # Specifies the call out function name for reading the data object content. Effect: ------------------------------------ If this parameter is not empty, the Dcm will call the specified function on DID reading diagnostic request. Constraints: ------------------------------------ none Dependencies: ------------------------------------ Has effect only if: - the diagnostic service 0x22 (ReadDataByIdentifier) is supported by Dcm (refer to /Dcm/DcmConfigSet/DcmDsd/DcmDsdServiceTable/DcmDsdService) - the DID to which the data object is mapped to, supports read access (refer to /Dcm/DcmConfigSet/DcmDsp/DcmDspDidInfo/DcmDspDidAccess/DcmDspDidRead) - the DcmDspDataUsePort is set to one of the FNC (e.g. call out) types (refer to /Dcm/DcmConfigSet/DcmDsp/DcmDspData/DcmDspDataUsePort) Runtime effects: ------------------------------------ none Code ROM usage effects: ------------------------------------ none Const data ROM usage effects: ------------------------------------ none Global RAM usage effects: ------------------------------------ none Stack RAM usage effects: ------------------------------------ none
          function name DcmDspDataResetToDefaultFnc [0..1]: set at pre-compile  # Specifies the call out function name for resetting the current IO state to its default state. Effect: ------------------------------------ If this parameter is not empty, the Dcm will call the specified function on DID IO control diagnostic request. Constraints: ------------------------------------ none Dependencies: ------------------------------------ Has effect only if: - the diagnostic service 0x2F (IOControlByDataIdentifier) is supported by Dcm (refer to /Dcm/DcmConfigSet/DcmDsd/DcmDsdServiceTable/DcmDsdService) - the DID to which the data object is mapped to, supports IO control access (refer to /Dcm/DcmConfigSet/DcmDsp/DcmDspDidInfo/DcmDspDidAccess/DcmDspDidControl/DcmDspDidResetToDefault) - the DcmDspDataUsePort is set to one of the FNC (e.g. call out) types (refer to /Dcm/DcmConfigSet/DcmDsp/DcmDspData/DcmDspDataUsePort) Runtime effects: ------------------------------------ none Code ROM usage effects: ------------------------------------ none Const data ROM usage effects: ------------------------------------ none Global RAM usage effects: ------------------------------------ none Stack RAM usage effects: ------------------------------------ none
          function name DcmDspDataReturnControlToEcuFnc [0..1]: set at pre-compile  # Specifies the call out function name for returning the IO control to the application. Effect: ------------------------------------ If this parameter is not empty, the Dcm will call the specified function on DID IO control diagnostic request. Constraints: ------------------------------------ none Dependencies: ------------------------------------ Has effect only if: - the diagnostic service 0x2F (IOControlByDataIdentifier) is supported by Dcm (refer to /Dcm/DcmConfigSet/DcmDsd/DcmDsdServiceTable/DcmDsdService) - the DID to which the data object is mapped to, supports IO control access (refer to "/Dcm/DcmConfigSet/DcmDsp/DcmDspDidInfo/DcmDspDidAccess/DcmDspDidControl/DcmDspDidReturnControlToEcu") - the DcmDspDataUsePort is set to one of the FNC (e.g. call out) types (refer to /Dcm/DcmConfigSet/DcmDsp/DcmDspData/DcmDspDataUsePort) Runtime effects: ------------------------------------ none Code ROM usage effects: ------------------------------------ none Const data ROM usage effects: ------------------------------------ none Global RAM usage effects: ------------------------------------ none Stack RAM usage effects: ------------------------------------ none
          function name DcmDspDataShortTermAdjustmentFnc [0..1]: set at pre-compile  # Specifies the call out function name for adjusting the IO state. Effect: ------------------------------------ If this parameter is not empty, the Dcm will call the specified function on DID IO control diagnostic request. Constraints: ------------------------------------ none Dependencies: ------------------------------------ Has effect only if: - the diagnostic service 0x2F (IOControlByDataIdentifier) is supported by Dcm (refer to /Dcm/DcmConfigSet/DcmDsd/DcmDsdServiceTable/DcmDsdService) - the DID to which the data object is mapped to, supports IO control access (refer to /Dcm/DcmConfigSet/DcmDsp/DcmDspDidInfo/DcmDspDidAccess/DcmDspDidControl/DcmDspDidShortTermAdjustment) - the DcmDspDataUsePort is set to one of the FNC (e.g. call out) types (refer to /Dcm/DcmConfigSet/DcmDsp/DcmDspData/DcmDspDataUsePort) Runtime effects: ------------------------------------ none Code ROM usage effects: ------------------------------------ none Const data ROM usage effects: ------------------------------------ none Global RAM usage effects: ------------------------------------ none Stack RAM usage effects: ------------------------------------ none
          integer DcmDspDataSize: 8..524280, set at pre-compile, default-value=65535  # Specifies the length of DID data in bits. If Data has variable data length, this parameter specifies the maximum data length. Effect: ------------------------------------ The sum of all data object lengths of a DID specifies the total DID length which, depending on the DID operation (e.g. write/read), will be validated at request reception resp. used for response composition. Constraints: ------------------------------------ The size shall always be a multiple of 8 (byte borders). On S/R data access the following constraints shall be considered: - if the data type is one of the multi byte atomics: (U|S)INT(16|32), the value of this parameter will not be evaluated. - if the data type is UINT8 and the size is a multiple (more than 1) of 8, the result implementation data type will be the same as if the data type was set to UINT8_N. Dependencies: ------------------------------------ The size parameter is either the concrete or maximum data object size, depending on the DcmDspDataFixedLength parameter value (refer to /Dcm/DcmConfigSet/DcmDsp/DcmDspDataInfo/DcmDspDataFixedLength). Runtime effects: ------------------------------------ none Code ROM usage effects: ------------------------------------ none Const data ROM usage effects: ------------------------------------ none Global RAM usage effects: ------------------------------------ none Stack RAM usage effects: ------------------------------------ none
          enumeration DcmDspDataUsePort: {USE_DATA_ASYNCH_CLIENT_SERVER, USE_DATA_ASYNCH_FNC, USE_PAGED_DATA_ASYNCH_CLIENT_SERVER, USE_PAGED_DATA_ASYNCH_FNC, USE_DATA_SYNCH_CLIENT_SERVER, USE_DATA_SYNCH_FNC, USE_BLOCK_ID, USE_NO_DATA, USE_DATA_SENDER_RECEIVER, USE_DATA_NV_DATA_INTERFACE}, set at pre-compile, default-value=USE_DATA_ASYNCH_CLIENT_SERVER  # Defines which kind of interface shall be used to access the data. Effect: ------------------------------------ Depending on the selected type, the Dcm application has to implement either a RTE call, a call out or nothing at all. Note: USE_NO_DATA is applied for gaps at the end of DID to fill up the DID layout. Since they do not carry and data, no callback will be invoked. Constraints: ------------------------------------ none Dependencies: ------------------------------------ none Runtime effects: ------------------------------------ none Code ROM usage effects: ------------------------------------ If set USE_BLOCK_ID, the code usage of DCM will slightly increase. Const data ROM usage effects: ------------------------------------ none Global RAM usage effects: ------------------------------------ none Stack RAM usage effects: ------------------------------------ none
          function name DcmDspDataWriteFnc [0..1]: set at pre-compile  # Specifies the call out function name for writing the data object content. Effect: ------------------------------------ If this parameter is not empty, the Dcm will call the specified function on DID write diagnostic request. Constraints: ------------------------------------ none Dependencies: ------------------------------------ Has effect only if: - the diagnostic service 0x2E (WriteDataByIdentifier) is supported by Dcm (refer to /Dcm/DcmConfigSet/DcmDsd/DcmDsdServiceTable/DcmDsdService) - the DID to which the data object is mapped to, supports read access (refer to /Dcm/DcmConfigSet/DcmDsp/DcmDspDidInfo/DcmDspDidAccess/DcmDspDidWrite) - the DcmDspDataUsePort is set to one of the FNC (e.g. call out) types (refer to /Dcm/DcmConfigSet/DcmDsp/DcmDspData/DcmDspDataUsePort) Runtime effects: ------------------------------------ none Code ROM usage effects: ------------------------------------ none Const data ROM usage effects: ------------------------------------ none Global RAM usage effects: ------------------------------------ none Stack RAM usage effects: ------------------------------------ none
          boolean DcmDspDataConditionCheckReadFncUsed [0..1]: set at pre-compile, origin=Vector Informatik, default-value=true  # This parameter determines if a condition check function is available or not. Effect: ------------------------------------ If set to TRUE and DcmDspDataUsePort is set to - 'USE_DATA_ASYNCH_CLIENT_SERVER' or 'USE_DATA_SYNCH_CLIENT_SERVER', the SWC will be called to get access permission. - 'USE_DATA_SYNCH_FNC' or 'USE_DATA_ASYNCH_FNC', the parameter 'DcmDspDataConditionCheckReadFnc shall contain a valid C-function name. Constraints: ------------------------------------ none Dependencies: ------------------------------------ Has effect only if: - the diagnostic service 0x22 (ReadDataByIdentifier) is supported by Dcm (refer to /Dcm/DcmConfigSet/DcmDsd/DcmDsdServiceTable/DcmDsdService) - the DID to which the data object is mapped to, supports read access (refer to /Dcm/DcmConfigSet/DcmDsp/DcmDspDidInfo/DcmDspDidAccess/DcmDspDidRead) - the DcmDspDataUsePort is set to one of the FNC or CLIENT_SERVER types (refer to /Dcm/DcmConfigSet/DcmDsp/DcmDspData/DcmDspDataUsePort) Runtime effects: ------------------------------------ If disabled, the run-time of a DID is speed up. Code ROM usage effects: ------------------------------------ none Const data ROM usage effects: ------------------------------------ For each data element that needs this function call, the constant ROM usage will increase by several bytes. Global RAM usage effects: ------------------------------------ none Stack RAM usage effects: ------------------------------------ none
          enumeration DcmDspDataType: {BOOLEAN, UINT8, UINT8_N, UINT16, UINT16_N, UINT32, UINT32_N, SINT8, SINT8_N, SINT16, SINT16_N, SINT32, SINT32_N, FLOAT, FLOAT_N}, set at pre-compile, default-value=UINT8  # Provide the data type of a data object belonging to a DID signal. Effect: ------------------------------------ Affects the data object access interface. Constraints: ------------------------------------ Only applicable for S/R and EcuSignal port interfaces. For C/S ports any set up type will be interpret as an UINT8 type. In this cases the actual signal size will be determined by corresponding parameter /Dcm/DcmConfigSet/DcmDsp/DcmDspData/DcmDspDataSize. Dependencies: ------------------------------------ Usage depends on the parameter /Dcm/DcmConfigSet/DcmDsp/DcmDspData/DcmDspDataUsePort. Runtime effects: ------------------------------------ none Code ROM usage effects: ------------------------------------ none Const data ROM usage effects: ------------------------------------ none Global RAM usage effects: ------------------------------------ none Stack RAM usage effects: ------------------------------------ none
          enumeration DcmDspDataEndianness [0..1]: {BIG_ENDIAN, LITTLE_ENDIAN, OPAQUE}, set at pre-compile, origin=Vector Informatik  # Defines the endianness of the data belonging to a DID in a diagnostic request or response message.
          boolean DcmDspDataTypedDataInterfaceEnabled [0..1]: set at pre-compile, origin=Vector Informatik, default-value=true  # Overwrites the default setting specified by DcmGeneral/DcmTypedDataInterfacesEnabled for a specific DID data object. Effect: ----------------------------------------- See DcmGeneral/DcmTypedDataInterfacesEnabled Constraints: ----------------------------------------- See DcmGeneral/DcmTypedDataInterfacesEnabled Dependencies: ----------------------------------------- See DcmGeneral/DcmTypedDataInterfacesEnabled Runtime effects: ----------------------------------------- See DcmGeneral/DcmTypedDataInterfacesEnabled Code ROM usage effects: ------------------------------------ See DcmGeneral/DcmTypedDataInterfacesEnabled Const data ROM usage effects: ----------------------------------------- See DcmGeneral/DcmTypedDataInterfacesEnabled Global RAM usage effects: ----------------------------------------- See DcmGeneral/DcmTypedDataInterfacesEnabled Stack RAM usage effects: ----------------------------------------- See DcmGeneral/DcmTypedDataInterfacesEnabled
          string DcmDspDataConstantValue [0..1]: set at pre-compile, origin=Vector Informatik, min-length=1  # Specifies the constant content of this signal. Effect: ------------------------------------ For a read access (i.e. via service 0x22) the content of this parameter gets reported. The DCM will handle the read access to this data signal internally, there will be no port available. The DCM will add padding bytes (0xFF) in case of the configured data size (DcmDspDataSize) is larger than the constant content. Constraints: ------------------------------------ The allowed characters/digits depend on the selected value of parameter /Dcm/DcmConfigSet/DcmDsp/DcmDspData/DcmDspDataConstantValueType. Dependencies: ------------------------------------ - /Dcm/DcmConfigSet/DcmDsp/DcmDspData/DcmDspDataConstantValueType - /Dcm/DcmConfigSet/DcmDsp/DcmDspData/DcmDspDataSize Runtime effects: ------------------------------------ none Code ROM usage effects: ------------------------------------ Enabling this feature leads to an increas of the Dcm generated code ROM usage. Const data ROM usage effects: ------------------------------------ none Global RAM usage effects: ------------------------------------ none Stack RAM usage effects: ------------------------------------ Enabling this feature can lead to a major increased stack size required by the Dcm_MainFunction. The amount of additional RAM usage depends on the provided constant vlaue and the related DcmDspDataSize.
          enumeration DcmDspDataConstantValueType [0..1]: {ASCII, DEC, HEX}, set at pre-compile, origin=Vector Informatik, default-value=HEX  # Specifies the type of the content provided within parameter DcmDspDataConstantValue. Effect: ------------------------------------ Defines how the DCM interprets the content of parameter DcmDspDataConstantValue. Constraints: ------------------------------------ none Dependencies: ------------------------------------ - /Dcm/DcmConfigSet/DcmDsp/DcmDspData/DcmDspDataConstantValue Runtime effects: ------------------------------------ none Code ROM usage effects: ------------------------------------ none Const data ROM usage effects: ------------------------------------ none Global RAM usage effects: ------------------------------------ none Stack RAM usage effects: ------------------------------------ none
          integer DcmDspDataConstantValuePaddingPattern [0..1]: 0..255, set at pre-compile, origin=Vector Informatik, default-value=255  # Determines the padding byte value for the unused data bytes for the constant value. Effect: ------------------------------------ If this parameter does not exist, padding will be applied with value 0xFF. If this parameter exists, the selected value will be used for padding in case of the configured data size (DcmDspDataSize) is larger than the constant content. Constraints: ------------------------------------ none Dependencies: ------------------------------------ - /Dcm/DcmConfigSet/DcmDsp/DcmDspData/DcmDspDataConstantValue - /Dcm/DcmConfigSet/DcmDsp/DcmDspData/DcmDspDataSize Runtime effects: ------------------------------------ none Code ROM usage effects: ------------------------------------ none Const data ROM usage effects: ------------------------------------ none Global RAM usage effects: ------------------------------------ none Stack RAM usage effects: ------------------------------------ none
          reference DcmDspDataInfoRef: set at pre-compile, destination=DcmDspDataInfo  # Reference to a DcmDspDataInfo. Effect: ------------------------------------ The Dcm will get the complete DID definition. Constraints: ------------------------------------ none Dependencies: ------------------------------------ See "destination ref". Runtime effects: ------------------------------------ none Code ROM usage effects: ------------------------------------ none Const data ROM usage effects: ------------------------------------ none Global RAM usage effects: ------------------------------------ none Stack RAM usage effects: ------------------------------------ none
          symbolic name reference DcmDspDataBlockIdRef [0..1]: set at pre-compile, destination=NvMBlockDescriptor  # Reference to a NvM block that shall be directly accessed by DCM. Effect: ------------------------------------ The Dcm will read/write from/to this NvM block. Constraints: ------------------------------------ The referenced data block shall have exactly the same length as the one specified for DcmDspData size: /Dcm/DcmConfigSet/DcmDsp/DcmDspData/DcmDspDataSize. Dependencies: ------------------------------------ See "destination ref". Runtime effects: ------------------------------------ none Code ROM usage effects: ------------------------------------ none Const data ROM usage effects: ------------------------------------ none Global RAM usage effects: ------------------------------------ none Stack RAM usage effects: ------------------------------------ none
          foreign reference DcmDspDataSystemTemplateDiagnosticDataElementRef [0..1]: set at pre-compile in variant post-build-loadable+pre-compile / post-build in variant post-build-selectable, origin=Vector Informatik, destination-type=DIAGNOSTIC-DATA-ELEMENT  # Reference to the DiagnosticDataElement which is represented by this DcmDspData
