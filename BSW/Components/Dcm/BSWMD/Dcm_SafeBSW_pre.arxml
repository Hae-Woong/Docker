AUTOSAR XML (schema 4-0-3)
package /MICROSAR
  module config Dcm_Rec: definition=Dcm
    DcmConfigSet
      DcmGeneral: DcmSafeBswChecks=1
