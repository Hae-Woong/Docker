AUTOSAR XML (schema 00048)
# COPYRIGHT
# Copyright (c) 2024 by Vector Informatik GmbH. All rights reserved.
# This software is copyright protected and proprietary to Vector Informatik GmbH.
# Vector Informatik GmbH grants to you only those rights as set out in the license conditions.
package /MICROSAR
  bsw implementation Dcm_Impl
    resource consumption ResourceConsumption
      20 x memory section:
        DCM_CALLOUT_CODE: sw-addrmethod=CALLOUT_CODE, symbol=CALLOUT_CODE
        DCM_CODE: sw-addrmethod=CODE, symbol=CODE
        DCM_APPL_CODE: sw-addrmethod=CODE, symbol=APPL_CODE
        DCM_CONST_8: alignment=8, sw-addrmethod=CONST, symbol=CONST_8
        DCM_CONST_16: alignment=16, sw-addrmethod=CONST, symbol=CONST_16
        DCM_CONST_32: alignment=32, sw-addrmethod=CONST, symbol=CONST_32
        DCM_CONST_UNSPECIFIED: alignment=UNSPECIFIED, sw-addrmethod=CONST, symbol=CONST_UNSPECIFIED
        DCM_CONST_PBCFG: sw-addrmethod=CONST_PBCFG, symbol=PBCFG
        DCM_VAR_INIT_8: alignment=8, sw-addrmethod=VAR_INIT, symbol=VAR_INIT_8
        DCM_VAR_INIT_16: alignment=16, sw-addrmethod=VAR_INIT, symbol=VAR_INIT_16
        DCM_VAR_INIT_32: alignment=32, sw-addrmethod=VAR_INIT, symbol=VAR_INIT_32
        DCM_VAR_NO_INIT_8: alignment=8, sw-addrmethod=VAR_NO_INIT, symbol=VAR_NO_INIT_8
        DCM_VAR_NO_INIT_16: alignment=16, sw-addrmethod=VAR_NO_INIT, symbol=VAR_NO_INIT_16
        DCM_VAR_NO_INIT_32: alignment=32, sw-addrmethod=VAR_NO_INIT, symbol=VAR_NO_INIT_32
        DCM_VAR_NO_INIT_UNSPECIFIED: alignment=UNSPECIFIED, sw-addrmethod=VAR_NO_INIT, symbol=VAR_NO_INIT_UNSPECIFIED
        DCM_VAR_PBCFG: sw-addrmethod=VAR_PBCFG, symbol=VAR_PBCFG
        DCM_CALIB_8: alignment=8, sw-addrmethod=CONST, symbol=CALIB_8
        DCM_CALIB_16: alignment=16, sw-addrmethod=CONST, symbol=CALIB_16
        DCM_CALIB_32: alignment=32, sw-addrmethod=CONST, symbol=CALIB_32
        DCM_CALIB_UNSPECIFIED: alignment=UNSPECIFIED, sw-addrmethod=CONST, symbol=CALIB_UNSPECIFIED
