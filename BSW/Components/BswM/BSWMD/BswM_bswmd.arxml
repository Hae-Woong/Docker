AUTOSAR XML (schema 4-0-3)
# COPYRIGHT
# Copyright (c) 2024 by Vector Informatik GmbH. All rights reserved.
# This software is copyright protected and proprietary to Vector Informatik GmbH.
# Vector Informatik GmbH grants to you only those rights as set out in the license conditions.
package /MICROSAR
  module definition BswM [0..1]: category=VENDOR_SPECIFIC_MODULE_DEFINITION, refined-module-def=BswM, variants pre-compile/post-build-loadable/post-build-selectable  # BSW Mode Manager. Implements the Vehicle Mode Management and Application Mode Management concept including the state handling of the ECU. It's responsibility is to arbitrate mode requests from application layer SW-Cs or other BSW modules based on rules, and perform actions based on the arbitration result. #ModeManagement #ModeRequest #Rules #Actionlist #Startup #Shutdown #StateHandling #AUTOSAR #ServiceComponent
    container BswMConfig [1..*]  # This container includes the configuration parameters and sub containers of the AUTOSAR BswM module. This container is a MultipleConfigurationContainer, i.e. this container and its sub-containers exist once per configuration set.
      reference BswMPartitionRef [0..1]: set at pre-compile, origin=Vector Informatik, destination=EcucPartition  # This references the partition the BswM shall run inside.
      reference BswMInitTask [0..1]: set at pre-compile, origin=Vector Informatik, destination=OsTask  # This parameter references the Init Task that initializes the selected BswM instance. Hint: It is the same task that calls the EcuM_StartupTwo() API. Note: This reference is only needed for MultiPartition use cases AND on partitions that share the same core.
      reference BswMInitTaskEvent [0..1]: set at pre-compile, origin=Vector Informatik, destination=OsEvent  # This parameter references the event that is needed for synchronization at initialization. Note: It is only necessary in case of Multi Partition use case AND if there are multiple BswMConfig containers (OsApplications) linked to one core.
      container BswMArbitration  # This container includes all configuration sub-containers and parameters related to the mode arbitration functionality of the BswM.
        container BswMLogicalExpression [0..*]  # This container describes the logical expressions that can be used for the mode arbitration. The logical expressions are built of a set of arguments and a logical operator. Each argument can either be a mode condition or a sub-expression to allow definition of more complex logical expressions. | There may be an unlimited number of arguments in each logical expression. Note that the order of evaluation of the expressions is not defined.
          enumeration BswMLogicalOperator [0..1]: {BSWM_AND, BSWM_NAND, BSWM_OR, BSWM_XOR}, set at pre-compile in variant post-build-loadable+pre-compile / post-build in variant post-build-selectable  # This parameter defines the logical operator to be used in the logical expression. If the expression only consists of a single condition this parameter is not considered.
          choice reference BswMArgumentRef [1..*]: set at pre-compile in variant post-build-loadable+pre-compile / post-build in variant post-build-selectable, destination=[BswMLogicalExpression, BswMModeCondition]  # Reference either to a mode condition or a sub-expression. | In case the BswMLogicalExpression.BswMLogicalOperator equals BSWM_NAND only two operands are supported.
        container BswMModeCondition [0..*]  # This container includes the BswM mode conditions that can be used either by itself to form a rule or as a part of a logical expression.
          enumeration BswMConditionType: {BSWM_EQUALS, BSWM_EQUALS_NOT}, set at pre-compile  # This parameter defines what kind of comparison is made for the evaluation of the mode condition.
          reference BswMConditionMode: set at pre-compile, destination=BswMModeRequestPort  # Reference to the mode request port that is used for the condition.
          choice container BswMConditionValue [0..1]  # This container includes the parameters and references necessary to identify the mode type and the value that the mode request is compared to.
            container BswMBswMode [0..1]  # This container includes the value and type of a mode in the BSW.
              string BswMBswRequestedMode: set at pre-compile  # This parameter defines the symbolic name (as a string) of a certain mode/state that can be requested/indicated by the BSW modules.
            container BswMModeDeclaration [0..1]  # This container includes a reference to a mode declaration. When the mode corresponds to a mode request or mode indication interface the mode is defined by a mode declaration. The mode declarations are defined in the SW-C Template and hence a foreign reference to the corresponding Mode Declaration is used.
              foreign reference BswMModeValueRef: set at pre-compile, destination-type=MODE-DECLARATION  # This is a foreign reference to the Mode Declaration used for the mode requests corresponding to this condition.
        container BswMModeRequestPort [0..*]  # Each instance of this container defines a mode request interface that is used to requests or indicate modes from/to the BswM. These interfaces are implemented as ports or as ordinary C-functions based upon if the request is made by an SW-C or a BSW module. | There are different types of mode requests: 1. Mode requests from the SW-C's 2. Mode Requests from other BSW modules such as the DCM. 3. State/mode indications from the RTE or other BSW modules such as the bus specific State Managers. Note that the BswM treats all request and indications in the exact same way.
          boolean BswMArbitrateOnInit: set at post-build in variant post-build-loadable+post-build-selectable / pre-compile in variant pre-compile, origin=Vector Informatik, default-value=false  # If enabled, rules which depend on this Request Port will be arbitrated on the init value of this port too. This will be performed at the end of BswM_Init. Only available for IMMEDIATE and FORCED_IMMEDIATE request processing. | If this parameter is false (and processing is not BSWM_DEFERRED), depending rules will only be arbitrated on the init value if rule arbitration is invoked by an other mode request port.
          enumeration BswMRequestProcessing: {BSWM_DEFERRED, BSWM_IMMEDIATE, BSWM_FORCED_IMMEDIATE}, set at pre-compile in variant pre-compile+post-build-loadable / post-build in variant post-build-selectable  # This parameter defines the processing of the mode arbitration. | If the processing values is BSWM_DEFERRED, the processing shall be deferred to the processing of the main function of BswM. If its value is BSWM_IMMEDIATE, the processing shall be done immediately when a mode request is received, requests are queued in case another immediate request is being processed or in case the deferred rules in the main function are being processed. When the processing value is BSWM_FORCED_IMMEDIATE the mode arbitration shall be done immediately, interrupting other immediate requests or deferred rules being processed in the main function.
          choice container BswMModeInitValue [0..1]  # This container defines the initial mode value that is used by BswM for the corresponding mode request after initialization. This container is optional and shall only be used for Mode Requests that do not already have an initial value. | If this container is not present the requested mode is undefined after initialization of BswM. The requested mode will remain undefined until the requester performs a request.
            container BswMBswModeInitValue [0..1]  # This is the choice for a initial mode value used for the initialization of mode requests in case the request is made by a BSW module.
              string BswMBswModeInitValueMode: set at post-build in variant post-build-loadable / pre-compile in variant post-build-selectable+pre-compile  # This parameter defines the initial mode value that is used by BswM for the corresponding mode request after initialization.
            container BswMSwcModeInitValue [0..1]  # This is the choice for a foreign reference to the Mode Declaration used for the initialization of mode requests in case the request is made by a SW-C.
              foreign reference BswMSwcModeInitValueRef: set at post-build in variant post-build-loadable / pre-compile in variant post-build-selectable+pre-compile, destination-type=MODE-DECLARATION  # This is a foreign reference to the Mode Declaration used for the initialization of mode requests.
            container BswMCompuScaleModeValue [0..1]  # This container contains parameters used to define a mode value.
              string BswMCompuConstText: set at post-build in variant post-build-loadable+post-build-selectable / pre-compile in variant pre-compile, origin=Vector Informatik  # The value of this parameter shall match one VT member of the referenced CompuMethod (BswMCompuMethodRef).
              foreign reference BswMCompuMethodRef: set at post-build in variant post-build-loadable+post-build-selectable / pre-compile in variant pre-compile, origin=Vector Informatik, destination-type=COMPU-METHOD  # This is a foreign reference to the CompuMethod used for mode requests. The CompuMethod category shall be TEXTTABLE.
          choice container BswMModeRequestSource  # This choice container specifies the source of the mode request or state/mode indication. The requester of a mode can be both SW-C's and other BSW Modules, such as the bus specific State Managers.
            container BswMBswModeNotification [0..0]  # The source of the mode request is a BSW Module. Not used parameter. | If the BswMRequestProcessing of this BswMModeRequestPort is set to BSWM_IMMEDIATE then it is assumed that the Basic Software Module Description of the BswM contains a BswSchedulableEntity which is activated by a BswModeSwitchEvent. This BswModeSwitchEvent shall refer to the ModeDeclarationGroupPrototype which is referenced by BswMBswModeDeclarationGroupPrototypeRef. If the BswMRequestProcessing of this BswMModeRequestPort is set to BSWM_DEFERRED then it is up to the implementer of the BswM tooling whether a BswSchedulableEntity is used to update the BswM internal mode mirror or whether the BswM internal mode mirror is updated during the main function execution.
              foreign reference BswMBswModeDeclarationGroupPrototypeRef: set at pre-compile, destination-type=MODE-DECLARATION-GROUP-PROTOTYPE  # This is a foreign reference to the Mode Declaration Group Prototype.
            container BswMCanSMIndication [0..1]  # CanSM Indication | This is an indication of the current state of the CAN State Manager.
              symbolic name reference BswMCanSMChannelRef: set at pre-compile, destination=ComMChannel  # CanSM Channel Ref | This is a reference to the CAN channel handle that the mode request corresponds to.
            container BswMComMIndication [0..1]  # ComM Indication | This is an indication of the current communication mode of a channel in the Communication Manager.
              symbolic name reference BswMComMChannelRef: set at pre-compile, destination=ComMChannel  # ComM Channel Ref | This is a reference to the Communication Manager channel handle that the indication corresponds to.
            container BswMComMInitiateReset [0..1]  # ComM Initiate Reset | This is an indication from the ComM to indicate a reset. This container does not contain any parameters since there is no further configuration needed for this type of request.
            container BswMComMPncRequest [0..1]  # ComM Pnc Request | This is a request of the current communication mode of a Partial Network Cluster in the Communication Manager.
              symbolic name reference BswMComMPncRef: set at pre-compile, destination=ComMPnc  # ComM Pnc Ref | This is a reference to the Communication Manager PNC handle of the Partial Network Cluster that the request corresponds to.
            container BswMDcmApplicationUpdatedIndication [0..1]  # This is a request to update application data from the DCM. This container does not contain any parameters since there are no further configuration needed for this type of request.
            container BswMDcmComModeRequest [0..1]  # The source of the mode request is the Diagnostic Communication Manager.
              string BswMDcmComMNetwork [0..1]: set at pre-compile  # Dcm ComM Network | This parameter specifies the network the request relates to. Not used parameter.
              reference BswMDcmComMChannelRef: set at pre-compile, origin=Vector Informatik, destination=ComMChannel  # Dcm ComM Channel Ref | This is a reference to the Communication Manager channel handle that the indication corresponds to.
            container BswMDoIPSetChannelReady [0..1]  # DoIP Set Channel Ready | This is a request from DoIP to report channel ready in case a routing activation has been successfully performed. This container does not contain any parameters since there are no further configuration needed for this type of request.
            container BswMDoIPIntSetChannelReady [0..1]  # DoIPInt Set Channel Ready | This is a request from DoIPInt to report channel ready in case a connection has been successfully established. This container does not contain any parameters since there are no further configuration needed for this type of request.
            container BswMEcuMIndication [0..1]  # EcuM Indication | This is a notification of the current operation mode of the ECU State Manager. This container does not contain any parameters since there are no further configuration needed for this type of request.
            container BswMEcuMRUNRequestIndication [0..1]  # EcuM RUN Request Indication | This is an indication of the current State of the RUN Request Protocol.
              enumeration BswMEcuMRUNRequestProtocolPort: {POST_RUN, RUN}, set at pre-compile, origin=Vector Informatik  # EcuM RUN Request Protocol Port | Identifies the EcuM State which is related to the mode request.
            container BswMEcuMWakeupSource [0..1]  # EcuM Wakeup Source | This is a notification of the current state of an ECU State Manager wakeup source.
              symbolic name reference BswMEcuMWakeupSrcRef: set at pre-compile, destination=EcuMWakeupSource  # EcuM Wakeup Src Ref | This is a reference to the ECU State Manager Wakeup Source that the indication corresponds to.
            container BswMEthIfPortGroupLinkStateChg [0..1]  # EthIf Port Group Link State Change | This is an indication from the EthIf if the link state of a ethernet interface switch port group has changed.
              symbolic name reference BswMEthIfSwitchPortGroupRef: set at pre-compile, origin=Vector Informatik, destination=EthIfSwitchPortGroup  # EthIf Switch Port Group Ref | This is a reference to the Ethernet Interface Switch Port Group that the indication corresponds to.
            container BswMEthSMIndication [0..1]  # EthSM Indication | This is an indication of the current state of the Ethernet State Manager.
              symbolic name reference BswMEthSMChannelRef: set at pre-compile, destination=ComMChannel  # EthSM Channel Ref | This is a reference to the Ethernet channel handle that the mode request corresponds to.
            container BswMFrSMIndication [0..1]  # FrSM Indication | This is an indication of the current state of the FlexRay State Manager.
              symbolic name reference BswMFrSMChannelRef: set at pre-compile, destination=ComMChannel  # FrSM Channel Ref | This is a reference to the FlexRay Cluster handle that the mode request corresponds to.
            container BswMGenericRequest [0..1]  # This mode request originates from a requester that is not among the list of standardized mode requesters (i.e. the different resource managers).
              integer BswMModeRequesterId: 0..65535, set at pre-compile  # This parameters identifies the different users of the generic mode request interface.
              integer BswMRequestedModeMax: 0..65535, set at pre-compile  # Not used parameter. This parameter defines the upper limit for the modes requested by this mode requester.
              container BswMGenericRequestMode [0..*]  # Each instance of this container defines a generic mode with name of this container. In Code, name of this define will be "BSWM_GENERICVALUE_" + short name of of BswMModeRequestPort + "_" + Short name of BswMGenericRequestMode
                integer BswMGenericRequestModeValue: 0..65535, set at pre-compile, origin=Vector Informatik  # Defines the value of the Generic Mode
                reference BswMGenericRequestPortValueRef [0..1]: set at pre-compile, origin=Vector Informatik, destination=BswMModeRequestPort  # If configured, the fixed value of BswMGenericRequestModeValue is ignored. Instead, this mode represents the current value of the referenced request port during runtime. So, using this mode, the corresponding BswMGenericRequest can be compared easily to another BswMGenericRequest or can overtake its value (if used in a BswMGenericModeSwitch).
            container BswMJ1939DcmBroadcastStatus [0..1]  # This is a notification of the desired broadcast status per network, triggered via DM13.
              symbolic name reference BswMJ1939DcmChannelRef: set at pre-compile, origin=Vector Informatik, destination=ComMChannel  # Reference to the channel represented by the nth bit in the networkMask parameter to J1939DcmBroadcastStatus.
            container BswMJ1939NmIndication [0..1]  # This is an indication of the current state of the J1939 network management module.
              symbolic name reference BswMJ1939NmChannelRef: set at pre-compile, origin=Vector Informatik, destination=ComMChannel  # This is a reference to the J1939Nm channel handle that the mode request corresponds to.
              symbolic name reference BswMJ1939NmNodeRef: set at pre-compile, origin=Vector Informatik, destination=J1939NmNode  # This is a reference to the node that the mode request corresponds to.
            container BswMLinScheduleEndNotification [0..1]  # Notifies the end of a schedule of configured LinSM channel.
              symbolic name reference BswMLinSMChannelRef: set at pre-compile, origin=Vector Informatik, destination=ComMChannel  # LinSM Channel Ref | This is a reference to the LIN channel handle that the mode request corresponds to.
            container BswMLinSMIndication [0..1]  # LinSM Indication | This is an indication of the current state of the LIN State Manager.
              symbolic name reference BswMLinSMChannelRef: set at pre-compile, destination=ComMChannel  # LinSM Channel Ref | This is a reference to the LIN channel handle that the mode request corresponds to.
            container BswMLinScheduleIndication [0..1]  # This is an indication of the currently active LIN Schedule Table for a specific LIN Interface.
              symbolic name reference BswMLinScheduleRef: set at post-build in variant post-build-loadable / pre-compile in variant pre-compile+post-build-selectable, destination=LinSMSchedule  # This is a reference to the LIN Schedule Table handle that the mode request corresponds to.
            container BswMLinTpModeRequest [0..1]  # LinTP Mode Request | This is a LinTp mode request from the LinIf. This port corresponds to a call of the BswM_LinTp_RequestMode API.
              symbolic name reference BswMLinTpChannelRef: set at pre-compile, destination=LinIfChannel  # LinTP Channel Ref | This is a reference to the LIN Interface Channel that the mode request corresponds to.
            container BswMNmIndication [0..1]  # This is an indication of the current state of the network management module.
              symbolic name reference BswMNmChannelRef: set at pre-compile, origin=Vector Informatik, destination=ComMChannel  # This is a reference to the Nm channel handle that the mode request corresponds to.
            container BswMNvMJobModeIndication [0..1]  # NvM Job Mode Indication | Indicates the current status of the multiblock job. The job is identified via BswMNvmService, e.g. 0x0c for NvmReadAll, 0x0d for NvmWriteAll. | Possible Values are: NVM_REQ_OK NVM_REQ_NOT_OK NVM_REQ_PENDING NVM_REQ_CANCELED
              enumeration BswMNvmService: {NvmReadAll, NvmWriteAll}, set at pre-compile  # NvM Service | Identifies the NvM job which is related to the mode request.
            container BswMNvMRequest [0..1]  # NvM Request | Via this Mode Request Source the NvM indicates the current status of the specified block. | Possible Values are: NVM_REQ_OK NVM_REQ_NOT_OK NVM_REQ_PENDING NVM_REQ_INTEGRITY_FAILED NVM_REQ_BLOCK_SKIPPED NVM_REQ_NV_INVALIDATED NVM_REQ_CANCELED NVM_REQ_REDUNDANCY_FAILED NVM_REQ_RESTORED_FROM_ROM
              symbolic name reference BswMNvMBlockRef: set at pre-compile, destination=NvMBlockDescriptor  # NvM Block Ref | This is a reference to the NvM Block Descriptor that the request corresponds to.
            container BswMPduRPreTransmit [0..1]  # BswM PduR Pre Transmit | This mode request port is called just before the <LowerDestModule>_Transmit function for the referred PduRDestPdu is called. This mode request source can only be used for PduRDestPdus with transmit direction.
              reference BswMPduRDestPduRef [1..*]: set at pre-compile, origin=Vector Informatik, destination=PduRDestPdu  # PduR Dest Pdu Ref | This is a reference to the Dest Pdu that the mode request corresponds to.
            container BswMPduRRxIndication [0..1]  # PduR Rx Indication | This is a Rx Indication from the PduR.
              reference BswMPduRSrcPduRef [1..*]: set at pre-compile, origin=Vector Informatik, destination=PduRSrcPdu  # PduR Src Pdu Ref | This is a reference to the Src Pdu that the mode request corresponds to.
            container BswMPduRTpRxIndication [0..1]  # PduR Tp Rx Indication | This is a Tp Rx Indication from the PduR.
              reference BswMPduRSrcPduRef [1..*]: set at pre-compile, origin=Vector Informatik, destination=PduRSrcPdu  # PduR Src Pdu Ref | This is a reference to the Src Pdu that the mode request corresponds to.
            container BswMPduRTpStartOfReception [0..1]  # PduR Tp Start Of Reception | This is a Start of Reception Nofitication from the PduR.
              reference BswMPduRSrcPduRef [1..*]: set at pre-compile, origin=Vector Informatik, destination=PduRSrcPdu  # PduR Src Pdu Ref | This is a reference to the Src Pdu that the mode request corresponds to.
            container BswMPduRTpTxConfirmation [0..1]  # PduR Tp Tx Confirmation | This is a Tp Tx Confirmation from the PduR.
              reference BswMPduRDestPduRef [1..*]: set at pre-compile, origin=Vector Informatik, destination=PduRDestPdu  # PduR Dest Pdu Ref | This is a reference to the Dest Pdu that the mode request corresponds to.
            container BswMPduRTransmit [0..1]  # PduR Transmit | This is a Transmit Nofitication from the PduR.
              reference BswMPduRSrcPduRef [1..*]: set at pre-compile, origin=Vector Informatik, destination=PduRSrcPdu  # PduR Src Pdu Ref | This is a reference to the Src Pdu that the mode request corresponds to.
            container BswMPduRTxConfirmation [0..1]  # PduR Tx Confirmation | This is a Tx Confirmation from the PduR.
              reference BswMPduRDestPduRef [1..*]: set at pre-compile, origin=Vector Informatik, destination=PduRDestPdu  # PduR Dest Pdu Ref | This is a reference to the Dest Pdu that the mode request corresponds to.
            container BswMSwcModeNotification [0..1]  # This is a mode switch notification associated with a RTE switch interface.
              foreign reference BswMSwcModeNotificationModeDeclarationGroupPrototypeRef: set at pre-compile, destination-type=MODE-DECLARATION-GROUP-PROTOTYPE  # This is a foreign reference to the ModeDeclarationGroupPrototype.
            container BswMSdClientServiceCurrentState [0..1]  # Used by Service Discovery module to indicate current state of the Client Service (available/down).
              symbolic name reference BswMSdClientMethodsRef: set at pre-compile, origin=Vector Informatik, destination=SdClientService  # This is a reference to a client service in the Sd module.
            container BswMSdConsumedEventGroupCurrentState [0..1]  # Used by Service Discovery to indicate current status of the EventHandler (requested/released).
              symbolic name reference BswMSdConsumedEventGroupRef: set at pre-compile, origin=Vector Informatik, destination=SdConsumedEventGroup  # This is a reference to an eventGroup that is defined within a client service in the Sd module.
            container BswMSdEventHandlerCurrentState [0..1]  # Used by Service Discovery to indicate current status of the EventHandler (requested/released).
              symbolic name reference BswMSdEventHandlerRef: set at pre-compile, origin=Vector Informatik, destination=SdEventHandler  # This is a reference to an event handler that is defined within a server service in the Sd module.
            container BswMSwcModeRequest [0..1]  # The source of the mode request is a SW Component.
              string BswMModeRequestDataElementPrototypeName [0..1]: set at pre-compile, origin=Vector Informatik, default-value=requestedMode  # The parameter describes the name of the SR-Interface data element which contains the requested mode. The data element name must be identical to the data element name of the corresponding application SR-Interface.
              foreign reference BswMSwcModeRequestModeDeclarationGroupPrototypeRef [0..1]: set at pre-compile, destination-type=MODE-DECLARATION-GROUP-PROTOTYPE  # This is a foreign reference to the ModeDeclarationGroupPrototype. As the mode request is SR-Communication the BswM shall provide a SR-Interface which corresponds to the ModeDeclarationGroupPrototype. The SR-Interface shall contain one ApplicationPrimitiveDataType which is defined as an enumeration (compuMethod) with the enumeration literals matching the ModeDeclarations. | The SR-Interface shall contain one ApplicationPrimitiveDataType which is defined as an enumeration (compuMethod) with the enumeration literals matching the ModeDeclarations.
              instance reference BswMSwcModeRequestPortInterfaceRef [0..1]: set at pre-compile, origin=Vector Informatik, destination-context=SW-COMPONENT-PROTOTYPE* PORT-PROTOTYPE, destination-type=VARIABLE-DATA-PROTOTYPE  # This is an instance reference to the variable data prototype used for the mode request.
            container BswMTimer [0..1]  # This is a timer which can be used for time depending rules.
            container BswMUserConditionRequest [0..1]  # The source of this Request can be any available function with a return value.
              string BswMUserCondition: set at pre-compile, origin=Vector Informatik  # Function with return value which shall be used as condition.
            container BswMWdgMRequestPartitionReset [0..1]  # WdgM Request Partition Reset | This is a Partition Reset request fromthe WdgM. This port corresponds to a call of the BswM_WdgM_RequestPartitionReset API.
              reference BswMWdgMRequestPartitionResetRef: set at pre-compile, destination=EcucPartition  # This is a reference to the partition that shall be reset.
        container BswMRule [0..*]: post-build-changeable=true  # Each instance of this container describes a BswM arbitration rule. The rule either consists of a simple mode condition or a more complex logical expression. This container also references the action lists that shall be invoked when the rule is evaluated to True or False.
          boolean BswMNestedExecutionOnly: set at post-build in variant post-build-loadable+post-build-selectable / pre-compile in variant pre-compile, default-value=false  # This parameter defines for its related Rule if the Rule is an Independent rule or a Subordinate rule. | false: an Independent rule, i.e. to be evaluated each time applicable (both as standalone Rule driven by its own BswMModeRequestSource and when referenced by another Rule). true: a Subordinated rule, to be evaluated ONLY as a result of being referenced in one or more Action Lists.
          integer BswMRuleId: 0..65535, set at pre-compile, origin=Vector Informatik, symbolic-name-value=true, default-value=0  # This parameters identifies the different rules and is used for the rule control interface.
          enumeration BswMRuleInitState: {BSWM_FALSE, BSWM_TRUE, BSWM_UNDEFINED, BSWM_DEACTIVATED}, set at post-build in variant post-build-loadable+post-build-selectable / pre-compile in variant pre-compile  # This parameter is a part of the reset/initialization behavior of BswM. | Action lists are executed when the result of a rule evaluation have changed since the last evaluation. This parameter defines the "previous evaluation result" of a rule to be used after initialization of the BswM. If this parameter is set to BSWM_UNDEFINED, the evaluation result is always treated as changed at the first evaluation of the rule after initialization. If this parameter is set to BSWM_TRUE, the evaluation result is treated as changed if the rule is evaluated to false. If this parameter is set to BSWM_FALSE, the evaluation result is treated as changed if the rule is evaluated to true.
          reference BswMRuleExpressionRef: set at post-build in variant post-build-loadable+post-build-selectable / pre-compile in variant pre-compile, destination=BswMLogicalExpression  # This is a reference to the logical expression that is evaluated for each rule.
          reference BswMRuleFalseActionList [0..1]: set at post-build in variant post-build-loadable+post-build-selectable / pre-compile in variant pre-compile, destination=BswMActionList  # This is a reference to the action list that shall be executed when the rule is evaluated to False
          reference BswMRuleTrueActionList [0..1]: set at post-build in variant post-build-loadable+post-build-selectable / pre-compile in variant pre-compile, destination=BswMActionList  # This is a reference to the action list that shall be executed when the rule is evaluated to True
      container BswMDataTypeMappingSets [0..1]  # Collection of references to DataTypeMappingSet.
        foreign reference BswMDataTypeMappingSetRef [1..*]: set at pre-compile, destination-type=DATA-TYPE-MAPPING-SET  # Reference to DataTypeMappingSet.
      container BswMModeControl  # This container includes all configuration sub-containers and parameters related to the mode control functionality of the BswM.
        reference BswMInitActionListRef [0..*]: set at post-build in variant post-build-loadable+post-build-selectable / pre-compile in variant pre-compile, origin=Vector Informatik, destination=BswMActionList  # Reference to an ActionList which will be executed at the end of BswM Initialization.
        container BswMAction [0..*]  # Each container of this type defines an action. These actions can be part of one or several action lists.
          choice container BswMAvailableActions  # Choice container including the available actions to be used in the action lists.
            container BswMComMAllowCom [0..1]  # ComM Allow Com | This container includes all parameters for the action to allow or to block communication for a ComM Channel. ComM_CommunicationAllowed is called when this action is configured.
              boolean BswMComAllowed: set at post-build in variant post-build-loadable+post-build-selectable / pre-compile in variant pre-compile, default-value=false  # The parameter BswMComMAllowChannelRef refers to a channel which will allow or block communication using the function ComM_CommunicationAllowed(). | This parameter corresponds to the parameter "Allowed" of the function ComM_CommunicationAllowed().
              symbolic name reference BswMComMAllowChannelRef: set at post-build in variant post-build-loadable+post-build-selectable / pre-compile in variant pre-compile, destination=ComMChannel  # ComM Allow Channel Ref | This is a reference to the ComM Channel for which communication shall be allowed or blocked. | This reference corresponds to the parameter "Channel" of the function ComM_CommunicationAllowed().
            container BswMComMModeLimitation [0..1]  # ComM Mode Limitation | This container includes all parameters related to a limitation of communication mode for a ComM Channel. ComM_LimitChannelToNoComMode is called when this action is configured.
              boolean BswMComMLimitMode: set at post-build in variant post-build-loadable+post-build-selectable / pre-compile in variant pre-compile  # ComM Mode Limit Mode | The function ComM_LimitChannelToNoComMode() takes in this boolean parameter to limit the channel's communication mode to NO_COM mode. | This parameter corresponds to the parameter "Status" of the function ComM_LimitChannelToNoComMode.
              symbolic name reference BswMComMLimitChannelRef: set at post-build in variant post-build-loadable+post-build-selectable / pre-compile in variant pre-compile, destination=ComMChannel  # ComM Limit Channel Ref | This is a reference to the ComM channel for which the communication mode should be limited. | This reference corresponds to the parameter "Channel" of the function ComM_LimitChannelToNoComMode.
            container BswMComMModeSwitch [0..1]  # ComM Mode Switch | This container includes all parameters related to a switch of communication mode for a ComM User. ComM_RequestComMode is called when this action is configured.
              enumeration BswMComMRequestedMode: {BSWM_FULL_COM, BSWM_NO_COM}, set at post-build in variant post-build-loadable+post-build-selectable / pre-compile in variant pre-compile  # ComM Requested Mode | This parameter specifies the requested communication mode. | This parameter corresponds to the parameter "ComMode" of the function ComM_RequestComMode.
              symbolic name reference BswMComMUserRef: set at post-build in variant post-build-loadable+post-build-selectable / pre-compile in variant pre-compile, destination=ComMUser  # ComM User Ref | This is a reference to the ComM User that is associated to the Communication channel for which the communication mode should be requested. | This reference corresponds to the parameter "User" of the function ComM_RequestComMode.
            container BswMDeadlineMonitoringControl [0..1]  # This container includes all parameters related to enabling and disabling of deadline monitoring for one or several PDUs in COM. | COM_ReceptionDMControl is called when this action is configured.
              symbolic name reference BswMDisabledDMPduGroupRef [0..*]: set at post-build in variant post-build-loadable+post-build-selectable / pre-compile in variant pre-compile, destination=ComIPduGroup  # This is a reference to a PDU Group for which the Deadline Monitoring should be disabled. | Together with the BswMEnabledDMPduGroupRef this reference corresponds to the parameter "ipduGroupVector" of the function COM_ReceptionDMControl.
              symbolic name reference BswMEnabledDMPduGroupRef [0..*]: set at post-build in variant post-build-loadable+post-build-selectable / pre-compile in variant pre-compile, destination=ComIPduGroup  # This is a reference to a PDU Group for which the Deadline Monitoring should be enabled. | Together with the BswMDisabledDMPduGroupRef this reference corresponds to the parameter "ipduGroupVector" of the function COM_ReceptionDMControl.
            container BswMDcmSetChannelReady [0..1]  # Dcm Set Channel Ready | This container defines the action to trigger the Dcm_SetChannelReady
            container BswMEcuMGoDown [0..1]  # EcuM Go Down | This container defines the UserId which shall be forwarded to the GoDown request.
              symbolic name reference BswMEcuMUserIdRef [0..1]: set at pre-compile, destination=EcuMFlexUserConfig  # EcuM UserId Ref | This is a reference to a EcuM UserId. BswM does not use this reference as it always calls the function EcuMGoDown with the module id of BswM (42) as parameter.
            container BswMEcuMGoHalt [0..1]  # EcuM Go Halt | This container defines the action to trigger the EcuM_GoHalt from BswM.
            container BswMEcuMGoPoll [0..1]  # EcuM Go Poll | This container defines the action to trigger the EcuM_GoPoll from BswM.
            container BswMEcuMSelectShutdownTarget [0..1]  # EcuM Select Shutdown Target | This container defines the shutdown target.
              enumeration BswMEcuMShutdownTarget: {OFF, RESET, SLEEP}, set at post-build in variant post-build-loadable+post-build-selectable / pre-compile in variant pre-compile, origin=Vector Informatik, default-value=OFF  # EcuM Shutdown Target | This parameter contains the shutdown target that the BswM selects at the EcuM. If SLEEP is selected, BswMEcuMSleepModeRef must be set. If RESET is selected, BswMEcuMResetModeRef must be set.
              symbolic name reference BswMEcuMShutdownTargetRef [0..1]: set at pre-compile, destination=EcuMSleepMode  # EcuM Shutdown Target Ref | This is a reference to a shutdown target. Not used parameter. BswMEcuMSleepModeRef and BswMEcuMResetModeRef are used instead!
              symbolic name reference BswMEcuMResetModeRef [0..1]: set at post-build in variant post-build-loadable+post-build-selectable / pre-compile in variant pre-compile, origin=Vector Informatik, destination=EcuMResetMode  # EcuM Reset Mode Ref | This is a reference to a reset mode. Necessary when BswMEcuMShutdownTarget is set to RESET.
              symbolic name reference BswMEcuMSleepModeRef [0..1]: set at post-build in variant post-build-loadable+post-build-selectable / pre-compile in variant pre-compile, origin=Vector Informatik, destination=EcuMSleepMode  # EcuM Sleep Mode Ref | This is a reference to a sleep mode. Necessary when BswMEcuMShutdownTarget is set to SLEEP.
            container BswMEcuMStateSwitch [0..1]  # EcuM State Switch | This container defines the action to switch a State of the ECU State Manager.
              enumeration BswMEcuMState: {POST_RUN, RUN, SHUTDOWN, SLEEP, STARTUP}, set at post-build in variant post-build-loadable+post-build-selectable / pre-compile in variant pre-compile, origin=Vector Informatik  # EcuM State | This parameter corresponds to the parameter "State" of the function EcuM_ SetState ().
            container BswMEthIfStartAllPorts [0..1]  # This container defines the action to call EthIf_StartAllPorts from BswM and thus to start all affected EthSwtPorts.
            container BswMGenericModeSwitch [0..1]  # This container includes all parameters for the action to switch a Generic Mode. BswM_RequestMode is called when this action is configured.
              reference BswMGenericRequestRef: set at post-build in variant post-build-loadable+post-build-selectable / pre-compile in variant pre-compile, origin=Vector Informatik, destination=BswMModeRequestPort  # Specify the Generic Request Port for which the mode shall be changed.
              reference BswMGenericRequestModeRef: set at post-build in variant post-build-loadable+post-build-selectable / pre-compile in variant pre-compile, origin=Vector Informatik, destination=BswMGenericRequestMode  # Specify the Generic Request Mode which shall be set.
            container BswMIdsMBlockStateChangeRequest [0..1]  # This container includes all parameters related to a switch of a IdsM Block State. IdsM_BswM_StateChanged is called when this action is configured.
              symbolic name reference BswMIdsMBlockStateChangeRequestRef: set at pre-compile, origin=Vector Informatik, destination=IdsMBlockState  # This is a reference to an IdsM block which should be entered.
            container BswMJ1939DcmStateSwitch [0..1]  # This container includes all parameters related to a switch of the J1939 Request Managers diagnostic state for a J1939 node. J1939Dcm_SetState is called when this action is configured.
              enumeration BswMJ1939DcmRequestedState: {J1939DCM_STATE_OFFLINE, J1939DCM_STATE_ONLINE}, set at post-build in variant post-build-loadable+post-build-selectable / pre-compile in variant pre-compile, origin=Vector Informatik  # This parameter describes the communication state of the J1939 Request Manager and corresponds to the parameter "new state" of the function J1939Dcm_SetState.
              symbolic name reference BswMJ1939DcmChannelRef: set at post-build in variant post-build-loadable+post-build-selectable / pre-compile in variant pre-compile, origin=Vector Informatik, destination=ComMChannel  # This reference points to the unique channel defined by the ComMChannel and provides access to the unique channel index value in ComMChannelId. | This reference corresponds to the parameter "channel" of the function J1939Dcm_SetState.
              symbolic name reference BswMJ1939DcmNodeRef: set at post-build in variant post-build-loadable+post-build-selectable / pre-compile in variant pre-compile, origin=Vector Informatik, destination=J1939NmNode  # This reference points to a J1939NmNode and provides access to the unique J1939NmNodeId. | This reference corresponds to the parameter "node" of the function J1939Dcm_SetState.
            container BswMJ1939RmStateSwitch [0..1]  # This container includes all parameters related to a switch of the J1939 Request Manager's network state for a J1939 node. J1939Rm_SetState is called when this action is configured.
              enumeration BswMJ1939RmRequestedState: {J1939RM_STATE_OFFLINE, J1939RM_STATE_ONLINE}, set at post-build in variant post-build-loadable+post-build-selectable / pre-compile in variant pre-compile, origin=Vector Informatik  # This parameter describes the communication state of the J1939 Request Manager and corresponds to the parameter "new state" of the function J1939Rm_SetState.
              symbolic name reference BswMJ1939RmChannelRef: set at post-build in variant post-build-loadable+post-build-selectable / pre-compile in variant pre-compile, origin=Vector Informatik, destination=ComMChannel  # This reference points to the unique channel defined by the ComMChannel and provides access to the unique channel index value in ComMChannelId. | This reference corresponds to the parameter "channel" of the function J1939Rm_SetState.
              symbolic name reference BswMJ1939RmNodeRef: set at post-build in variant post-build-loadable+post-build-selectable / pre-compile in variant pre-compile, origin=Vector Informatik, destination=J1939NmNode  # This reference points to a J1939NmNode and provides access to the unique J1939NmNodeId. | This reference corresponds to the parameter "node" of the function J1939Rm_SetState.
            container BswMLinScheduleSwitch [0..1]  # This container includes all parameters related to a switch of LIN schedule table. LinSM_ScheduleRequest is called when this action is configured. | The configuration for the "network" parameter can be accessed via the reference LinSMComMNetworkHandleRef contained in the parent container LinSMChannel of the container referenced by BswMLinScheduleRef.
              symbolic name reference BswMLinScheduleRef: set at post-build in variant post-build-loadable+post-build-selectable / pre-compile in variant pre-compile, destination=LinSMSchedule  # This is a reference to the LIN schedule table that the LIN SM shall change to. | This reference corresponds to the parameter "schedule" of the function LinSM_ScheduleRequest.
            container BswMNMControl [0..1]  # This container includes all parameters related to enabling and disabling of Network Management communication. Disabling of NM communication can be requested by DCM. | Nm_EnableCommunication or Nm_DisableCommunication is called when this action is configured.
              enumeration BswMNMAction: {BSWM_NM_DISABLE, BSWM_NM_ENABLE}, set at post-build in variant post-build-loadable+post-build-selectable / pre-compile in variant pre-compile  # This parameter specifies if the communication of the corresponding NM channel should be enabled or disabled.
              symbolic name reference BswMComMNetworkHandleRef: set at post-build in variant post-build-loadable+post-build-selectable / pre-compile in variant pre-compile, destination=ComMChannel  # ComM Network Handle Ref | This reference points to the unique channel defined by the ComMChannel and provides access to the unique channel index value in ComMChannelId. | This reference corresponds to the parameter "NetworkHandle" of the function Nm_EnableCommunication and Nm_DisableCommunication.
            container BswMPduGroupSwitch [0..1]  # This container includes references to the PDU groups that shall be enabled and disabled. Com_IpduGroupControl is called when this action is configured.
              boolean BswMPduGroupSwitchReinit: set at post-build in variant post-build-loadable+post-build-selectable / pre-compile in variant pre-compile, default-value=false  # This parameter defines if the values for the parameters like periodical timer, minimum delay timer etc. is retained or reinitialized during a PDU Group Switch. | This parameter corresponds to the parameter "initialize" of the function Com_IpduGroupControl.
              symbolic name reference BswMDisabledPduGroupRef [0..*]: set at post-build in variant post-build-loadable+post-build-selectable / pre-compile in variant pre-compile, destination=ComIPduGroup  # This is a reference to a PDU Group that should be disabled. | Together with the BswMEnabledIPduGroupRef this reference corresponds to the parameter "ipduGroupVector" of the function Com_IpduGroupControl.
              symbolic name reference BswMEnabledPduGroupRef [0..*]: set at post-build in variant post-build-loadable+post-build-selectable / pre-compile in variant pre-compile, destination=ComIPduGroup  # This is a reference to a PDU Group that should be enabled. | Together with the BswMDisabledIPduGroupRef this reference corresponds to the parameter "ipduGroupVector" of the function Com_IpduGroupControl.
            container BswMPduRouterControl [0..1]  # This container includes all parameters related to enabling and disabling of routing of Routing Path Groups in the PDU Router. PduR_EnableRouting or PduR_DisableRouting is called when this action is configured.
              enumeration BswPduRouterAction: {BSWM_PDUR_DISABLE, BSWM_PDUR_ENABLE}, set at post-build in variant post-build-loadable+post-build-selectable / pre-compile in variant pre-compile  # This parameter specifies if the routing of the corresponding PDU should be enabled or disabled.
              symbolic name reference BswMPduRoutingPathGroupRef [1..*]: set at post-build in variant post-build-loadable+post-build-selectable / pre-compile in variant pre-compile, destination=PduRRoutingPathGroup  # This is a reference to the PDU Routing Path Group for which the routing in the PDU Router should be enabled or disabled. | This reference corresponds to the parameter "id" of the function PduR_EnableRouting and PduR_DisableRouting.
            container BswMRteModeRequest [0..1]  # This container defines a mode request that the BswM may send to a SW-C which is acting as a mode-manager. RTE_Write is called when this action is configured.
              string BswMRequestedMode: set at pre-compile, origin=Vector Informatik  # This represents the RTE mode used for the mode request port.
              reference BswMRteModeRequestPortRef: set at pre-compile, origin=Vector Informatik, destination=BswMRteModeRequestPort  # This is a reference to a BswMRteModeRequestPort.
            container BswMRteSwitch [0..1]  # This container defines a mode switch indication that the BswM provides to the SW-C that need to be notified about the mode switch. RTE_Switch is called when this action is configured.
              foreign reference BswMSwitchedMode: set at pre-compile, destination-type=MODE-DECLARATION  # This parameter contains the integer value that corresponds to a certain mode in a Mode Declaration Group.
              reference BswMRteSwitchPortRef: set at pre-compile, destination=BswMSwitchPort  # This is a reference to the BswMSwitchPort.
            container BswMSchMSwitch [0..0]  # SchM Switch | This container defines a mode switch indication that the BswM provides to the SW-C that need to be notified about the mode switch. SchM_Switch is called when this action is configured. Not used parameter.
              foreign reference BswMSchMSwitchedMode: set at pre-compile, destination-type=MODE-DECLARATION  # SchM Switched Mode | This parameter contains the integer value that corresponds to a certain mode in a Mode Declaration Group.
              reference BswMSchMSwitchPortRef: set at pre-compile, destination=BswMSwitchPort  # SchM Switch Port Ref | This is a reference to the BswMSwitchPort.
            container BswMSdClientServiceModeRequest [0..1]  # This container includes all parameters related to the selection of an client service of Sd. Sd_ClientServiceSetState is called when this action is configured.
              enumeration BswMSdClientServiceState: {BSWM_SD_CLIENT_SERVICE_RELEASED, BSWM_SD_CLIENT_SERVICE_REQUESTED}, set at post-build in variant post-build-loadable+post-build-selectable / pre-compile in variant pre-compile, origin=Vector Informatik  # This parameter specifies if the corresponding client service shall be released or requested.
              symbolic name reference BswMSdClientMethodsRef: set at post-build in variant post-build-loadable+post-build-selectable / pre-compile in variant pre-compile, origin=Vector Informatik, destination=SdClientService  # This is a reference to a client service in the Sd module.
            container BswMSdConsumedEventGroupModeRequest [0..1]  # This container includes all parameters related to the selection of a consumed EventGroup of Sd. Sd_ConsumedEventGroupSetState is called when this action is configured.
              enumeration BswMSdConsumedEventGroupState: {BSWM_SD_CONSUMED_EVENTGROUP_RELEASED, BSWM_SD_CONSUMED_EVENTGROUP_REQUESTED}, set at post-build in variant post-build-loadable+post-build-selectable / pre-compile in variant pre-compile, origin=Vector Informatik  # This parameter specifies if the corresponding consumed event group shall be released or requested.
              symbolic name reference BswMSdConsumedEventGroupRef: set at post-build in variant post-build-loadable+post-build-selectable / pre-compile in variant pre-compile, origin=Vector Informatik, destination=SdConsumedEventGroup  # This is a reference to an eventGroup that is defined within a client service in the Sd module.
            container BswMSdServerServiceModeRequest [0..1]  # This container includes all parameters related to the selection of a server service of Sd. Sd_ServerServiceSetState is called when this action is configured.
              enumeration BswMSdServerServiceState: {BSWM_SD_SERVER_SERVICE_AVAILABLE, BSWM_SD_SERVER_SERVICE_DOWN}, set at post-build in variant post-build-loadable+post-build-selectable / pre-compile in variant pre-compile, origin=Vector Informatik  # This parameter specifies if the corresponding server service shall be down or available.
              symbolic name reference BswMSdServerMethodsRef: set at post-build in variant post-build-loadable+post-build-selectable / pre-compile in variant pre-compile, origin=Vector Informatik, destination=SdServerService  # This is a reference to a server service in the Sd module.
            container BswMSdServiceGroupSwitch [0..1]  # This container includes references to the SdServiceGroups that shall be enabled and disabled.
              symbolic name reference BswMDisabledSdServiceGroupRef [0..*]: set at pre-compile, origin=Vector Informatik, destination=SdServiceGroup  # This is a reference to a SdServiceGroup that should be disabled. This reference corresponds to the parameter "ServiceGroupId" of the function Sd_ServiceGroupStop.
              symbolic name reference BswMEnabledSdServiceGroupRef [0..*]: set at pre-compile, origin=Vector Informatik, destination=SdServiceGroup  # This is a reference to a SdServiceGroup that should be enabled. This reference corresponds to the parameter "ServiceGroupId" of the function Sd_ServiceGroupStart.
            container BswMSwitchIPduMode [0..1]  # This container includes all parameters related to the selection of the transmission mode an I-PDU to be sent by COM. Com_SwitchIpduTxMode is called when this action is configured.
              boolean BswMSwitchIPduModeValue: set at post-build in variant post-build-loadable+post-build-selectable / pre-compile in variant pre-compile  # This parameter defines which transmission mode shall be selected during this call. | This parameter corresponds to the boolean parameter "Mode" of the function Com_SwitchIpduTxMode.
              symbolic name reference BswMSwitchIPduModeRef: set at post-build in variant post-build-loadable+post-build-selectable / pre-compile in variant pre-compile, destination=ComIPdu  # This is a reference to an I-PDU for which the transmission mode shall be set. | This reference corresponds to the parameter "PduId" of the function Com_SwitchIpduTxMode.
            container BswMTriggerIPduSend [0..1]  # This container includes all parameters related to the triggering of an I-PDU to be sent by COM. Com_TriggerIPDUSend is called when this action is configured.
              symbolic name reference BswMTriggeredIPduRef [1..*]: set at post-build in variant post-build-loadable+post-build-selectable / pre-compile in variant pre-compile, destination=ComIPdu  # This is a reference to an I-PDU that should be triggered for transmission. | This reference corresponds to the parameter "PduId" of the function Com_TriggerIPDUSend.
            container BswMTriggerSlaveRTEStop [0..1]  # This container includes all parameters needed to stop the RTE on a slave core. This choice shall only be chosen if multicore is used. Not used parameter.
              integer BswMCoreId: 0..18446744073709551615, set at pre-compile  # This parameter defines the identifier of the slave core that is used as input parameter for the BswM_TriggerStartUpPhase2 and BswM_TriggerSlaveRTEStop functions. The value of this parameter shall be synchronized with the OsApplicationCoreAssignment parameter.
            container BswMTriggerStartUpPhase2 [0..1]  # This container includes all parameters needed to start phase two on a slave core. This choice shall only be chosen if multicore is used. Not used parameter.
              integer BswMCoreId: 0..18446744073709551615, set at pre-compile  # This parameter defines the identifier of the slave core that is used as input parameter for the BswM_TriggerStartUpPhase2 and BswM_TriggerSlaveRTEStop functions. The value of this parameter shall be synchronized with the OsApplicationCoreAssignment parameter.
            container BswMTimerControl [0..1]  # This container includes all parameters for the action to start or to stop a timer. BswM_TimerControl is called when this action is configured.
              enumeration BswMTimerAction: {BSWM_TIMER_START, BSWM_TIMER_STOP}, set at post-build in variant post-build-loadable+post-build-selectable / pre-compile in variant pre-compile, origin=Vector Informatik, default-value=BSWM_TIMER_START  # Specify the action for the timer. The timer can be started or stopped.
              float BswMTimerValue: 0..4294967295, set at post-build in variant post-build-loadable+post-build-selectable / pre-compile in variant pre-compile, origin=Vector Informatik  # Specify the timer value that is used when the timer is started.
              reference BswMTimerRef: set at post-build in variant post-build-loadable+post-build-selectable / pre-compile in variant pre-compile, origin=Vector Informatik, destination=BswMModeRequestPort  # Specify the Timer for which the timer action shall be executed.
            container BswMUserCallout [0..1]  # This container includes all details needed for a user defined function call.
              string BswMUserCalloutFunction: set at pre-compile in variant post-build-loadable+pre-compile / post-build in variant post-build-selectable  # This parameter specifies the complete function call including all parameters. The parameters are specified during configuration time, and cannot be changed during run time. Any return values passed by the callout will be ignored. | Example usage can be: Actions to initialize other BSW modules Action to call Rte_Start() Action to call Rte_Stop() Action to call NvM_ReadAll() Action to call NvM_WriteAll()
              boolean BswMCreateCallout: set at pre-compile, origin=Vector Informatik, default-value=false  # If enabled, function body will be defined in BswM_Callout_Stubs.c
              string BswMCalloutParameterList [0..1]: set at pre-compile, origin=Vector Informatik  # Semicolon separated list of parameters prototypes which are used for creating the Callout. (e.g: uint16 number; const uint8* ptr;)
              multiline string BswMUserCode [0..1]: set at pre-compile, origin=Vector Informatik  # This parameter defines an additional code in the callout function. RESTRICTIONS: 'BswMUserCode' is only available, if 'BswMCreateCallout' is enabled.
              string BswMUserIncludeFile [0..1]: set at pre-compile, origin=Vector Informatik  # This parameter defines a header file name which shall be included by the BswM.
            container BswMRuleControl [0..1]  # Rule Control | This container includes all details needed for BswM Rule Control.
              enumeration BswMRuleAction: {BSWM_FALSE, BSWM_TRUE, BSWM_UNDEFINED, BSWM_DEACTIVATED}, set at pre-compile, origin=Vector Informatik  # Specify the action for the rule. The rule will be deactivated for BSWM_DEACTIVATED, all other will activate the rule.
              reference BswMRuleRef: set at pre-compile, origin=Vector Informatik, destination=BswMRule  # Specify the Rule for which the rule action shall be executed.
        container BswMActionList [0..*]: post-build-changeable=true  # Each instance of this container defines an action list that is invoked based on the BswM Rules. An action list contains a list of numbered action items to be processed. An action list can also include other action lists.
          enumeration BswMActionListExecution: {BSWM_CONDITION, BSWM_TRIGGER}, set at post-build in variant post-build-loadable+post-build-selectable / pre-compile in variant pre-compile, default-value=BSWM_TRIGGER  # This parameter controls if the corresponding action list shall be executed every time the rule is evaluated or only when the result of the evaluation changes. | BSWM_CONDITION: Action list shall be executed every time the rule is evaluated. BSWM_TRIGGER: Action list shall be executed every time the result of the evaluation changes.
          integer BswMActionListPriority [0..1]: 0..65535, set at post-build in variant post-build-loadable+post-build-selectable / pre-compile in variant pre-compile, origin=Vector Informatik, default-value=0  # This parameter sets a priority for this action list. A greater value (higher priority) means earlier execution. If parameter is absent, 0 is assumed. | If rule arbitration leads to the execution of more than one action list, action lists will be executed in the order of their priority, starting with the highest priority.
          container BswMActionListItem [0..*]: post-build-changeable=true  # This container defines an item in an action list.
            boolean BswMAbortOnFail: set at post-build in variant post-build-loadable+post-build-selectable / pre-compile in variant pre-compile, default-value=false  # This parameter defines if the execution of the action list shall be aborted if this specific action returns E_NOT_OK. Note that this is only applicable for actions that have E_NOT_OK as a possible return value.
            integer BswMActionListItemIndex: 0..255, set at post-build in variant post-build-loadable+post-build-selectable / pre-compile in variant pre-compile  # This parameter defines the index of the action in the action list. It is used define in which order the actions shall be performed.
            choice reference BswMActionListItemRef: set at post-build in variant post-build-loadable+post-build-selectable / pre-compile in variant pre-compile, destination=[BswMAction, BswMActionList, BswMRule]  # The action item can either be an atomic action or a reference to another action list or rule.
            symbolic name reference BswMReportFailToDemRef [0..1]: set at post-build in variant post-build-loadable+post-build-selectable / pre-compile in variant pre-compile, destination=DemEventParameter  # If the reference is given, the DEM event shall be reported failed if this specific action returns E_NOT_OK; it shall be reported passed if this specific action returns E_OK.
        container BswMRteModeRequestPort [0..*]  # This container defines a mode request port which the BswM may utilize to send a mode request to a SW-C which is acting as a mode-manager. If this container is referenced by a BswMRteModeRequest, the BswM shall create a corresponding PPort in its service description.
          string BswMRteModeInitValue [0..1]: set at pre-compile, origin=Vector Informatik  # This represents the value used for the init value of RTE mode request port.
          instance reference BswMRteModeRequestPortInterfaceRef: set at pre-compile, origin=Vector Informatik, destination-context=SW-COMPONENT-PROTOTYPE* PORT-PROTOTYPE, destination-type=VARIABLE-DATA-PROTOTYPE  # This is an instance reference to the variable data prototype used for the mode request.
        container BswMSwitchPort [0..*]  # This container specifies PPorts and/or provided ModeDeclarationGroups, which the BswM has to create in its SWCD. | If the container is referenced by one or more BswMRteSwitchActions the BswM shall create a corresponding PPort in its Service Description. If the container is referenced by a BswMSchMSwitch action the BswM shall create the corresponding ModeDeaclarationGroupPrototype as providedModeDeclarationGroup in it BSWMD. If the container is referenced by BswMSchMSwitch AND BswmRteSwitchActions the a providedModeDeclarationGroup as well as a PPort shall be created. In the corresponding SwcBswMapping a synchronizedModeGroup has to be created. See also chapter 4.4.7 in SWS_RTE.
          foreign reference BswMModeSwitchInterfaceRef: set at pre-compile, destination-type=MODE-SWITCH-INTERFACE  # Reference to the ModeSwitchInterface of this BswMModeSwitchPort.
      container BswMRteModeDclGroup [0..*]  # This container describes a ModeDeclarationGroup which is created by the BswM. | The following elements are created in the BswM_swc.arxml: - ModeDeclarationGroup with the name of this container. - ModeSwitchInterface which uses the ModeDeclarationGroup as its ModeDeclarationGroupPrototpye - ImplementationType with a CompuMethod which contains all Modes of the ModeDeclarationGroup - DataTypeMappingSet which maps the Mode Declaration Group to the ImplementationType
        reference BswMInitMode: set at pre-compile, origin=Vector Informatik, destination=BswMRteMode  # Reference to a Mode of this ModeDeclarationGroup. Target is used as InitalMode of the ModeDeclarationGroup.
        container BswMRteMode [1..*]  # This container describes a Mode of a ModeDeclarationGroup. | The name of the container represents the name of the corresponding Mode.
          integer BswMModePhysicalValue: 0..255, set at pre-compile, origin=Vector Informatik  # Describes the physical value of the Mode. Value is used in the CompuMehod of the ImplemenationType.
    container BswMGeneral  # General configuration parameters of the Basic SW Mode Manager.
      boolean BswMCanSMEnabled: set at pre-compile, default-value=false  # CanSM Enabled | This parameter defines if the CanSM module related BswM API is enabled. | true: Enabled false: Disabled
      boolean BswMComMEnabled: set at pre-compile, default-value=false  # ComM Enabled | This parameter defines if the ComM module related BswM API is enabled. | true: Enabled false: Disabled
      boolean BswMDcmEnabled: set at pre-compile, default-value=false  # This parameter defines if the Dcm module related BswM API is enabled. | true: Enabled false: Disabled
      boolean BswMDevErrorDetect: set at pre-compile, default-value=true  # This parameter switches the Development Error Detection and Notification ON or OFF. true: Development error detection is enabled. false: Development error detection is disabled. Note: In general, the development error detection is recommended during pre-test phase. It is not recommended to enable the development error detection in production code due to increased runtime and ROM needs. | true: Enabled false: Disabled
      boolean BswMDoIPEnabled: set at pre-compile, origin=Vector Informatik, default-value=false  # DoIP Enabled | This parameter defines if the DoIP module related BswM API is enabled. | true: Enabled false: Disabled
      boolean BswMDoIPIntEnabled: set at pre-compile, origin=Vector Informatik, default-value=false  # DoIPInt Enabled | This parameter defines if the DoIPInt module related BswM API is enabled. | true: Enabled false: Disabled
      boolean BswMEcuMEnabled: set at pre-compile, default-value=false  # EcuM Enabled | This parameter defines if the EcuM module related BswM API is enabled. | true: Enabled false: Disabled
      boolean BswMEthIfEnabled: set at pre-compile, origin=Vector Informatik, default-value=false  # EthIf Enabled | This parameter defines if the EthIf module related BswM API is enabled.
      boolean BswMEthSMEnabled: set at pre-compile, default-value=false  # EthSM Enabled | This parameter defines if the EthSM module related BswM API is enabled. | true: Enabled false: Disabled
      boolean BswMFrSMEnabled: set at pre-compile, default-value=false  # FrSM Enabled | This parameter defines if the FrSM module related BswM API is enabled. | true: Enabled false: Disabled
      boolean BswMGenericRequestEnabled: set at pre-compile, default-value=false  # This parameter defines if the Generic Request related BswM API is enabled. | true: Enabled false: Disabled
      boolean BswMJ1939DcmEnabled: set at pre-compile, origin=Vector Informatik, default-value=false  # This parameter defines if the 1939Dcm module related BswM API is enabled. | true: Enabled false: Disabled
      boolean BswMJ1939NmEnabled: set at pre-compile, origin=Vector Informatik, default-value=false  # This parameter defines if the 1939Nm module related BswM API is enabled. | true: Enabled false: Disabled
      boolean BswMLinSMEnabled: set at pre-compile, default-value=false  # LinSM Enabled | This parameter defines if the LinSM module related BswM API is enabled. | true: Enabled false: Disabled
      boolean BswMLinTPEnabled: set at pre-compile, default-value=false  # LinTP Enabled | This parameter defines if the LinTp module related BswM API is enabled. | true: Enabled false: Disabled
      float BswMMainFunctionPeriod [0..1]: 0..65.535, set at pre-compile, default-value=0.01  # This value specifies the cycle time of the periodic main function of BswM
      boolean BswMNmEnabled: set at pre-compile, origin=Vector Informatik, default-value=false  # This parameter defines if the Nm module related BswM API is enabled. | true: Enabled false: Disabled
      boolean BswMNvMEnabled: set at pre-compile, default-value=false  # NvM Enabled | This parameter defines if the NvM module related BswM API is enabled. | true: Enabled false: Disabled
      boolean BswMPduREnabled: set at pre-compile, origin=Vector Informatik, default-value=false  # PduR Enabled | This parameter defines if the PduR module related BswM API is enabled. | true: Enabled false: Disabled
      boolean BswMRuleControlEnabled: set at pre-compile, origin=Vector Informatik, default-value=false  # This parameter defines if the Rule Control related BswM API (BswM_SetRuleState) is enabled. | true: Enabled false: Disabled
      boolean BswMSchMEnabled [0..1]: set at pre-compile, default-value=false  # SchM Enabled | This parameter defines if the SchM module related BswM API is enabled. Not used parameter. | true: Enabled false: Disabled
      boolean BswMSdEnabled: set at pre-compile, origin=Vector Informatik, default-value=false  # This parameter defines if the Sd module related BswM API is enabled. | true: Enabled false: Disabled
      boolean BswMVersionInfoApi: set at pre-compile, default-value=false  # This parameter enables/disables the function BswM_GetVersionInfo() to get major, minor and patch version information. | true: Enabled false: Disabled
      boolean BswMWdgMEnabled: set at pre-compile, default-value=false  # WdgM Enabled | This parameter defines if the WdgM module related BswM API is enabled. | true: Enabled false: Disabled
      string BswMUserConfigurationFile [0..1]: set at pre-compile, origin=Vector Informatik  # Reference to an external text file that will be included during generation to BswM_Cfg.h. The content of the user configuration file will be added at the end of the generated module configuration file and allows altering or extending the generated code. Caution: User configuration files can cause the software module to malfunction and must only be used with great care.
      boolean BswMModeCheck: set at pre-compile, origin=Vector Informatik, default-value=true  # If enabled, mode values which are passed to the Mode Request APIs are checked. Only relevant if DevErrorDetect is enabled.
      enumeration BswMActionListQueueSearchAlgorithm: set at pre-compile, origin=Vector Informatik, default-value=LINEAR_SEARCH  # This parameter determines the algorithm that shall be used for the action list execution. There are two possible algorithms: LINEAR_SEARCH: uses a sequential search for the action list execution. The insertion into the queue of action lists that shall be executed during rule arbitration has a constant complexity. The execution of the action lists after rule arbitration has a linear complexity (over the number of action lists). Use this search algorithm if there are only few action lists or if the ROM/RAM consumption shall be minimized. PRIORITY_QUEUE: uses a priority queue realized as heap for the action list execution. The insertion into the queue has a logarithmic complexity (over all existing elements in the queue). The execution of the queue has a linear complexity (over all existing elements in the queue). The RAM/ROM consumption of this search is higher compared to the LINEAR_SEARCH. In configurations with a large number of action lists, this option can improve the runtime.
        LINEAR_SEARCH  # Linear Search
        PRIORITY_QUEUE  # Priority Queue (Heap)
      boolean BswMSafeBswChecks: set at pre-compile, origin=Vector Informatik, default-value=false  # Selects if safety checks are used. These checks improve robustness as e.g. invalid parameters are checked before function is executed. This attribute has to be enabled for safety projects where this component is mapped to an ASIL partition.
      container BswMUserIncludeFiles [0..1]  # This container includes a collection of header file names which shall be included by the BswM.
        string BswMUserIncludeFile [1..*]: set at pre-compile  # This parameter defines a header file name which shall be included by the BswM. | The value of this parameter shall be used as h-char-sequence or q-char-sequence according to ISO C90 section 6.10.2 "source file inclusion". The parameter value MUST NOT represent a path, since ISO C90 does not specify how such a path is treated (i.e., this is implementation defined (and additionally depends on the operating system and the underlying file system)).
      container BswMCommonData  # This container is used to store internal data of BswM. DO NOT REMOVE!
        reference BswMCanSMEcuCPartition [0..1]: set at pre-compile, origin=Vector Informatik, destination=EcucPartition  # CanSM EcuC Partition | This parameter defines the default partition for CanSM and is used by BSW Management Auto Configuration. The default partition of CanSM is the partition where CanSM is located. The following APIs are expected to be called on this partition: - BswM_CanSM_CurrentState() If no partition is referenced, the partition corresponding to first BswMConfig container is used.
        reference BswMComEcuCPartition [0..1]: set at pre-compile, origin=Vector Informatik, destination=EcucPartition  # Com EcuC Partition | This parameter defines the default partition for Com and is used by BSW Management Auto Configuration. The following APIs are called on the partition referenced in /[ANY]/Com/ComConfig/ComIPdu/ComEcucPartitionRef: - Com_EnableReceptionDM() - Com_DisableReceptionDM() - Com_IpduGroupStart() - Com_IpduGroupStop() - Com_SwitchIpduTxMode() If the Auto Configuration is not able to determine the correct partition for the listed APIs, the default partition is used as fallback. If no partition is referenced, the partition corresponding to first BswMConfig container is used.
        reference BswMComMEcuCPartition [0..1]: set at pre-compile, origin=Vector Informatik, destination=EcucPartition  # ComM EcuC Partition | This parameter defines the default partition for ComM and is used by BSW Management Auto Configuration. The default partition of ComM is where the ComM master is located. The following APIs are expected to be called on this partition: - BswM_ComM_CurrentMode() - BswM_ComM_CurrentPNCMode() The following APIs are called on this partition: - ComM_CommunicationAllowed() If no partition is referenced, the partition corresponding to first BswMConfig container is used.
        reference BswMDcmEcuCPartition [0..1]: set at pre-compile, origin=Vector Informatik, destination=EcucPartition  # Dcm EcuC Partition | This parameter defines the default partition for Dcm and is used by BSW Management Auto Configuration. The default partition of Dcm is the partition where Dcm is located. The following APIs are expected to be called on this partition: - BswM_Dcm_CommunicationMode_CurrentState() If no partition is referenced, the partition corresponding to first BswMConfig container is used.
        reference BswMDemEcuCPartition [0..1]: set at pre-compile, origin=Vector Informatik, destination=EcucPartition  # Dem EcuC Partition | This parameter defines the default partition for Dem and is used by BSW Management Auto Configuration. The default partition of Dem is where the Dem master is located. The following APIs are expected to be called on this partition: - ESH_Dem_PostRunRequested() The following APIs are called on this partition: - Dem_Init() - Dem_Shutdown() If no partition is referenced, the partition corresponding to first BswMConfig container is used.
        reference BswMEcuMEcuCPartition [0..1]: set at pre-compile, origin=Vector Informatik, destination=EcucPartition  # EcuM EcuC Partition | This parameter defines the default partition for EcuM and is used by BSW Management Auto Configuration. The default partition of EcuM is where the EcuM master is located. The following APIs are expected to be called on this partition: - BswM_EcuM_CurrentState() - BswM_EcuM_CurrentWakeup() The following APIs are expected to be called on the partition(s) referenced in /[ANY]/EcuM/EcuMConfiguration/EcuMFlexConfiguration/EcuMFlexUserConfig/EcuMFlexEcucPartitionRef: - BswM_EcuM_RequestedState() The following APIs are called on this partition: - EcuM_SetState() If the Auto Configuration is not able to determine the correct partition for the listed APIs, the default partition is used as fallback. If no partition is referenced, the partition corresponding to first BswMConfig container is used.
        reference BswMEthIfEcuCPartition [0..1]: set at pre-compile, origin=Vector Informatik, destination=EcucPartition  # EthIf EcuC Partition | This parameter defines the default partition for EthIf and is used by BSW Management Auto Configuration. The default partition of EthIf is where the EthIf master is located. The following APIs are expected to be called on this partition: - EthIf_StartAllPorts() If no partition is referenced, the partition corresponding to first BswMConfig container is used.
        reference BswMEthSMEcuCPartition [0..1]: set at pre-compile, origin=Vector Informatik, destination=EcucPartition  # EthSM EcuC Partition | This parameter defines the default partition for EthSM and is used by BSW Management Auto Configuration. The default partition of EthSM is the partition where EthSM is located. The following APIs are expected to be called on this partition: - BswM_EthSM_CurrentState() If no partition is referenced, the partition corresponding to first BswMConfig container is used.
        reference BswMFrSMEcuCPartition [0..1]: set at pre-compile, origin=Vector Informatik, destination=EcucPartition  # FrSM EcuC Partition | This parameter defines the default partition for FrSM and is used by BSW Management Auto Configuration. The default partition of FrSM is the partition where FrSM is located. The following APIs are expected to be called on this partition: - BswM_FrSM_CurrentState() If no partition is referenced, the partition corresponding to first BswMConfig container is used.
        reference BswMJ1939DcmEcuCPartition [0..1]: set at pre-compile, origin=Vector Informatik, destination=EcucPartition  # J1939Dcm EcuC Partition | This parameter defines the default partition for J1939Dcm and is used by BSW Management Auto Configuration. The default partition of J1939Dcm is the partition where J1939Dcm is located. The following APIs are expected to be called on this partition: - BswM_J1939DcmBroadcastStatus() The following APIs are called on this partition: - J1939Dcm_SetState() If no partition is referenced, the partition corresponding to first BswMConfig container is used.
        reference BswMJ1939NmEcuCPartition [0..1]: set at pre-compile, origin=Vector Informatik, destination=EcucPartition  # J1939Nm EcuC Partition | This parameter defines the default partition for J1939Nm and is used by BSW Management Auto Configuration. The default partition of J1939Nm is the partition where J1939Nm is located. The following APIs are expected to be called on this partition: - BswM_J1939Nm_StateChangeNotification() If no partition is referenced, the partition corresponding to first BswMConfig container is used.
        reference BswMJ1939RmEcuCPartition [0..1]: set at pre-compile, origin=Vector Informatik, destination=EcucPartition  # J1939Rm EcuC Partition | This parameter defines the default partition for J1939Rm and is used by BSW Management Auto Configuration. The default partition of J1939Rm is the partition where J1939Rm is located. The following APIs are called on this partition: - J1939Rm_SetState() If no partition is referenced, the partition corresponding to first BswMConfig container is used.
        reference BswMLinSMEcuCPartition [0..1]: set at pre-compile, origin=Vector Informatik, destination=EcucPartition  # LinSM EcuC Partition | This parameter defines the default partition for LinSM and is used by BSW Management Auto Configuration. The default partition of LinSM is the partition where LinSM is located. The following APIs are expected to be called on this partition: - BswM_LinSM_CurrentState() - BswM_LinSM_CurrentSchedule() The following APIs are called on this partition: - LinSM_ScheduleRequest() If no partition is referenced, the partition corresponding to first BswMConfig container is used.
        reference BswMNmEcuCPartition [0..1]: set at pre-compile, origin=Vector Informatik, destination=EcucPartition  # Nm EcuC Partition | This parameter defines the default partition for Nm and is used by BSW Management Auto Configuration. The default partition of Nm is the partition where the Nm master is located. The following APIs are expected to be called on this partition: - BswM_Nm_StateChangeNotification() The following APIs are called on the partition(s) referenced in /[ANY]/ComM/ComMConfigSet/ComMChannel/ComMChannelPartitionRef: - Nm_EnableCommunication() - Nm_DisableCommunication() If the Auto Configuration is not able to determine the correct partition for the listed APIs, the default partition is used as fallback. If no partition is referenced, the partition corresponding to first BswMConfig container is used.
        reference BswMNvMEcuCPartition [0..1]: set at pre-compile, origin=Vector Informatik, destination=EcucPartition  # NvM EcuC Partition | This parameter defines the default partition for NvM and is used by BSW Management Auto Configuration. The default partition of NvM is the partition where NvM is located. The following APIs are expected to be called on this partition: - BswM_NvM_CurrentJobMode() If no partition is referenced, the partition corresponding to first BswMConfig container is used.
        reference BswMPduREcuCPartition [0..1]: set at pre-compile, origin=Vector Informatik, destination=EcucPartition  # PduR EcuC Partition | This parameter defines the default partition for PduR and is used by BSW Management Auto Configuration. The following APIs are expected to be called on the partition(s) referenced in /[ANY]/EcuC/EcucPduCollection/Pdu/EcucPduDefaultPartitionRef: - BswM_PduR_PreTransmit() - BswM_PduR_RxIndication() - BswM_PduR_TpStartOfReception() The following APIs are called on the partition(s) referenced in /[ANY]/EcuC/EcucPduCollection/Pdu/EcucPduDefaultPartitionRef: - PduR_EnableRouting() - PduR_DisableRouting() If the Auto Configuration is not able to determine the correct partition for the listed APIs, the default partition is used as fallback. If no partition is referenced, the partition corresponding to first BswMConfig container is used.
        reference BswMSdEcuCPartition [0..1]: set at pre-compile, origin=Vector Informatik, destination=EcucPartition  # Sd EcuC Partition | This parameter defines the default partition for Sd and is used by BSW Management Auto Configuration. The following APIs are expected to be called on the partition(s) referenced in /[ANY]/Sd/SdConfig/SdInstance/SdPartitionRef: - BswM_Sd_ClientServiceCurrentState() - BswM_Sd_ConsumedEventGroupCurrentState() - BswM_Sd_EventHandlerCurrentState() The following APIs are called on the partition(s) referenced in /[ANY]/Sd/SdConfig/SdInstance/SdPartitionRef: - Sd_ClientServiceSetState() - Sd_ConsumedEventGroupSetState() - Sd_ServerServiceSetState() If the Auto Configuration is not able to determine the correct partition for the listed APIs, the default partition is used as fallback. If no partition is referenced, the partition corresponding to first BswMConfig container is used.
      container BswMGeneration  # Contains parameters which have influence on the generation of the module
        boolean BswMOutOfBoundsWriteSanitizer: set at pre-compile, origin=Vector Informatik, default-value=false  # This parameter activates/deactivates the generation of runtime checks which call a DET error notification function to find easily out of bounds write problems. FALSE: no checks are generated in the data access. TRUE: the data access is enriched with DET checks to validate indexes. For more details, refer to TechnicalReference_ComStackLib.pdf
        boolean BswMOutOfBoundsReadSanitizer: set at pre-compile, origin=Vector Informatik, default-value=false  # This parameter activates/deactivates the generation of runtime checks which call a DET error notification function to find easily out of bounds read problems. FALSE: no checks are generated in the data access. TRUE: the data access is enriched with DET checks to validate indexes. For more details, refer to TechnicalReference_ComStackLib.pdf
        boolean BswMReduceConstantData2Define: set at pre-compile, origin=Vector Informatik, default-value=true  # Reduce Constant Data To a Define | This parameter activates/deactivates the capability to generate CONFIG-CLASS PRE-COMPILE ROM arrays as constant define. FALSE: ROM arrays are generated as data even if all values are identical. TRUE: ROM arrays are generated as constant define if all values are identical. For more details, refer to TechnicalReference_ComStackLib.pdf
        enumeration BswMBoolDataInArrayOfStructStrategy: set at pre-compile, origin=Vector Informatik, default-value=BITMASKING  # This parameter is used to tailor the usage of boolean data in structures in all CONFIG-CLASSES ROM data. The difference between BITFIELD and BITMASKING depends on your compiler options and memory mapping. BOOLEAN: the datatype of boolean data is native boolean. BITFIELD: the bitfield type is used and the compiler extracts the boolean data from structures. BITMASKING: generated masks are used to extract the boolean data from structures. For more details, refer to TechnicalReference_ComStackLib.pdf
          BOOLEAN  # boolean
          BITFIELD  # bitfield
          BITMASKING  # bitmasking
  bsw implementation BswM_Impl: programming-language=C, sw-version=18.00.01, used-code-generator=DaVinci Configurator, vendor-id=30, ar-release-version=4.00.03, behavior=BswMBehavior, preconfigured-configuration=BswM_Pre, recommended-configuration=BswM_Rec, vendor-specific-module-def=BswM
  module config BswM_Pre: definition=BswM
    BswMGeneral
  module config BswM_Rec: definition=BswM
