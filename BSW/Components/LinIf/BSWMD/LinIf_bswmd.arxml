AUTOSAR XML (schema 4-0-3)
package /MICROSAR
  bsw implementation LinIf_Impl: programming-language=C, sw-version=12.00.00, used-code-generator=DaVinci Configurator, vendor-id=30, ar-release-version=4.00.03, behavior=LinIfBehavior, preconfigured-configuration=LinIf_Pre, recommended-configuration=LinIf_Rec, vendor-specific-module-def=LinIf
  module definition LinIf [0..1]: category=VENDOR_SPECIFIC_MODULE_DEFINITION, refined-module-def=LinIf, variants post-build-loadable/pre-compile/post-build-selectable  # The LIN Interface (LinIf) abstracts the usage of the underlying LIN driver (Lin) and LIN transceiver (LinTrcv). The LinIf provides LIN master and LIN slave functionality towards the upper layers which includes reception and transmission of LIN frames, schedule table handling and processing of wake up and Go to sleep sequences. The LIN Transport Protocol (LinTp) is included in the LinIf. #LIN #ISO17987 #Communication #AUTOSAR
    container LinIfGeneral  # General configuration parameters of the LINIF.
      boolean LinIfCancelTransmitSupported: set at pre-compile, default-value=false  # This parameter enables the LinIf_CancelTransmit API.The LinIf_CancelTransmit API does not contain any functionality, but may be required by upper layer modules.
      boolean LinIfDevErrorDetect: set at pre-compile, default-value=true  # This parameter switches the Development Error Detection and Notification ON or OFF. true: Development error detection is enabled. false: Development error detection is disabled. Note: In general, the development error detection is recommended during pre-test phase. It is not recommended to enable the development error detection in production code due to increased runtime and ROM needs.
      boolean LinIfMultipleDriversSupported: set at pre-compile, default-value=false  # This parameter defines if multiple drivers are included in the LIN Interface or not. The reason for this parameter is to reduce the size of LIN Interface if multiple drivers are not used.
      boolean LinIfMultipleTrcvDriverSupported: set at pre-compile, default-value=false  # This parameter defines if multiple transceiver drivers are included in the LIN Interface or not. The reason for this parameter is to reduce the size of LIN Interface if multiple transceiver drivers are not used.
      boolean LinIfNcOptionalRequestSupported: set at pre-compile, default-value=true  # This parameter defines if optional node configuration commands are supported. For LIN maser nodes, optional node configuration services are always supported by Vector LINIF (depending on schedule table command definitions in the current configuration). This parameter has no influence. For LIN slave nodes, this parameter enables the support for Assign NAD node configuration command and Assign Frame Id (LIN 2.0 only).
      string LinIfPublicCddHeaderFile [0..*]: set at pre-compile, max-length=32, min-length=1  # This parameter defines header files for callback functions which shall be included in case of CDDs. All CDD callback functions configured in LinIfGotoSleepConfirmationFctUL, LinIfScheduleRequestConfirmationFctUL, LinIfWakeupConfirmationUL, LinIfTxConfirmationUL, LinIfTxTriggerTransmitUL and LinIfUserRxIndicationUL must be declared in these header files. Range of characters is 1.. 32.
      boolean LinIfTpSupported: set at pre-compile, default-value=false  # This parameter defines if the LINTP is included in the LIN Interface or not. The reason for this parameter is to reduce the size of LIN Interface if the TP is not used.
      boolean LinIfTrcvDriverSupported: set at pre-compile, default-value=false  # This parameter defines if LIN transceiver drivers are included in the LIN Interface or not. The reason for this parameter is to reduce the size of LIN Interface if transceiver drivers are not used.
      boolean LinIfVersionInfoApi: set at pre-compile, default-value=false  # This parameter enables/disables the function LinIf_GetVersionInfo() to get major, minor and patch version information.
      boolean LinIfEvtFrameSupported: set at pre-compile, origin=Vector Informatik, default-value=false  # This parameter defines if event triggered (EVT) frames are supported in the LIN Interface or not. The reason for this parameter is to reduce the size of LIN Interface if EVT frames are not used. Only relevant for LIN master nodes.
      boolean LinIfSporadicFrameSupported: set at pre-compile, origin=Vector Informatik, default-value=false  # This parameter defines if sporadic frames are supported in the LIN Interface or not. The reason for this parameter is to reduce the size of LIN Interface if sporadic frames are not used. Only relevant for master nodes.
      string LinIfUserConfigFile [0..1]: set at pre-compile, origin=Vector Informatik  # Reference to an external text file that will be included during generation to LinIf_Cfg.h. The content of the user configuration file will be added at the end of the generated module configuration file and allows altering or extending the generated code. Caution: User configuration files can cause the software module to malfunction and must only be used with great care.
      boolean LinIfRuntimeMeasurementSupport: set at pre-compile, origin=Vector Informatik, default-value=false  # If enabled runtime measurement points are added to the BSW module code and are added to the module configuration of MICROSAR RTM. The available measurement points can be seen and configured in the RTM module configuration. Availability of the MICROSAR RTM module is a prerequisite to make use of the runtime measurement functionality. Runtime measurement should be disabled in production code as measurement points may inflict additional runtime.
      boolean LinIfScheduleEndNotificationSupported [0..1]: set at pre-compile, origin=Vector Informatik, default-value=false  # If enabled the LinIf will report the end of the current schedule table to the LinSm when the last frame header of the schedule table has been transmitted. This allows the upper layers to change to a different schedule table after processing the current one completely. Only relevant for LIN master nodes.
      boolean LinIfJ2602ResponseToleranceSupport [0..1]: set at pre-compile, origin=Vector Informatik, default-value=false  # This parameter enables the configuration of frame response tolerances to values different than the fixed 40% of the LIN standard. If enabled, the maximum header duration in bits, the response tolerance of Tx frames and the response tolerance of all Rx frames have to be configured. These values are used to calculate the maximum duration time of frames. The intended use of this feature is the support of SAE J2602 response tolerances. Only relevant for LIN master nodes.
      boolean LinIfSafeBswChecks: set at pre-compile, origin=Vector Informatik, default-value=false  # Selects if safety checks are used. These checks improve robustness as e.g. invalid parameters are checked before function is executed. This attribute has to be enabled for safety projects where this component is mapped to an ASIL partition.
      boolean LinIfScheduleInfoApi [0..1]: set at pre-compile, origin=Vector Informatik, default-value=false  # This parameter enables/disables the function LinIf_GetScheduleInfo() to get detailed information about the current schedule table handler state. Only relevant for LIN master nodes.
      boolean LinIfBusMirroringSupported: set at pre-compile, origin=Vector Informatik, default-value=false  # States if Bus Mirroring is enabled in the LIN Interface or not. The reason for this parameter is to reduce the size of LIN Interface if the Bus Mirroring is not used. This parameter is introduced in AUTOSAR 4.4.
      function name LinIfResponseErrorSignalChangedCallout [0..1]: set at pre-compile  # This parameter contains the name of the callout function that is called after a response error signal change. Only relevant for LIN slave nodes.
      function name LinIfSaveConfigurationCallout [0..1]: set at pre-compile  # This parameter contains the name of the callout function that is called when a save configuration node configuration command is processed by this slave node. The service is only supported when this parameter is configured. Only relevant for LIN slave nodes.
      boolean LinIfProductIdentificationConfigurableSupported [0..1]: set at pre-compile, origin=Vector Informatik, default-value=false  # This parameter provides the update of Supplier ID, Function ID and Variant ID during runtime. If enabled, these values can be overwritten using the API function LinIf_SetLinProductIdentification(). Only relevant for LIN slave nodes.
      boolean LinIfReadByIdentifierSerialNumberSupported [0..1]: set at pre-compile, origin=Vector Informatik, default-value=false  # This parameter specifies if the node configuration identificaton command ReadbyIdentifier (SID 0xB2) with identifier 1 (serial number) is supported. Only relevant for LIN slave nodes.
      boolean LinIfReadByIdentifierUserDefinedSupported [0..1]: set at pre-compile, origin=Vector Informatik, default-value=false  # This parameter specifies if the node configuration identificaton command ReadbyIdentifier (SID 0xB2) with identifier in range [32, 63] (user defined identifier) is supported. Only relevant for LIN slave nodes.
      boolean LinIfDataDumpSupported [0..1]: set at pre-compile, origin=Vector Informatik, default-value=false  # This parameter specifies if the node configuration command DataDump (SID 0xB4) is supported. Only relevant for LIN slave nodes.
      boolean LinIfAutoAddressingSupported [0..1]: set at pre-compile, origin=Vector Informatik, default-value=false  # This parameter specifies if the node configuration command AutoAddressing / Slave Node Position Detection (SID 0xB8) is supported. Only relevant for LIN slave nodes.
      boolean LinIfSeparateMainFunctionPostProcessing: set at pre-compile, origin=Vector Informatik, default-value=false  # This parameter specifies if the post processings (all notifications to upper layer modules) are performed inside the main function of a LinIf channel or inside a separate additional main function. If this parameter is FALSE, the default behavior is used that there is one main function per LinIf channel which performs all necessary processing, including the notifications to LinSM, PduR and BswM. For special timing use cases, this parameter can be configured to TRUE: In this case, two separate main function for each LinIf channel are provided. The standard main function LinIf_MainFunction_<channel> performs the schedule and frame handling. The second main function LinIf_MainFunctionPostProcessing_<channel> performs all notifications to upper layer modules. The user is responsible that both main functions per LinIf channel are called alternating with the appropriate cycle times. This option minimizes the temporal offset between the schedule processing of several LinIf channels. Only relevant for LIN master nodes.
      container LinIfOptimization [0..1]  # Optional optimization configuration parameters of the LINIF. These parameters affect the generated data using the ComStackLib module.
        boolean LinIfOptimizeConstArrays2Define: set at pre-compile, origin=Vector Informatik, default-value=false  # This parameter activates/deactivates the capability to generate CONFIG-CLASS PRE-COMPILE ROM arrays as constant define. TRUE: ROM arrays are generated as constant define if all values are identical. Code: the code size is smaller. RAM: no change expected. ROM: the ROM size is minimized. Runtime: the runtime is increased. FALSE: ROM arrays are generated as data even if all values are identical.
        enumeration LinIfMinimizeNumericalDataTypes: {NONE, MINIMIZE_NUMERICAL_DATA_TYPES_WITHOUT_CAST, MINIMIZE_NUMERICAL_DATA_TYPES_WITH_CAST}, set at pre-compile, origin=Vector Informatik, default-value=MINIMIZE_NUMERICAL_DATA_TYPES_WITH_CAST  # This parameter is used to minimize the datatypes of CONFIG-CLASS PRE-COMPILE numerical data based on the used values. NONE: The datatype is not minimized. MINIMIZE_NUMERICAL_DATA_TYPES_WITHOUT_CAST: The datatype of numerical data is minimized. Unsigned data types are not changed to signed datatypes. Code: the code size is reduced. RAM: the RAM size is reduced. ROM: the ROM size is reduced. Runtime: no change expected. MINIMIZE_NUMERICAL_DATA_TYPES_WITH_CAST: The datatype of numerical data is minimized. Unsigned data types can be optimized to signed datatypes. Code: the code size is reduced. RAM: the RAM size is reduced. ROM: the ROM size is reduced. Runtime: no change expected.
        enumeration LinIfConstDataDeduplication: {NONE, DEDUPLICATE_CONST_DATA_WITHOUT_CAST, DEDUPLICATE_CONST_DATA_WITH_CAST}, set at pre-compile, origin=Vector Informatik, default-value=DEDUPLICATE_CONST_DATA_WITH_CAST  # This parameter is used to deduplicate CONFIG-CLASS PRE-COMPILE ROM data. NONE: The generated data is not deduplicated. DEDUPLICATE_CONST_DATA_WITHOUT_CAST: The data is deduplicated without using casts. Code: no change expected. RAM: no change expected. ROM: the ROM size can be minimized. Runtime: no change expected. DEDUPLICATE_CONST_DATA_WITH_CAST: The data is deduplicated using casts. Code: no change expected. RAM: no change expected. ROM: the ROM size can be minimized more than in DEDUPLICATE_CONST_DATA_WITHOUT_CAST. Runtime: no change expected.
    container LinIfGlobalConfig  # Global configuration parameters of the LINIF. | It is a MultipleConfigurationContainer, i.e. this container and its sub-containers exit once per configuration set.
      container LinIfChannel [1..*]  # Channel specific configuration parameters of the LINIF.
        integer LinIfChannelId: 0..255, set at link in variant post-build-loadable+post-build-selectable / pre-compile in variant pre-compile, symbolic-name-value=true, default-value=0  # This value specifies the unique channel index value beginning with 0. | Implementation Type: NetworkHandleType
        enumeration LinIfGotoSleepConfirmationUL: {CDD, LIN_SM}, set at post-build in variant post-build-loadable+post-build-selectable / pre-compile in variant pre-compile, default-value=LIN_SM  # This parameter defines the upper layer (UL) module to which the confirmation of the goto-sleep command shall be reported.
        enumeration LinIfScheduleRequestConfirmationUL [0..1]: {CDD, LIN_SM}, set at post-build in variant post-build-loadable+post-build-selectable / pre-compile in variant pre-compile, default-value=LIN_SM  # This parameter defines the upper layer (UL) module to which the confirmation of the successfully performed schedule table change shall be reported. Only relevant for master nodes.
        enumeration LinIfStartupState: {NORMAL, SLEEP}, set at link in variant post-build-loadable / post-build in variant post-build-selectable / pre-compile in variant pre-compile, default-value=SLEEP  # Startup State LinIf | This parameter specifies the initial channel state of this LIN channel in LinIf after initialization. The LinIf ensures the consistent overall LIN channel initialization based on the configuration of this parameter and parameter LinIfLinDriverStartupState.
        enumeration LinIfWakeupConfirmationUL: {CDD, LIN_SM}, set at post-build in variant post-build-loadable+post-build-selectable / pre-compile in variant pre-compile, default-value=LIN_SM  # This parameter defines the upper layer (UL) module to which the confirmation of the wake-up shall be reported.
        float LinIfWakeupDelay: 0..0.1, set at post-build in variant post-build-loadable+post-build-selectable / pre-compile in variant pre-compile, origin=Vector Informatik, default-value=0.1  # This parameter specifies the delay after wakeup frame transmission (internal wakeup) before scheduling is started. The default value of 100ms is according to LIN 2.x / ISOLIN specification.
        function name LinIfGotoSleepConfirmationFctUL [0..1]: set at post-build in variant post-build-loadable+post-build-selectable / pre-compile in variant pre-compile, origin=Vector Informatik  # This parameter defines the name of the upper layer <User_GotoSleepConfirmation>. This parameter depends on the parameter LinIfGotoSleepConfirmationUL. It is only used if LinIfGotoSleepConfirmationUL has value CDD.
        function name LinIfScheduleRequestConfirmationFctUL [0..1]: set at post-build in variant post-build-loadable+post-build-selectable / pre-compile in variant pre-compile, origin=Vector Informatik  # This parameter defines the name of the upper layer <User_ScheduleRequestConfirmation>. This parameter depends on the parameter LinIfScheduleRequestConfirmationUL. It is only used if LinIfScheduleRequestConfirmationUL has value CDD. Only relevant for master nodes.
        function name LinIfWakeupConfirmationFctUL [0..1]: set at post-build in variant post-build-loadable+post-build-selectable / pre-compile in variant pre-compile, origin=Vector Informatik  # This parameter defines the name of the upper layer <User_WakeupConfirmation>. This parameter depends on the parameter LinIfWakeupConfirmationUL. It is only used if LinIfWakeupConfirmationUL has value CDD.
        integer LinIfJ2602HeaderTolerance [0..1]: 34..48, set at post-build in variant post-build-loadable+post-build-selectable / pre-compile in variant pre-compile, origin=Vector Informatik, default-value=48  # This parameter defines the maximum header length in bits. The default value of 48 bits is according to the LIN standard. The intended use of this parameter is the support of SAE J2602 header tolerance values. This parameter is only applicable if the general SAE J2602 response tolerance support is enabled. Only relevant for master nodes.
        integer LinIfJ2602ResponseToleranceTx [0..1]: 0..40, set at post-build in variant post-build-loadable+post-build-selectable / pre-compile in variant pre-compile, origin=Vector Informatik, default-value=40  # This parameter defines the maximum response tolerance of Tx frames in percent. The default value of 40% is according to the LIN standard. The intended use of this parameter is the support of SAE J2602 response tolerance values. Only relevant for master nodes. This parameter is only applicable if the general SAE J2602 response tolerance support is enabled.
        boolean LinIfScheduleChangeNextTimeBase [0..1]: set at post-build in variant post-build-loadable+post-build-selectable / pre-compile in variant pre-compile, origin=Vector Informatik, default-value=false  # This parameter defines the point in time where a schedule table switch is performed. If it's disabled, a schedule table switch is performed at the end of the current schedule table slot. If this parameter is enabled, a schedule table switch is performed when the message transmission / reception within the current slot is finished. This parameter is introduced due to AUTOSAR 4.3.0. Only relevant for master nodes.
        float LinIfWakeupDelayExternal: 0..0.1, set at post-build in variant post-build-loadable+post-build-selectable / pre-compile in variant pre-compile, origin=Vector Informatik, default-value=0.1  # This parameter specifies the delay after wakeup frame reception (external wakeup) before scheduling is started. The default value of 100ms is according to LIN 2.x / ISOLIN specification.
        float LinIfBusIdleTimeoutPeriod: 0.1..65535, set at post-build in variant post-build-loadable+post-build-selectable / pre-compile in variant pre-compile, default-value=4  # Bus idle timeout in seconds. Only used for slave nodes.
        enumeration LinIfGotoSleepIndicationUL [0..1]: {CDD, LIN_SM}, set at post-build in variant post-build-loadable+post-build-selectable / pre-compile in variant pre-compile, default-value=LIN_SM  # This parameter defines the upper layer (UL) module to which the indication of the goto-sleep command shall be sent. Only relevant for slave nodes.
        function name LinIfGotoSleepIndicationFctUL [0..1]: set at pre-compile, origin=Vector Informatik  # This parameter defines the name of the upper layer <User_GotoSleepIndication>. This parameter depends on the parameter LinIfGotoSleepIndicationUL. It is only used if LinIfGotoSleepIndicationUL has value CDD. Only relevant for slave nodes.
        float LinIfClusterTimeBase: 0.001..0.255, set at pre-compile, origin=Vector Informatik, default-value=0.005  # This value specifies the time-base for one LIN cluster (normally 2, 5 or 10ms).
        float LinIfWakeupConfirmationTimeoutPeriod: 0.1..65535, set at post-build in variant post-build-loadable+post-build-selectable / pre-compile in variant pre-compile, origin=Vector Informatik, default-value=2  # This parameter specifies the timeout duration in seconds after sleep mode is indicated to upper layer caused by a missing wakeup confirmation from the LIN master node after a wakeup request. Only used for slave nodes.
        symbolic name reference LinIfChannelRef: set at link in variant post-build-loadable / post-build in variant post-build-selectable / pre-compile in variant pre-compile, destination=LinChannel  # Reference to the used channel in Lin. | Replaces LINIF_CHANNEL_INDEX
        symbolic name reference LinIfComMNetworkHandleRef: set at link in variant post-build-loadable / post-build in variant post-build-selectable / pre-compile in variant pre-compile, destination=ComMChannel  # ComM Network Handle Ref | Reference to a network handle in ComM.
        container LinIfFrame [0..*]: post-build-changeable=true  # Generic container for all types of LIN frames. The ShortName of this container is used as LinIfFrameName.
          enumeration LinIfChecksumType: {CLASSIC, ENHANCED}, set at post-build in variant post-build-loadable+post-build-selectable / pre-compile in variant pre-compile, default-value=ENHANCED  # This parameter defines the type of checksum that the frame is using.
          enumeration LinIfFrameType: {ASSIGN, ASSIGN_FRAME_ID_RANGE, ASSIGN_NAD, CONDITIONAL, EVENT_TRIGGERED, FREE, MRF, SAVE_CONFIGURATION, SPORADIC, SRF, UNASSIGN, UNCONDITIONAL}, set at post-build in variant post-build-loadable+post-build-selectable / pre-compile in variant pre-compile, default-value=UNCONDITIONAL  # This parameter defines the type of frame (e.g. sporadic frame). For master nodes, all frame types are permitted. A sporadic slot may be used by a set of unconditional frames in the role of substitution frames. For slave nodes, only following types are permitted: Uncondtional, MRF, SRF, Event-triggered. An event-triggered slot may be used by a set of unconditional frames in the role of substitution frames. | The sporadic slot is not found among the frame types. A sporadic slot is a set of sporadic frames.
          integer LinIfLength: 1..8, set at post-build in variant post-build-loadable+post-build-selectable / pre-compile in variant pre-compile, default-value=8  # This value specifies the length of the LIN frame in bytes.
          integer LinIfPid: 0..255, set at post-build in variant post-build-loadable+post-build-selectable / pre-compile in variant pre-compile, default-value=0  # This value specifies the protected ID of the LIN frame. There is no reason to calculate the parity in run-time.
          integer LinIfFrameIndex [0..1]: 0..63, set at post-build in variant post-build-loadable+post-build-selectable / pre-compile in variant pre-compile  # PID index of the frame. This index is used in the AssignFrameIdentifierRange node configuration service to identify the frame(s) to which a new PID shall be assigned. Only relevant for LIN slave nodes.
          integer LinIfMessageId [0..1]: 0..65535, set at post-build in variant post-build-loadable+post-build-selectable / pre-compile in variant pre-compile, origin=Vector Informatik  # Message identifier of the frame. This value is used in LIN 2.0 AssignFrameId node configuration service to identify the frame(s) to which a new PID shall be assigned. Only relevant for LIN 2.0 slave nodes.
          container LinIfFixedFrameSdu [0..1]  # This container includes the bytes send within a Fixed Frame. The container is only required in case the LinIfFrameType is one of the following: ASSIGN ASSIGN_FRAME_ID_RANGE ASSIGN_NAD CONDITIONAL FREE SAVE_CONFIGURATION UNASSIGN Only relevant to LIN master nodes. | This container represent an eight byte array. The Byte order shall be MSB first.
            container LinIfFixedFrameSduByte [8..8]  # This container represents a byte within the 8 byte array.
              integer LinIfFixedFrameSduBytePos: 0..7, set at post-build in variant post-build-loadable+post-build-selectable / pre-compile in variant pre-compile, default-value=0  # This value specifies the index of the byte in the fixed frame.
              integer LinIfFixedFrameSduByteVal: 0..255, set at post-build in variant post-build-loadable+post-build-selectable / pre-compile in variant pre-compile, default-value=0  # This value specifies the byte value in the fixed frame.
          choice container LinIfPduDirection  # This container specifies the direction of the frame.
            container LinIfInternalPdu [0..1]  # This choice container specifies a Diagnostic or Configuration frame : no Message ID (no PduId).
            container LinIfRxPdu [0..1]  # This choice container specifies a received PDU/frame.
              function name LinIfRxIndicationUL [0..1]: set at post-build in variant post-build-loadable+post-build-selectable / pre-compile in variant pre-compile  # This parameter defines the name of the <User_RxIndication>. This parameter depends on the parameter LinIfUserRxIndicationUL. If LinIfUserRxIndicationUL equals PDUR, the name of the <User_RxIndication> is fixed to PduR_LinIfRxIndication. If LinIfUserRxIndicationUL equals CDD, the name of the <User_RxIndication> is selectable. | If LinIfUserRxIndicationUL equals PDUR, the name of the <User_RxIndication> is fixed. If LinIfUserRxIndicationUL equals CDD, the name of the <User_RxIndication> is selectable.
              enumeration LinIfUserRxIndicationUL: {CDD, PDUR}, set at post-build in variant post-build-loadable+post-build-selectable / pre-compile in variant pre-compile, default-value=PDUR  # This parameter defines the upper layer (UL) module to which the indication of the successfully received LINRXPDUID has to be routed via <User_RxIndication>. | This <User_RxIndication> has to be invoked when the indication of the configured LINRXPDUID will be received by a Rx indication event from the LIN Driver module.
              integer LinIfJ2602ResponseToleranceRx [0..1]: 0..40, set at post-build in variant post-build-loadable+post-build-selectable / pre-compile in variant pre-compile, origin=Vector Informatik, default-value=40  # This parameter defines the maximum response tolerance of a Rx frame in percent. The default value of 40% is according to the LIN standard. The intended use of this parameter is the support of SAE J2602 response tolerance values. Only relevant for master nodes. This parameter is only applicable if the general SAE J2602 response tolerance support is enabled.
              reference LinIfRxPduRef: set at post-build in variant post-build-loadable+post-build-selectable / pre-compile in variant pre-compile, destination=Pdu  # Reference to the global PDU that is received in this frame.
            container LinIfSlaveToSlavePdu [0..1]  # This choice container specifies a slave-to-slave PDU/frame. Master does only send the header but doesn't receive the response. Only relevant for master nodes. | Added for completeness
            container LinIfTxPdu [0..1]  # This choice container specifies a transmitted PDU/frame.
              function name LinIfTxConfirmationUL [0..1]: set at post-build in variant post-build-loadable+post-build-selectable / pre-compile in variant pre-compile  # This parameter defines the name of the <User_TxConfirmation>. This parameter depends on the parameter LinIfUserTxUL. If LinIfUserTxUL equals PDUR, the name of the <User_TxConfirmation> is fixed to PduR_LinIfTxConfirmation. If LinIfUserTxUL equals CDD, the name of the <User_TxConfirmation> is selectable. | If LinIfUserTxUL equals PDUR, the name of the <User_TxConfirmation> is fixed. If LinIfUserTxUL equals CDD, the name of the <User_TxConfirmation> is selectable.
              integer LinIfTxPduId: 0..65535, set at link in variant post-build-loadable+post-build-selectable / pre-compile in variant pre-compile, symbolic-name-value=true, default-value=0  # This value specifies the identifier of the PDU for the upper layer.
              function name LinIfTxTriggerTransmitUL [0..1]: set at post-build in variant post-build-loadable+post-build-selectable / pre-compile in variant pre-compile  # This parameter defines the name of the <User_TriggerTransmit>. This parameter depends on the parameter LinIfUserTxUL. If LinIfUserTxUL equals PDUR, the name of the <User_TriggerTransmit> is fixed to PduR_LinIfTriggerTransmit. If LinIfUserTxUL equals CDD, the name of the <User_TriggerTransmit> is selectable. | If LinIfUserTxUL equals CDD, the name of the <User_TriggerTransmit> is selectable.
              enumeration LinIfUserTxUL: {CDD, PDUR}, set at post-build in variant post-build-loadable+post-build-selectable / pre-compile in variant pre-compile, default-value=PDUR  # This parameter defines the upper layer (UL) module to which the trigger of the transmitted LinTxPdu (via the <User_TriggerTransmit>) or the confirmation of the successfully transmitted LinTxPdu has to be routed (via the <User_TxConfirmation>).
              reference LinIfTxPduRef: set at post-build in variant post-build-loadable+post-build-selectable / pre-compile in variant pre-compile, destination=Pdu  # Reference to the global PDU that is transmitted in this frame.
          container LinIfSubstitutionFrames [0..*]  # This container includes a list of unconditional Frames that can be sent in a sporadic frame slot in master nodes or in an event-triggered frame slot in slave nodes.
            integer LinIfFramePriority: 0..255, set at post-build in variant post-build-loadable+post-build-selectable / pre-compile in variant pre-compile, default-value=0  # This value specifies the priority of an unconditional frame if used as a sporadic frame in master nodes or of an event-triggered frames in slave nodes. 255 is highest priority, 0 is lowest priority.
            reference LinIfSubstitutionFrameRef: set at post-build in variant post-build-loadable+post-build-selectable / pre-compile in variant pre-compile, destination=LinIfFrame  # Reference to an unconditional Frame that can be sent in a Sporadic Frame slot.
        container LinIfScheduleTable [0..*]: post-build-changeable=true  # This container includes the description of a schedule table. Each LinIfChannel may have several schedule tables. Each schedule table can only be connected to one channel. Only relevant for LIN master nodes.
          enumeration LinIfResumePosition: {CONTINUE_AT_IT_POINT, START_FROM_BEGINNING}, set at post-build in variant post-build-loadable+post-build-selectable / pre-compile in variant pre-compile, default-value=START_FROM_BEGINNING  # This value specifies where a schedule table shall be proceeded in case if it has been interrupted by a RUN-ONCE table. CONTINUE_AT_IT_POINT: Schedule processing continues with subsequent slot where the interruption happened. START_FROM_BEGINNING: Schedule processing starts after interruption with the first slot of the table.
          enumeration LinIfRunMode: {RUN_CONTINUOUS, RUN_ONCE}, set at post-build in variant post-build-loadable+post-build-selectable / pre-compile in variant pre-compile, default-value=RUN_CONTINUOUS  # This value specifies the mode of the schedule table: Run continuous: After setting this schedule table it is repeated until another continuous schedule table is selected. Run once: After selecting this schedule table it is transmitted once, afterward the before set schedule table is transmitted again.
          enumeration LinIfScheduleMode: {LINTP_APPLICATIVE_SCHEDULE, LINTP_DIAG_REQUEST, LINTP_DIAG_RESPONSE}, set at post-build in variant post-build-loadable+post-build-selectable / pre-compile in variant pre-compile, default-value=LINTP_APPLICATIVE_SCHEDULE  # This parameter defines the mode of the schedule table. Note: Parameter not used!
          integer LinIfScheduleTableIndex: 0..255, set at link in variant post-build-loadable+post-build-selectable / pre-compile in variant pre-compile, symbolic-name-value=true, default-value=0  # This value specifies the unique index used by upper layers to identify a schedule. Note that the NULL_SCHEDULE for each channel has index 0.
          string LinIfScheduleTableName [0..1]: set at post-build in variant post-build-loadable+post-build-selectable / pre-compile in variant pre-compile  # Optional schedule name used to cross-reference with a LDF. This parameter shall always be accompanied by LIN_IF_SCHEDULE_INDEX. Note: Parameter not used! Instead the ShortName of the parent container is used.
          container LinIfEntry [0..*]: post-build-changeable=true  # This container includes the configuration of a schedule table entry (also known as Frame Slot).
            float LinIfDelay: 0..0.255, set at post-build in variant post-build-loadable+post-build-selectable / pre-compile in variant pre-compile, default-value=0.01  # This value specifies the delay to next entry in the schedule table .
            integer LinIfEntryIndex: 0..255, set at post-build in variant post-build-loadable+post-build-selectable / pre-compile in variant pre-compile, default-value=0  # This value specifies the position of the frame entry in the schedule table. The first entry index in the schedule table is 0.
            reference LinIfCollisionResolvingRef [0..1]: set at post-build in variant post-build-loadable+post-build-selectable / pre-compile in variant pre-compile, destination=LinIfScheduleTable  # Reference to the schedule table, which resolves the collision. This reference is only applicable in case of an event-triggered frame.
            reference LinIfFrameRef [1..*]: set at post-build in variant post-build-loadable+post-build-selectable / pre-compile in variant pre-compile, destination=LinIfFrame  # Reference to the frames that belong to this schedule table entry.
        container LinIfTransceiverDrvConfig [0..1]  # This container includes the configuration (parameters) of all addressed LIN transceivers by each underlying LIN Transceiver Driver.
          symbolic name reference LinIfTrcvIdRef: set at link in variant post-build-loadable+post-build-selectable / pre-compile in variant pre-compile, destination=LinTrcvChannel  # Reference to the logical handle of the underlying LIN transceiver to be served by the LIN Interface.
        choice container LinIfNodeType  # This container defines the LIN node type of this channel.
          container LinIfMaster [0..1]  # Each Master can only be connected to one physical channel. This could be compared to the Node parameter in a LDF file.
            float LinIfJitter: 0..0.255, set at pre-compile, default-value=0  # The jitter specifies the differences between the maximum and minimum delay from time base tick to the header sending start point in seconds. The jitter value is considered in the calculation of the maximum frame duration after which the LIN driver is allowed to be requested for the frame status. Configure this value to the actual worst-case jitter of the LinIf main function calls in the system to avoid potential LIN communication errors caused by delays of the LinIf main function invocations. Further it is used to validate the consistency between schedule slot delays and maximum frame durations.
          container LinIfSlave [0..1]  # Describes all parameters which are only relevant for a LIN Slave node.
            enumeration LinIfLinProtocolVersion: {ISO17987, LIN13, LIN20, LIN21, LIN22, SAE_J2602_2012}, set at pre-compile  # Defines the LIN protocol version of the slave node.
            reference LinIfResponseErrorSignal [0..*]: set at link in variant post-build-loadable / post-build in variant post-build-selectable / pre-compile in variant pre-compile, destination=ComSignal  # Reference to the response_error signal.
            container LinIfNodeConfigurationIdentification [0..1]  # This container is mandatory for all LIN 2.x and ISO17987 LIN slave nodes, and ignored for LIN 1.3 slave nodes and all master nodes,
              integer LinIfConfiguredNAD: 1..125, set at post-build in variant post-build-loadable+post-build-selectable / pre-compile in variant pre-compile  # Slave node configured NAD.
              integer LinIfFunctionId: 0..65535, set at post-build in variant post-build-loadable+post-build-selectable / pre-compile in variant pre-compile  # LIN function Id.
              integer LinIfInitialNAD: 1..125, set at post-build in variant post-build-loadable+post-build-selectable / pre-compile in variant pre-compile  # Slave node initial NAD.
              float LinIfNasTimeout [0..1]: 0..5, set at post-build in variant post-build-loadable+post-build-selectable / pre-compile in variant pre-compile, default-value=1  # N_As timeout in seconds.
              integer LinIfSupplierId: 0..32767, set at post-build in variant post-build-loadable+post-build-selectable / pre-compile in variant pre-compile  # LIN consortium or ISO LIN supplier Id.
              integer LinIfVariantId: 0..255, set at post-build in variant post-build-loadable+post-build-selectable / pre-compile in variant pre-compile  # LIN variant Id.
              boolean LinIfReadByIdDatabaseVersionSupported: set at post-build in variant post-build-loadable+post-build-selectable / pre-compile in variant pre-compile, origin=Vector Informatik, default-value=false  # This parameter specifies if the ReadbyIdentifier command with identifier 3 is supported.
              container LinIfDatabaseVersion [0..1]  # This container describes the source and version of the underlying data base. This information is used in the ReadByIdenfier identification service with identifier 3.
                enumeration LinIfDatabaseSource: {LDF, NCF, AUTOSAR}, set at post-build in variant post-build-loadable+post-build-selectable / pre-compile in variant pre-compile, origin=Vector Informatik  # This parameter specifies the type of the underlying database used for configuration of the LIN slave node.
                integer LinIfDatabaseMajorVersion: 0..255, set at post-build in variant post-build-loadable+post-build-selectable / pre-compile in variant pre-compile, origin=Vector Informatik, default-value=0  # This parameter specifies the 8-bit major version of the underlying database.
                integer LinIfDatabaseMinorVersion: 0..255, set at post-build in variant post-build-loadable+post-build-selectable / pre-compile in variant pre-compile, origin=Vector Informatik, default-value=0  # This parameter specifies the 8-bit minor version of the underlying database.
                integer LinIfDatabaseSubVersion: 0..255, set at post-build in variant post-build-loadable+post-build-selectable / pre-compile in variant pre-compile, origin=Vector Informatik, default-value=0  # This parameter specifies the 8-bit sub version of the underlying database.
        container LinIfLinDriverAutosarCompatibility  # This container includes the configuration of the AUTOSAR version respectively MICROSAR of the underlying LIN driver.
          enumeration LinIfDrvArVersion: {LIN_DRV_EQC_MICROSAR, LIN_DRV_EQC_AUTOSAR_431, LIN_DRV_EQC_AUTOSAR_440, LIN_DRV_EQC_AUTOSAR_R21_11}, set at link in variant post-build-loadable / post-build in variant post-build-selectable / pre-compile in variant pre-compile, origin=Vector Informatik, default-value=LIN_DRV_EQC_MICROSAR  # LIN Driver AUTOSAR version | This parameter defines the AUTOSAR compatibility of the used LIN driver on this channel. The AUTOSAR release versions are clustered in equivalence classes (EQCs). If a MICROSAR Classic LIN driver is used, this parameter shall be set to LIN_DRV_EQC_MICROSAR. If a 3rd party AUTOSAR LIN driver is used, this parameter shall be set to the corresponding AUTOSAR version of this driver: - LIN_DRV_EQC_AUTOSAR_431: AUTOSAR release version 4.3.1. - LIN_DRV_EQC_AUTOSAR_440: AUTOSAR release version 4.4.0. - LIN_DRV_EQC_AUTOSAR_R21_11: AUTOSAR release version R21-11. This parameter is the main parameter to configure the LIN driver version. The other parameters in this container are set by validation rules based on the selected value of this parameter.
          enumeration LinIfLinDriverStartupState: {NORMAL, SLEEP}, set at link in variant post-build-loadable / post-build in variant post-build-selectable / pre-compile in variant pre-compile, origin=Vector Informatik, default-value=NORMAL  # Startup State Lin Driver | This parameter specifies the initial channel state of this LIN channel in the referenced LIN driver after initialization. It is recommended to not set this parameter directly, instead configure the Lin Driver AR version parameter (LinIfDrvArVersion). MICROSAR LIN drivers initialize into channel state NORMAL (= OPERATIONAL) by default. AUTOSAR LIN drivers initialize into channel state SLEEP. So this parameter provides compatibility to 3rd party LIN driver implementations according to AUTOSAR specification. The LinIf ensures the consistent overall LIN channel initialization based on the configuration of this parameter and parameter LinIfStartupState.
          boolean LinIfStatusCallAfterWakeupTx: set at link in variant post-build-loadable / post-build in variant post-build-selectable / pre-compile in variant pre-compile, origin=Vector Informatik, default-value=true  # This parameter defines if the GetStatus() function is called after wakeup frame transmission. It is recommended to not set this parameter directly, instead configure the Lin Driver AR version parameter (LinIfDrvArVersion). If a MICROSAR Classic LIN driver is used, it is expected that GetStatus() is called after wakeup frame transmission and the transition to OPERATIONAL state is performed afterwards. If a 3rd party AUTOSAR LIN driver is used, it is expected that GetStatus() is not called after wakeup frame transmission and the transition to OPERATIONAL state is done inside LinIf_Wakeup(). Only used for master nodes.
          boolean LinIfUseLegacyFrameResponseType: set at pre-compile, origin=Vector Informatik, default-value=false  # This parameter enables a legacy mapping of Lin_FrameResponseType values. It is recommended to not set this parameter directly, instead configure the Lin Driver AR version parameter (LinIfDrvArVersion). If a 3rd party AUTOSAR LIN driver according to AR 4.3.1 or before is used, this parameter shall be enabled to active a mapping of the previous Lin_FrameResponseType to the ones of AUTOSAR 4.4 and later. In other cases, this parameter shall be disabled. Note that a mixed usage of AR 4.3.1 and other AUTOSAR versions is not supported.
          enumeration LinIfChannelHandleTypeInCallbacks: {CHANNEL_TYPE_LIN, CHANNEL_TYPE_COMM}, set at link in variant post-build-loadable / post-build in variant post-build-selectable / pre-compile in variant pre-compile, origin=Vector Informatik, default-value=CHANNEL_TYPE_LIN  # This parameter specifies the type of channel handle used in the following slave callback functions from LIN driver: - LinIf_HeaderIndication - LinIf_RxIndication - LinIf_TxConfirmation - LinIf_LinErrorIndication It is recommended to not set this parameter directly, instead configure the Lin Driver AR version parameter (LinIfDrvArVersion). MICROSAR Classic LIN drivers use the LIN driver channel handle (CHANNEL_TYPE_LIN) by default. AUTOSAR LIN drivers use the LinIf channel handle (CHANNEL_TYPE_COMM). Only relevant for slave nodes.
  bsw implementation LinTp_Impl: programming-language=C, sw-version=10.00.00, used-code-generator=DaVinci Configurator, vendor-id=30, ar-release-version=4.00.03, behavior=LinTpBehavior, preconfigured-configuration=LinTp_Pre, recommended-configuration=LinTp_Rec, vendor-specific-module-def=LinTp
  module definition LinTp [0..1]: category=VENDOR_SPECIFIC_MODULE_DEFINITION, refined-module-def=LinTp, variants post-build-loadable/pre-compile/post-build-selectable  # The LIN Transport Protocol (LinTp) provides segmentation (Tx) and reassembly (Rx) of large messages used for diagnostics on a LIN bus according to ISO 17987. #LIN #ISO17987 #Communication #AUTOSAR
    container LinTpGeneral  # General configuration parameters of the LINTP.
      boolean LinTpVersionInfoApi: set at pre-compile, default-value=false  # This parameter enables/disables the function LinTp_GetVersionInfo() to get major, minor and patch version information.
      string LinTpUserConfigFile [0..1]: set at pre-compile, origin=Vector Informatik  # Reference to an external text file that will be included during generation to LinTp_Cfg.h. The content of the user configuration file will be added at the end of the generated module configuration file and allows altering or extending the generated code. Caution: User configuration files can cause the software module to malfunction and must only be used with great care!
      boolean LinTpForwardRespPendingFrames: set at pre-compile, origin=Vector Informatik, default-value=true  # This parameter defines if frames containing an UDS response pending service are forwarded to PDU Router as any other response PDU or not. The default value for ASR4.x compliance is ON. Only relevant for LIN master nodes.
      boolean LinTpFunctionalRequestsSupported [0..1]: set at pre-compile, origin=Vector Informatik, default-value=true  # This parameter defines if the LINTP supports functional requests. A functional request uses a special NAD (0x7E) for diagnostic requests. A functional request may be inserted into an ongoing physical TP connection. No answer is expected from a LIN slave for a functional request. If this functionality is not required, deactivating this option reduces the size of the LIN Interface.
      boolean LinTpRuntimeMeasurementSupport: set at pre-compile, origin=Vector Informatik, default-value=false  # If enabled runtime measurement points are added to the BSW module code and are added to the module configuration of MICROSAR RTM. The available measurement points can be seen and configured in the RTM module configuration. Availability of the MICROSAR RTM module is a prerequisite to make use of the runtime measurement functionality. Runtime measurement should be disabled in production code as measurement points may inflict additional runtime.
      boolean LinTpBroadcastRequestHandling: set at pre-compile, origin=Vector Informatik, default-value=false  # This parameter defines the handling after transmission of a diagnostic broadcast request. A broadcast request uses a special NAD (0x7F). All slave nodes receive this request. Bus collisions might occur if an subsequent slave response header is scheduled. If this parameter is enabled, LinTp requests an applicative schedule table after a valid broadcast request transmission using BswM_LinTp_RequestMode() and expects no answer from a slave node. If this parameter is disabled, LinTp requests a diagnostic response schedule after a valid broadcast request transmission. No special handling for broadcast requests is performed. Only relevant for LIN master nodes.
      boolean LinTpMetaDataSupport: set at pre-compile, origin=Vector Informatik, default-value=false  # This parameter enables the usage of MetaData in the Transport Protocol. MetaData support is used to realize generic connections where the LIN slave NAD is dynamically provided by and passed to the upper layer component as meta information. The usage of MetaData for a connection is enabled by configuring the size of the MetaData (configuration parameter MetaDataLength) of the global PDU definition. Only relevant for LIN master nodes.
      container LinTpOptimization [0..1]  # Optional optimization configuration parameters of the LINTP. These parameters affect the generated data using the ComStackLib module.
        boolean LinTpOptimizeConstArrays2Define: set at pre-compile, origin=Vector Informatik, default-value=false  # This parameter activates/deactivates the capability to generate CONFIG-CLASS PRE-COMPILE ROM arrays as constant define. TRUE: ROM arrays are generated as constant define if all values are identical. Code: the code size is smaller. RAM: no change expected. ROM: the ROM size is minimized. Runtime: the runtime is increased. FALSE: ROM arrays are generated as data even if all values are identical.
        enumeration LinTpMinimizeNumericalDataTypes: {NONE, MINIMIZE_NUMERICAL_DATA_TYPES_WITHOUT_CAST, MINIMIZE_NUMERICAL_DATA_TYPES_WITH_CAST}, set at pre-compile, origin=Vector Informatik, default-value=MINIMIZE_NUMERICAL_DATA_TYPES_WITH_CAST  # This parameter is used to minimize the datatypes of CONFIG-CLASS PRE-COMPILE numerical data based on the used values. NONE: The datatype is not minimized. MINIMIZE_NUMERICAL_DATA_TYPES_WITHOUT_CAST: The datatype of numerical data is minimized. Unsigned data types are not changed to signed datatypes. Code: the code size is reduced. RAM: the RAM size is reduced. ROM: the ROM size is reduced. Runtime: no change expected. MINIMIZE_NUMERICAL_DATA_TYPES_WITH_CAST: The datatype of numerical data is minimized. Unsigned data types can be optimized to signed datatypes. Code: the code size is reduced. RAM: the RAM size is reduced. ROM: the ROM size is reduced. Runtime: no change expected.
        enumeration LinTpConstDataDeduplication: {NONE, DEDUPLICATE_CONST_DATA_WITHOUT_CAST, DEDUPLICATE_CONST_DATA_WITH_CAST}, set at pre-compile, origin=Vector Informatik, default-value=DEDUPLICATE_CONST_DATA_WITH_CAST  # This parameter is used to deduplicate CONFIG-CLASS PRE-COMPILE ROM data. NONE: The generated data is not deduplicated. DEDUPLICATE_CONST_DATA_WITHOUT_CAST: The data is deduplicated without using casts. Code: no change expected. RAM: no change expected. ROM: the ROM size can be minimized. Runtime: no change expected. DEDUPLICATE_CONST_DATA_WITH_CAST: The data is deduplicated using casts. Code: no change expected. RAM: no change expected. ROM: the ROM size can be minimized more than in DEDUPLICATE_CONST_DATA_WITHOUT_CAST. Runtime: no change expected.
    container LinTpGlobalConfig  # Global configuration parameters of the LINTP. | It is a MultipleConfigurationContainer, i.e. this container and its sub-containers exit once per configuration set.
      integer LinTpMaxNumberOfRespPendingFrames: 0..65535, set at post-build in variant post-build-loadable+post-build-selectable / pre-compile in variant pre-compile, default-value=3  # This value specifies the maximum number of allowed response pending frames before data has to be sent. Only used for LIN Master nodes, ignored for slave nodes.
      integer LinTpNumberOfRxNSdu: 0..65535, set at post-build in variant post-build-loadable+post-build-selectable / pre-compile in variant pre-compile, default-value=0  # This value specifies the number of transport protocol messages that can be received for all channels this node is connected to. According to AUTOSAR Bugzilla #52857, this value is deprecated because it can be calculated. It is kept just for compatibility reasons.
      integer LinTpNumberOfTxNSdu: 0..65535, set at post-build in variant post-build-loadable+post-build-selectable / pre-compile in variant pre-compile, default-value=0  # This value specifies the number of transport protocol messages that can be transmitted for all channels this node is connected to. According to AUTOSAR Bugzilla #52857, this value is deprecated because it can be calculated. It is kept just for compatibility reasons.
      container LinTpChannelConfig [0..*]: post-build-changeable=true  # Channel specific configuration parameters of the LINTP.
        boolean LinTpDropNotRequestedNad: set at post-build in variant post-build-loadable+post-build-selectable / pre-compile in variant pre-compile, default-value=false  # This parameter defines if TP Frames of not requested LIN Slaves are dropped or not. TRUE: Drop TP frames of not requested LIN-Slaves. FALSE: Keep/Process TP frames of not requested LIN-Slaves. Only used for LIN Master nodes, ignored for slave nodes.
        boolean LinTpScheduleChangeDiag: set at post-build in variant post-build-loadable+post-build-selectable / pre-compile in variant pre-compile, default-value=false  # This parameter defines if BswM_LinTp_RequestMode() is called to set a diagnostic request/response schedule. Only used for LIN Master nodes, ignored for slave nodes.
        float LinTpP2Max: 0.05..2, set at post-build in variant post-build-loadable+post-build-selectable / pre-compile in variant pre-compile, default-value=1.5  # This value specifies the P2 Timeout when a response pending frame is expected. This is the time between response pending indication and provision of data by the LIN slave. Note that the minimum value of LinTpP2Max shall be more than or equal to the value of LinTpP2Timing. Only used for LIN Master nodes, ignored for slave nodes.
        float LinTpP2Timing: 0.05..0.5, set at post-build in variant post-build-loadable+post-build-selectable / pre-compile in variant pre-compile, default-value=0.1  # This value specifies the P2 timeout observation parameter. This is the time between successive transmitted request and reception of SF / FF. Only used for LIN Master nodes, ignored for slave nodes.
        reference LinTpChannelRef: set at link in variant post-build-loadable+post-build-selectable / pre-compile in variant pre-compile, origin=Vector Informatik, destination=LinIfChannel  # Reference to the LINIF channel this container belongs to. The necessity of this reference is discussed in AUTOSAR Bugzilla #52171.
      container LinTpRxNSdu [0..*]: post-build-changeable=true  # This container includes the configuration if a received N-SDU.
        integer LinTpDl: 1..4095, set at post-build in variant post-build-loadable+post-build-selectable / pre-compile in variant pre-compile, default-value=1  # This value specifies Data Length Code of this RxNSdu. In case of variable length message, this value indicates the minimum data length. | Range of minimum length is 1 to 4095. Note that this is not relevant for Tx. The reason for this is to have identical structures for Tx and Rx.
        float LinTpNcr [0..1]: 0..1, set at post-build in variant post-build-loadable+post-build-selectable / pre-compile in variant pre-compile, default-value=0.15  # This value specifies the N_Cr timeout. N_Cr is the time until reception of the next Consecutive Frame N_PDU.
        integer LinTpRxNSduId: 0..65535, set at link in variant post-build-loadable+post-build-selectable / pre-compile in variant pre-compile, symbolic-name-value=true, default-value=0  # This value specifies the identifier of the Transport Protocol message. This ID will be the one that is communicated with upper layers.
        integer LinTpRxNSduNad: 0..255, set at post-build in variant post-build-loadable+post-build-selectable / pre-compile in variant pre-compile, default-value=1  # For LIN master nodes, the received NAD is evaluated to match with the requested LIN Slave node. For LIN slave nodes, the received NAD is evaluated to determine if the request addresses the current node. See also the parameter LinTpRxNSduConfigurableNADSupported for using the currently configured NAD of the LIN slave node in the comparison to the received NAD.
        boolean LinTpRxNSduConfigurableNADSupported [0..1]: set at pre-compile, origin=Vector Informatik, default-value=false  # This parameter determines if the static configured NAD of this RxNSdu or the currently configured NAD of the LIN slave node (retrieved from the LIN Interface during runtime) is used. This parameter is only allowed to be set for one RxNSDU per LIN channel. Only relevant for LIN slave nodes.
        reference LinTpRxNSduPduRef: set at post-build in variant post-build-loadable+post-build-selectable / pre-compile in variant pre-compile, destination=Pdu  # Reference to the global N-SDU.
        symbolic name reference LinTpRxNSduChannelRef: set at link in variant post-build-loadable+post-build-selectable / pre-compile in variant pre-compile, destination=LinIfChannel  # Reference to the LINIF channel this N-SDU belongs to.
      container LinTpTxNSdu [0..*]: post-build-changeable=true  # This container includes the configuration if a transmitted N-SDU.
        float LinTpNas: 0..1, set at post-build in variant post-build-loadable+post-build-selectable / pre-compile in variant pre-compile, default-value=0.1  # This value specifies N_As timeout. N_As is the time for transmission of a LIN frame (any N_PDU) on the part of the sender.
        float LinTpNcs [0..1]: 0..1, set at post-build in variant post-build-loadable+post-build-selectable / pre-compile in variant pre-compile, default-value=0.15  # This value specifies the performance requirement of N_Cs. N_Cs is the time which elapses between the transmit request of a CF N-PDU until the transmit request of the next CF N-PDU.
        integer LinTpTxNSduId: 0..65535, set at link in variant post-build-loadable+post-build-selectable / pre-compile in variant pre-compile, symbolic-name-value=true, default-value=0  # This value specifies the identifier of the Transport Protocol message. This ID will be the one that is communicated with upper layers.
        integer LinTpTxNSduNad: 0..255, set at post-build in variant post-build-loadable+post-build-selectable / pre-compile in variant pre-compile, default-value=1  # This value specifies the NAD (Node Address for Diagnostics) for the LIN node which handles this transmission N-SDU. For LIN master nodes, the NAD is used in the transmitted request to address a specific slave node. For LIN slave nodes, the NAD is used in the transmitted response sent to the LIN master node. See also the parameter LinTpTxNSduConfigurableNADSupported for using the currently configured NAD of the LIN slave node.
        boolean LinTpTxNSduConfigurableNADSupported [0..1]: set at pre-compile, origin=Vector Informatik, default-value=false  # This parameter determines if the static configured NAD of this TxNSdu or the currently configured NAD of the LIN slave node (retrieved from the LIN Interface during runtime) is used. This parameter is only allowed to be set for one TxNSDU per LIN channel. Only relevant for LIN slave nodes.
        reference LinTpTxNSduPduRef: set at post-build in variant post-build-loadable+post-build-selectable / pre-compile in variant pre-compile, destination=Pdu  # Reference to the global N-SDU.
        symbolic name reference LinTpTxNSduChannelRef: set at link in variant post-build-loadable+post-build-selectable / pre-compile in variant pre-compile, destination=LinIfChannel  # Reference to the LINIF channel this N-SDU belongs to.
  module config LinIf_Pre: definition=LinIf
  module config LinIf_Rec: definition=LinIf
  module config LinTp_Pre: definition=LinTp
  module config LinTp_Rec: definition=LinTp
