AUTOSAR XML (schema 4-0-3)
package /MICROSAR
  module config LinIf_Rec: definition=LinIf
    LinIfGeneral: LinIfSafeBswChecks=1
