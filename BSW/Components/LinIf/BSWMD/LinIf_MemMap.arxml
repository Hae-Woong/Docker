AUTOSAR XML (schema 00048)
# COPYRIGHT
# Copyright (c) 2021 by Vector Informatik GmbH. All rights reserved.
# This software is copyright protected and proprietary to Vector Informatik GmbH.
# Vector Informatik GmbH grants to you only those rights as set out in the license conditions.
package /MICROSAR
  bsw implementation LinIf_Impl
    required-artifacts:
      dependency on artifact LinIf_MemMap: category=MEMMAP, artifact-descriptor={short-label=LinIf_MemMap.h, category=SWHDR}
    resource consumption ResourceConsumption
      10 x memory section:
        LINIF_CODE: sw-addrmethod=CODE, symbol=CODE
        LINIF_PBCFG: sw-addrmethod=CONST_PBCFG, symbol=PBCFG
        LINIF_CONST_8: alignment=8, sw-addrmethod=CONST, symbol=CONST_8BIT
        LINIF_CONST_16: alignment=16, sw-addrmethod=CONST, symbol=CONST_16BIT
        LINIF_CONST_32: alignment=32, sw-addrmethod=CONST, symbol=CONST_32BIT
        LINIF_CONST_UNSPECIFIED: alignment=UNSPECIFIED, sw-addrmethod=CONST, symbol=CONST_UNSPECIFIED
        LINIF_VAR_PBCFG: sw-addrmethod=VAR_PBCFG, symbol=VAR_PBCFG
        LINIF_VAR_NO_INIT_8: alignment=8, sw-addrmethod=VAR_NO_INIT, symbol=VAR_NOINIT_8BIT
        LINIF_VAR_NO_INIT_UNSPECIFIED: alignment=UNSPECIFIED, sw-addrmethod=VAR_NO_INIT, symbol=VAR_NOINIT_UNSPECIFIED
        LINIF_VAR_CLEARED_8: alignment=8, sw-addrmethod=VAR_CLEARED, symbol=VAR_ZERO_INIT_8BIT
  bsw implementation LinTp_Impl
    required-artifacts:
      dependency on artifact LinTp_MemMap: category=MEMMAP, artifact-descriptor={short-label=LinIf_MemMap.h, category=SWHDR}
    resource consumption ResourceConsumption
      10 x memory section:
        LINTP_CODE: sw-addrmethod=CODE, symbol=CODE
        LINTP_PBCFG: sw-addrmethod=CONST_PBCFG, symbol=PBCFG
        LINTP_CONST_8: alignment=8, sw-addrmethod=CONST, symbol=CONST_8BIT
        LINTP_CONST_16: alignment=16, sw-addrmethod=CONST, symbol=CONST_16BIT
        LINTP_CONST_32: alignment=32, sw-addrmethod=CONST, symbol=CONST_32BIT
        LINTP_CONST_UNSPECIFIED: alignment=UNSPECIFIED, sw-addrmethod=CONST, symbol=CONST_UNSPECIFIED
        LINTP_VAR_PBCFG: sw-addrmethod=VAR_PBCFG, symbol=VAR_PBCFG
        LINTP_VAR_NO_INIT_8: alignment=8, sw-addrmethod=VAR_NO_INIT, symbol=VAR_NOINIT_8BIT
        LINTP_VAR_NO_INIT_UNSPECIFIED: alignment=UNSPECIFIED, sw-addrmethod=VAR_NO_INIT, symbol=VAR_NOINIT_UNSPECIFIED
        LINTP_VAR_CLEARED_8: alignment=8, sw-addrmethod=VAR_CLEARED, symbol=VAR_ZERO_INIT_8BIT
