AUTOSAR XML (schema 00048)
package /MICROSAR
  module definition MemMap [0..1]: category=VENDOR_SPECIFIC_MODULE_DEFINITION, refined-module-def=MemMap, variants pre-compile  # The Memory Mapping (MemMap) module is used to generate memory mapping header files for BSW modules as well as SWCs. These files control the assigment of code, constants and variables to linker sections. #Memory #MemoryMapping #AUTOSAR
    container MemMapAddressingModeSet [0..*]: multiplicity set at pre-compile  # Defines a set of addressing modes which might apply to a SwAddrMethod.
      string MemMapCompilerMemClassSymbolImpl: scope=ECU, multiplicity set at pre-compile, set at pre-compile  # Defines the implementation behind a MemClassSymbol and configures the Compiler Abstraction. Note: Parameter not used.
      string MemMapSupportedAddressingMethodOption [0..*]: scope=ECU, multiplicity set at pre-compile, set at pre-compile  # This constrains the usage of this addressing mode set for Generic Mappings to swAddrMethods. | The attribute option of a swAddrMethod mapped via MemMapGenericMapping to this MemMapAddressingModeSet shall be equal to one of the configured MemMapSupportedAddressMethodOption's
      enumeration MemMapSupportedMemoryAllocationKeywordPolicy [0..*]: {MEMMAP_ALLOCATION_KEYWORD_POLICY_ADDR_METHOD_SHORT_NAME, MEMMAP_ALLOCATION_KEYWORD_POLICY_ADDR_METHOD_SHORT_NAME_AND_ALIGNMENT}, scope=ECU, multiplicity set at pre-compile, set at pre-compile  # This constrains the usage of this addressing mode set for Generic Mappings to swAddrMethods. | The attribute MemoryAllocationKeywordPolicy of a swAddrMethod mapped via MemMapGenericMapping to this MemMapAddressingModeSet shall be equal to one of the configured MemMapSupportedMemoryAllocationKeywordPolicy's
      string MemMapSupportedSectionInitializationPolicy [0..*]: scope=ECU, multiplicity set at pre-compile, set at pre-compile  # This constrains the usage of this addressing mode set for Generic Mappings to swAddrMethods. | The sectionIntializationPolicy attribute value of a swAddrMethod mapped via MemMapGenericMapping to this MemMapAddressingModeSet shall be equal to one of the configured MemMapSupportedSectionIntializationPolicy's Please note that SectionInitializationPolicyType describes the intended initialization of MemorySections. The following values are standardized in AUTOSAR Methodology: * '''NO-INIT''': No initialization and no clearing is performed. Such data elements must not be read before one has written a value into it. * '''INIT''': To be used for data that are initialized by every reset to the specified value (initValue). * '''POWER-ON-INIT''': To be used for data that are initialized by "Power On" to the specified value (initValue). Note: there might be several resets between power on resets. * '''CLEARED''': To be used for data that are initialized by every reset to zero. * '''POWER-ON-CLEARED''': To be used for data that are initialized by "Power On" to zero. Note: there might be several resets between power on resets. Please note that the values are defined similar to the representation of enumeration types in the XML schema to ensure backward compatibility.
      enumeration MemMapSupportedSectionType [0..*]: {MEMMAP_SECTION_TYPE_CAL_PRM, MEMMAP_SECTION_TYPE_CODE, MEMMAP_SECTION_TYPE_CONFIG_DATA, MEMMAP_SECTION_TYPE_CONST, MEMMAP_SECTION_TYPE_EXCLUDE_FROM_FLASH, MEMMAP_SECTION_TYPE_VAR}, scope=ECU, multiplicity set at pre-compile, set at pre-compile  # This constrains the usage of this addressing mode set for Generic Mappings to swAddrMethods. | The attribute sectionType of a swAddrMethod mapped via MemMapGenericMapping or MemMapSectionSpecificMapping to this MemMapAddressingModeSet shall be equal to one of the configured MemMapSupportedSectionType's.
      container MemMapAddressingMode [1..*]: multiplicity set at pre-compile  # Defines a addressing mode with a set of #pragma statements implementing the start and the stop of a section.
        multiline string MemMapAddressingModeStart [0..1]: multiplicity set at pre-compile, set at pre-compile  # Defines a set of #pragma statements implementing the start of a section.
        multiline string MemMapAddressingModeStop [0..1]: multiplicity set at pre-compile, set at pre-compile  # Defines a set of #pragma statements implementing the start of a section.
        string MemMapAlignmentSelector [1..*]: multiplicity set at pre-compile, set at pre-compile  # Defines a the alignments for which the MemMapAddressingMode applies. | The to be used alignment is defined in the alignment attribute of the MemorySection. If the MemMapAlignmentSelector fits to alignment attribute of the MemorySection the set of #pragmas of the related MemMapAddressingMode shall be used to implement the start and the stop of a section. Please note that the same MemMapAddressingMode can be applicable for several alignments, e.g. "8" bit and "UNSPECIFIED".
        choice reference MemMapLinkerLogicalGroupRef [0..1]: multiplicity set at pre-compile, origin=Vector Informatik, set at pre-compile, destination=[vLinkGenLogicalConstGroup, vLinkGenLogicalVarGroup]  # vLinkGen Logical Group Ref | Reference to the vLinkGen logical group to which the MemMapAddressingMode should map. This reference is required for the automatic pragma generation.
    container MemMapAllocation [0..*]: multiplicity set at pre-compile  # Defines which MemorySection of a BSW Module or a Software Component is implemented with which MemMapAddressingModeSet. | This can either be specified for a set of MemorySections which refer to an identical SwAddrMethod (MemMapGenericMapping) or for individual MemorySections (MemMapSectionSpecificMapping). If both are defined for the same MemorySection the MemMapSectionSpecificMapping overrules the MemMapGenericMapping.
      container MemMapGenericMapping [0..*]: multiplicity set at pre-compile  # Defines which SwAddrMethod is implemented with which MemMapAddressingModeSet. | The pragmas for the implementation of the MemorySelectorKeywords are taken from the MemMapAddressingModeStart and MemMapAddressingModeStop parameters of the MemMapAddressingModeSet for the individual alignments. That this mapping becomes valid requires matching MemMapSupportedSectionType's, MemMapSupportedSectionInitializationPolicy's and MemMapSupportedAddressingMethodOption's. The MemMapGenericMapping applies only if it is not overruled by an MemMapSectionSpecificMapping
        reference MemMapAddressingModeSetRef: scope=ECU, multiplicity set at pre-compile, set at pre-compile, destination=MemMapAddressingModeSet  # Reference to the MemMapAddressingModeSet which applies to the MemMapGenericMapping.
        reference MemMapMappingSelectorRef [0..1]: scope=ECU, multiplicity set at pre-compile, set at pre-compile, destination=MemMapMappingSelector  # Reference to a MemMapPrefixSelector. The owning MemMapGenericMapping is only effective for those memories where the MemMapMappingSelector matches. Note: Parameter not used.
        foreign reference MemMapSwAddressMethodRef [1..*]: scope=ECU, multiplicity set at pre-compile, set at pre-compile, destination-type=SW-ADDR-METHOD  # Reference to the SwAddrMethod which applies to the MemMapGenericMapping.
      container MemMapMappingSelector [0..*]: multiplicity set at pre-compile  # The container holds a section criteria reusable for MemMapGenericMappings. Note: Container not used.
        string MemMapPrefixSelector [0..1]: scope=ECU, multiplicity set at pre-compile, set at pre-compile  # The parameter MemMapPrefixSelector defines a regular expression which shall be applied to the <PREFIX> part of the memory allocation keywords. Note: Parameter not used. | The mapping using this selector is only effective for those memories where the <PREFIX> part of the memory allocation keyword matches the regular expression. Note: This is in particular intended the restrict the usage of of a MemMapAddressingModeSet for a sub set of BSW Modules or Software Components or a subset of allocatable memory parts inside BSW Modules or Software Components.
      container MemMapSectionSpecificMapping [0..*]: multiplicity set at pre-compile  # Defines which MemorySection of a BSW Module or a Software Component is implemented with which MemMapAddressingModeSet. | The pragmas for the implementation of the MemorySelectorKeywords are taken from the MemMapAddressingModeStart and MemMapAddressingModeStop parameters of the MemMapAddressingModeSet for the specific alignment of the MemorySection. The MemMapSectionSpecificMapping precedes a mapping defined by MemMapGenericMapping.
        reference MemMapAddressingModeSetRef: scope=ECU, multiplicity set at pre-compile, set at pre-compile, destination=MemMapAddressingModeSet  # Reference to the MemMapAddressingModeSet which applies to the MemMapModuleSectionSpecificMapping.
        foreign reference MemMapMemorySectionRef [1..*]: scope=ECU, multiplicity set at pre-compile, set at pre-compile, destination-type=MEMORY-SECTION  # Reference to the MemorySection which applies to the MemMapSectionSpecificMapping.
      container MemMapAdditionalSpecificMapping [0..*]: multiplicity set at pre-compile  # Defines which AdditionalMemorySection is implemented with which MemMapAddressingModeSet.
        reference MemMapAddressingModeSetRef: multiplicity set at pre-compile, origin=Vector Informatik, set at pre-compile, destination=MemMapAddressingModeSet  # Reference to the MemMapAddressingModeSet which applies to the MemMapAdditionalSpecificMapping.
        reference MemMapAdditionalMemorySectionRef [1..*]: multiplicity set at pre-compile, origin=Vector Informatik, set at pre-compile, destination=MemMapAdditionalMemorySection  # Reference to the AdditionalMemorySection which applies to the MemMapAdditionalSpecificMapping.
    container MemMapGenericCompilerMemClass [0..*]: multiplicity set at pre-compile  # The shortName of the container defines the name of the generic Compiler memclass which is global for all using modules, e.g. REGSPACE. Note: Container not used. | The configures the Compiler Abstraction.
      string MemMapGenericCompilerMemClassSymbolImpl: scope=ECU, multiplicity set at pre-compile, set at pre-compile  # Defines the implementation behind the generic MemClassSymbol and configures the Compiler Abstraction. Note: Parameter not used.
    container MemMapGeneral: multiplicity set at pre-compile  # General configuration parameters of the MemMap.
      enumeration MemMapGeneration: {FULL, EMPTY, USER_CONFIG_ONLY, NON}, multiplicity set at pre-compile, origin=Vector Informatik, set at pre-compile, default-value=FULL  # MemMap Generation | Specifies how the module specific memory mapping header file(s) shall be generated. FULL: Generates a memory mapping header file for each BSW module and software component type in the project that has MemorySections configured. In addition the MemMapAdditionalMemorySection(s) are generated into their respective files. EMPTY: Creates the same files as with the generation type FULL. However, the files will be empty in this case. USER_CONFIG_ONLY: Creates the same files as with the generation type FULL. However, the files will only contain the contents of 'Pre User Config File' and 'Post User Config File'. NON: None of the files that would be generated with generation type FULL will be created.
      enumeration MemMapCompatibilityGeneration: {FULL, EMPTY, USER_CONFIG_ONLY, NON}, multiplicity set at pre-compile, origin=Vector Informatik, set at pre-compile, default-value=FULL  # MemMap Compatibility Generation | Specifies if and how the compatibility memory mapping header file (MemMap_Compatibility.h) shall be generated. FULL: Generates a compatibility memory mapping header file that contains the MemorySections of all BSW modules in the project. EMPTY: Generates a compatibility memory mapping header file that is empty. USER_CONFIG_ONLY: Generates a compatibility memory mapping header file that only contains the contents of 'Pre User Config File' and 'Post User Config File'. NON: No compatibility memory mapping header file will be generated.
      boolean MemMapTypedPragmas: multiplicity set at pre-compile, origin=Vector Informatik, set at pre-compile, default-value=true  # Generate Typed Pragmas | Specifies whether pragmas are generated with types. Pragmas that are entered manually are not affected by this parameter. Note: This parameter only affects the automatic pragma generation for the Tasking compiler. The parameter should only be set to "false" when using the platform "ARM". Otherwise it should be set to "true".
      boolean MemMapGeneratePragmas: multiplicity set at pre-compile, origin=Vector Informatik, set at pre-compile, default-value=true  # Generate Pragmas | Specifies whether pragmas are generated into the memory mapping header file(s). If set to "false" the memory mapping header file(s) will not contain any pragmas and therefore there will be no mapping to linker sections.
      enumeration MemMapErrorChecks: {ALL, AUTOSAR, NON}, multiplicity set at pre-compile, origin=Vector Informatik, set at pre-compile, default-value=ALL  # Error Checks | Specifies if and which error checks shall be added to the generated memory mapping header file(s). Note: Error checks with a higher level also include the error checks of lower levels, e.g. ALL includes the error checks of AUTOSAR. ALL (Level 2): All possible error checks are added to the memory mapping header file(s). AUTOSAR (Level 1): All error checks defined by AUTOSAR are added to the memory mapping header file(s). NON (Level 0): No error checks are added to the memory mapping header file(s).
      boolean MemMapGeneratePragmasForNearAddressing: multiplicity set at pre-compile, origin=Vector Informatik, set at pre-compile, default-value=true  # Generate Pragmas For Near Addressing | Specifies whether pragmas are generated for near addressing modes (e.g. sdata, sbss, sconst). If the near addressing mode is not necessary according to the compiler options used, generation can be disabled with this parameter.
      string MemMapPreUserConfigFile [0..1]: multiplicity set at pre-compile, origin=Vector Informatik, set at pre-compile  # Pre User Config File | Reference to an external text file that will be included during generation to ANY memory mapping header file. The content of the user configuration file will be added at the beginning of the generated files and allows altering or extending the generated code. Note: In contrast to the other MICROSAR components, MemMap provides the possibility to insert user config files at the beginning and end of the generated memory mapping header files. See also 'Post User Config File'. Caution: User configuration files can cause the software module to malfunction and must only be used with great care!
      string MemMapPostUserConfigFile [0..1]: multiplicity set at pre-compile, origin=Vector Informatik, set at pre-compile  # Post User Config File | Reference to an external text file that will be included during generation to ANY memory mapping header file. The content of the user configuration file will be added at the end of the generated files and allows altering or extending the generated code. Note: In contrast to the other MICROSAR components, MemMap provides the possibility to insert user config files at the beginning and end of the generated memory mapping header files. See also 'Pre User Config File'. Caution: User configuration files can cause the software module to malfunction and must only be used with great care!
    container MemMapModule [0..*]: multiplicity set at pre-compile  # Abstraction layer for grouping AdditionalMemorySections that belong to the same module.
      boolean MemMapGenerateAdditionalMemorySections: multiplicity set at pre-compile, origin=Vector Informatik, set at pre-compile, default-value=true  # Generate Additional Memory Sections | Specifies whether the AdditionalMemorySection(s) defined for this module should be generated into the memory mapping header file(s).
      foreign reference MemMapModuleRef [0..1]: multiplicity set at pre-compile, origin=Vector Informatik, set at pre-compile, destination-type=ECUC-MODULE-CONFIGURATION-VALUES  # Module Ref | Optional reference that specifies to which module the AdditionalMemorySection(s) belong. Note: If this reference is set, the container is typically created by another module's generator. Caution: If a module is referenced it must contain a BSW-IMPLEMENTATION. Otherwise none of the MemMapAdditionalMemorySections contained in the MemMapModule can be generated.
      container MemMapAdditionalMemorySection [1..*]: multiplicity set at pre-compile  # Vector MemorySections that can be configured in the ECUC. These MemorySections are generated in addition to the MemorySections configured according to AUTOSAR.
        string MemMapMemorySectionAlignment [0..1]: multiplicity set at pre-compile, origin=Vector Informatik, set at pre-compile  # Alignment | The alignment of objects within this AdditionalMemorySection. The following alignments are supported: BOOLEAN, 8, 16, 32, 64, UNSPECIFIED. Note: If this parameter is not set the default alignment "UNSPECIFIED" will be used.
        string MemMapMemorySectionFileName [0..1]: multiplicity set at pre-compile, origin=Vector Informatik, set at pre-compile  # Filename | Specifies the name of the file this AdditionalMemorySection shall be generated into. Note: If this parameter is not set the MemMapModuleRef in the parent container MemMapModule needs to be set.
        string MemMapMemorySectionPrefix [0..1]: multiplicity set at pre-compile, origin=Vector Informatik, set at pre-compile  # Prefix | Specifies the {PREFIX} part in the memory allocation keyword {PREFIX}_(START|STOP)_SEC_{SYMBOL}. Note: If this parameter is not set the MemMapModuleRef in the parent container MemMapModule needs to be set.
        string MemMapMemorySectionSymbol [0..1]: multiplicity set at pre-compile, origin=Vector Informatik, set at pre-compile  # Symbol | Specifies the {SYMBOL} part in the memory allocation keyword {PREFIX}_(START|STOP)_SEC_{SYMBOL}. Note: If this parameter is not set the ShortName of the container this parameter is contained in will be used as {SYMBOL}.
        foreign reference MemMapMemorySectionSwAddrMethodRef: multiplicity set at pre-compile, origin=Vector Informatik, set at pre-compile, destination-type=SW-ADDR-METHOD  # Sw Addr Method Ref | Reference to the SwAddrMethod this AdditionalMemorySection is associated with.
  bsw implementation MemMap_Impl: programming-language=C, sw-version=1.07.00, used-code-generator=DaVinci Configurator, vendor-id=30, ar-release-version=4.05.00, preconfigured-configuration=MemMap_Pre, recommended-configuration=MemMap_Rec, vendor-specific-module-def=MemMap
