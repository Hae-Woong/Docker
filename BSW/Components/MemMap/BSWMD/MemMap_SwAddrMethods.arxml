AUTOSAR XML (schema 00048)
package /MICROSAR_MemMap/SwAddrMethods
  134 x sw addr method:
    CALLOUT_CODE: section-type=CODE
    CODE: section-type=CODE
    CODE_FAST: section-type=CODE
    CODE_ISR: section-type=CODE
    CODE_SLOW: section-type=CODE
    CONFIG_DATA: section-type=CONFIG-DATA
    CONST_PBCFG: section-type=CONST
    PBCFG_GLOBALROOT: section-type=CONST
    CONST: section-type=CONST
    CONST_SAVED_RECOVERY_ZONE: section-type=CONST
    CONST_FAST: section-type=CONST
    VAR_PBCFG: section-type=VAR
    VAR_INIT: section-type=VAR
    VAR_NO_INIT: section-initialization-policy=NO-INIT, section-type=VAR
    VAR_CLEARED: section-initialization-policy=CLEARED, section-type=VAR
    VAR_FAST_INIT: section-type=VAR-FAST
    VAR_FAST_NO_INIT: section-initialization-policy=NO-INIT, section-type=VAR-FAST
    VAR_FAST_CLEARED: section-initialization-policy=CLEARED, section-type=VAR-FAST
    VAR_NOCACHE_INIT: section-type=VAR
    VAR_NOCACHE_NO_INIT: section-initialization-policy=NO-INIT, section-type=VAR
    VAR_NOCACHE_CLEARED: section-initialization-policy=CLEARED, section-type=VAR
    VAR_SAVED_ZONE: section-initialization-policy=NO-INIT, section-type=VAR
    VAR_SLOW: section-initialization-policy=INIT, section-type=VAR
    INTERNAL_VAR: section-initialization-policy=INIT, section-type=VAR
    CALIB: section-type=CALPRM
    CONST_BOOLEAN: section-type=CONST
    CONST_8: section-type=CONST
    CONST_16: section-type=CONST
    CONST_32: section-type=CONST
    CONST_64: section-type=CONST
    CONST_UNSPECIFIED: section-type=CONST
    CONST_FAST_BOOLEAN: section-type=CONST
    CONST_FAST_8: section-type=CONST
    CONST_FAST_16: section-type=CONST
    CONST_FAST_32: section-type=CONST
    CONST_FAST_64: section-type=CONST
    CONST_FAST_UNSPECIFIED: section-type=CONST
    VAR_INIT_BOOLEAN: section-type=VAR
    VAR_INIT_8: section-type=VAR
    VAR_INIT_16: section-type=VAR
    VAR_INIT_32: section-type=VAR
    VAR_INIT_64: section-type=VAR
    VAR_INIT_UNSPECIFIED: section-type=VAR
    VAR_NO_INIT_BOOLEAN: section-initialization-policy=NO-INIT, section-type=VAR
    VAR_NO_INIT_8: section-initialization-policy=NO-INIT, section-type=VAR
    VAR_NO_INIT_16: section-initialization-policy=NO-INIT, section-type=VAR
    VAR_NO_INIT_32: section-initialization-policy=NO-INIT, section-type=VAR
    VAR_NO_INIT_64: section-initialization-policy=NO-INIT, section-type=VAR
    VAR_NO_INIT_UNSPECIFIED: section-initialization-policy=NO-INIT, section-type=VAR
    VAR_NOINIT_BOOLEAN: section-initialization-policy=NO-INIT, section-type=VAR
    VAR_NOINIT_8: section-initialization-policy=NO-INIT, section-type=VAR
    VAR_NOINIT_16: section-initialization-policy=NO-INIT, section-type=VAR
    VAR_NOINIT_32: section-initialization-policy=NO-INIT, section-type=VAR
    VAR_NOINIT_64: section-initialization-policy=NO-INIT, section-type=VAR
    VAR_NOINIT_UNSPECIFIED: section-initialization-policy=NO-INIT, section-type=VAR
    VAR_CLEARED_BOOLEAN: section-initialization-policy=CLEARED, section-type=VAR
    VAR_CLEARED_8: section-initialization-policy=CLEARED, section-type=VAR
    VAR_CLEARED_16: section-initialization-policy=CLEARED, section-type=VAR
    VAR_CLEARED_32: section-initialization-policy=CLEARED, section-type=VAR
    VAR_CLEARED_64: section-initialization-policy=CLEARED, section-type=VAR
    VAR_CLEARED_UNSPECIFIED: section-initialization-policy=CLEARED, section-type=VAR
    VAR_ZERO_INIT: section-initialization-policy=CLEARED, section-type=VAR
    VAR_ZERO_INIT_BOOLEAN: section-initialization-policy=CLEARED, section-type=VAR
    VAR_ZERO_INIT_8: section-initialization-policy=CLEARED, section-type=VAR
    VAR_ZERO_INIT_16: section-initialization-policy=CLEARED, section-type=VAR
    VAR_ZERO_INIT_32: section-initialization-policy=CLEARED, section-type=VAR
    VAR_ZERO_INIT_64: section-initialization-policy=CLEARED, section-type=VAR
    VAR_ZERO_INIT_UNSPECIFIED: section-initialization-policy=CLEARED, section-type=VAR
    VAR_FAST_INIT_BOOLEAN: section-type=VAR-FAST
    VAR_FAST_INIT_8: section-type=VAR-FAST
    VAR_FAST_INIT_16: section-type=VAR-FAST
    VAR_FAST_INIT_32: section-type=VAR-FAST
    VAR_FAST_INIT_64: section-type=VAR-FAST
    VAR_FAST_INIT_UNSPECIFIED: section-type=VAR-FAST
    VAR_FAST_NO_INIT_BOOLEAN: section-initialization-policy=NO-INIT, section-type=VAR-FAST
    VAR_FAST_NO_INIT_8: section-initialization-policy=NO-INIT, section-type=VAR-FAST
    VAR_FAST_NO_INIT_16: section-initialization-policy=NO-INIT, section-type=VAR-FAST
    VAR_FAST_NO_INIT_32: section-initialization-policy=NO-INIT, section-type=VAR-FAST
    VAR_FAST_NO_INIT_64: section-initialization-policy=NO-INIT, section-type=VAR-FAST
    VAR_FAST_NO_INIT_UNSPECIFIED: section-initialization-policy=NO-INIT, section-type=VAR-FAST
    VAR_FAST_NOINIT_BOOLEAN: section-initialization-policy=NO-INIT, section-type=VAR-FAST
    VAR_FAST_NOINIT_8: section-initialization-policy=NO-INIT, section-type=VAR-FAST
    VAR_FAST_NOINIT_16: section-initialization-policy=NO-INIT, section-type=VAR-FAST
    VAR_FAST_NOINIT_32: section-initialization-policy=NO-INIT, section-type=VAR-FAST
    VAR_FAST_NOINIT_64: section-initialization-policy=NO-INIT, section-type=VAR-FAST
    VAR_FAST_NOINIT_UNSPECIFIED: section-initialization-policy=NO-INIT, section-type=VAR-FAST
    VAR_FAST_CLEARED_BOOLEAN: section-initialization-policy=CLEARED, section-type=VAR-FAST
    VAR_FAST_CLEARED_8: section-initialization-policy=CLEARED, section-type=VAR-FAST
    VAR_FAST_CLEARED_16: section-initialization-policy=CLEARED, section-type=VAR-FAST
    VAR_FAST_CLEARED_32: section-initialization-policy=CLEARED, section-type=VAR-FAST
    VAR_FAST_CLEARED_64: section-initialization-policy=CLEARED, section-type=VAR-FAST
    VAR_FAST_CLEARED_UNSPECIFIED: section-initialization-policy=CLEARED, section-type=VAR-FAST
    VAR_FAST_ZERO_INIT_BOOLEAN: section-initialization-policy=CLEARED, section-type=VAR-FAST
    VAR_FAST_ZERO_INIT_8: section-initialization-policy=CLEARED, section-type=VAR-FAST
    VAR_FAST_ZERO_INIT_16: section-initialization-policy=CLEARED, section-type=VAR-FAST
    VAR_FAST_ZERO_INIT_32: section-initialization-policy=CLEARED, section-type=VAR-FAST
    VAR_FAST_ZERO_INIT_64: section-initialization-policy=CLEARED, section-type=VAR-FAST
    VAR_FAST_ZERO_INIT_UNSPECIFIED: section-initialization-policy=CLEARED, section-type=VAR-FAST
    VAR_NOCACHE_INIT_BOOLEAN: section-type=VAR
    VAR_NOCACHE_INIT_8: section-type=VAR
    VAR_NOCACHE_INIT_16: section-type=VAR
    VAR_NOCACHE_INIT_32: section-type=VAR
    VAR_NOCACHE_INIT_64: section-type=VAR
    VAR_NOCACHE_INIT_UNSPECIFIED: section-type=VAR
    VAR_NOCACHE_NO_INIT_BOOLEAN: section-initialization-policy=NO-INIT, section-type=VAR
    VAR_NOCACHE_NO_INIT_8: section-initialization-policy=NO-INIT, section-type=VAR
    VAR_NOCACHE_NO_INIT_16: section-initialization-policy=NO-INIT, section-type=VAR
    VAR_NOCACHE_NO_INIT_32: section-initialization-policy=NO-INIT, section-type=VAR
    VAR_NOCACHE_NO_INIT_64: section-initialization-policy=NO-INIT, section-type=VAR
    VAR_NOCACHE_NO_INIT_UNSPECIFIED: section-initialization-policy=NO-INIT, section-type=VAR
    VAR_NOCACHE_NOINIT_BOOLEAN: section-initialization-policy=NO-INIT, section-type=VAR
    VAR_NOCACHE_NOINIT_8: section-initialization-policy=NO-INIT, section-type=VAR
    VAR_NOCACHE_NOINIT_16: section-initialization-policy=NO-INIT, section-type=VAR
    VAR_NOCACHE_NOINIT_32: section-initialization-policy=NO-INIT, section-type=VAR
    VAR_NOCACHE_NOINIT_64: section-initialization-policy=NO-INIT, section-type=VAR
    VAR_NOCACHE_NOINIT_UNSPECIFIED: section-initialization-policy=NO-INIT, section-type=VAR
    VAR_NOCACHE_CLEARED_BOOLEAN: section-initialization-policy=CLEARED, section-type=VAR
    VAR_NOCACHE_CLEARED_8: section-initialization-policy=CLEARED, section-type=VAR
    VAR_NOCACHE_CLEARED_16: section-initialization-policy=CLEARED, section-type=VAR
    VAR_NOCACHE_CLEARED_32: section-initialization-policy=CLEARED, section-type=VAR
    VAR_NOCACHE_CLEARED_64: section-initialization-policy=CLEARED, section-type=VAR
    VAR_NOCACHE_CLEARED_UNSPECIFIED: section-initialization-policy=CLEARED, section-type=VAR
    VAR_NOCACHE_ZERO_INIT_BOOLEAN: section-initialization-policy=CLEARED, section-type=VAR
    VAR_NOCACHE_ZERO_INIT_8: section-initialization-policy=CLEARED, section-type=VAR
    VAR_NOCACHE_ZERO_INIT_16: section-initialization-policy=CLEARED, section-type=VAR
    VAR_NOCACHE_ZERO_INIT_32: section-initialization-policy=CLEARED, section-type=VAR
    VAR_NOCACHE_ZERO_INIT_64: section-initialization-policy=CLEARED, section-type=VAR
    VAR_NOCACHE_ZERO_INIT_UNSPECIFIED: section-initialization-policy=CLEARED, section-type=VAR
    VAR_SAVED_ZONE_BOOLEAN: section-initialization-policy=NO-INIT, section-type=VAR
    VAR_SAVED_ZONE_8: section-initialization-policy=NO-INIT, section-type=VAR
    VAR_SAVED_ZONE_16: section-initialization-policy=NO-INIT, section-type=VAR
    VAR_SAVED_ZONE_32: section-initialization-policy=NO-INIT, section-type=VAR
    VAR_SAVED_ZONE_64: section-initialization-policy=NO-INIT, section-type=VAR
    VAR_SAVED_ZONE_UNSPECIFIED: section-initialization-policy=NO-INIT, section-type=VAR
