AUTOSAR XML (schema 00048)
package /MICROSAR
  module config MemMap_Rec: definition=MemMap
    MemMap_Common (MemMapModule)
      113 x MemMapAdditionalMemorySection, all with MemMapMemorySectionFileName=MemMap_Common.h, MemMapMemorySectionPrefix=:
        CODE: MemMapMemorySectionSymbol=CODE, MemMapMemorySectionSwAddrMethodRef=CODE
        CODE_FAST: MemMapMemorySectionSymbol=CODE_FAST, MemMapMemorySectionSwAddrMethodRef=CODE_FAST
        CODE_ISR: MemMapMemorySectionSymbol=CODE_ISR, MemMapMemorySectionSwAddrMethodRef=CODE_ISR
        CONST: MemMapMemorySectionAlignment=UNSPECIFIED, MemMapMemorySectionSymbol=CONST, MemMapMemorySectionSwAddrMethodRef=CONST
        CONST_8BIT: MemMapMemorySectionAlignment=8, MemMapMemorySectionSymbol=CONST_8BIT, MemMapMemorySectionSwAddrMethodRef=CONST
        CONST_16BIT: MemMapMemorySectionAlignment=16, MemMapMemorySectionSymbol=CONST_16BIT, MemMapMemorySectionSwAddrMethodRef=CONST
        CONST_32BIT: MemMapMemorySectionAlignment=32, MemMapMemorySectionSymbol=CONST_32BIT, MemMapMemorySectionSwAddrMethodRef=CONST
        CONST_64BIT: MemMapMemorySectionAlignment=64, MemMapMemorySectionSymbol=CONST_64BIT, MemMapMemorySectionSwAddrMethodRef=CONST
        CONST_8: MemMapMemorySectionAlignment=8, MemMapMemorySectionSymbol=CONST_8, MemMapMemorySectionSwAddrMethodRef=CONST
        CONST_16: MemMapMemorySectionAlignment=16, MemMapMemorySectionSymbol=CONST_16, MemMapMemorySectionSwAddrMethodRef=CONST
        CONST_32: MemMapMemorySectionAlignment=32, MemMapMemorySectionSymbol=CONST_32, MemMapMemorySectionSwAddrMethodRef=CONST
        CONST_64: MemMapMemorySectionAlignment=64, MemMapMemorySectionSymbol=CONST_64, MemMapMemorySectionSwAddrMethodRef=CONST
        CONST_UNSPECIFIED: MemMapMemorySectionAlignment=UNSPECIFIED, MemMapMemorySectionSymbol=CONST_UNSPECIFIED, MemMapMemorySectionSwAddrMethodRef=CONST
        CONST_FAST_8BIT: MemMapMemorySectionAlignment=8, MemMapMemorySectionSymbol=CONST_FAST_8BIT, MemMapMemorySectionSwAddrMethodRef=CONST_FAST
        CONST_FAST_16BIT: MemMapMemorySectionAlignment=16, MemMapMemorySectionSymbol=CONST_FAST_16BIT, MemMapMemorySectionSwAddrMethodRef=CONST_FAST
        CONST_FAST_32BIT: MemMapMemorySectionAlignment=32, MemMapMemorySectionSymbol=CONST_FAST_32BIT, MemMapMemorySectionSwAddrMethodRef=CONST_FAST
        CONST_FAST_64BIT: MemMapMemorySectionAlignment=64, MemMapMemorySectionSymbol=CONST_FAST_64BIT, MemMapMemorySectionSwAddrMethodRef=CONST_FAST
        CONST_FAST_8: MemMapMemorySectionAlignment=8, MemMapMemorySectionSymbol=CONST_FAST_8, MemMapMemorySectionSwAddrMethodRef=CONST_FAST
        CONST_FAST_16: MemMapMemorySectionAlignment=16, MemMapMemorySectionSymbol=CONST_FAST_16, MemMapMemorySectionSwAddrMethodRef=CONST_FAST
        CONST_FAST_32: MemMapMemorySectionAlignment=32, MemMapMemorySectionSymbol=CONST_FAST_32, MemMapMemorySectionSwAddrMethodRef=CONST_FAST
        CONST_FAST_64: MemMapMemorySectionAlignment=64, MemMapMemorySectionSymbol=CONST_FAST_64, MemMapMemorySectionSwAddrMethodRef=CONST_FAST
        CONST_FAST_UNSPECIFIED: MemMapMemorySectionAlignment=UNSPECIFIED, MemMapMemorySectionSymbol=CONST_FAST_UNSPECIFIED, MemMapMemorySectionSwAddrMethodRef=CONST_FAST
        CONST_PBCFG: MemMapMemorySectionSymbol=CONST_PBCFG, MemMapMemorySectionSwAddrMethodRef=CONST_PBCFG
        PBCFG_GLOBALROOT: MemMapMemorySectionSymbol=PBCFG_GLOBALROOT, MemMapMemorySectionSwAddrMethodRef=PBCFG_GLOBALROOT
        VAR: MemMapMemorySectionAlignment=UNSPECIFIED, MemMapMemorySectionSymbol=VAR, MemMapMemorySectionSwAddrMethodRef=VAR_INIT
        VAR_INIT_8BIT: MemMapMemorySectionAlignment=8, MemMapMemorySectionSymbol=VAR_INIT_8BIT, MemMapMemorySectionSwAddrMethodRef=VAR_INIT
        VAR_INIT_16BIT: MemMapMemorySectionAlignment=16, MemMapMemorySectionSymbol=VAR_INIT_16BIT, MemMapMemorySectionSwAddrMethodRef=VAR_INIT
        VAR_INIT_32BIT: MemMapMemorySectionAlignment=32, MemMapMemorySectionSymbol=VAR_INIT_32BIT, MemMapMemorySectionSwAddrMethodRef=VAR_INIT
        VAR_INIT_64BIT: MemMapMemorySectionAlignment=64, MemMapMemorySectionSymbol=VAR_INIT_64BIT, MemMapMemorySectionSwAddrMethodRef=VAR_INIT
        VAR_INIT_8: MemMapMemorySectionAlignment=8, MemMapMemorySectionSymbol=VAR_INIT_8, MemMapMemorySectionSwAddrMethodRef=VAR_INIT
        VAR_INIT_16: MemMapMemorySectionAlignment=16, MemMapMemorySectionSymbol=VAR_INIT_16, MemMapMemorySectionSwAddrMethodRef=VAR_INIT
        VAR_INIT_32: MemMapMemorySectionAlignment=32, MemMapMemorySectionSymbol=VAR_INIT_32, MemMapMemorySectionSwAddrMethodRef=VAR_INIT
        VAR_INIT_64: MemMapMemorySectionAlignment=64, MemMapMemorySectionSymbol=VAR_INIT_64, MemMapMemorySectionSwAddrMethodRef=VAR_INIT
        VAR_INIT_UNSPECIFIED: MemMapMemorySectionAlignment=UNSPECIFIED, MemMapMemorySectionSymbol=VAR_INIT_UNSPECIFIED, MemMapMemorySectionSwAddrMethodRef=VAR_INIT
        VAR_NOINIT_8BIT: MemMapMemorySectionAlignment=8, MemMapMemorySectionSymbol=VAR_NOINIT_8BIT, MemMapMemorySectionSwAddrMethodRef=VAR_NO_INIT
        VAR_NOINIT_16BIT: MemMapMemorySectionAlignment=16, MemMapMemorySectionSymbol=VAR_NOINIT_16BIT, MemMapMemorySectionSwAddrMethodRef=VAR_NO_INIT
        VAR_NOINIT_32BIT: MemMapMemorySectionAlignment=32, MemMapMemorySectionSymbol=VAR_NOINIT_32BIT, MemMapMemorySectionSwAddrMethodRef=VAR_NO_INIT
        VAR_NOINIT_64BIT: MemMapMemorySectionAlignment=64, MemMapMemorySectionSymbol=VAR_NOINIT_64BIT, MemMapMemorySectionSwAddrMethodRef=VAR_NO_INIT
        VAR_NO_INIT_8: MemMapMemorySectionAlignment=8, MemMapMemorySectionSymbol=VAR_NO_INIT_8, MemMapMemorySectionSwAddrMethodRef=VAR_NO_INIT
        VAR_NO_INIT_16: MemMapMemorySectionAlignment=16, MemMapMemorySectionSymbol=VAR_NO_INIT_16, MemMapMemorySectionSwAddrMethodRef=VAR_NO_INIT
        VAR_NO_INIT_32: MemMapMemorySectionAlignment=32, MemMapMemorySectionSymbol=VAR_NO_INIT_32, MemMapMemorySectionSwAddrMethodRef=VAR_NO_INIT
        VAR_NO_INIT_64: MemMapMemorySectionAlignment=64, MemMapMemorySectionSymbol=VAR_NO_INIT_64, MemMapMemorySectionSwAddrMethodRef=VAR_NO_INIT
        VAR_NOINIT_UNSPECIFIED: MemMapMemorySectionAlignment=UNSPECIFIED, MemMapMemorySectionSymbol=VAR_NOINIT_UNSPECIFIED, MemMapMemorySectionSwAddrMethodRef=VAR_NO_INIT
        VAR_NO_INIT_UNSPECIFIED: MemMapMemorySectionAlignment=UNSPECIFIED, MemMapMemorySectionSymbol=VAR_NO_INIT_UNSPECIFIED, MemMapMemorySectionSwAddrMethodRef=VAR_NO_INIT
        VAR_ZERO_INIT_8BIT: MemMapMemorySectionAlignment=8, MemMapMemorySectionSymbol=VAR_ZERO_INIT_8BIT, MemMapMemorySectionSwAddrMethodRef=VAR_CLEARED
        VAR_ZERO_INIT_16BIT: MemMapMemorySectionAlignment=16, MemMapMemorySectionSymbol=VAR_ZERO_INIT_16BIT, MemMapMemorySectionSwAddrMethodRef=VAR_CLEARED
        VAR_ZERO_INIT_32BIT: MemMapMemorySectionAlignment=32, MemMapMemorySectionSymbol=VAR_ZERO_INIT_32BIT, MemMapMemorySectionSwAddrMethodRef=VAR_CLEARED
        VAR_ZERO_INIT_64BIT: MemMapMemorySectionAlignment=64, MemMapMemorySectionSymbol=VAR_ZERO_INIT_64BIT, MemMapMemorySectionSwAddrMethodRef=VAR_CLEARED
        VAR_CLEARED_8: MemMapMemorySectionAlignment=8, MemMapMemorySectionSymbol=VAR_CLEARED_8, MemMapMemorySectionSwAddrMethodRef=VAR_CLEARED
        VAR_CLEARED_16: MemMapMemorySectionAlignment=16, MemMapMemorySectionSymbol=VAR_CLEARED_16, MemMapMemorySectionSwAddrMethodRef=VAR_CLEARED
        VAR_CLEARED_32: MemMapMemorySectionAlignment=32, MemMapMemorySectionSymbol=VAR_CLEARED_32, MemMapMemorySectionSwAddrMethodRef=VAR_CLEARED
        VAR_CLEARED_64: MemMapMemorySectionAlignment=64, MemMapMemorySectionSymbol=VAR_CLEARED_64, MemMapMemorySectionSwAddrMethodRef=VAR_CLEARED
        VAR_CLEARED_UNSPECIFIED: MemMapMemorySectionAlignment=UNSPECIFIED, MemMapMemorySectionSymbol=VAR_CLEARED_UNSPECIFIED, MemMapMemorySectionSwAddrMethodRef=VAR_CLEARED
        VAR_ZERO_INIT_UNSPECIFIED: MemMapMemorySectionAlignment=UNSPECIFIED, MemMapMemorySectionSymbol=VAR_ZERO_INIT_UNSPECIFIED, MemMapMemorySectionSwAddrMethodRef=VAR_CLEARED
        VAR_FAST_INIT_8BIT: MemMapMemorySectionAlignment=8, MemMapMemorySectionSymbol=VAR_FAST_INIT_8BIT, MemMapMemorySectionSwAddrMethodRef=VAR_FAST_INIT
        VAR_FAST_INIT_16BIT: MemMapMemorySectionAlignment=16, MemMapMemorySectionSymbol=VAR_FAST_INIT_16BIT, MemMapMemorySectionSwAddrMethodRef=VAR_FAST_INIT
        VAR_FAST_INIT_32BIT: MemMapMemorySectionAlignment=32, MemMapMemorySectionSymbol=VAR_FAST_INIT_32BIT, MemMapMemorySectionSwAddrMethodRef=VAR_FAST_INIT
        VAR_FAST_INIT_64BIT: MemMapMemorySectionAlignment=64, MemMapMemorySectionSymbol=VAR_FAST_INIT_64BIT, MemMapMemorySectionSwAddrMethodRef=VAR_FAST_INIT
        VAR_FAST_INIT_8: MemMapMemorySectionAlignment=8, MemMapMemorySectionSymbol=VAR_FAST_INIT_8, MemMapMemorySectionSwAddrMethodRef=VAR_FAST_INIT
        VAR_FAST_INIT_16: MemMapMemorySectionAlignment=16, MemMapMemorySectionSymbol=VAR_FAST_INIT_16, MemMapMemorySectionSwAddrMethodRef=VAR_FAST_INIT
        VAR_FAST_INIT_32: MemMapMemorySectionAlignment=32, MemMapMemorySectionSymbol=VAR_FAST_INIT_32, MemMapMemorySectionSwAddrMethodRef=VAR_FAST_INIT
        VAR_FAST_INIT_64: MemMapMemorySectionAlignment=64, MemMapMemorySectionSymbol=VAR_FAST_INIT_64, MemMapMemorySectionSwAddrMethodRef=VAR_FAST_INIT
        VAR_FAST_INIT_UNSPECIFIED: MemMapMemorySectionAlignment=UNSPECIFIED, MemMapMemorySectionSymbol=VAR_FAST_INIT_UNSPECIFIED, MemMapMemorySectionSwAddrMethodRef=VAR_FAST_INIT
        VAR_FAST_NOINIT_8BIT: MemMapMemorySectionAlignment=8, MemMapMemorySectionSymbol=VAR_FAST_NOINIT_8BIT, MemMapMemorySectionSwAddrMethodRef=VAR_FAST_NO_INIT
        VAR_FAST_NOINIT_16BIT: MemMapMemorySectionAlignment=16, MemMapMemorySectionSymbol=VAR_FAST_NOINIT_16BIT, MemMapMemorySectionSwAddrMethodRef=VAR_FAST_NO_INIT
        VAR_FAST_NOINIT_32BIT: MemMapMemorySectionAlignment=32, MemMapMemorySectionSymbol=VAR_FAST_NOINIT_32BIT, MemMapMemorySectionSwAddrMethodRef=VAR_FAST_NO_INIT
        VAR_FAST_NOINIT_64BIT: MemMapMemorySectionAlignment=64, MemMapMemorySectionSymbol=VAR_FAST_NOINIT_64BIT, MemMapMemorySectionSwAddrMethodRef=VAR_FAST_NO_INIT
        VAR_FAST_NO_INIT_8: MemMapMemorySectionAlignment=8, MemMapMemorySectionSymbol=VAR_FAST_NO_INIT_8, MemMapMemorySectionSwAddrMethodRef=VAR_FAST_NO_INIT
        VAR_FAST_NO_INIT_16: MemMapMemorySectionAlignment=16, MemMapMemorySectionSymbol=VAR_FAST_NO_INIT_16, MemMapMemorySectionSwAddrMethodRef=VAR_FAST_NO_INIT
        VAR_FAST_NO_INIT_32: MemMapMemorySectionAlignment=32, MemMapMemorySectionSymbol=VAR_FAST_NO_INIT_32, MemMapMemorySectionSwAddrMethodRef=VAR_FAST_NO_INIT
        VAR_FAST_NO_INIT_64: MemMapMemorySectionAlignment=64, MemMapMemorySectionSymbol=VAR_FAST_NO_INIT_64, MemMapMemorySectionSwAddrMethodRef=VAR_FAST_NO_INIT
        VAR_FAST_NOINIT_UNSPECIFIED: MemMapMemorySectionAlignment=UNSPECIFIED, MemMapMemorySectionSymbol=VAR_FAST_NOINIT_UNSPECIFIED, MemMapMemorySectionSwAddrMethodRef=VAR_FAST_NO_INIT
        VAR_FAST_NO_INIT_UNSPECIFIED: MemMapMemorySectionAlignment=UNSPECIFIED, MemMapMemorySectionSymbol=VAR_FAST_NO_INIT_UNSPECIFIED, MemMapMemorySectionSwAddrMethodRef=VAR_FAST_NO_INIT
        VAR_FAST_ZERO_INIT_8BIT: MemMapMemorySectionAlignment=8, MemMapMemorySectionSymbol=VAR_FAST_ZERO_INIT_8BIT, MemMapMemorySectionSwAddrMethodRef=VAR_FAST_CLEARED
        VAR_FAST_ZERO_INIT_16BIT: MemMapMemorySectionAlignment=16, MemMapMemorySectionSymbol=VAR_FAST_ZERO_INIT_16BIT, MemMapMemorySectionSwAddrMethodRef=VAR_FAST_CLEARED
        VAR_FAST_ZERO_INIT_32BIT: MemMapMemorySectionAlignment=32, MemMapMemorySectionSymbol=VAR_FAST_ZERO_INIT_32BIT, MemMapMemorySectionSwAddrMethodRef=VAR_FAST_CLEARED
        VAR_FAST_ZERO_INIT_64BIT: MemMapMemorySectionAlignment=64, MemMapMemorySectionSymbol=VAR_FAST_ZERO_INIT_64BIT, MemMapMemorySectionSwAddrMethodRef=VAR_FAST_CLEARED
        VAR_FAST_CLEARED_8: MemMapMemorySectionAlignment=8, MemMapMemorySectionSymbol=VAR_FAST_CLEARED_8, MemMapMemorySectionSwAddrMethodRef=VAR_FAST_CLEARED
        VAR_FAST_CLEARED_16: MemMapMemorySectionAlignment=16, MemMapMemorySectionSymbol=VAR_FAST_CLEARED_16, MemMapMemorySectionSwAddrMethodRef=VAR_FAST_CLEARED
        VAR_FAST_CLEARED_32: MemMapMemorySectionAlignment=32, MemMapMemorySectionSymbol=VAR_FAST_CLEARED_32, MemMapMemorySectionSwAddrMethodRef=VAR_FAST_CLEARED
        VAR_FAST_CLEARED_64: MemMapMemorySectionAlignment=64, MemMapMemorySectionSymbol=VAR_FAST_CLEARED_64, MemMapMemorySectionSwAddrMethodRef=VAR_FAST_CLEARED
        VAR_FAST_CLEARED_UNSPECIFIED: MemMapMemorySectionAlignment=UNSPECIFIED, MemMapMemorySectionSymbol=VAR_FAST_CLEARED_UNSPECIFIED, MemMapMemorySectionSwAddrMethodRef=VAR_FAST_CLEARED
        VAR_FAST_ZERO_INIT_UNSPECIFIED: MemMapMemorySectionAlignment=UNSPECIFIED, MemMapMemorySectionSymbol=VAR_FAST_ZERO_INIT_UNSPECIFIED, MemMapMemorySectionSwAddrMethodRef=VAR_FAST_CLEARED
        VAR_NOCACHE_INIT_8BIT: MemMapMemorySectionAlignment=8, MemMapMemorySectionSymbol=VAR_NOCACHE_INIT_8BIT, MemMapMemorySectionSwAddrMethodRef=VAR_NOCACHE_INIT
        VAR_NOCACHE_INIT_16BIT: MemMapMemorySectionAlignment=16, MemMapMemorySectionSymbol=VAR_NOCACHE_INIT_16BIT, MemMapMemorySectionSwAddrMethodRef=VAR_NOCACHE_INIT
        VAR_NOCACHE_INIT_32BIT: MemMapMemorySectionAlignment=32, MemMapMemorySectionSymbol=VAR_NOCACHE_INIT_32BIT, MemMapMemorySectionSwAddrMethodRef=VAR_NOCACHE_INIT
        VAR_NOCACHE_INIT_64BIT: MemMapMemorySectionAlignment=64, MemMapMemorySectionSymbol=VAR_NOCACHE_INIT_64BIT, MemMapMemorySectionSwAddrMethodRef=VAR_NOCACHE_INIT
        VAR_NOCACHE_INIT_8: MemMapMemorySectionAlignment=8, MemMapMemorySectionSymbol=VAR_NOCACHE_INIT_8, MemMapMemorySectionSwAddrMethodRef=VAR_NOCACHE_INIT
        VAR_NOCACHE_INIT_16: MemMapMemorySectionAlignment=16, MemMapMemorySectionSymbol=VAR_NOCACHE_INIT_16, MemMapMemorySectionSwAddrMethodRef=VAR_NOCACHE_INIT
        VAR_NOCACHE_INIT_32: MemMapMemorySectionAlignment=32, MemMapMemorySectionSymbol=VAR_NOCACHE_INIT_32, MemMapMemorySectionSwAddrMethodRef=VAR_NOCACHE_INIT
        VAR_NOCACHE_INIT_64: MemMapMemorySectionAlignment=64, MemMapMemorySectionSymbol=VAR_NOCACHE_INIT_64, MemMapMemorySectionSwAddrMethodRef=VAR_NOCACHE_INIT
        VAR_NOCACHE_INIT_UNSPECIFIED: MemMapMemorySectionAlignment=UNSPECIFIED, MemMapMemorySectionSymbol=VAR_NOCACHE_INIT_UNSPECIFIED, MemMapMemorySectionSwAddrMethodRef=VAR_NOCACHE_INIT
        VAR_NOCACHE_NOINIT_8BIT: MemMapMemorySectionAlignment=8, MemMapMemorySectionSymbol=VAR_NOCACHE_NOINIT_8BIT, MemMapMemorySectionSwAddrMethodRef=VAR_NOCACHE_NO_INIT
        VAR_NOCACHE_NOINIT_16BIT: MemMapMemorySectionAlignment=16, MemMapMemorySectionSymbol=VAR_NOCACHE_NOINIT_16BIT, MemMapMemorySectionSwAddrMethodRef=VAR_NOCACHE_NO_INIT
        VAR_NOCACHE_NOINIT_32BIT: MemMapMemorySectionAlignment=32, MemMapMemorySectionSymbol=VAR_NOCACHE_NOINIT_32BIT, MemMapMemorySectionSwAddrMethodRef=VAR_NOCACHE_NO_INIT
        VAR_NOCACHE_NOINIT_64BIT: MemMapMemorySectionAlignment=64, MemMapMemorySectionSymbol=VAR_NOCACHE_NOINIT_64BIT, MemMapMemorySectionSwAddrMethodRef=VAR_NOCACHE_NO_INIT
        VAR_NOCACHE_NO_INIT_8: MemMapMemorySectionAlignment=8, MemMapMemorySectionSymbol=VAR_NOCACHE_NO_INIT_8, MemMapMemorySectionSwAddrMethodRef=VAR_NOCACHE_NO_INIT
        VAR_NOCACHE_NO_INIT_16: MemMapMemorySectionAlignment=16, MemMapMemorySectionSymbol=VAR_NOCACHE_NO_INIT_16, MemMapMemorySectionSwAddrMethodRef=VAR_NOCACHE_NO_INIT
        VAR_NOCACHE_NO_INIT_32: MemMapMemorySectionAlignment=32, MemMapMemorySectionSymbol=VAR_NOCACHE_NO_INIT_32, MemMapMemorySectionSwAddrMethodRef=VAR_NOCACHE_NO_INIT
        VAR_NOCACHE_NO_INIT_64: MemMapMemorySectionAlignment=64, MemMapMemorySectionSymbol=VAR_NOCACHE_NO_INIT_64, MemMapMemorySectionSwAddrMethodRef=VAR_NOCACHE_NO_INIT
        VAR_NOCACHE_NOINIT_UNSPECIFIED: MemMapMemorySectionAlignment=UNSPECIFIED, MemMapMemorySectionSymbol=VAR_NOCACHE_NOINIT_UNSPECIFIED, MemMapMemorySectionSwAddrMethodRef=VAR_NOCACHE_NO_INIT
        VAR_NOCACHE_NO_INIT_UNSPECIFIED: MemMapMemorySectionAlignment=UNSPECIFIED, MemMapMemorySectionSymbol=VAR_NOCACHE_NO_INIT_UNSPECIFIED, MemMapMemorySectionSwAddrMethodRef=VAR_NOCACHE_NO_INIT
        VAR_NOCACHE_ZERO_INIT_8BIT: MemMapMemorySectionAlignment=8, MemMapMemorySectionSymbol=VAR_NOCACHE_ZERO_INIT_8BIT, MemMapMemorySectionSwAddrMethodRef=VAR_NOCACHE_CLEARED
        VAR_NOCACHE_ZERO_INIT_16BIT: MemMapMemorySectionAlignment=16, MemMapMemorySectionSymbol=VAR_NOCACHE_ZERO_INIT_16BIT, MemMapMemorySectionSwAddrMethodRef=VAR_NOCACHE_CLEARED
        VAR_NOCACHE_ZERO_INIT_32BIT: MemMapMemorySectionAlignment=32, MemMapMemorySectionSymbol=VAR_NOCACHE_ZERO_INIT_32BIT, MemMapMemorySectionSwAddrMethodRef=VAR_NOCACHE_CLEARED
        VAR_NOCACHE_ZERO_INIT_64BIT: MemMapMemorySectionAlignment=64, MemMapMemorySectionSymbol=VAR_NOCACHE_ZERO_INIT_64BIT, MemMapMemorySectionSwAddrMethodRef=VAR_NOCACHE_CLEARED
        VAR_NOCACHE_CLEARED_8: MemMapMemorySectionAlignment=8, MemMapMemorySectionSymbol=VAR_NOCACHE_CLEARED_8, MemMapMemorySectionSwAddrMethodRef=VAR_NOCACHE_CLEARED
        VAR_NOCACHE_CLEARED_16: MemMapMemorySectionAlignment=16, MemMapMemorySectionSymbol=VAR_NOCACHE_CLEARED_16, MemMapMemorySectionSwAddrMethodRef=VAR_NOCACHE_CLEARED
        VAR_NOCACHE_CLEARED_32: MemMapMemorySectionAlignment=32, MemMapMemorySectionSymbol=VAR_NOCACHE_CLEARED_32, MemMapMemorySectionSwAddrMethodRef=VAR_NOCACHE_CLEARED
        VAR_NOCACHE_CLEARED_64: MemMapMemorySectionAlignment=64, MemMapMemorySectionSymbol=VAR_NOCACHE_CLEARED_64, MemMapMemorySectionSwAddrMethodRef=VAR_NOCACHE_CLEARED
        VAR_NOCACHE_CLEARED_UNSPECIFIED: MemMapMemorySectionAlignment=UNSPECIFIED, MemMapMemorySectionSymbol=VAR_NOCACHE_CLEARED_UNSPECIFIED, MemMapMemorySectionSwAddrMethodRef=VAR_NOCACHE_CLEARED
        VAR_NOCACHE_ZERO_INIT_UNSPECIFIED: MemMapMemorySectionAlignment=UNSPECIFIED, MemMapMemorySectionSymbol=VAR_NOCACHE_ZERO_INIT_UNSPECIFIED, MemMapMemorySectionSwAddrMethodRef=VAR_NOCACHE_CLEARED
        VAR_PBCFG: MemMapMemorySectionAlignment=UNSPECIFIED, MemMapMemorySectionSymbol=VAR_PBCFG, MemMapMemorySectionSwAddrMethodRef=VAR_PBCFG
