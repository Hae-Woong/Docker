AUTOSAR XML (schema 00048)
package /MICROSAR
  module config MemMap_Rec: definition=MemMap
    MSR_Generic (MemMapAllocation)
      8 x MemMapGenericMapping:
        MSR_CODE: MemMapSwAddressMethodRef=CODE, MemMapSwAddressMethodRef=CALLOUT_CODE, MemMapSwAddressMethodRef=CODE_FAST, MemMapSwAddressMethodRef=CODE_ISR, MemMapSwAddressMethodRef=CODE_SLOW, MemMapAddressingModeSetRef=MemMap_Rec/MSR_CODE
        MSR_CONST: MemMapSwAddressMethodRef=CONST_8, MemMapSwAddressMethodRef=CONST_16, MemMapSwAddressMethodRef=CONST_32, MemMapSwAddressMethodRef=CONST_64, MemMapSwAddressMethodRef=CONST_BOOLEAN, MemMapSwAddressMethodRef=CONST_FAST_8, MemMapSwAddressMethodRef=CONST_FAST_16, MemMapSwAddressMethodRef=CONST_FAST_32, MemMapSwAddressMethodRef=CONST_FAST_64, MemMapSwAddressMethodRef=CONST_FAST_BOOLEAN, MemMapSwAddressMethodRef=CONST_FAST_UNSPECIFIED, MemMapSwAddressMethodRef=CONST_UNSPECIFIED, MemMapAddressingModeSetRef=MemMap_Rec/MSR_CONST, MemMapSwAddressMethodRef=CONFIG_DATA, MemMapSwAddressMethodRef=CONST, MemMapSwAddressMethodRef=CONST_FAST, MemMapSwAddressMethodRef=CALIB, MemMapSwAddressMethodRef=CONST_SAVED_RECOVERY_ZONE
        MSR_PBCFG_CONST: MemMapSwAddressMethodRef=CONST_PBCFG, MemMapAddressingModeSetRef=MemMap_Rec/MSR_PBCFG_CONST, MemMapSwAddressMethodRef=PBCFG_GLOBALROOT
        MSR_PBCFG_VAR: MemMapSwAddressMethodRef=VAR_PBCFG, MemMapAddressingModeSetRef=MemMap_Rec/MSR_PBCFG_VAR
        MSR_VAR_CLEARED: MemMapSwAddressMethodRef=VAR_ZERO_INIT_8, MemMapSwAddressMethodRef=VAR_ZERO_INIT_16, MemMapSwAddressMethodRef=VAR_ZERO_INIT_32, MemMapSwAddressMethodRef=VAR_ZERO_INIT_64, MemMapSwAddressMethodRef=VAR_ZERO_INIT_UNSPECIFIED, MemMapAddressingModeSetRef=MemMap_Rec/MSR_VAR_CLEARED, MemMapSwAddressMethodRef=VAR_ZERO_INIT_BOOLEAN, MemMapSwAddressMethodRef=VAR_FAST_ZERO_INIT_8, MemMapSwAddressMethodRef=VAR_FAST_ZERO_INIT_16, MemMapSwAddressMethodRef=VAR_FAST_ZERO_INIT_32, MemMapSwAddressMethodRef=VAR_FAST_ZERO_INIT_64, MemMapSwAddressMethodRef=VAR_FAST_ZERO_INIT_BOOLEAN, MemMapSwAddressMethodRef=VAR_FAST_ZERO_INIT_UNSPECIFIED, MemMapSwAddressMethodRef=VAR_NOCACHE_ZERO_INIT_8, MemMapSwAddressMethodRef=VAR_NOCACHE_ZERO_INIT_16, MemMapSwAddressMethodRef=VAR_NOCACHE_ZERO_INIT_32, MemMapSwAddressMethodRef=VAR_NOCACHE_ZERO_INIT_64, MemMapSwAddressMethodRef=VAR_NOCACHE_ZERO_INIT_BOOLEAN, MemMapSwAddressMethodRef=VAR_NOCACHE_ZERO_INIT_UNSPECIFIED, MemMapSwAddressMethodRef=VAR_CLEARED_BOOLEAN, MemMapSwAddressMethodRef=VAR_CLEARED_8, MemMapSwAddressMethodRef=VAR_CLEARED_16, MemMapSwAddressMethodRef=VAR_CLEARED_32, MemMapSwAddressMethodRef=VAR_CLEARED_64, MemMapSwAddressMethodRef=VAR_CLEARED_UNSPECIFIED, MemMapSwAddressMethodRef=VAR_FAST_CLEARED_BOOLEAN, MemMapSwAddressMethodRef=VAR_FAST_CLEARED_8, MemMapSwAddressMethodRef=VAR_FAST_CLEARED_16, MemMapSwAddressMethodRef=VAR_FAST_CLEARED_32, MemMapSwAddressMethodRef=VAR_FAST_CLEARED_64, MemMapSwAddressMethodRef=VAR_FAST_CLEARED_UNSPECIFIED, MemMapSwAddressMethodRef=VAR_NOCACHE_CLEARED_BOOLEAN, MemMapSwAddressMethodRef=VAR_NOCACHE_CLEARED_8, MemMapSwAddressMethodRef=VAR_NOCACHE_CLEARED_16, MemMapSwAddressMethodRef=VAR_NOCACHE_CLEARED_32, MemMapSwAddressMethodRef=VAR_NOCACHE_CLEARED_64, MemMapSwAddressMethodRef=VAR_NOCACHE_CLEARED_UNSPECIFIED, MemMapSwAddressMethodRef=VAR_CLEARED, MemMapSwAddressMethodRef=VAR_FAST_CLEARED, MemMapSwAddressMethodRef=VAR_NOCACHE_CLEARED, MemMapSwAddressMethodRef=VAR_ZERO_INIT
        MSR_VAR_INIT: MemMapSwAddressMethodRef=VAR_FAST_INIT_8, MemMapSwAddressMethodRef=VAR_FAST_INIT_16, MemMapSwAddressMethodRef=VAR_FAST_INIT_32, MemMapSwAddressMethodRef=VAR_FAST_INIT_64, MemMapSwAddressMethodRef=VAR_FAST_INIT_UNSPECIFIED, MemMapSwAddressMethodRef=VAR_INIT_8, MemMapSwAddressMethodRef=VAR_INIT_16, MemMapSwAddressMethodRef=VAR_INIT_32, MemMapSwAddressMethodRef=VAR_INIT_64, MemMapSwAddressMethodRef=VAR_INIT_BOOLEAN, MemMapSwAddressMethodRef=VAR_INIT_UNSPECIFIED, MemMapAddressingModeSetRef=MemMap_Rec/MSR_VAR_INIT, MemMapSwAddressMethodRef=VAR_FAST_INIT_BOOLEAN, MemMapSwAddressMethodRef=VAR_NOCACHE_INIT_8, MemMapSwAddressMethodRef=VAR_NOCACHE_INIT_16, MemMapSwAddressMethodRef=VAR_NOCACHE_INIT_32, MemMapSwAddressMethodRef=VAR_NOCACHE_INIT_64, MemMapSwAddressMethodRef=VAR_NOCACHE_INIT_BOOLEAN, MemMapSwAddressMethodRef=VAR_NOCACHE_INIT_UNSPECIFIED, MemMapSwAddressMethodRef=VAR_INIT, MemMapSwAddressMethodRef=VAR_FAST_INIT, MemMapSwAddressMethodRef=VAR_NOCACHE_INIT, MemMapSwAddressMethodRef=VAR_SLOW, MemMapSwAddressMethodRef=INTERNAL_VAR
        MSR_VAR_NO_INIT: MemMapAddressingModeSetRef=MemMap_Rec/MSR_VAR_NO_INIT, MemMapSwAddressMethodRef=VAR_FAST_NO_INIT_8, MemMapSwAddressMethodRef=VAR_FAST_NO_INIT_16, MemMapSwAddressMethodRef=VAR_FAST_NO_INIT_32, MemMapSwAddressMethodRef=VAR_FAST_NO_INIT_64, MemMapSwAddressMethodRef=VAR_FAST_NO_INIT_UNSPECIFIED, MemMapSwAddressMethodRef=VAR_NO_INIT_8, MemMapSwAddressMethodRef=VAR_NO_INIT_16, MemMapSwAddressMethodRef=VAR_NO_INIT_32, MemMapSwAddressMethodRef=VAR_NO_INIT_64, MemMapSwAddressMethodRef=VAR_NO_INIT_UNSPECIFIED, MemMapSwAddressMethodRef=VAR_NO_INIT_BOOLEAN, MemMapSwAddressMethodRef=VAR_FAST_NO_INIT_BOOLEAN, MemMapSwAddressMethodRef=VAR_NOCACHE_NO_INIT_8, MemMapSwAddressMethodRef=VAR_NOCACHE_NO_INIT_16, MemMapSwAddressMethodRef=VAR_NOCACHE_NO_INIT_32, MemMapSwAddressMethodRef=VAR_NOCACHE_NO_INIT_64, MemMapSwAddressMethodRef=VAR_NOCACHE_NO_INIT_BOOLEAN, MemMapSwAddressMethodRef=VAR_NOCACHE_NO_INIT_UNSPECIFIED, MemMapSwAddressMethodRef=VAR_FAST_NOINIT_8, MemMapSwAddressMethodRef=VAR_FAST_NOINIT_16, MemMapSwAddressMethodRef=VAR_FAST_NOINIT_32, MemMapSwAddressMethodRef=VAR_FAST_NOINIT_64, MemMapSwAddressMethodRef=VAR_FAST_NOINIT_UNSPECIFIED, MemMapSwAddressMethodRef=VAR_NOINIT_8, MemMapSwAddressMethodRef=VAR_NOINIT_16, MemMapSwAddressMethodRef=VAR_NOINIT_32, MemMapSwAddressMethodRef=VAR_NOINIT_64, MemMapSwAddressMethodRef=VAR_NOINIT_UNSPECIFIED, MemMapSwAddressMethodRef=VAR_NOINIT_BOOLEAN, MemMapSwAddressMethodRef=VAR_FAST_NOINIT_BOOLEAN, MemMapSwAddressMethodRef=VAR_NOCACHE_NOINIT_8, MemMapSwAddressMethodRef=VAR_NOCACHE_NOINIT_16, MemMapSwAddressMethodRef=VAR_NOCACHE_NOINIT_32, MemMapSwAddressMethodRef=VAR_NOCACHE_NOINIT_64, MemMapSwAddressMethodRef=VAR_NOCACHE_NOINIT_BOOLEAN, MemMapSwAddressMethodRef=VAR_NOCACHE_NOINIT_UNSPECIFIED, MemMapSwAddressMethodRef=VAR_NO_INIT, MemMapSwAddressMethodRef=VAR_FAST_NO_INIT, MemMapSwAddressMethodRef=VAR_NOCACHE_NO_INIT
        MSR_VAR_SAVED_ZONE: MemMapAddressingModeSetRef=MemMap_Rec/MSR_VAR_SAVED_ZONE, MemMapSwAddressMethodRef=VAR_SAVED_ZONE_BOOLEAN, MemMapSwAddressMethodRef=VAR_SAVED_ZONE_8, MemMapSwAddressMethodRef=VAR_SAVED_ZONE_16, MemMapSwAddressMethodRef=VAR_SAVED_ZONE_32, MemMapSwAddressMethodRef=VAR_SAVED_ZONE_64, MemMapSwAddressMethodRef=VAR_SAVED_ZONE_UNSPECIFIED, MemMapSwAddressMethodRef=VAR_SAVED_ZONE
    8 x MemMapAddressingModeSet:
      MSR_CODE
        MSR_CODE (MemMapAddressingMode):
          MemMapAlignmentSelector = UNSPECIFIED
          MemMapAlignmentSelector = 8
          MemMapAlignmentSelector = 16
          MemMapAlignmentSelector = 32
          MemMapAlignmentSelector = 64
          MemMapAlignmentSelector = BOOLEAN
      MSR_CONST
        MSR_CONST (MemMapAddressingMode):
          MemMapAlignmentSelector = UNSPECIFIED
          MemMapAlignmentSelector = 8
          MemMapAlignmentSelector = 16
          MemMapAlignmentSelector = 32
          MemMapAlignmentSelector = 64
          MemMapAlignmentSelector = BOOLEAN
      MSR_PBCFG_CONST
        MSR_PBCFG_CONST (MemMapAddressingMode):
          MemMapAlignmentSelector = UNSPECIFIED
          MemMapAlignmentSelector = 8
          MemMapAlignmentSelector = 16
          MemMapAlignmentSelector = 32
          MemMapAlignmentSelector = 64
          MemMapAlignmentSelector = BOOLEAN
      MSR_PBCFG_VAR
        MSR_PBCFG_VAR (MemMapAddressingMode):
          MemMapAlignmentSelector = UNSPECIFIED
          MemMapAlignmentSelector = 8
          MemMapAlignmentSelector = 16
          MemMapAlignmentSelector = 32
          MemMapAlignmentSelector = 64
          MemMapAlignmentSelector = BOOLEAN
      MSR_VAR_CLEARED
        MSR_VAR_CLEARED (MemMapAddressingMode):
          MemMapAlignmentSelector = UNSPECIFIED
          MemMapAlignmentSelector = 8
          MemMapAlignmentSelector = 16
          MemMapAlignmentSelector = 32
          MemMapAlignmentSelector = 64
          MemMapAlignmentSelector = BOOLEAN
      MSR_VAR_INIT
        MSR_VAR_INIT (MemMapAddressingMode):
          MemMapAlignmentSelector = UNSPECIFIED
          MemMapAlignmentSelector = 8
          MemMapAlignmentSelector = 16
          MemMapAlignmentSelector = 32
          MemMapAlignmentSelector = 64
          MemMapAlignmentSelector = BOOLEAN
      MSR_VAR_NO_INIT
        MSR_VAR_NO_INIT (MemMapAddressingMode):
          MemMapAlignmentSelector = UNSPECIFIED
          MemMapAlignmentSelector = 8
          MemMapAlignmentSelector = 16
          MemMapAlignmentSelector = 32
          MemMapAlignmentSelector = 64
          MemMapAlignmentSelector = BOOLEAN
      MSR_VAR_SAVED_ZONE
        MSR_VAR_SAVED_ZONE (MemMapAddressingMode):
          MemMapAlignmentSelector = UNSPECIFIED
          MemMapAlignmentSelector = 8
          MemMapAlignmentSelector = 16
          MemMapAlignmentSelector = 32
          MemMapAlignmentSelector = 64
          MemMapAlignmentSelector = BOOLEAN
