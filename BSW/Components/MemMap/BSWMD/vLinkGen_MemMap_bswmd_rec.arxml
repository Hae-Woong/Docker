AUTOSAR XML (schema 4-2-1)
package /MICROSAR
  module config vLinkGen_Rec: definition=vLinkGen
    vLinkGenMemLayout
      vLinkGenLinkerSections
        MSR_CODE (vLinkGenLinkerCodeSection): vLinkGenLinkerCodeSectionName=MSR_CODE
        MSR_CONST (vLinkGenLinkerConstSection): vLinkGenLinkerConstSectionName=MSR_CONST
        MSR_PBCFG_CONST (vLinkGenLinkerConstSection): vLinkGenLinkerConstSectionName=MSR_PBCFG_CONST
        4 x vLinkGenLinkerVarSection:
          MSR_PBCFG_VAR: vLinkGenLinkerVarSectionName=MSR_PBCFG_VAR
          MSR_VAR_CLEARED: vLinkGenLinkerVarSectionName=MSR_VAR_CLEARED
          MSR_VAR_INIT: vLinkGenLinkerVarSectionName=MSR_VAR_INIT
          MSR_VAR_NO_INIT: vLinkGenLinkerVarSectionName=MSR_VAR_NO_INIT
        MSR_CONST_FAST (vLinkGenLinkerConstSection): vLinkGenLinkerConstSectionFast=1, vLinkGenLinkerConstSectionName=MSR_CONST_FAST
        3 x vLinkGenLinkerVarSection, all with vLinkGenLinkerVarSectionFast=1:
          MSR_VAR_FAST_CLEARED: vLinkGenLinkerVarSectionName=MSR_VAR_FAST_CLEARED
          MSR_VAR_FAST_INIT: vLinkGenLinkerVarSectionName=MSR_VAR_FAST_INIT
          MSR_VAR_FAST_NO_INIT: vLinkGenLinkerVarSectionName=MSR_VAR_FAST_NO_INIT
        MSR_PBCFG_CONST_FAST (vLinkGenLinkerConstSection): vLinkGenLinkerConstSectionFast=1, vLinkGenLinkerConstSectionName=MSR_PBCFG_CONST_FAST
        9 x vLinkGenLinkerVarSection:
          MSR_PBCFG_VAR_FAST: vLinkGenLinkerVarSectionFast=1, vLinkGenLinkerVarSectionName=MSR_PBCFG_VAR_FAST
          MSR_PBCFG_VAR_FAST_NO_INIT: vLinkGenLinkerVarSectionFast=1, vLinkGenLinkerVarSectionName=MSR_PBCFG_VAR_FAST_NO_INIT
          MSR_PBCFG_VAR_NO_INIT: vLinkGenLinkerVarSectionName=MSR_PBCFG_VAR_NO_INIT
          MSR_VAR_SAVED_ZONE_INIT: vLinkGenLinkerVarSectionName=MSR_VAR_SAVED_ZONE_INIT
          MSR_VAR_SAVED_ZONE_NO_INIT: vLinkGenLinkerVarSectionName=MSR_VAR_SAVED_ZONE_NO_INIT
          MSR_VAR_SAVED_ZONE_FAST_INIT: vLinkGenLinkerVarSectionFast=1, vLinkGenLinkerVarSectionName=MSR_VAR_SAVED_ZONE_FAST_INIT
          MSR_VAR_SAVED_ZONE_FAST_NO_INIT: vLinkGenLinkerVarSectionFast=1, vLinkGenLinkerVarSectionName=MSR_VAR_SAVED_ZONE_FAST_NO_INIT
          MSR_PBCFG_VAR_CLEARED: vLinkGenLinkerVarSectionName=MSR_PBCFG_VAR_CLEARED
          MSR_PBCFG_VAR_FAST_CLEARED: vLinkGenLinkerVarSectionName=MSR_PBCFG_VAR_FAST_CLEARED, vLinkGenLinkerVarSectionFast=1
      3 x vLinkGenLogicalConstGroup:
        MSR_CODE: vLinkGenConstGroupContentType=GLOBAL_CODE
          MSR_CODE (vLinkGenConstSectionGroup): vLinkGenConstSectionGroupRef=vLinkGenLinkerSections/MSR_CODE
        MSR_CONST: vLinkGenConstGroupContentType=GLOBAL_CONST
          MSR_CONST (vLinkGenConstSectionGroup): vLinkGenConstSectionGroupRef=vLinkGenLinkerSections/MSR_CONST, vLinkGenConstSectionGroupRef=MSR_CONST_FAST
        MSR_PBCFG_CONST: vLinkGenConstGroupContentType=GLOBAL_CONST
          MSR_PBCFG_CONST (vLinkGenConstSectionGroup): vLinkGenConstSectionGroupRef=vLinkGenLinkerSections/MSR_PBCFG_CONST, vLinkGenConstSectionGroupRef=MSR_PBCFG_CONST_FAST
      3 x vLinkGenLogicalVarGroup:
        MSR_VAR: vLinkGenVarGroupContentType=GLOBAL_DATA
          3 x vLinkGenVarSectionGroup:
            MSR_VAR_CLEARED: vLinkGenVarSectionGroupInit=ZERO_INIT, vLinkGenVarSectionGroupRef=vLinkGenLinkerSections/MSR_VAR_CLEARED, vLinkGenVarSectionGroupRef=MSR_VAR_FAST_CLEARED
            MSR_VAR_INIT: vLinkGenVarSectionGroupInit=INIT, vLinkGenVarSectionGroupRef=vLinkGenLinkerSections/MSR_VAR_INIT, vLinkGenVarSectionGroupRef=MSR_VAR_FAST_INIT
            MSR_VAR_NO_INIT: vLinkGenVarSectionGroupInit=NONE, vLinkGenVarSectionGroupRef=vLinkGenLinkerSections/MSR_VAR_NO_INIT, vLinkGenVarSectionGroupRef=MSR_VAR_FAST_NO_INIT
        MSR_PBCFG_VAR: vLinkGenVarGroupContentType=GLOBAL_DATA
          3 x vLinkGenVarSectionGroup:
            MSR_PBCFG_VAR_INIT: vLinkGenVarSectionGroupInit=INIT, vLinkGenVarSectionGroupRef=vLinkGenLinkerSections/MSR_PBCFG_VAR, vLinkGenVarSectionGroupRef=MSR_PBCFG_VAR_FAST
            MSR_PBCFG_VAR_NO_INIT: vLinkGenVarSectionGroupInit=NONE, vLinkGenVarSectionGroupRef=vLinkGenLinkerSections/MSR_PBCFG_VAR_NO_INIT, vLinkGenVarSectionGroupRef=MSR_PBCFG_VAR_FAST_NO_INIT
            MSR_PBCFG_VAR_CLEARED: vLinkGenVarSectionGroupInit=ZERO_INIT, vLinkGenVarSectionGroupRef=vLinkGenLinkerSections/MSR_PBCFG_VAR_CLEARED, vLinkGenVarSectionGroupRef=MSR_PBCFG_VAR_FAST_CLEARED
        MSR_VAR_SAVED_ZONE: vLinkGenVarGroupContentType=RETENTION_DATA
          MSR_VAR_SAVED_ZONE_INIT (vLinkGenVarSectionGroup):
            vLinkGenVarSectionGroupInit = INIT
            vLinkGenVarSectionGroupRef = vLinkGenLinkerSections/MSR_VAR_SAVED_ZONE_INIT
            vLinkGenVarSectionGroupRef = MSR_VAR_SAVED_ZONE_FAST_INIT
          MSR_VAR_SAVED_ZONE_NO_INIT (vLinkGenVarSectionGroup):
            vLinkGenVarSectionGroupInit = NONE
            vLinkGenVarSectionGroupRef = vLinkGenLinkerSections/MSR_VAR_SAVED_ZONE_NO_INIT
            vLinkGenVarSectionGroupRef = MSR_VAR_SAVED_ZONE_FAST_NO_INIT
  module config MemMap_Rec: definition=MemMap
    7 x MemMapAddressingModeSet:
      MSR_CONST
        MSR_CONST (MemMapAddressingMode): MemMapLinkerLogicalGroupRef=vLinkGenMemLayout/MSR_CONST
      MSR_PBCFG_CONST
        MSR_PBCFG_CONST (MemMapAddressingMode): MemMapLinkerLogicalGroupRef=vLinkGenMemLayout/MSR_PBCFG_CONST
      MSR_PBCFG_VAR
        MSR_PBCFG_VAR (MemMapAddressingMode): MemMapLinkerLogicalGroupRef=vLinkGenMemLayout/MSR_PBCFG_VAR
      MSR_VAR_CLEARED
        MSR_VAR_CLEARED (MemMapAddressingMode): MemMapLinkerLogicalGroupRef=MSR_VAR
      MSR_VAR_INIT
        MSR_VAR_INIT (MemMapAddressingMode): MemMapLinkerLogicalGroupRef=MSR_VAR
      MSR_VAR_NO_INIT
        MSR_VAR_NO_INIT (MemMapAddressingMode): MemMapLinkerLogicalGroupRef=MSR_VAR
      MSR_VAR_SAVED_ZONE
        MSR_VAR_SAVED_ZONE (MemMapAddressingMode): MemMapLinkerLogicalGroupRef=vLinkGenMemLayout/MSR_VAR_SAVED_ZONE
