AUTOSAR XML (schema 4-0-3)
# COPYRIGHT
# Copyright (c) 2022 by Vector Informatik GmbH. All rights reserved.
# This software is copyright protected and proprietary to Vector Informatik GmbH.
# Vector Informatik GmbH grants to you only those rights as set out in the license conditions.
package /MICROSAR/CddDes
  bsw implementation Cdd_Impl: programming-language=C, sw-version=4.00.00, used-code-generator=DaVinci Configurator, vendor-id=30, ar-release-version=4.00.03, behavior=CddDesBehavior, preconfigured-configuration=Cdd_Pre, recommended-configuration=Cdd_Rec, vendor-specific-module-def=Cdd
  module definition Cdd [0..1]: category=VENDOR_SPECIFIC_MODULE_DEFINITION, api-service-prefix=CddDes, refined-module-def=Cdd, variants pre-compile  # The CddDes (Diagnostic Event Synchronizer) is a complex device driver that allows to forward qualified test results for diagnostic events from a dependent MCU to a master MCU. In the dependent MCU a standard AUTOSAR Dem is used to de-bounce the event reportings. The CddDes in the master MCU then reports the qualified test result to the Dem. #Diag #Diagnostics #Communication #MultiProcessor #Vector
    container CddComStackContribution  # Contribution of COM Stack modules.
      container CddPduRUpperLayerContribution [0..1]  # PduR Upper Layer Contribution | Parameters that are necessary for the configuration of a Complex Device Driver that serves as the UpperLayer of the Pdu Router module.
        container CddPduRUpperLayerRxPdu [0..254]  # PduR Upper Layer Rx Pdu | This container specifies Rx PDUs that are exchanged between the CDD and the standardized BSW module.
          integer CddPduRUpperLayerHandleId: 0..65535, set at pre-compile, symbolic-name-value=true, default-value=0  # PduR Upper Layer Handle Id | ECU wide unique, symbolic handle for the Pdu.
          reference CddPduRUpperLayerPduRef: set at pre-compile, destination=Pdu  # PduR Upper Layer Pdu Ref | Reference to the "global" Pdu structure to allow harmonization of handle IDs in the COM-Stack.
        container CddPduRUpperLayerTxPdu [0..254]  # PduR Upper Layer Tx Pdu | This container specifies Tx PDUs that are exchanged between the CDD and the standardized BSW module.
          integer CddPduRUpperLayerHandleId: 0..65535, set at pre-compile, symbolic-name-value=true, default-value=0  # PduR Upper Layer Handle Id | ECU wide unique, symbolic handle for the Pdu.
          reference CddPduRUpperLayerPduRef: set at pre-compile, destination=Pdu  # PduR Upper Layer Pdu Ref | Reference to the "global" Pdu structure to allow harmonization of handle IDs in the COM-Stack.
    container CddGeneral  # Parameters of the CddDes that are not specific to a Connection.
      float CddTaskCycleTime: 0.01..0.1, set at pre-compile, origin=Vector Informatik, default-value=0.01  # This value specifies the cyclic cal period of modules main function.
      boolean CddDevErrorDetect: set at pre-compile, origin=Vector Informatik, default-value=true  # Development Error Detection | Switches the Development Error Detection ON or OFF. true: Enabled false: Disabled
      boolean CddVersionInfoApi: set at pre-compile, origin=Vector Informatik, default-value=false  # Activate/Deactivate the version information API.
      enumeration CddMode: {CDD_MODE_MASTER, CDD_MODE_DEPENDENT}, set at pre-compile, origin=Vector Informatik  # Selects the mode that the component shall support. MASTER: The component expects to be integrated in the master MCU. It sets the event status received from the dependent MCU and notifies Clear DTC events. DEPENDENT: The component expected to be integrated in the dependent MCU. Its task is to transmit the qualified event test results to the master MCU.
      integer CddCollectionBufferSize: 10..65535, set at pre-compile, origin=Vector Informatik, default-value=128  # To reduce communication effort, the CddDes collects multiple event status change events in its collection buffer... Dependent: ... and transmits them periodically (or if the buffer is filled above the configured threshold) to the Master MCU. Mastert: ... and transmits them as soon as at least one element is queued in the buffer. Hint: Configure the TP Buffer size on the receiving MCU accordingly.
      float CddTimeoutReconnect: 0.01..10, set at pre-compile, origin=Vector Informatik, default-value=0.5  # Dependend MCU only: When the CddDes detected a loss of communication, it periodically tries to reestablish the connection to the Master MCU. This parameter configures the deplay between consecuitve
      float CddTimeoutResponse: 0.1..10, set at pre-compile, origin=Vector Informatik, default-value=1  # How long should the CddDes wait for a response after sending a request? This value should not be too low as processing events on the receiving side might take several task cycles.
      integer CddRetriesTransmission: 0..255, set at pre-compile, origin=Vector Informatik, default-value=5  # When the Communication Stack is busy, how often should the CddDes retry transmission?
      float CddTimeoutCyclicTransmission: 0.1..10, set at pre-compile, origin=Vector Informatik, default-value=0.2  # Dependent only: Once connected to the Master MCU, the CddDes periodically transmits the collected status changes since the last transmission. The periodic transmission is also used to detect a connection loss. This parameters configures the maximum delay between two consecutive synchronization messages. Should the collection buffer be filled about the configured threashold earlier, the synchronization message is also transmitted earlier.
      float CddTimeoutConnectionAlive: 0.2..20, set at pre-compile, origin=Vector Informatik, default-value=0.4  # Master only: Once connected to a dependend MCU, how long should the Master MCU wait for a SyncMessage before it assumes that the connection is lost? e.g. twice of Dependent MCUs TransmitPeriod
      integer CddCollectionBufferTransmitThreshold: 6..39320, set at pre-compile, origin=Vector Informatik, default-value=80  # Dependent only: To avoid a buffer overrun, the status colleciton buffer is also transmitted when it reaches this threashold. e.g. 60% of collection buffer size.
      reference CddDemClientRef: set at pre-compile, origin=Vector Informatik, destination=DemClient  # Reference to DemClient in Dem configuration. | Used by the Dem to distinguish different client calls.
    container CddConnection
      container CddPhysicalMaster  # Used for Communicating: DEPENDENT to MASTER and response to DEPENDENT
        integer CddTpBufferSize: 1..65535, set at pre-compile, origin=Vector Informatik, default-value=128  # Specifies the size for theTP buffer
        reference CddTransmitPduRef: set at pre-compile, origin=Vector Informatik, destination=CddPduRUpperLayerTxPdu  # Reference to TxPdu for request
        reference CddReceivePduRef: set at pre-compile, origin=Vector Informatik, destination=CddPduRUpperLayerRxPdu  # Reference to RxPdu for response.
      container CddPhysicalDependent  # Used for Communicating: MASTER to DEPENDENT and response to MASTER
        integer CddTpBufferSize: 1..65535, set at pre-compile, origin=Vector Informatik, default-value=128  # Specifies the size for theTP buffer
        reference CddTransmitPduRef: set at pre-compile, origin=Vector Informatik, destination=CddPduRUpperLayerTxPdu  # Reference to TxPdu for request
        reference CddReceivePduRef: set at pre-compile, origin=Vector Informatik, destination=CddPduRUpperLayerRxPdu  # Reference to RxPdu for response.
  module config Cdd_Pre: definition=Cdd, implementation-config-variant=VARIANT-PRE-COMPILE
  module config Cdd_Rec: definition=Cdd
