AUTOSAR XML (schema 4-0-3)
package /MICROSAR
  bsw implementation IpduM_Impl: programming-language=C, sw-version=13.02.00, used-code-generator=DaVinci Configurator, vendor-id=30, ar-release-version=4.03.01, behavior=IpduMBehavior, preconfigured-configuration=IpduM_Pre, recommended-configuration=IpduM_Rec, vendor-specific-module-def=IpduM
  module definition IpduM [0..1]: category=VENDOR_SPECIFIC_MODULE_DEFINITION, refined-module-def=IpduM, variants pre-compile/post-build-loadable/post-build-selectable  # The I-PDU Multiplexer realizes two distinct functionalities: (1) PDU multiplexing. One PDU on the bus can have different, static data layouts, defined by a selector value. The multiplexed PDU usually is of similar size for all layouts. (2) Container handling. Multiple PDUs are combined in one container in static or dynamic order, transmitted as one large PDU, and then unpacked into separate PDUs at the receiver again. The containers are usually much larger than the individual PDUs.
    container IpduMGeneral  # Global configuration parameters of the IpduM.
      boolean IpduMContainedTxPduPriorityHandling [0..1]: set at pre-compile, origin=Vector Informatik, default-value=false  # This parameter enables/disables handling of priority for IpduMContainedTxPdu's with IpduMContainedTxPduCollectionSemantics IPDUM_LAST_IS_BEST. | true: enabled false: disabled
      float IpduMConfigurationTimeBase: 0..3600, set at pre-compile, default-value=0.01  # The cycle time with which IpduM_MainFunction is invoked. Note: This parameter is not used by the generator.
      float IpduMRxTimeBase: 0..3600, set at pre-compile, origin=Vector Informatik, default-value=0.01  # The period between successive calls to IpduM_MainFunctionRx. This parameter is used by the IpduM generator to transform the values of the reception related timing configuration parameters of the IpduM module to internal implementation specific counter or tick values.
      float IpduMTxTimeBase: 0..3600, set at pre-compile, origin=Vector Informatik, default-value=0.01  # The period between successive calls to IpduM_MainFunctionTx. This parameter is used by the IpduM generator to transform the values of the transmission related timing configuration parameters of the IpduM module to internal implementation specific counter or tick values.
      boolean IpduMDevErrorDetect: set at pre-compile, default-value=true  # This parameter switches the Development Error Detection and Notification ON or OFF. true: Development Error Detection is enabled. false: Development Error Detection is disabled.
      enumeration IpduMHeaderByteOrder: {IPDUM_BIG_ENDIAN, IPDUM_LITTLE_ENDIAN}, set at pre-compile, origin=Vector Informatik, default-value=IPDUM_BIG_ENDIAN  # This parameter defines the ByteOrder of the headers inside a Container I-PDU.
      boolean IpduMStaticPartExists: set at pre-compile, default-value=true  # Allow optimizations in the case the IpduM will never be used with a static part. Note that this is a pre-compile option. If it is de-activated, it will not be possible to configure static parts after compilation. True: A static part may exist. False: A static part will never exist.
      boolean IpduMVersionInfoApi: set at pre-compile, default-value=false  # This parameter enables/disables the function IpduM_GetVersionInfo() to get major, minor and patch version information. True: version information activated. False: version information de-activated.
      string IpduMUserConfigFile [0..1]: set at pre-compile, origin=Vector Informatik  # The content of the user configuration file will be added at the end of the generated module configuration file and allows altering or extending the generated code. Caution: User configuration files can cause the software module to malfunction and must only be used with great care!
      boolean IpduMSafeBswChecks: set at pre-compile, origin=Vector Informatik, default-value=false  # Selects if safety checks are used. These checks improve robustness as e.g. invalid parameters are checked before function is executed. This attribute has to be enabled for safety projects where this component is mapped to an ASIL partition.
    container IpduMGeneration  # Contains the generation configuration parameters of the module IpduM.
      enumeration IpduMOutOfBoundsWriteProtectionStrategy: set at pre-compile, origin=Vector Informatik, default-value=NONE  # This parameter is used to configure a strategy to protect the code to write out of bounds. NONE: no protection strategy is generated in the data access. INDEX_SATURATION: arrays are blown up and the data access index is saturated by an appropriate mask. The advantage is the speed of the data access, but own data elements at other indexes of the same variable can be overridden. This debugging feature must not be used in production code! INDEX_CHECKING: the data access index is validated by a runtime check. The advantage is that values are never written to incorrect indexes of the data access. This debugging feature must not be used in production code!
        NONE  # none
        INDEX_SATURATION  # index saturation
        INDEX_CHECKING  # index checking
      boolean IpduMOutOfBoundsWriteSanitizer: set at pre-compile, origin=Vector Informatik, default-value=false  # This parameter activates/deactivates the generation of runtime checks which call a DET error notification function to find easily out of bounds write problems. This debugging feature must not be used in production code! FALSE: no checks are generated in the data access. TRUE: the data access is enriched with DET checks to validate indexes.
      boolean IpduMOutOfBoundsReadSanitizer: set at pre-compile, origin=Vector Informatik, default-value=false  # This parameter activates/deactivates the generation of runtime checks which call a DET error notification function to find easily out of bounds read problems. This debugging feature must not be used in production code! FALSE: no checks are generated in the data access. TRUE: the data access is enriched with DET checks to validate indexes.
      boolean IpduMReduceConstantData2Define: set at pre-compile, origin=Vector Informatik, default-value=true  # Reduce Constant Data To a Define | This parameter activates/deactivates the capability to generate CONFIG-CLASS PRE-COMPILE ROM arrays as constant define. FALSE: ROM arrays are generated as data even if all values are identical. TRUE: ROM arrays are generated as constant define if all values are identical.
      enumeration IpduMBoolDataInArrayOfStructStrategy: {BOOLEAN, BITFIELD, BITMASKING}, set at pre-compile, origin=Vector Informatik, default-value=BITMASKING  # This parameter is used to tailor the usage of boolean data in structures in all CONFIG-CLASSES. The difference between BITFIELD and BITMASKING depends on your compiler options and memory mapping. BOOLEAN: The datatype of boolean data is native boolean. Code: the code size is small. RAM: no change expected. ROM: the ROM size is large. Runtime: the runtime is fast. BITFIELD: The bitfield type is used and the compiler extracts the boolean data from structures. Code: the code size is larger than using BOOLEAN. RAM: no change expected. ROM: the ROM size is smaller than using BOOLEAN. Runtime: the runtime is larger than using BOOLEAN. BITMASKING: Generated Masks are used to extract the boolean data from structures. Code: the code size is larger than using BOOLEAN. RAM: no change expected. ROM: the ROM size is smaller than using BOOLEAN. Runtime: the runtime is larger than using BOOLEAN.
      boolean IpduMDeduplicateIndirectedData: set at pre-compile, origin=Vector Informatik, default-value=true  # This parameter activates/deactivates the capability to compress 0:N relational ROM data in all CONFIG-CLASSES without increasing the runtime. This option can be used in lib builds and in postbuild configurations. TRUE: 0:N relational ROM data is compressed without decreasing the runtime. Code: no change expected. RAM: no change expected. ROM: the ROM size is minimized. Runtime: no change expected. FALSE: 0:N relational ROM data is not compressed.
      enumeration IpduMDataDeduplicationStrategy: {NONE, WITHOUT_CAST, WITH_CAST}, set at pre-compile, origin=Vector Informatik, default-value=WITH_CAST  # This parameter is used to deduplicate CONFIG-CLASS PRE-COMPILE ROM data. NONE: The generated data is not deduplicated. WITHOUT_CAST: The data is deduplicated without using casts. Code: no change expected. RAM: no change expected. ROM: the ROM size can be minimized. Runtime: no change expected. WITH_CAST: The data is deduplicated using casts. Code: no change expected. RAM: no change expected. ROM: the ROM size can be minimized more than in DEDUPLICATE_CONST_DATA_WITHOUT_CAST. Runtime: no change expected.
      integer IpduMReduceBoolDataByNegationThreshold: 0.., set at pre-compile, origin=Vector Informatik, default-value=2  # This parameter activates/deactivates the capability to compress boolean CONFIG-CLASS PRE-COMPILE ROM data by using the negation operator. 0: The optimization is not performed. >0: This is the threshold to activate the data optimization. Code: the code size is increased due to the usage of the negation operator in the data access. RAM: no change expected. ROM: the ROM size is minimized. Runtime: the runtime is increased due to the usage of the negation operator in the data access.
      integer IpduMReduceBoolDataByNumericalComparisonThreshold: 0.., set at pre-compile, origin=Vector Informatik, default-value=2  # This parameter activates/deactivates the capability to compress boolean CONFIG-CLASS PRE-COMPILE ROM data by using comparison with other ROM data. 0: The optimization is not performed. >0: This is the threshold to activate the data optimization. Code: the code size is increased due to the usage of the operation in the data access. RAM: no change expected. ROM: the ROM size is minimized. Runtime: the runtime is increased due to the usage of the operation in the data access.
      integer IpduMReduceBoolDataByNumericalRelationThreshold: 0.., set at pre-compile, origin=Vector Informatik, default-value=2  # This parameter activates/deactivates the capability to compress boolean CONFIG-CLASS PRE-COMPILE ROM data by using relational comparison with other ROM data. 0: The optimization is not performed. >0: This is the threshold to activate the data optimization. Code: the code size is increased due to the usage of the operation in the data access. RAM: no change expected. ROM: the ROM size is minimized. Runtime: the runtime is increased due to the usage of the operation in the data access.
      enumeration IpduMReduceBoolDataByNumericalOperandStrategy: {NONE, WITH_ZERO, WITH_ANY_VALUE}, set at pre-compile, origin=Vector Informatik, default-value=WITH_ANY_VALUE  # This parameter is used to taylor the CONFIG-CLASS PRE-COMPILE ROM data deduplication mechaisms. A comparison with 0 is very efficient, but a numerical comparison with a value not 0 can be used to increase the ROM data compression rate. NONE: ROM data deduplications are switched off. Code: the code size is small. RAM: no change expected. ROM: the ROM size is large. Runtime: the runtime is fast. WITH_ZERO: ROM data deduplications can be applied with the value 0. Code: the code size is larger than using NONE RAM: no change expected. ROM: the ROM size is smaller than using NONE. Runtime: the runtime is larger than using NONE. WITH_ANY_VALUE: ROM data deduplications can be applied with any numerical value. Code: the code size is larger than using NONE RAM: no change expected. ROM: the ROM size is smaller than using DEDUPLICATE_DATA_WITH_ZERO. Runtime: the runtime is larger than using NONE.
      integer IpduMReduceNumericalDataByOffsetThreshold: 0.., set at pre-compile, origin=Vector Informatik, default-value=2  # This parameter activates/deactivates the capability to compress numerical CONFIG-CLASS PRE-COMPILE ROM data by using a constant offset. 0: The optimization is not performed. >0: This is the threshold to activate the data optimization. Code: the code size is increased due to the usage of the constant offset operation in the data access. RAM: no change expected. ROM: the ROM size is minimized. Runtime: the runtime is increased due to the usage of the constant offset operation in the data access.
      integer IpduMReduceNumericalDataByArraySubtractionThreshold: 0.., set at pre-compile, origin=Vector Informatik, default-value=2  # This parameter activates/deactivates the capability to compress numerical CONFIG-CLASS PRE-COMPILE ROM data by using a subtraction with other ROM data. 0: The optimization is not performed. >0: This is the threshold to activate the data optimization. Code: the code size is increased due to the usage of the operation in the data access. RAM: no change expected. ROM: the ROM size is minimized. Runtime: the runtime is increased due to the usage of the operation in the data access.
      boolean IpduMReduceDataByStreaming: set at pre-compile, origin=Vector Informatik, default-value=false  # This parameter activates/deactivates the capability to pack generated CONFIG-CLASS PRE-COMPILE ROM data into a data type dependent stream. TRUE: generated const data is packed into a data type dependent stream. Code: no change expected. RAM: no change expected. ROM: configuration dependent smaller than with FALSE. Runtime: no change expected. FALSE: generated const data is not packed into a data type dependent stream.
      boolean IpduMShortSymbols: set at pre-compile, origin=Vector Informatik, default-value=false  # This parameter activates/deactivates the capability to generate shortened symbol names. FALSE: symbol names are generated in a human readable style based on the MIP, tags and variant names. TRUE: symbol names are generated based on the MIP and a CRC32.
      boolean IpduMInterfacesForDeactivatedData: set at pre-compile, origin=Vector Informatik, default-value=false  # This parameter activates/deactivates the capability to generate bsw data interfaces for deactivated data elements. This is an advantage for the BSW developer to reduce the time to market with a development environment using auto completition and to investigate potential interfaces. FALSE: data interfaces are not generated if the data elementis deactivated. TRUE: data interfaces are generated as e.g. emty macros.
      boolean IpduMReferringKeysInComments: set at pre-compile, origin=Vector Informatik, default-value=false  # This parameter activates/deactivates the capability to generate referring keys in comments. This is an advantage for the developer to investigate indirections, but this feature reduces the overall readability of the generated data. FALSE: referring keys are not generated in comments. TRUE: referring keys are generated in comments.
    container IpduMConfig  # This container contains the sub containers of the IpduM module. The IpduMTxPathway subcontainer includes information about transmitted multiplex I-PDUs. The IpduMRxPathway includes information about received multiplex I-PDUs.
      container IpduMContainedRxPdu [0..*]: post-build-changeable=true  # Configuration of a received contained Pdu.
        integer IpduMContainedPduHeaderId [0..1]: 1..4294967295, set at pre-compile in variant pre-compile / post-build in variant post-build-loadable+post-build-selectable, origin=Vector Informatik  # Header Id which is part of the ContainerPdu when this ContainedPdu is inside.
        integer IpduMContainedPduOffset [0..1]: 0..4294967295, set at pre-compile in variant pre-compile / post-build in variant post-build-loadable+post-build-selectable, origin=Vector Informatik  # Static offset (in bytes) of the ContainedPdu.
        integer IpduMPduUpdateBitPosition [0..1]: 0..4294967295, set at pre-compile in variant pre-compile / post-build in variant post-build-loadable+post-build-selectable, origin=Vector Informatik  # This value specifies where the PDU's Update-Bit is stored in the Container PDU (bit location of PDU's Update-Bit in the Container PDU).
        reference IpduMContainedRxInContainerPduRef [0..1]: set at pre-compile in variant pre-compile / post-build in variant post-build-loadable+post-build-selectable, origin=Vector Informatik, destination=IpduMContainerRxPdu  # Optional reference to a container Pdu this contained Pdu may be transported in. | The reference may be omitted in case IpduMContainerRxAcceptContainedPdu=IPDUM_ACCEPT_ALL.
        reference IpduMContainedRxPduRef: set at pre-compile in variant pre-compile / post-build in variant post-build-loadable+post-build-selectable, origin=Vector Informatik, destination=Pdu  # Reference to the Pdu which represents this ContainedPdu and is used for reception indication.
      container IpduMContainedTxPdu [0..*]: post-build-changeable=true  # Configuration of a sender ContainedPdu.
        integer IpduMContainedPduHeaderId [0..1]: 1..4294967295, set at pre-compile in variant pre-compile / post-build in variant post-build-loadable+post-build-selectable, origin=Vector Informatik  # Header Id which is part of the ContainerPdu when this ContainedPdu is inside.
        integer IpduMContainedPduOffset [0..1]: 0..4294967295, set at pre-compile in variant pre-compile / post-build in variant post-build-loadable+post-build-selectable, origin=Vector Informatik  # Static offset (in bytes) of the ContainedPdu.
        enumeration IpduMContainedTxPduCollectionSemantics: {IPDUM_COLLECT_LAST_IS_BEST, IPDUM_COLLECT_QUEUED}, set at pre-compile in variant pre-compile / post-build in variant post-build-loadable+post-build-selectable, origin=Vector Informatik  # Defines whether this IpduMContainedTxPdu shall be collected using a last-is-best or queued semantics.
        boolean IpduMContainedTxPduConfirmation: set at pre-compile, origin=Vector Informatik, default-value=false  # This Parameter determines whether for this contained I-PDU a TxConfirmation shall be provided. If set to TRUE a TxConfirmation is issued. It is not used when an I-PDU is requested using the trigger transmit API. | If this Parameter is omitted, the default value shall be used.
        integer IpduMContainedTxPduHandleId: 0..65535, set at pre-compile, origin=Vector Informatik, symbolic-name-value=true, default-value=0  # Handle Id of the ContainedPdu.
        integer IpduMContainedTxPduPriority [0..1]: 0..255, set at pre-compile in variant pre-compile / post-build in variant post-build-loadable+post-build-selectable, origin=Vector Informatik, default-value=255  # Defines a priority of a ContainedTxPdu. 255 represents the lowest priority and 0 represent the highest priority.
        float IpduMContainedTxPduSendTimeout [0..1]: 0..65.535, set at pre-compile in variant pre-compile / post-build in variant post-build-loadable+post-build-selectable, origin=Vector Informatik  # Defines a ContainedPdu specific sender timeout which can reduce the ContainerPdu timer when this ContainedPdu is put inside the ContainerPdu. If this parameter is omitted, the linked Container-PDU must have a SendTimeout configured. The value 0 does not have special semantics here, 0 is a normal, valid value. | Defined in seconds.
        enumeration IpduMContainedTxPduTrigger: {IPDUM_TRIGGER_ALWAYS, IPDUM_TRIGGER_NEVER}, set at pre-compile in variant pre-compile / post-build in variant post-build-loadable+post-build-selectable, origin=Vector Informatik  # Defines whether this Pdu triggers the sending of the ContainerPdu.
        integer IpduMPduUpdateBitPosition [0..1]: 0..4294967295, set at pre-compile in variant pre-compile / post-build in variant post-build-loadable+post-build-selectable, origin=Vector Informatik  # This value specifies where the PDU's Update-Bit is stored in the Container PDU (bit location of PDU's Update-Bit in the Container PDU).
        reference IpduMContainedTxInContainerPduRef: set at pre-compile in variant pre-compile / post-build in variant post-build-loadable+post-build-selectable, origin=Vector Informatik, destination=IpduMContainerTxPdu  # Reference to the container Pdu which this contained Pdu shall be collected in.
        reference IpduMContainedTxPduRef: set at pre-compile in variant pre-compile / post-build in variant post-build-loadable+post-build-selectable, origin=Vector Informatik, destination=Pdu  # Reference to the Pdu which represents this ContainedPdu and is used for transmission.
      container IpduMContainerRxPdu [0..*]: post-build-changeable=true  # Configuration of a receiver ContainerPdu which may collect several ContainedPdus.
        enumeration IpduMContainerHeaderSize: {IPDUM_HEADERTYPE_LONG, IPDUM_HEADERTYPE_SHORT, IPDUM_HEADERTYPE_NONE}, set at pre-compile in variant pre-compile / post-build in variant post-build-loadable+post-build-selectable, origin=Vector Informatik  # Defines the layout of the header information (header id and length).
        enumeration IpduMContainerPduProcessing: {IPDUM_PROCESSING_DEFERRED, IPDUM_PROCESSING_IMMEDIATE}, set at pre-compile in variant pre-compile / post-build in variant post-build-loadable+post-build-selectable, origin=Vector Informatik, default-value=IPDUM_PROCESSING_IMMEDIATE  # Defines whether the handling of this ContainerPdu shall be done in the context of the caller (IMMEDIATE) or in the next IpduM main function (DEFERRED).
        integer IpduMContainerQueueSize: 0..254, set at pre-compile in variant pre-compile / post-build in variant post-build-loadable+post-build-selectable, origin=Vector Informatik, default-value=1  # Defines a local queue for handling of each ContainerPdu. | Defined in number of instances of this ContainerPdu.
        enumeration IpduMContainerRxAcceptContainedPdu: {IPDUM_ACCEPT_ALL, IPDUM_ACCEPT_CONFIGURED}, set at pre-compile in variant pre-compile / post-build in variant post-build-loadable+post-build-selectable, origin=Vector Informatik  # Defines for the received IpduMRxContainerPdu whether the list of referencing IpduMRxContainedPdus (via the reference IpduMRxContainedPduContainerRef) is a closed set.
        integer IpduMContainerRxHandleId: 0..65535, set at pre-compile, origin=Vector Informatik, symbolic-name-value=true, default-value=0  # Handle Id used by the PduR for RxIndication.
        reference IpduMContainerRxPduRef: set at pre-compile in variant pre-compile / post-build in variant post-build-loadable+post-build-selectable, origin=Vector Informatik, destination=Pdu  # Reference to the Pdu which represents the container and is used for reception.
      container IpduMContainerTxPdu [0..*]: post-build-changeable=true  # Configuration of a transmitted container Pdu.
        enumeration IpduMContainerHeaderSize: {IPDUM_HEADERTYPE_LONG, IPDUM_HEADERTYPE_SHORT, IPDUM_HEADERTYPE_NONE}, set at pre-compile in variant pre-compile / post-build in variant post-build-loadable+post-build-selectable, origin=Vector Informatik  # Defines the layout of the header information (header id and length).
        integer IpduMContainerQueueSize: 1..254, set at pre-compile in variant pre-compile / post-build in variant post-build-loadable+post-build-selectable, origin=Vector Informatik, default-value=1  # Defines a local queue for handling of each ContainerPdu. The actual queue length in the implementation is incremented by 1 as a performance optimization. So the current instance is within the queue and does not need additional copy instructions. The maximum value was lowered to 254 to enable this performance optimization. | Defined in number of instances of this ContainerPdu.
        float IpduMContainerTxConfirmationTimeout: 0..65.535, set at pre-compile in variant pre-compile / post-build in variant post-build-loadable+post-build-selectable, origin=Vector Informatik, default-value=0  # This timeout (in seconds) defines the timeout period for monitoring the reception of the TxConfirmation. It is not used when an I-PDU is requested using the trigger transmit API. | If this Parameter is omitted, the default value shall be used.
        boolean IpduMContainerTxFirstContainedPduTrigger: set at pre-compile in variant pre-compile / post-build in variant post-build-loadable+post-build-selectable, origin=Vector Informatik  # Defines if the transmission of this IpduMContainerTxPdu shall be requested right after the first IpduMContainedTxPdu was put into it.
        integer IpduMContainerTxHandleId: 0..65535, set at pre-compile, origin=Vector Informatik, symbolic-name-value=true, default-value=0  # Handle Id used by the PduR for TxConfirmation and for TriggerTransmit of the ContainerPdu.
        float IpduMContainerTxSendTimeout [0..1]: 0..65.535, set at pre-compile in variant pre-compile / post-build in variant post-build-loadable+post-build-selectable, origin=Vector Informatik  # When this timeout expires the ContainerPdu is triggered for sending. The respective timer is started when the first Pdu is put into the ContainerPdu. | Defined in seconds.
        integer IpduMContainerTxSizeThreshold [0..1]: 0..4294967295, set at pre-compile in variant pre-compile / post-build in variant post-build-loadable+post-build-selectable, origin=Vector Informatik  # Defines the size threshold in bytes which, when exceeded, triggers the sending of the ContainerPdu although the maxium Pdu size (PduLength parameter of Pdu object) has not been reached yet.
        enumeration IpduMContainerTxTriggerMode: {IPDUM_DIRECT, IPDUM_TRIGGERTRANSMIT}, set at pre-compile in variant pre-compile / post-build in variant post-build-loadable+post-build-selectable, origin=Vector Informatik  # Defines whether this ContainerPdu is fetched via trigger transmit.
        integer IpduMUnusedAreasDefault [0..1]: 0..255, set at pre-compile in variant pre-compile / post-build in variant post-build-loadable+post-build-selectable, origin=Vector Informatik, default-value=0  # IpduM fills not updated areas of the Container PDU with this byte-pattern.
        reference IpduMContainerTxPduRef: set at pre-compile in variant pre-compile / post-build in variant post-build-loadable+post-build-selectable, origin=Vector Informatik, destination=Pdu  # Reference to the Pdu which represents the container and is used for transmission.
      container IpduMRxPathway [0..*]: post-build-changeable=true  # Defines one lower layer I-PDU that is received from the network and resolved to multiple upper layer I-PDUs depending on the selector field value.
        container IpduMRxIndication  # Contains the configuration for incoming calls to the IpduM_RxIndication API.
          enumeration IpduMByteOrder: {BIG_ENDIAN, LITTLE_ENDIAN}, set at post-build in variant post-build-loadable+post-build-selectable / pre-compile in variant pre-compile  # This parameter defines the ByteOrder for all IpduMSegments (static and dynamic part) and for the selectorField within the MultiplexedPdu. This is necessary because the positions are defined differently (LSB for little endian and MSB for big endian) based on endianness. | The absolute position of a segment in the MultiplexedIPdu is determined by the definition of the ByteOrder parameter: If BIG_ENDIAN is specified, the SegmentPosition indicates the bit position of the most significant bit in an IPDU. If LITTLE_ENDIAN is specified, the SegmentPosition indicates the bit position of the least significant bit in an IPDU.
          integer IpduMRxHandleId: 0..65535, set at pre-compile, symbolic-name-value=true, default-value=0  # This is the I-PDU ID of the incoming I-PDU. If an incoming RxIndication's I-PDU ID matches this value then it is unpacked according to the specification in this container.
          reference IpduMRxIndicationPduRef: set at post-build in variant post-build-loadable+post-build-selectable / pre-compile in variant pre-compile, destination=Pdu  # Reference to the lower layer I-PDU that is processed and demultiplexed by the IpduM.
          container IpduMRxDynamicPart [1..*]: post-build-changeable=true  # This container contains the configuration for the dynamic part of incoming RxIndication calls. If an incoming received I-PDU's selector field matches the IpduMRxSelectorValue of any of the dynamic parts, the new outgoing I-PDU for the dynamic part is de-multiplexed according to the corresponding dynamic IpduMSegment specification and sent out with the I-PDU ID referenced by IpduMOutgoingDynamicPduRef.
            integer IpduMRxSelectorValue: 0..65535, set at post-build in variant post-build-loadable+post-build-selectable / pre-compile in variant pre-compile  # Identifies the dynamic part that is transmitted within the received multiplexed I-PDU. If the selector field value of the received multiplex I-PDU matches this value. It will be de-multiplexed according to the configuration in the parent IpduMRxDynamicPart container.
            reference IpduMOutgoingDynamicPduRef: set at post-build in variant post-build-loadable+post-build-selectable / pre-compile in variant pre-compile, destination=Pdu  # Reference to the upper layer I-PDU that is notified by the IpduM depending on the selector field value.
            container IpduMSegment [1..*]: post-build-changeable=true  # Defines the location and the length of a segment that is used to describe the composition of a multiplexed I-PDU for one selector field value. The data area that is covered by the configured segment(s) is copied from the lower layer I-PDU t the upper layer I-DU. Thereby the data is copied to the same location within the upper layer I-PDU.
              integer IpduMSegmentLength: 1..2032, set at post-build in variant post-build-loadable+post-build-selectable / pre-compile in variant pre-compile  # Length of the segment [bit].
              integer IpduMSegmentPosition: 0..2031, set at post-build in variant post-build-loadable+post-build-selectable / pre-compile in variant pre-compile  # Segments bit position in the multiplexed Pdu. Bits within a byte are always numbered in ascending order. Bytes are ordered based on IpduMByteOrder.
          container IpduMRxStaticPart [0..1]  # This container describes the optional static part of incoming lower layer I-PDU. If a static part is defined any reception of the lower layer I-PDU will cause the notification of the upper layer I-PDU representing the static part. This is independent from the selector field value.
            reference IpduMOutgoingStaticPduRef: set at post-build in variant post-build-loadable+post-build-selectable / pre-compile in variant pre-compile, destination=Pdu  # Reference to the upper layer I-PDU that notified by the IPDUM as static I-PDU part of each multiplexed I-PDU.
            container IpduMSegment [1..*]: post-build-changeable=true  # This contains the location and the length of a segment. A segment must fit inside the I-PDU. The segment in the source I-PDU that is located at the IpduMSegmentPosition is copied to the same position in the destination I-PDU.
              integer IpduMSegmentLength: 1..2032, set at post-build in variant post-build-loadable+post-build-selectable / pre-compile in variant pre-compile  # Length of the segment [bit].
              integer IpduMSegmentPosition: 0..2031, set at post-build in variant post-build-loadable+post-build-selectable / pre-compile in variant pre-compile  # Segments bit position in the multiplexed Pdu.
          container IpduMSelectorFieldPosition  # Defines the location and the length of the selector field that is used to identify the dynamic part of each multiplexed I-PDU.
            integer IpduMSelectorFieldLength: 1..16, set at post-build in variant post-build-loadable+post-build-selectable / pre-compile in variant pre-compile  # Length of the selector field [bit].
            integer IpduMSelectorFieldPosition: 0..2031, set at post-build in variant post-build-loadable+post-build-selectable / pre-compile in variant pre-compile  # Selector field bit position in the multiplexed Pdu. Bits are numbered ascending, bytes depending on the endianness defined in IpduMByteOrder.
      container IpduMTxPathway [0..*]: post-build-changeable=true  # Defines one lower layer I-PDU that is assembled from multiple upper layer I-PDUs depending on the selector field value.
        container IpduMTxRequest  # This is used to specify the configuration for Transmit requests. There will one instance of this container for each I-PDU that can be requested for transmission (the outgoing I-PDUs) by the IpduM.
          enumeration IpduMByteOrder: {BIG_ENDIAN, LITTLE_ENDIAN}, set at post-build in variant post-build-loadable+post-build-selectable / pre-compile in variant pre-compile  # This parameter defines the ByteOrder for all IpduMSegments (static and dynamic part) and for the selectorField within the MultiplexedPdu.
          integer IpduMIPduUnusedAreasDefault: 0..255, set at post-build in variant post-build-loadable+post-build-selectable / pre-compile in variant pre-compile, default-value=0  # IPDUM module fills unused areas of a transmitted multiplexed I-PDU with this bit-pattern. If this attribute is undefined unused areas are not initialized any may have an arbitrary value
          integer IpduMTxConfirmationPduId: 0..65535, set at pre-compile, symbolic-name-value=true, default-value=0  # Tx Confirmation Pdu Id | The handle Id used by the lower layer to identify this IPDUM I-PDU during TriggerTransmit and TxConfirmation calls.
          float IpduMTxConfirmationTimeout: 0..3600, set at post-build in variant post-build-loadable+post-build-selectable / pre-compile in variant pre-compile, default-value=0  # Specifies the timeout time for monitoring the TxConfirmation call from the lower layer (i.e. the transmission of the corresponding multiplex I-PDU occured). Parameter is not used for lower layer I-PDU that use the TriggerTransmit API.
          enumeration IpduMTxTriggerMode: {DYNAMIC_PART_TRIGGER, NONE, STATIC_OR_DYNAMIC_PART_TRIGGER, STATIC_PART_TRIGGER}, set at post-build in variant post-build-loadable+post-build-selectable / pre-compile in variant pre-compile, default-value=DYNAMIC_PART_TRIGGER  # Specifies the upper layer transmission event that causes the transmission of the multiplexed I-PDU through the lower layer. NONE: do not trigger transmission on upper layer transmission events STATIC_PART_TRIGGER: trigger transmission if the static part I-PDU is transmitted to IpduM DYNAMIC_PART_TRIGGER: trigger transmission if the dynamic part I-PDU is transmitted to IpduM STATIC_OR_DYNAMIC_PART_TRIGGER: trigger transmission if the static or dynamic part I-PDU is transmitted to IpduM
          reference IpduMInitialDynamicPart: set at post-build in variant post-build-loadable+post-build-selectable / pre-compile in variant pre-compile, destination=IpduMTxDynamicPart  # Reference to the dynamic part that shall be used to initialize this multiplexed TX-I-PDU. This part is used as the dynamic part in case of a static part first being triggered for transmission after ECU initialization, i.e. no last transmitted dynamic part is available yet.
          reference IpduMOutgoingPduRef: set at post-build in variant post-build-loadable+post-build-selectable / pre-compile in variant pre-compile, destination=Pdu  # Reference to I-Pdu representation in the ECU Configuration Description exchange file. When the outgoing I-PDU is sent this is the I-PDU ID to give it. It is the IPDUM I-PDU ID of the assembled I-PDU.
          container IpduMSelectorFieldPosition  # This contains the location and the length of the selector field.
            integer IpduMSelectorFieldLength: 1..16, set at post-build in variant post-build-loadable+post-build-selectable / pre-compile in variant pre-compile  # Length of the selector field [bit].
            integer IpduMSelectorFieldPosition: 0..2031, set at post-build in variant post-build-loadable+post-build-selectable / pre-compile in variant pre-compile  # Selector field bit position in the multiplexed Pdu.
          container IpduMTxDynamicPart [1..*]: post-build-changeable=true  # Configuration parameters for an instance of a TxRequest call into the IpduM. When a Tx Request with the IpduMTxDynamicHandleId is received by the IpduM, all segments as defined by this container are copied from the incoming I-PDU into the outgoing I-PDU buffer and then the send mode honored. This container is used by the dynamic part of a TxRequest configuration. Therefore, for each outgoing I-PDU there will be one instance of this container for the dynamic part.
            boolean IpduMJitUpdate: set at post-build in variant post-build-loadable+post-build-selectable / pre-compile in variant pre-compile, default-value=false  # If configured to true fetch the data of this part Just-In-Time via the triggerTransmit API of the PduR. This way, transmitted data is always up-to-date and update bits in Autosar Com can be cleared correctly. If configured to false, the data currently present in the IpduM's buffer for this dynamic part I-PDU is used, i.e. the dynamic part that was transmitted last. This way, transmissions may be on the bus faster, depending on configuration. Jit update can be activated independently from the lower layer.
            boolean IpduMTxDynamicConfirmation: set at post-build in variant post-build-loadable+post-build-selectable / pre-compile in variant pre-compile, default-value=false  # If enabled the I-PDU transmission is confirmed to the upper layer upon successful transmission of the multiplexed I-PDU by the lower layer.
            integer IpduMTxDynamicHandleId: 0..65535, set at pre-compile, symbolic-name-value=true, default-value=0  # This is the handle id of a requested transmit. When the handle of an incoming Tx Request matches this, the TxDynamicPart is multiplexed according to the corresponding IpduMSegments.
            reference IpduMTxDynamicPduRef: set at post-build in variant post-build-loadable+post-build-selectable / pre-compile in variant pre-compile, destination=Pdu  # Reference to the Pdu representation in the ECU Configuration Description exchange file to be transmitted.
            container IpduMSegment [1..*]: post-build-changeable=true  # Defines the location and the length of a segment that is used to describe the composition of a multiplexed I-PDU for one selector field value. The data area that is covered by the configured segment(s) is copied from the lower layer I-PDU to the upper layer I-PDU. Thereby the data is copied to the same location within the upper layer I-PDU.
              integer IpduMSegmentLength: 1..2032, set at post-build in variant post-build-loadable+post-build-selectable / pre-compile in variant pre-compile  # Length of the segment in bits.
              integer IpduMSegmentPosition: 0..2031, set at post-build in variant post-build-loadable+post-build-selectable / pre-compile in variant pre-compile  # Segments bit position in the multiplexed Pdu.
          container IpduMTxStaticPart [0..1]  # This container describes the optional static part of outgoing multiplexed lower layer I-PDU. If a static part is defined any transmission of the lower layer I-PDU will include I-PDU data provided by the static part. This is independent from the selector field value that shall be transmitted.
            boolean IpduMJitUpdate: set at post-build in variant post-build-loadable+post-build-selectable / pre-compile in variant pre-compile, default-value=false  # If configured to true fetch the data of this part Just-In-Time via the triggerTransmit API of the PduR. This way, transmitted data is always up-to-date and update bits in Autosar Com can be cleared correctly. If configured to false, the data currently present in the IpduM's buffer for the static part I-PDU is used, i.e. the static part that was transmitted last. This way, transmissions may be on the bus faster, depending on configuration. Jit update can be activated independently from the lower layer.
            boolean IpduMTxStaticConfirmation: set at post-build in variant post-build-loadable+post-build-selectable / pre-compile in variant pre-compile, default-value=false  # If enabled the I-PDU transmission is confirmed to the upper layer upon successful transmission of the multiplexed I-PDU by the lower layer.
            integer IpduMTxStaticHandleId: 0..65535, set at pre-compile, symbolic-name-value=true, default-value=0  # This is the handle id of a requested transmit. If the handle of an incoming Tx Request matches this, the TxStaticPart is multiplexed according to the corresponding IpduMSegments and the send mode is honored.
            reference IpduMTxStaticPduRef: set at post-build in variant post-build-loadable+post-build-selectable / pre-compile in variant pre-compile, destination=Pdu  # Reference to the multiplexed Pdu's (static part, if exists) representation in the ECU Configuration Description exchange file to be transmitted.
            container IpduMSegment [1..*]: post-build-changeable=true  # Defines the location and the length of a segment that is used to describe the composition of a multiplexed I-PDU for one selector field value. The data area that is covered by the configured segment(s) is copied from the lower layer I-PDU to the upper layer I-PDU. Thereby the data is copied to the same location within the upper layer I-PDU.
              integer IpduMSegmentLength: 1..2032, set at post-build in variant post-build-loadable+post-build-selectable / pre-compile in variant pre-compile  # Length of the segment in bits.
              integer IpduMSegmentPosition: 0..2031, set at post-build in variant post-build-loadable+post-build-selectable / pre-compile in variant pre-compile  # Segments bit position in the multiplexed Pdu.
    container IpduMPublishedInformation  # Additional published parameters not covered by CommonPublishedInformation container. Note that these parameters do not have any configuration class setting, since they are published information.
      boolean IpduMRxDirectComInvocation: set at published-information, default-value=true  # Direct Com Invocation | If set to TRUE the methods Com_RxIndication and Com_TriggerTransmit are invocated directly without using the PduR as intermediate module. This is required by the AUTOSAR requirement IPDUM140.
  module config IpduM_Pre: definition=IpduM
    IpduMPublishedInformation: IpduMRxDirectComInvocation=0
  module config IpduM_Rec: definition=IpduM
