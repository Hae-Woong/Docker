AUTOSAR XML (schema 00048)
# COPYRIGHT
# Copyright (c) 2024 by Vector Informatik GmbH. All rights reserved.
# This software is copyright protected and proprietary to Vector Informatik GmbH.
# Vector Informatik GmbH grants to you only those rights as set out in the license conditions.
package /MICROSAR
  bsw implementation EthIf_Impl
    required-artifacts:
      dependency on artifact EthIf_MemMap: category=MEMMAP, artifact-descriptor={short-label=EthIf_MemMap.h, category=SWHDR}
    resource consumption ResourceConsumption
      28 x memory section:
        ETHIF_CALLOUT_CODE: sw-addrmethod=CALLOUT_CODE, symbol=CALLOUT_CODE
        ETHIF_CODE: sw-addrmethod=CODE, symbol=CODE
        ETHIF_CODE_ISR: sw-addrmethod=CODE_ISR, symbol=CODE_ISR
        ETHIF_PBCFG: sw-addrmethod=CONST_PBCFG, symbol=PBCFG
        ETHIF_CONST_PBCFG: sw-addrmethod=CONST_PBCFG, symbol=CONST_PBCFG
        ETHIF_PBCFG_GLOBALROOT: sw-addrmethod=PBCFG_GLOBALROOT, symbol=PBCFG_GLOBALROOT
        ETHIF_CONFIG_DATA: sw-addrmethod=CONFIG_DATA, symbol=CONFIG_DATA
        ETHIF_CONST_BOOLEAN: alignment=BOOLEAN, sw-addrmethod=CONST, symbol=CONST_BOOLEAN
        ETHIF_CONST_8: alignment=8, sw-addrmethod=CONST, symbol=CONST_8
        ETHIF_CONST_16: alignment=16, sw-addrmethod=CONST, symbol=CONST_16
        ETHIF_CONST_32: alignment=32, sw-addrmethod=CONST, symbol=CONST_32
        ETHIF_CONST_UNSPECIFIED: alignment=UNSPECIFIED, sw-addrmethod=CONST, symbol=CONST_UNSPECIFIED
        ETHIF_VAR_PBCFG: sw-addrmethod=VAR_PBCFG, symbol=VAR_PBCFG
        ETHIF_VAR_NO_INIT_BOOLEAN: alignment=BOOLEAN, sw-addrmethod=VAR_NO_INIT, symbol=VAR_NO_INIT_BOOLEAN
        ETHIF_VAR_NO_INIT_8: alignment=8, sw-addrmethod=VAR_NO_INIT, symbol=VAR_NO_INIT_8
        ETHIF_VAR_NO_INIT_16: alignment=16, sw-addrmethod=VAR_NO_INIT, symbol=VAR_NO_INIT_16
        ETHIF_VAR_NO_INIT_32: alignment=32, sw-addrmethod=VAR_NO_INIT, symbol=VAR_NO_INIT_32
        ETHIF_VAR_NO_INIT_UNSPECIFIED: alignment=UNSPECIFIED, sw-addrmethod=VAR_NO_INIT, symbol=VAR_NO_INIT_UNSPECIFIED
        ETHIF_VAR_INIT_BOOLEAN: alignment=BOOLEAN, sw-addrmethod=VAR_INIT, symbol=VAR_INIT_BOOLEAN
        ETHIF_VAR_INIT_8: alignment=8, sw-addrmethod=VAR_INIT, symbol=VAR_INIT_8
        ETHIF_VAR_INIT_16: alignment=16, sw-addrmethod=VAR_INIT, symbol=VAR_INIT_16
        ETHIF_VAR_INIT_32: alignment=32, sw-addrmethod=VAR_INIT, symbol=VAR_INIT_32
        ETHIF_VAR_INIT_UNSPECIFIED: alignment=UNSPECIFIED, sw-addrmethod=VAR_INIT, symbol=VAR_INIT_UNSPECIFIED
        ETHIF_VAR_CLEARED_BOOLEAN: alignment=BOOLEAN, sw-addrmethod=VAR_CLEARED, symbol=VAR_CLEARED_BOOLEAN
        ETHIF_VAR_CLEARED_8: alignment=8, sw-addrmethod=VAR_CLEARED, symbol=VAR_CLEARED_8
        ETHIF_VAR_CLEARED_16: alignment=16, sw-addrmethod=VAR_CLEARED, symbol=VAR_CLEARED_16
        ETHIF_VAR_CLEARED_32: alignment=32, sw-addrmethod=VAR_CLEARED, symbol=VAR_CLEARED_32
        ETHIF_VAR_CLEARED_UNSPECIFIED: alignment=UNSPECIFIED, sw-addrmethod=VAR_CLEARED, symbol=VAR_CLEARED_UNSPECIFIED
