AUTOSAR XML (schema 4-0-3)
package /MICROSAR
  module config EthIf_Rec: definition=EthIf
    EthIfGeneral: EthIfSafeBswChecks=1
