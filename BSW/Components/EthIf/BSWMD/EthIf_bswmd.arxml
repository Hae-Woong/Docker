AUTOSAR XML (schema 4-1-1)
# COPYRIGHT
# Copyright (c) 2024 by Vector Informatik GmbH. All rights reserved.
# This software is copyright protected and proprietary to Vector Informatik GmbH.
# Vector Informatik GmbH grants to you only those rights as set out in the license conditions.
package /MICROSAR
  module definition EthIf [0..1]: category=VENDOR_SPECIFIC_MODULE_DEFINITION, refined-module-def=EthIf, variants pre-compile/post-build-selectable  # The Ethernet Interface provides to upper layers (TCP/IP, EthSM, CDD, V2x) a hardware independent interface to access underling Ethernet communication system composed of Ethernet controller(s), Ethernet transceiver(s) and Ethernet switch(es). The Ethernet Interface does not directly access the Ethernet hardware, but rather access it through one or more driver modules (Ethernet controller driver, Ethernet transceiver, Ethernet switch). #Ethernet #Interface #Communication #AUTOSAR
    container EthIfConfigSet  # This container includes containers and parameters that may be part of a multiple configuration set.
      container EthIfFrameOwnerConfig [1..*]  # These containers include the configuration of Ethernet frame owners. Each frame owner registers for a certain Ethertype to receive and transmit Ethernet frames with the respective Ethertype. Each frame owner must implement an RxIndication and TxConfirmation function that need to be configured in the EthIfRxIndicationConfig and EthIfTxConfirmationConfig containers.
        integer EthIfFrameType: 0..65535, set at pre-compile, default-value=0  # Frame Type | This value selects the Ethernet frame type the frame owner wants to register for.
        integer EthIfOwner: 0..255, set at pre-compile, symbolic-name-value=true, default-value=0  # Owner Index | This value selects the owner of an Ethernet frame type. The owner is a zero based index into the callback function configuration 'EthIfRxIndicationConfig'. I.e. an Ethernet frame of type IPv4 (0x800) at index 0 will call the first callback function configured in 'EthIfRxIndicationConfig'. The EthIfOwner is calculated automatically and is not relevant for the user since it is not used in any external APIs.
        foreign reference EthIfBswModuleRef [0..1]: set at pre-compile, origin=Vector Informatik, destination-type=ECUC-MODULE-CONFIGURATION-VALUES  # Owning BSW Module | This is a reference to one BSW module's configuration the frame owner shall be related to.
      container EthIfRxIndicationConfig [1..*]  # These containers include the configuration of receive callback functions.
        function name EthIfRxIndicationFunction: set at pre-compile, default-value=Msn_RxIndication  # Rx Indication | This parameter defines the name of a receive indication callback function. The prototype of the function is as specified as followed: void <User>_RxIndication(uint8 EthIfCtrlIdx, Eth_FrameType FrameType, boolean IsBroadcast, uint8 *PhysAddrPtr, uint8 *DataPtr, uint16 LenByte);
        reference EthIfFrameOwnerConfigRef: set at pre-compile, origin=Vector Informatik, destination=EthIfFrameOwnerConfig  # Frame Owner Reference | Reference to the frame owner to assign the RxIndication function.
      container EthIfTrcvLinkStateChgConfig [1..*]  # These containers include the link state change callback function. In case the transceiver link of ther underlaying hardware changes all transceiver link state change callback functions are called by the EthIf to inform the observers about a link state change.
        function name EthIfTrcvLinkStateChgFunction: set at pre-compile  # Transceiver Link State Change Indication | This parameter defines the name of a link state change indication function. This function is called in case the transceiver link state of the underlaying hardware changes. The prototype of the function is as specified as followed: void <User>_TrcvLinkStateChg(uint8 EthIfCtrlIdx, EthTrcv_LinkStateType TrcvLinkState);
        reference EthIfFrameOwnerConfigRef [0..1]: set at pre-compile, origin=Vector Informatik, destination=EthIfFrameOwnerConfig  # Frame Owner Reference | Reference to the frame owner to assign the Transceiver Link State Change function.
      container EthIfTxConfirmationConfig [1..*]  # These containers include the configuration of transmit indication callback functions.
        function name EthIfTxConfirmationFunction: set at pre-compile, default-value=Msn_TxConfirmation  # Tx Confirmation | This parameter defines the name of a transmit indication callback function. The prototype of the function is as specified as followed: void <User>_TxConfirmation(uint8 EthIfCtrlIdx, uint8 BufferIdx);
        reference EthIfFrameOwnerConfigRef: set at pre-compile, origin=Vector Informatik, destination=EthIfFrameOwnerConfig  # Frame Owner Reference | Reference to the frame owner to assign the TxConfirmation function.
      container EthIfController [1..*]  # These containers include the configuration of virtual controllers. A virtual controller either directly references a physical controller or points to a VLAN that is mapped onto a physical controller. An EthIfController is used by the upper layers to send and receive frames of a certain VLAN or frames that aren't VLAN-tagged.
        integer EthIfCtrlIdx: 0..255, set at pre-compile, symbolic-name-value=true, default-value=0  # This parameter provides a zero-based consecutive index of the Ethernet Communication Controllers. Upper layer BSW modules and the EthIf itself use this index to identify an Ethernet Interface Controller.
        boolean EthIfEnableVLAN: set at pre-compile, origin=Vector Informatik, default-value=false  # This parameter defines if the virtual controller is mapped to a VLAN.
        integer EthIfVlanId: 0..4095, set at post-build in variant post-build-selectable / pre-compile in variant pre-compile, default-value=0  # This value specifies a 12 bit VLAN identifier according to IEEE 802.1Q. Only values between 0x000 and 0xffe are valid. All other values are reserved or invalid. When VID equals 0x000, the transmitted frames does not belong to any VLAN. The VLAN tag of the transmitted frames only specifies the priority. The receive behavior of a VLAN with VID=0x000 is the same to the behavior of a physical controller. All frames without any VLAN tag or with VID=0x000 are received.
        integer EthIfCtrlMtu: 46..9000, set at pre-compile, default-value=1500  # This value specifies the maximum transmission unit (MTU) of the EthIfController in bytes. The MTU defines the maximum frame size that can be transmitted on the network. Note: In case a VLAN tag is used for the EthIfCtrl, the MTU is 4 bytes smaller than the maximum buffer size configured within the Eth module.
        boolean EthIfEnableLaxLinkAggregation: set at pre-compile, origin=Vector Informatik, default-value=false  # Enable Lax Link Aggregation | This parameter defines if Lax Link Aggregation for this EthIf Controller is enabled/disabled. Unaivailable/Disabled: The link for this EthIf Controller is aggregated by retrieving the link information of all switch ports configured in the referenced Switch Port Group. Only if all of the ports have established a link the EthIf Controller issues also a link to its upper layers. Enabled: The link for the EthIf Controller is aggregated by retrieving the link of all switch ports configured in the reference Switch Port Group. However the EthIf Controller now issues a link to its upper layers when at least two ports have a link established. Restriction: This parameter is only available if a Switch Port Group is mapped to the EthIf Controller.
        enumeration EthIfMacSecSupport [0..1]: {HW_MACSEC, NO_MACSEC}, set at pre-compile, default-value=NO_MACSEC  # MACsec Support | MACsec support of the ethernet interface controller.
        symbolic name reference EthIfPhysControllerRef: set at post-build in variant post-build-selectable / pre-compile in variant pre-compile, destination=EthCtrlConfig  # Physical Eth Controller | Reference to the Ethernet controller used for sending/receiving Ethernet frames and controlled by the EthIf mode management.
        symbolic name reference EthIfTransceiverRef [0..1]: set at post-build in variant post-build-selectable / pre-compile in variant pre-compile, destination=EthTrcvConfig  # Eth Transceiver | Reference to the Ethernet transceiver used to retrieve the link state and controlled by the EthIf mode management.
        symbolic name reference EthIfSwitchRef [0..*]: set at pre-compile, destination=EthIfSwitch  # Eth Switch | Reference to the Ethernet switch controlled by the EthIf mode management.
        symbolic name reference EthIfSwitchPortGroupRef [0..1]: set at pre-compile, destination=EthIfSwitchPortGroup  # Eth Switch Port Group | Reference to the EthIf switch port group used to retrieve the link state and controlled by the EthIf mode management.
        symbolic name reference EthIfEcucPartitionRef [0..1]: set at pre-compile, origin=Vector Informatik, destination=EcucPartition  # Ecuc Partition | This references the EcucPartition which is related to the RX/TX operation of an Ethernet Interface Controller.
        symbolic name reference EthIfPaeInstanceRef [0..1]: set at pre-compile, origin=Vector Informatik, destination=MkaInstance  # Reference to MkaInstance
      container EthIfBufFilterConfig [0..1]  # This container includes buffer filter rules. A buffer filter rules defines if a reception buffers must be explicitly unlocked by upper layers or not. Explicitly unlocking reception buffers may be necessary to implement zero-copy concepts. By default unlocking of the reception buffers is implicitly done right after the receive indication callback method.
        container EthIfVlanFilterConfig [0..255]  # VLAN Filter Configuration | These containers include buffer filter rules depending on the VLAN ID of an Ethernet frame. As far as a filter rule for a specific VLAN ID exists, the buffer must be explicitly unlocked when the VLAN ID of the Ethernet frame matches.
          reference EthIfControllerRef: set at pre-compile, origin=Vector Informatik, destination=EthIfController  # Controller Reference | Reference to the EthIfController associated with the VLAN that the filter rule shall be applied to.
        container EthIfEthTypeFilterConfig [0..255]  # Ethertype Filter Configuration | These containers include buffer filter rules depending on the Ethertype of an Ethernet frame. As far as a filter rule for a specific Ethertype AND VLAN exists, the buffer must be explicitly unlocked when the Ethertype of the Ethernet frame matches.
          reference EthIfFrameOwnerConfigRef: set at pre-compile, origin=Vector Informatik, destination=EthIfFrameOwnerConfig  # Frame Owner Reference | Reference to the frame owner containing the Ethertype to be filtered.
          reference EthIfControllerRef: set at pre-compile, origin=Vector Informatik, destination=EthIfController  # Controller Reference | Reference to the EthIfController associated with the VLAN that the filter rule shall be applied to.
      container EthIfSwitch [0..*]  # This container is used to globally index all hardware switches that are used by the Ethernet Interface. The index may be used by upper layers like the DHCP server component as a unique identifier when calling a Ethernet Interface API. Besides the global index a reference to a hardware switch configuration container resides in this container.
        integer EthIfSwitchIndex: 0..255, set at pre-compile, symbolic-name-value=true, default-value=0  # EthIf Ethernet Switch Index | This value specifies a globally unique index for each hardware Ethernet Switch that is used by the Ethernet Interface. The index is zero-based and incremented by one for each hardware switch.
        symbolic name reference EthIfEthSwtRef: set at pre-compile, destination=EthSwtConfig  # Ethernet Switch Reference | Reference to a Ethernet Switch configuration container.
      container EthIfWakeupMap [0..*]  # This container includes the mapping of EcuM wakeup sources to corresponding hardware drivers for wakeup check.
        symbolic name reference EthIfEcuMWakeupSourceRef: set at pre-compile, origin=Vector Informatik, destination=EcuMWakeupSource  # Reference to an EcuM wakeup source that is used during wakeup check for calling EthIf_CheckWakeup() API.
        symbolic name reference EthIfEthTrcvRef: set at pre-compile, origin=Vector Informatik, destination=EthTrcvConfig  # Reference to an Ethernet transceiver which is invoked in the wakeup check if the related EcuM wakeup reason is passed to EthIf.
      choice container EthIfExtendedTrafficHandling [0..1]  # This choice container specifies which extended frame handling feature shall be applied.
        container EthIfTrafficMirroring [0..1]  # This container includes the general configuration elements and sub containers of the traffic mirroring feature.
          integer EthIfMaxParallelTxTrafficFrames: 1..65535, set at pre-compile, origin=Vector Informatik, default-value=2  # Max Parallel Tx Traffic Frames | This value defines how many parallel Tx traffic frames can be handled by traffic mirroring.
          container EthIfMirroringMap [1..*]  # This container contains the configuration elements for one mirroring map.
            boolean EthIfKeepOrgSrcMac: set at pre-compile, origin=Vector Informatik, default-value=true  # Keep original Source MAC | This parameter defines if the original Source MAC of the frame mirrored is keept or substituted on the destination interface. True: Source MAC address of frame to be mirrored is kept for frame mirrored on the Ethernet Controller referenced by "EthIfDestEthCtrlRef". False: Source MAC address of frame to be mirrored is replaced by the source MAC address of the Ethernet Controller referenced by "EthIfDestEthCtrlRef".
            symbolic name reference EthIfDestEthCtrlRef: set at pre-compile, origin=Vector Informatik, destination=EthCtrlConfig  # Destination Eth Controller | Reference to the Ethernet Controller the traffic shall be mirrored to.
            symbolic name reference EthIfTxSourceEthIfCtrlRef [0..*]: set at pre-compile, origin=Vector Informatik, destination=EthIfController  # Tx Source EthIf Controller | Reference to the Ethernet Interface Controller whose Tx traffic shall be mirrored.
            symbolic name reference EthIfRxSourceEthIfCtrlRef [0..*]: set at pre-compile, origin=Vector Informatik, destination=EthIfController  # Rx Source EthIf Controller | Reference to the Ethernet Interface Controller whose Rx traffic shall be mirrored.
        container EthIfTrafficGateway [0..1]
          string EthIfSrcMacBlackListEntry [0..*]: set at pre-compile, origin=Vector Informatik  # Black List Source MAC address | This parameter defines an entry for the source MAC address list of the traffic gateway. Ethernet frames containing the MAC address as source address will be ignored for traffic gateway.
          container EthIfTrafficGatewayRoute [1..*]  # This container containes two Ethernet Interface Controller references which reference the controllers involved in the gateway route.
            symbolic name reference EthIfRouteEthIfCtrlRef [2..2]: set at pre-compile, origin=Vector Informatik, destination=EthIfController  # Reference to the Ethernet Interface Controller participating in the traffic gateway route.
      container EthIfSwitchPortGroup [0..*]
        enumeration EthIfSwitchPortGroupSemantics [0..1]: {ETHIF_SWITCH_PORT_GROUP_CONTROL, ETHIF_SWITCH_PORT_GROUP_LINK_INFO}, set at pre-compile, default-value=ETHIF_SWITCH_PORT_GROUP_CONTROL  # Port Group Semantic | This parameter defines the semantics of the port group. Not existing: Port group is handled by BswM - mode control with EthIf_SwitchPortGroupRequestMode() - link indication to BswM_EthIf_PortGroupLinkStateChg() Existing: Port group is handled by EthIf dependent on the selected semantic ETHIF_SWITCH_PORT_GROUP_CONTROL: EthIf requests mode changes for the ports in the port group and uses the link state to define a link for the EthIf controller using the port group. ETHIF_SWITCH_PORT_GROUP_LINK_INFO: EthIf doesn't request mode changes for the ports but only uses the link state to define a link for the EthIf controller using the port group.
        integer EthIfSwitchPortGroupIdx: 0..65535, set at pre-compile, symbolic-name-value=true, default-value=0  # Switch Port Group Idx | This parameter defines the value of the symbolic name representing this switch port group.
        symbolic name reference EthIfSwitchPortGroupPortRef [1..*]: set at pre-compile, destination=EthSwtPort  # Switch Port | Reference to an Ethernet switch port that shall be managed by the switch port group.
      container EthIfSecurityEventRefs [0..1]  # This container contains the security event reference configuration.
        symbolic name reference ETHIF_SEV_DROPPED_UNKNOWN_ETHERTYPE_DATAGRAM [0..1]: set at pre-compile, destination=IdsMEvent  # Reference to the sequrity event "An ethernet datagram was dropped due the Ethertype in not known".
        symbolic name reference ETHIF_SEV_DROPPED_VLAN_DOUBLE_TAG_DATAGRAM [0..1]: set at pre-compile, destination=IdsMEvent  # Reference to the sequrity event "An ethernet datagram was dropped due to double VLAN tag".
        symbolic name reference ETHIF_SEV_DROPPED_INVALID_CTRLIDX_DATAGRAM [0..1]: set at pre-compile, destination=IdsMEvent  # Reference to the sequrity event "An ethernet datagram was dropped due to an invalid CrtlIdx/VLAN".
        symbolic name reference ETHIF_SEV_ETH_MAC_COLLISION [0..1]: set at pre-compile, destination=IdsMEvent  # Reference to the sequrity event "Received local MAC as source MAC in an incoming frame".
    container EthIfGeneral  # General configuration parameters of the EthIf
      boolean EthIfDevErrorDetect: set at pre-compile, default-value=true  # Dev Error Detect | This parameter switches the Development Error Detection and Notification ON or OFF. true: Development error detection is enabled. false: Development error detection is disabled. Note: In general, the development error detection is recommended during pre-test phase. It is not recommended to enable the development error detection in production code due to increased runtime and ROM needs.
      boolean EthIfEnableRxInterrupt: set at pre-compile, default-value=true  # Enable Rx Interrupt | This parameter defines if the interrupt mode is used by Ethernet interface to receive data. In interrupt mode the reception of a frame is immediately indicated to the upper modules within an interrupt context. If interrupt mode is disabled, the EthIf polls the uderlaying hardware to receive the data. RESTRICTIONS: 'EthIfEnableRxInterrupt' needs to be set corresponding to Ethernet Drivers 'EthEnableRxInterrupt'.
      boolean EthIfEnableTxInterrupt: set at pre-compile, default-value=true  # Enable Tx Interrupt | This parameter defines if the interrupt mode is used by Ethernet interface to send data. In interrupt mode the transmission confirmation is triggered within the interrupt context immediately after frame transmission. If interrupt mode is disabled, the transmission confirmation is triggered when the EthIf polls the Eth module within its EthIf_MainFunctionTx function. The MainFunction is scheduled by the RTE. RESTRICTIONS: 'EthIfEnableTxInterrupt' needs to be set corresponding to Ethernet Drivers 'EthEnableTxInterrupt'
      integer EthIfMaxTrcvsTotal: 1..255, set at pre-compile, default-value=1  # Max Trcvs Total | This value specifies the the maximum number of transceivers. This value is not relevant to the user since it is only used for internal DET checks.
      integer EthIfMaxTxBufsTotal: 1..255, set at pre-compile, default-value=10  # Max Tx Bufs Total | This value specifies the maximum number of transmit buffers.
      integer EthIfTrcvLinkStateChgMainReload: 1..255, set at pre-compile, default-value=5  # Trcv Link State Chg Main Reload | This value specifies the period of the link state change check triggered in EthIf_MainFunctionTx() if EthIf_MainFunctionState() isn't used. Example: If this value is configured to 5, link state change checkis trigger every (5 * EthIf_MainFunctionPeriod) milliseconds. So the minimal latency to detect a link state change is equal to this timespan, the maximum latency is ( (2 * (EthIfTrcvLinkStatChgMainReload * EthIf_MainFunctionPeriod) ) - 1)
      boolean EthIfVersionInfoApi: set at pre-compile, default-value=false  # Version Info API | This parameter enables/disables the function EthIf_GetVersionInfo() to get major, minor and patch version information. This parameter enables/disables the function EthIf_GetVersionInfo() to get major, minor and patch version information.
      boolean EthIfVersionInfoApiMacro: set at pre-compile, default-value=false  # Version Info API Macro | This parameter defines if EthIf_GetVersionInfo() is implemented as a macro. RESTRICTIONS: 'EthIfVersionInfoApiMacro' is only relevant, if 'EthIfVersionInfoApi' is set to 'true'.
      string EthIfUserConfigFile [0..1]: set at pre-compile, origin=Vector Informatik  # User Config File | Reference to an external text file that will be included during generation to EthIf_Cfg.h. The content of the user configuration file will be added at the end of the generated module configuration file and allows altering or extending the generated code. Caution: User configuration files can cause the software module to malfunction and must only be used with great care!
      boolean EthIfEnableMainFunctionState: set at pre-compile, origin=Vector Informatik, default-value=true  # Enable Main Function State | This parameter defines if a separate main function for transceiver link state supervision is used. Instead of polling the link within the EthIf_MainFunctionTx function (as specified in Autosar), the link is polled with the function EthIf_MainFunctionState. This function is called by the RTE scheduler directly. Instead of checking that the EthIfLinkStateChgMainReload counter in each period of the EthIf_MainFunctionTx state reaches zero, the scheduler already calls the EthIf_MainFunctionState with the proper period.
      float EthIfMainFunctionPeriod: 0..32.767, set at pre-compile, default-value=0.005  # This value specifies the the cycle time at which the EthIf_MainFunctionCyclic() is called.
      float EthIfMainFunctionRxTimeout: 0..32.767, set at pre-compile, default-value=0.005  # In polling mode (EthIfEnableRxInterrupt = false) the EthIf_MainFunctionRx polls the underlaying hardware for new received frames. This value specifies the timeout after the EthIf stops to receive frames. The current implementation does not support a timeout because it has no suitable time base for the supervision.
      string EthIfPublicCddHeaderFile [0..255]: set at pre-compile  # These parameters defines header files for callback functions which shall be included in case of CDDs.
      integer EthIfRxIndicationIterations: 0..65535, set at pre-compile, default-value=5  # Max Frames per Eth Controller | This parameter defines the maximum number of Ethernet frames received during a EthIf_MainFunctionRx on one Ethernet controller, when EthIf is configured to polling mode (EthIfEnableRxInterrupt == FALSE). In case not all frames can be processed by EthIf, the reception queues of the underlaying hardware could get filled till next main function cycle and the hardware may drop frames.
      boolean EthIfUpdatePhysAddrFilter: set at pre-compile, origin=Vector Informatik, default-value=false  # This parameter defines if the optional API EthIf_UpdatePhysAddrFilter is enabled. The API is used to enable and disable the frame reception filter for multicast addresses. If the filter for a certain multicast address is enabled, all frames are received that are destined for that address.
      boolean EthIfEnableZeroCopyExtensions: set at pre-compile, origin=Vector Informatik, default-value=false  # Enable Zero-Copy Extensions | This parameter defines if buffer filtering and usage of external buffers is enabled. Depending on the buffer filter, reception buffers must be explicitly unlocked by upper layers or not. Explicitly unlocking reception buffers may be necessary to implement zero-copy concepts. However, default behavior is unlocking the reception buffer is implicitly done by the Eth component right after the receive indication callback method. For transmission the upper layer may use own buffers that must not be provided by the Eth component. Analogical to buffer filtering, external transmission buffers may be necessary to implement zero-copy concepts. RESTRICTIONS: 'EthIfEnableZeroCopyExtensions' needs to be set corresponding to Ethernet Drivers 'EthEnableZeroCopyExtensions'
      integer EthIfMaxExtTxBufsTotal: 0..255, set at pre-compile, origin=Vector Informatik, default-value=0  # Max External Tx Bufs Total | This value specifies the maximum number of external transmission buffers. RESTRICTIONS: 'EthIfEnableZeroCopyExtensions' needs to be enabled for external transmission buffers.
      boolean EthIfGlobalTimeSupport: set at pre-compile, default-value=false  # Global Time Support | This parameter defines if the global time support is enabled/disabled. The global time support allows the retrieve time stamping information related to an Ethernet frame either from an local Ethernet controller or from an Ethernet switch.
      boolean EthIfEnableHeaderAccessApi: set at pre-compile, origin=Vector Informatik, default-value=false  # Enable Header Access API | This parameter defines if APIs are provided to allow access to the Ethernet frame header. Usually the Ethernet header is cut off during reception or is assembled during transmission by the Ethernet driver. To read the header information during reception or to overwrite the header that is assembled by the driver during transmission, further APIs are provided. RESTRICTIONS: 'EthIfEnableHeaderAccessApi' needs to be set corresponding to Ethernet Drivers 'EthEnableHeaderAccessApi'
      boolean EthIfGetTransceiverWakeupModeApi [0..1]: set at pre-compile, default-value=false  # This parameter defines if the EthIf_GetTransceiverWakeupMode() API is available.
      boolean EthIfWakeupSupport: set at pre-compile, default-value=false  # This parameter defines if the wakeup functionallity is supported.
      boolean EthIfSwitchManagementSupport: set at pre-compile, default-value=false  # Switch Management Support | This parameter defines if switch frame management is supported
      boolean EthIfSafeBswChecks: set at pre-compile, origin=Vector Informatik, default-value=false  # Selects if safety checks are used. These checks improve robustness as e.g. invalid parameters are checked before function is executed. This attribute has to be enabled for safety projects where this component is mapped to an ASIL partition.
      boolean EthIfEnableSignalQualityApi: set at pre-compile, default-value=false  # Enable Signal Quality Api | This parameter defines if the APIs EthIf_GetTrcvSignalQuality EthIf_ClearTrcvSignalQuality EthIf_GetSwitchPortSignalQuality EthIf_ClearSwitchPortSignalQuality are available.
      float EthIfSignalQualityCheckPeriod [0..1]: 0..32.767, set at pre-compile, default-value=0.25  # Specifies the period in units of seconds in which the signal quality it polled in the context of EthIf_MainfunctionState. The value shall be an integral multiple of EthIfMainFunctionStatePeriod. If this parameter is defined, the EthIf_MainFunctionState shall be generated and parameter EthIfEnableSignalQualityApi shall be set to TRUE.
      boolean EthIfGetAndResetMeasurementDataApi: set at pre-compile, default-value=false  # This parameter defines if the EthIf_GetAndResetMeasurementData() API is available.
      boolean EthIfEnableSecurityEventReporting: set at pre-compile, default-value=false  # Enable Security Event Reporting | This parameter defines if the security events reporting feature is enabled or disabled.
      float EthIfPortStartupActiveTime: 0.001..65.535, set at pre-compile, default-value=0.5  # Denote the time delay after the mode "ETH_MODE_ACTIVE" of all EthIfSwitchPorts are requested via EthIf_StartAllPorts. Note: This value should always be in multiple of EthIfMainFunctionPeriod.
      boolean EthIfEnableAutosarForwardCompatibility: set at pre-compile, origin=Vector Informatik, default-value=false  # Enable AUTOSAR foward compatibility | This parameter defines the interface version between Ethernet Driver and the Ethernet Interface. It affects the APIs EthIf_TxConfirmation and EthIf_CtrlModeIndication. This parameter can enabled based on the condition below: Enabled: Interface according to AUTOSAR version 4.3.0 and above Disabled: Interface according to AUTOSAR version below 4.3.0
      integer EthIfSetControllerModeTimeout [0..1]: 0..1000000, set at pre-compile, origin=Vector Informatik, default-value=1000  # Set Controller Mode Timeout | This parameter defines the maximum number of clock cycles to wait for the Eth driver to set its controller mode to ACTIVE. This parameter is CPU clock dependent. Please take this into consideration when chossing the value for this parameter.
  bsw implementation EthIf_Impl: programming-language=C, sw-version=17.02.00, used-code-generator=DaVinci Configurator, vendor-id=30, ar-release-version=4.9.0, behavior=EthIfBehavior, preconfigured-configuration=EthIf_Pre, recommended-configuration=EthIf_Rec, vendor-specific-module-def=EthIf
  module config EthIf_Pre: definition=EthIf
  module config EthIf_Rec: definition=EthIf
