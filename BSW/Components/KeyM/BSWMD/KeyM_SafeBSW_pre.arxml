AUTOSAR XML (schema 00046)
# COPYRIGHT
# Copyright (c) 2024 by Vector Informatik GmbH. All rights reserved.
# This software is copyright protected and proprietary to Vector Informatik GmbH.
# Vector Informatik GmbH grants to you only those rights as set out in the license conditions.
package /MICROSAR
  module config KeyM_Rec: definition=KeyM  # KeyM recommended configuration
    KeyMGeneral: KeyMSafeBswChecks=1
