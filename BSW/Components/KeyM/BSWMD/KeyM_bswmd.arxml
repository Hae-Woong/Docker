AUTOSAR XML (schema 00046)
# COPYRIGHT
# Copyright (c) 2024 by Vector Informatik GmbH. All rights reserved.
# This software is copyright protected and proprietary to Vector Informatik GmbH.
# Vector Informatik GmbH grants to you only those rights as set out in the license conditions.
package /MICROSAR
  module definition KeyM [0..1]: category=VENDOR_SPECIFIC_MODULE_DEFINITION, refined-module-def=KeyM, variants pre-compile  # The Key Manager (KeyM) module is separated into two sub modules, the crypto key submodule and the certificate submodule. The certificate submodule provides services for different operations on certificates. The crypto key submodule provides services to introduce or update pre-defined cryptographic key material. #Security #Certificate #AUTOSAR #ServiceComponent
    container KeyMCertificate [1..65535]: multiplicity set at pre-compile  # This container contains the certificate configuration.
      enumeration KeyMCertAlgorithmType: {ECC, RSA}, multiplicity set at pre-compile, set at pre-compile, default-value=ECC  # Specifies the algorithm of the public key contained in this certificate. Note: The algorithm used by the issuer to sign this certificate is defined through the configured algorithm type of the corresponding issuer certificate, defined by KeyMCertUpperHierarchicalType. In case of a dynamic issuer type, the algorithm used by the issuer to sign this certificate is equal to the algorithm of the public key contained in this certificate.
      enumeration KeyMCertFormatType: {CRL, CVC, X509, AC}, multiplicity set at pre-compile, set at pre-compile, default-value=X509  # Specify in which format the certificate will be provided. X509 - PublicKey Infrastructure Certificate (according to RFC-5280) CRL - Certificate Revocation List (according to RFC-5280) CVC - Card Verifiable Certificate (according to BSI TR-03110) AC - Attribute Certificate (according to RFC-5755)
      integer KeyMCertificateId: 0..65535, multiplicity set at pre-compile, set at pre-compile, symbolic-name-value=true, default-value=0  # Identifier of the certificate. The set of configured identifiers shall be consecutive and gapless.
      integer KeyMCertificateMaxLength: 1..65535, multiplicity set at pre-compile, set at pre-compile, default-value=1200  # Specifies the maximum length in bytes of the certificate.
      string KeyMCertificateName: multiplicity set at pre-compile, set at pre-compile, default-value=KeyMCertificate, max-length=255, min-length=1  # Provides an unique name of the certificate for identification. The certificate provisional will reference certificates by this unique name.
      function name KeyMCertificateVerifyCallbackNotificationFunc [0..1]: multiplicity set at pre-compile, set at pre-compile, default-value=Appl_KeyMCertificateVerifyCallbackNotification, min-length=1  # This parameter provides the function name for the callback <KeyM_CertificateVerifyCallbackNotification>. It indicates if a certificate verification operation was finished and provides its status. If this parameter is omitted, no callback will be provided.
      function name KeyMServiceCertificateCallbackNotificationFunc [0..1]: multiplicity set at pre-compile, set at pre-compile, default-value=Appl_KeyMServiceCertificateCallbackNotification, min-length=1  # This parameter provides the function name for the service certificate callback <KeyM_ServiceCertificateCallbackNotification>. It indicates if a certificate service operation was finished and provides its status. If this parameter is not set, no callback will be provided.
      enumeration KeyMCertificateStorage: {KEYM_STORAGE_IN_CSM, KEYM_STORAGE_IN_NVM, KEYM_STORAGE_IN_RAM, KEYM_STORAGE_IN_ROM, KEYM_STORAGE_REMOTE}, multiplicity set at pre-compile, origin=Vector Informatik, set at pre-compile, default-value=KEYM_STORAGE_IN_RAM  # Specifies the storage location of the certificate.
      function name KeyMCertificateSetKeyCalloutFunc [0..1]: multiplicity set at pre-compile, origin=Vector Informatik, set at pre-compile, default-value=Appl_KeyMCertificateSetKeyCallout, min-length=1  # This parameter can be configured if the KeyM does not provide the required public key parsing. If a callout is configured, the callout will be called to set the public key of the certificate. The callout is only required if the key format is not supported by the KeyM.
      enumeration KeyMCertAlgorithmFamily: {ECDSA, EDDSA, RSA}, multiplicity set at pre-compile, origin=Vector Informatik, set at pre-compile, default-value=ECDSA  # Specifies which algorithm family will be used for certificate verification.
      function name KeyMCertificateGetCurrentTimeCalloutFunc [0..1]: multiplicity set at pre-compile, origin=Vector Informatik, set at pre-compile, default-value=Appl_KeyMCertificateGetCurrentTimeCalloutFunc, min-length=1  # This parameter can be configured if the StbM is not used for providing a current timestamp. If a callout is configured, the callout will be called to get the current time. The callout is only required if StbM shall not be used.
      boolean KeyMCertUsePort: multiplicity set at pre-compile, origin=Vector Informatik, set at pre-compile, default-value=false  # Specifies whether RTE interfaces are needed for this particular certificate.
      enumeration KeyMCertStartUpHandling: {NONE, PARSE_AND_TRUST, PARSE_AND_VERIFY}, multiplicity set at pre-compile, origin=Vector Informatik, set at pre-compile, default-value=NONE  # Specifies the type of startup handling. The startup handling for a given certificate is disabled per default (NONE). It allows parsing and verifying certain certificates (PARSE_AND_VERIFY). Furthermore, if the permanent certificate storage is unaltered, it is also possible to only parse and skip the verification operation (PARSE_AND_TRUST).
      enumeration KeyMCertUpperHierarchicalType: {PRESET_ISSUER, DYNAMIC_MANDATORY_ISSUER, DYNAMIC_SELFSIGNED_OR_MANDATORY_ISSUER, DYNAMIC_OPTIONAL_ISSUER}, multiplicity set at pre-compile, origin=Vector Informatik, set at pre-compile, default-value=PRESET_ISSUER  # Specify the issuer relation of a certificate. PRESET_ISSUER - Relation is given by the configuration parameter KeyMCertUpperHierarchicalCertRef DYNAMIC_MANDATORY_ISSUER - Issuer is determined dynamically during runtime. If issuer is not found or not valid, certificate becomes invalid. DYNAMIC_SELFSIGNED_OR_MANDATORY_ISSUER - Issuer is determined dynamically during runtime. Certificate handling is same as DYNAMIC_MANDATORY_ISSUER, however certificate can be also self-signed. DYNAMIC_OPTIONAL_ISSUER - Issuer is determined dynamically during runtime. If issuer is not found and certificate is not self-signed, validation is skipped. A certificate with dynamic issuer has to be assigned to a certificate group. Dynamic issuers are only searched within the certificate's group and can be configured as additional issuers in the group.
      boolean KeyMCertAllowUnconfiguredElements: multiplicity set at pre-compile, origin=Vector Informatik, set at pre-compile, default-value=true  # Specifies whether the ASN.1 parser shall skip unsupported or unconfigured certificate elements. This allows to set certificates which are not fully configured. If disabled all elements need to be configured.
      boolean KeyMCertAllowFlexibleElementOrder: multiplicity set at pre-compile, origin=Vector Informatik, set at pre-compile, default-value=true  # Specifies whether the ASN.1 parser shall parse the configured certificate elements in a flexible order. If this feature is disabled, the certificate data is parsed according to the configured element order.
      integer KeyMRemoteCertificateId [0..1]: 0..65535, multiplicity set at pre-compile, origin=Vector Informatik, set at pre-compile, default-value=0  # Identifier of the certificate on remote side. The parameter value is set by the generated preconfiguration based on the remote configuration.
      multiline string KeyMValidatorCertValue [0..1]: multiplicity set at pre-compile, origin=Vector Informatik, set at pre-compile, default-value=0  # Certificate value which will be used to validate current certificate confguration and provide additional configuration hints. The certificate can be provided in the form of comma- or space-separated decimal or hexadecimal byte values (hexadecimal bytes should be prefixed with 0x). The validator will check the configuration parameters for certificate format, algorithm family, algorithm type and certificate max length on KeyMCertificate level. In addition, the certificate elements will be validated on KeyMCertificateElement level including the certificate element max length, the structure type, the object type, and the object identifier. The proposed certificate element max length is derived from the actual certificate element length. Therefore, it is possible that additional adjustment of this parameter is needed if different element lengths shall be supported. The validator currently only supports X509 certificates. Other formats, such as CVC or CRL, will produce a validation error. For certificate extensions, the validator checks only the object identifier. Hence, when creating certificate elements for extensions via solving actions, the primitive ASN.1 elements of the extensions will be not included. These primitive ASN.1 elements need to be added manually if they are required and shall be retrievable. When using the validator, make sure that the switches KeyMCertAllowFlexibleElementOrder and KeyMCertAllowUnconfiguredElements are enabled. Both switches are enabled by default.
      enumeration KeyMCertificateSwcInterfaceVersion: {KEYM_SWCVER_ASR_4_4_0_A, KEYM_SWCVER_ASR_4_4_0_B, KEYM_SWCVER_ASR_R21_11, KEYM_SWCVER_ASR_R22_11}, multiplicity set at pre-compile, origin=Vector Informatik, set at pre-compile, default-value=KEYM_SWCVER_ASR_R22_11  # Specifies the interface version that the Client-Server-Interfaces of this KeyMCertificate and its KeyMCertificateElements key should adhere to. Only relevant if this KeyMCertificate's KeyMCertUsePort parameter is set to TRUE. ========================= Values ========================= KEYM_SWCVER_ASR_4_04_A --------------------------------------------------- SWC interface adheres to the AUTOSAR 4.4.0 specification with the following deviations: - Interface KeyMCertificateNotification's operation ServiceCertificateCallbackNotification uses KeyM_const_CryptoKeyDataType (const uint8*) instead of KeyM_CryptoKeyDataType (uint8*) for parameter ResultData - Interface KeyMCertificateElement uses error code KEYM_E_KEY_CERT_INVALID instead of KEYM_E_CERT_INVALID KEYM_SWCVER_ASR_4_04_B --------------------------------------------------- SWC interface adheres to the AUTOSAR 4.4.0 specification with the following deviations: - Interface KeyMCertificateNotification's operation ServiceCertificateCallbackNotification uses KeyM_const_CryptoKeyDataType (const uint8*) instead of KeyM_CryptoKeyDataType (uint8*) for parameter ResultData KEYM_SWCVER_ASR_R21_11 --------------------------------------------------- SWC interface adheres to the AUTOSAR R21-11 specification with the following deviations: - Interface KeyMCertificate_{KeyMCertificate}: - Operation GetCertificate: - Parameter Certificate uses direction INOUT instead of OUT - Data Type KeyM_CertDataType of parameter Certificate uses data type KeyM_CertDataPointerType (uint8 Data Reference) instead of VoidPtr for member certData - Operation SetCertificate: - Data Type KeyM_CertDataType of parameter Certificate uses data type KeyM_CertDataPointerType (uint8 Data Reference) instead of VoidPtr for member certData - Interface KeyMCertificateNotification: - Operation ServiceCertificateCallbackNotification uses KeyM_const_CryptoKeyDataType (const uint8*) instead of KeyM_CryptoKeyDataType (uint8*) for parameter ResultData KEYM_SWCVER_ASR_R22_11 --------------------------------------------------- SWC interface adheres to the AUTOSAR R22-11 specification with the following deviations: - Interface KeyMCertificate_{KeyMCertificate}: - Operation GetCertificate: - Parameter Certificate uses direction INOUT instead of OUT - Data Type KeyM_CertDataType of parameter Certificate uses data type KeyM_CertDataPointerType (uint8 Data Reference) instead of VoidPtr for member certData - Operation SetCertificate: - Data Type KeyM_CertDataType of parameter Certificate uses data type KeyM_CertDataPointerType (uint8 Data Reference) instead of VoidPtr for member certData - Interface KeyMVerifyCertificateNotification: - Operation ServiceCertificateCallbackNotification does not exist (ServiceCertificate callback uses interface KeyMServiceCertificateNotification) - Operation "{ecuc(KeyM/KeyMGeneral/KeyMServiceCertificateFunctionEnabled)} == true" uses the name "VerifyNotification" instead - Interface KeyMServiceCertificate: - Parameters ResponseData and ResponseDataLength of operation ServiceCertificate use direction IN instead of OUT - Interface KeyMServiceCertificateByCertId: - Parameters ResponseData and ResponseDataLength of operation ServiceCertificateByCertId use direction IN instead of OUT
      enumeration KeyMCertHashType [0..1]: {CERT, PUBKEY}, multiplicity set at pre-compile, origin=Vector Informatik, set at pre-compile, default-value=CERT  # Specifies over which part of the certificate the hash is calculated. CERT: The hash is calculated over the complete certificate. PUBKEY: The hash is caluclated over the subjectPublicKey value of the certificate.
      reference KeyMCertCertificateElementRuleRef [0..65535]: multiplicity set at pre-compile, set at pre-compile, destination=KeyMCertificateElementRule  # Reference to certificate element rules which should be verified within the certification validation step. Parameter not used.
      reference KeyMCertCsmSignatureVerifyJobRef: multiplicity set at pre-compile, set at pre-compile, requires-symbolic-name-value=true, destination=CsmJob  # Reference to the CSM job that is used to verify the signature. If remote storage type is configured, this parameter references an AEAD Decrypt CSM job that is used to transfer a remote service request. Please ensure that the used CSM job primitive is set to the AEAD Decrypt primitive provided by the custom Crypto driver. Configurational Hint: Please use separate CSM jobs for each certificate.
      reference KeyMCertCsmSignatureVerifyKeyRef [0..1]: multiplicity set at pre-compile, set at pre-compile, requires-symbolic-name-value=true, destination=CsmKey  # References to the CSM key associated to the CSM signature verify job. This parameter is set automatically to the CSM key referenced in the CSM signature verify job. If remote storage type is configured, this parameter references a CSM key that is used to transfer a remote service request. Configurational Hint: Please use separate CSM keys for each certificate. | If this configuration option is present, the public key of the certificate will be placed into this key and its element (No. #1) to store the key.
      reference KeyMCertPrivateKeyStorageCryptoKeyRef [0..1]: multiplicity set at pre-compile, set at pre-compile, destination=KeyMCryptoKey  # Defines a storage location of the private key of a certificate. Parameter not used.
      reference KeyMCertTimebaseRef [0..1]: multiplicity set at pre-compile, set at pre-compile, requires-symbolic-name-value=true, destination=StbMSynchronizedTimeBase  # This is a reference to an StbM time base to validate the validity period. Alternatively, KeyMCertificateElementVerification with the KeyMCertificateElement of CertificateValidityPeriodNotBefore or CertificateValidityPeriodNotAfter could be used.
      reference KeyMCertUpperHierarchicalCertRef: multiplicity set at pre-compile, set at pre-compile, destination=KeyMCertificate  # Identifier of the certificate that is the next higher in the PKI hierarchical structure. For root certificate, this reference should point to the root certificate itself.
      reference KeyMCertificateCsmKeyTargetRef [0..1]: multiplicity set at pre-compile, origin=Vector Informatik, set at pre-compile, requires-symbolic-name-value=true, destination=CsmKey  # Defines a reference to the associated CSM Certificate that shall be stored. This parameter is mandatory if CSM key storage is configured in KeyMCertificateStorage. Configurational Hint: Please use separate CSM keys for each certificate.
      reference KeyMCertCsmSignatureGenerateJobRef [0..1]: multiplicity set at pre-compile, origin=Vector Informatik, set at pre-compile, requires-symbolic-name-value=true, destination=CsmJob  # Reference to the CSM job that is used to generate a signature for a certificate signing request. This parameter has to be set only if a certificate signing request shall be performed for the corresponding certificate.
      reference KeyMCertCsmHashJobRef [0..1]: multiplicity set at pre-compile, origin=Vector Informatik, set at pre-compile, destination=CsmJob  # Reference to the CSM job that is used to compute a hash over the certificate data.
      reference KeyMCertificateSlotRef [0..1]: multiplicity set at pre-compile, origin=Vector Informatik, set at pre-compile, destination=KeyMCertificateSlot  # This is a reference to a certificate slot.
      reference KeyMCertAttributeHolderCertRef [0..1]: multiplicity set at pre-compile, origin=Vector Informatik, set at pre-compile, destination=KeyMCertificate  # Identifier of the attribute certificate (AC) holder. This parameter is only enabled for attribute certificates with the certificate format type AC.
      container KeyMCertificateElement [1..65535]: multiplicity set at pre-compile  # This container contains the certificate element configuration.
        boolean KeyMCertificateElementHasIteration: multiplicity set at pre-compile, set at pre-compile, default-value=false  # Defines if the certificate element can occur more than one time. If so, the iterator can be used to retrieve the individual data values of this certificate element.
        integer KeyMCertificateElementId: 0..65535, multiplicity set at pre-compile, set at pre-compile, symbolic-name-value=true, default-value=0  # Identifier of a certificate element.
        integer KeyMCertificateElementMaxLength: 1..65535, multiplicity set at pre-compile, set at pre-compile, default-value=1  # Maximum length in bytes
        string KeyMCertificateElementObjectId [0..1]: multiplicity set at pre-compile, set at pre-compile  # This is the object identifier (OID) that is used to identify the certificate element within its element structure.
        integer KeyMCertificateElementObjectType [0..1]: 0..255, multiplicity set at pre-compile, set at pre-compile  # Certificate elements are stored in ASN.1 format. In this item the ASN.1 tag identifier can be specified. This can be used to identify only such certificate elements. If the type is different, the element is not included in the search. The following list shows the supported universal primitive ASN.1 tags and the corresponding object types: Boolean - 0x01 Integer - 0x02 Bit String - 0x03 Octet String - 0x04 NULL - 0x05 Object Id - 0x06 Enumerated - 0x0A UTF8 - 0x0C Printable String - 0x13 IA5 String - 0x16 UTC Time - 0x17 Generalized Time - 0x18 BMPString - 0x1E Please refer to the Technical Reference for further details on how to configure the object type for CVC certificates. In order to configure variant time formats (Generalized Time, UTC) for a time stamp element (notBefore, notAfter field), only one certificate element must be configured. The object type can be configured to either 0x17 for UTC or 0x18 for GeneralizedTime. KeyM accepts both object types, no matter what the actual time format in the certificate data is. | If KeyMCertificateElementObjectType is not specified, any ASN.1 encoding datatype is used to read the value.
        enumeration KeyMCertificateElementOfStructure: {CertificateExtension, CertificateIssuerName, CertificateIssuerUniqueIdentifier, CertificateSerialNumber, CertificateSignature, CertificateSignatureAlgorithm, CertificateSignatureAlgorithmID, CertificateSubjectName, CertificateSubjectPublicKeyInfo_PublicKeyAlgorithm, CertificateSubjectPublicKeyInfo_SubjectPublicKey, CertificateSubjectUniqueIdentifier, CertificateValidityPeriodNotAfter, CertificateValidityPeriodNotBefore, CertificateVersionNumber, CertificateSubjectAuthorization, RevokedCertificates, CertificateRevocationList, CertificateAttributeHolder, CertificateAttribute}, multiplicity set at pre-compile, set at pre-compile  # This defines in which structure the certificate element is located.
        boolean KeyMCertificateElementOptional: multiplicity set at pre-compile, origin=Vector Informatik, set at pre-compile, default-value=false  # This defines if the certificate element is optional and is skipped during parsing.
        function name KeyMCertificateElementVerificationCalloutFunc [0..1]: multiplicity set at pre-compile, origin=Vector Informatik, set at pre-compile, default-value=Appl_CertificateElementVerificationCallout, min-length=1  # If this parameter is configured the function will be called for element verification. The same callout can be used for severall elements.
        string KeyMCertificateElementPath [0..1]: multiplicity set at pre-compile, origin=Vector Informatik, set at pre-compile  # This is the certificate element path that is used to specify the position of the configured certificate sub-element within its basic element structure. The path is based on the outer ASN.1 sequence element of the basic element structure. The certificate element path is configured in chapters so that each chapter corresponds to a nesting level within the ASN.1 sequence. Chapters are specified with decimal integers and dots inbetween subchapters. Exemplary configuration of the element path for an INTEGER within a SEQUENCE: 1.2.1 SEQUENCE { OBJECT IDENTIFIER, OCTET STRING { INTEGER, } }
        boolean KeyMCertificateElementSuppressPort: multiplicity set at pre-compile, origin=Vector Informatik, set at pre-compile, default-value=false  # Specifies whether this CertificateElement's Service Port shall be suppressed. If it is set to TRUE, no Service Port is generated for this KeyMCertificateElement. Suppressing unused CertificateElement ports can facilitate SWC configuration in DaVinci Developer and reduce the amount of generated functions that need to be reviewed in ASIL use-cases. This parameter is only relevant if the parent KeyMCertificate's KeyMCertUsePort parameter is set to TRUE.
      container KeyMNvmBlock [0..1]: multiplicity set at pre-compile  # Configuration of optional usage of Nvm in case the KeyM module requires non volatile memory in the Ecu to store information (e.g. crypto keys or certificates).
        enumeration KeyMCertNvBlockProcessing: {IMMEDIATE, DEFERRED}, multiplicity set at pre-compile, origin=Vector Informatik, set at pre-compile, default-value=IMMEDIATE  # Set the block processing type. DEFERRED: write block will not be triggered by the KeyM. The block needs to be written manually and configured to be written on shutdown. Use this setting to prevent inconsistencies when updating certificate chains. IMMEDIATE: write block will be triggered by the KeyM when a valid certificate is set.
        reference KeyMNvmBlockDescriptorRef: scope=ECU, multiplicity set at pre-compile, origin=Vector Informatik, set at pre-compile, requires-symbolic-name-value=true, destination=NvMBlockDescriptor  # Reference to the Nvm block description in the Nvm module configuration.
      choice container KeyMCertInit [0..1]: multiplicity set at pre-compile  # This optional choice container contains the configuration of the initial certificate data.
        container KeyMCertInitValue [0..1]: multiplicity set at pre-compile  # This container contains the configuration of an initial value for the certificate data.
          string KeyMCertInitValue: multiplicity set at pre-compile, origin=Vector Informatik, set at pre-compile, default-value=0  # Value which will be used to set the certificate data during initialization for a given certificate.
        container KeyMCertInitCallout [0..1]: multiplicity set at pre-compile  # This container contains the configuration of a callout function to initialize the certificate data.
          function name KeyMCertInitCallout: multiplicity set at pre-compile, origin=Vector Informatik, set at pre-compile, default-value=Appl_KeyMCertificateCertInitCalloutFunc  # Callout function which will be used to set the certificate data during initialization for a given certificate.
      container KeyMOCSP [0..1]: multiplicity set at pre-compile  # This container contains configuration of OCSP revocation state handling.
        reference KeyMOCSPDelegatedResponderRef [0..1]: multiplicity set at pre-compile, origin=Vector Informatik, set at pre-compile, destination=KeyMCertificateGroup  # Reference to certificate group for delegated certificates to verify OCSP response. The responder may include certificates in the Certs field of BasicOCSPResponse that help verify the responder's signature (RFC6090). Those certificates shall be installed in the referenced certificate group.
        reference KeyMOCSPResponseCertIdHashCsmJobRef: multiplicity set at pre-compile, origin=Vector Informatik, set at pre-compile, requires-symbolic-name-value=true, destination=CsmJob  # Reference to the CSM job that is used to compute a hash over the issuer's public key and issuer's distinguished name of the certificate which is checked for revocation using OCSP. The computed hashes correspond to the CertId field of a BasicOCSPResponse (RFC6090).
        reference KeyMOCSPResponderPubKeyHashCsmJobRef [0..1]: multiplicity set at pre-compile, origin=Vector Informatik, set at pre-compile, requires-symbolic-name-value=true, destination=CsmJob  # Optional reference to the CSM job that is used to compute a hash over the public key of the signing certificate of the OCSP response. The computed hash corresponds to the ResponderId field of a BasicOCSPResponse (RFC6090). Use this reference only if the signing certificate of the OCSP Response is identified by its public key. According to RFC6090, the used hash algorithm for the responder's public key in the ResponderId structure shall be SHA1.
    container KeyMCertificateElementVerification [0..65535]: multiplicity set at pre-compile  # This container defines if and how certificate elements are to be verified. Container not used.
      container KeyMCertificateElementCondition [1..*]: multiplicity set at pre-compile  # This container contains the configuration of KeyElement compare conditions which can be used as arguments for a KeyMCertificateElementRule. Parameter not used. | One KeyMCertificateElementCondition shall contain either one KeyMCertificateElementSwcCallback or one KeyMCertificateElementSwcSRDataElementRef or one KeyMCertificateElementSwcSRDataElementValueRef.
        enumeration KeyMCertElementConditionType: {KEYM_EQUALS, KEYM_EQUALS_NOT, KEYM_GREATER_OR_EQUAL, KEYM_LESS_OR_EQUAL, KEYM_LESS_THAN}, multiplicity set at pre-compile, set at pre-compile  # This parameter specifies what kind of comparison that is made for the evaluation of the mode condition. Parameter not used.
        reference KeyMCertificateElementRef [0..1]: multiplicity set at pre-compile, set at pre-compile, destination=KeyMCertificateElement  # Reference to a certificate element used for the condition. Parameter not used.
        container KeyMCertificateElementConditionValue: multiplicity set at pre-compile  # This container contains the configuration of a compare value. Parameter not used.
          container KeyMCertificateElementConditionArray [0..1]: multiplicity set at pre-compile  # This container contains the configuration of a array compare value. Parameter not used.
            container KeyMCertificateElementConditionArrayElement [0..*]: multiplicity set at pre-compile  # This container contains the configuration of an array compare value. Parameter not used.
              integer KeyMCertificateElementConditionArrayElementIndex: 0..65535, multiplicity set at pre-compile, set at pre-compile, default-value=0  # Index to an element of the compare value array. Parameter not used.
              integer KeyMCertificateElementConditionArrayElementValue: 0..18446744073709551615, multiplicity set at pre-compile, set at pre-compile, default-value=0  # Value of an array element compare value. Parameter not used.
          container KeyMCertificateElementConditionCerificateElement [0..1]: multiplicity set at pre-compile  # This container contains the configuration of a certificate element as a compare value. Parameter not used.
            reference KeyMCertificateElementRef: multiplicity set at pre-compile, set at pre-compile, destination=KeyMCertificateElement  # Reference to another certificate element. Parameter not used.
          container KeyMCertificateElementConditionPrimitive [0..1]: multiplicity set at pre-compile  # This container contains the configuration of a primitive compare value. Parameter not used.
            integer KeyMCertificateElementConditionPrimitiveValue: 0..18446744073709551615, multiplicity set at pre-compile, set at pre-compile, default-value=0  # Primitive compare value Parameter not used.
          container KeyMCertificateElementConditionSenderReceiver [0..1]: multiplicity set at pre-compile  # This container contains the configuration of a dynamic compare value in a sender-/receiver interface. Parameter not used.
            instance reference KeyMCertificateElementConditionSenderReceiver: multiplicity set at pre-compile, set at pre-compile, destination-context=ROOT-SW-COMPOSITION-PROTOTYPE SW-COMPONENT-PROTOTYPE PORT-PROTOTYPE, destination-type=AUTOSAR-DATA-PROTOTYPE  # This parameter references a mode in a particular mode request port of a software component that is used for the condition. Parameter not used.
      container KeyMCertificateElementRule [1..*]: multiplicity set at pre-compile  # This container contains the configuration of a mode rule which represents a logical expression with KeyMCertificateElementCondition or other KeyMCertificateElementRule as arguments. Parameter not used. | All arguments are processed with the operator defined by KeyMLogicalOperator, for instance: Argument_A AND Argument_B AND Argument_C.
        enumeration KeyMLogicalOperator [0..1]: {KEYM_AND, KEYM_OR}, multiplicity set at pre-compile, set at pre-compile  # This parameter specifies the logical operator to be used in the logical expression. If the expression only consists of a single condition this parameter shall not be used. Parameter not used.
        choice reference KeyMArgumentRef [1..*]: multiplicity set at pre-compile, set at pre-compile, destination=[KeyMCertificateElementCondition, KeyMCertificateElementRule]  # This is a choice reference either to a condition or another rule serving as sub-expression. Parameter not used.
    container KeyMCryptoKey [0..65535]: multiplicity set at pre-compile  # This container contains the crypto keys that can be updated. Container not used.
      enumeration KeyMCryptoCsmVerifyJobType [0..1]: {KEYM_VERIFY_AEADDECRYPT, KEYM_VERIFY_AEADENCRYPT, KEYM_VERIFY_DECRYPT, KEYM_VERIFY_ENCRYPT, KEYM_VERIFY_MACGENERATE, KEYM_VERIFY_MACVERIFY}, multiplicity set at pre-compile, set at pre-compile  # Specifies what type of function for key verification operation is used. Parameter not used.
      string KeyMCryptoKeyCryptoProps [0..1]: multiplicity set at pre-compile, set at pre-compile  # If set, it will provide additional hints to the crypto key that is used by KeyM to identify the key. Parameter not used. | Typical approach is to set the value to the SHE-Slot ID where the key was placed to. If present, the KeyM will take the information and identify the key by its slot ID. The slot information will be extracted from the corresponding field of the M1M2M3 data.
      string KeyMCryptoKeyGenerationInfo [0..1]: multiplicity set at pre-compile, set at pre-compile  # This data may contain static data for key derivation. If a key is configured to be derived from another key and this configuration item is set, the data will be added as salt. Parameter not used.
      enumeration KeyMCryptoKeyGenerationType: {KEYM_DERIVED_KEY, KEYM_STORED_KEY}, multiplicity set at pre-compile, set at pre-compile  # Specifies how the CryptoKey will be generated. If it is derived from another key or simply stored with KeyElementSet. Parameter not used.
      integer KeyMCryptoKeyId: 0..65535, multiplicity set at pre-compile, set at pre-compile, symbolic-name-value=true, default-value=0  # Identifier of the crypto key. The set of configured identifiers shall be consecutive and gapless. Parameter not used.
      integer KeyMCryptoKeyMaxLength: 1..4294967295, multiplicity set at pre-compile, set at pre-compile, default-value=1  # The maximum size in bytes of a CryptoKey. Parameter not used.
      string KeyMCryptoKeyName: multiplicity set at pre-compile, set at pre-compile  # Provides a unique name of the key for identification. The key master will reference keys by this unique key name. Parameter not used.
      enumeration KeyMCryptoKeyStorage: {KEYM_STORAGE_IN_CSM, KEYM_STORAGE_IN_NVM, KEYM_STORAGE_IN_RAM}, multiplicity set at pre-compile, set at pre-compile  # Specify the storage location of the certificate. Parameter not used.
      reference KeyMCryptoKeyCsmKeySourceDeriveRef [0..1]: multiplicity set at pre-compile, set at pre-compile, requires-symbolic-name-value=true, destination=CsmKey  # Defines a reference to the associated CSM key that is used as source for the key derivation of this key. Parameter not used.
      reference KeyMCryptoKeyCsmKeyTargetRef: multiplicity set at pre-compile, set at pre-compile, requires-symbolic-name-value=true, destination=CsmKey  # Defines a reference to the associated CSM key that shall be generated. Parameter not used.
      reference KeyMCryptoKeyCsmVerifyJobRef [0..1]: multiplicity set at pre-compile, set at pre-compile, requires-symbolic-name-value=true, destination=CsmJob  # Defines the crypto job that the key verify function can use for verification of a certain key. Parameter not used.
      container KeyMNvmBlock [0..1]: multiplicity set at pre-compile  # Configuration of optional usage of Nvm in case the KeyM module requires non volatile memory in the Ecu to store information (e.g. crypto keys or certificates). Parameter not used.
        reference KeyMNvmBlockDescriptorRef [0..1]: scope=ECU, multiplicity set at pre-compile, set at pre-compile, requires-symbolic-name-value=true, destination=NvMBlockDescriptor  # Reference to the Nvm block description in the Nvm module configuration. Parameter not used.
    container KeyMGeneral: multiplicity set at pre-compile  # This container holds general configuration (parameters) for key manager.
      integer KeyMCertificateChainMaxDepth: 1..255, multiplicity set at pre-compile, set at pre-compile, default-value=5  # Maximum number of certificates defined in a certificate chain.
      boolean KeyMCertificateManagerEnabled: multiplicity set at pre-compile, set at pre-compile, default-value=false  # Enables (TRUE) or disables (FALSE) the part that manages certificates.
      boolean KeyMCryptoKeyHandlerPrepareEnabled: multiplicity set at pre-compile, set at pre-compile, default-value=false  # Enables (TRUE) or disables (FALSE) the key handler prepare function call. If set to true, the corresponding key handler function shall be provided. Parameter not used.
      boolean KeyMCryptoKeyHandlerServiceCertificateEnabled: multiplicity set at pre-compile, set at pre-compile, default-value=false  # Enables (TRUE) or disables (FALSE) the key handler service function call. If set to true, the certificate submodule function KeyM_KH_ServiceCertificate() shall be provided. Parameter not used.
      boolean KeyMCryptoKeyHandlerStartFinalizeEnabled: multiplicity set at pre-compile, set at pre-compile, default-value=false  # Enables (TRUE) or disables (FALSE) the key handler start and finalize function call. If set to true, the key handler functions KeyM_KH_Start() and KeyM_KH_Finalize() shall be provided. Parameter not used.
      boolean KeyMCryptoKeyHandlerUpdateEnabled: multiplicity set at pre-compile, set at pre-compile, default-value=false  # Enables (TRUE) or disables (FALSE) the call to the key handler update function KeyM_KH_Update(). If set to true, the corresponding key handler function shall be provided. Parameter not used.
      boolean KeyMCryptoKeyHandlerVerifyEnabled: multiplicity set at pre-compile, set at pre-compile, default-value=false  # Enables (TRUE) or disables (FALSE) the call to the key handler verify function KeyM_KH_Verify(). If set to true, the corresponding key handler function shall be provided. Parameter not used.
      boolean KeyMCryptoKeyManagerEnabled: multiplicity set at pre-compile, set at pre-compile, default-value=false  # Enables (TRUE) or disables (FALSE) the part that manages crypto key operations. Crypto key submodule is not supported.
      boolean KeyMCryptoKeyPrepareFunctionEnabled [0..1]: multiplicity set at pre-compile, set at pre-compile, default-value=false  # Enables (TRUE) or disables (FALSE) the prepare function of the key manager. If set to true, the KeyM_Prepare() function has to be called accordingly. Crypto key submodule is not supported.
      boolean KeyMCryptoKeyStartFinalizeFunctionEnabled [0..1]: multiplicity set at pre-compile, set at pre-compile, default-value=false  # Enables (TRUE) or disables (FALSE) the start and Finish function of the key manager. If set to true, the KeyM_Start() and KeyM_Finalize() functions have to be called. Crypto key submodule is not supported.
      boolean KeyMCryptoKeyVerifyAsyncMode [0..1]: multiplicity set at pre-compile, set at pre-compile, default-value=false  # This parameter defines if the function KeyM_Verify() runs in synchronous or asynchronous mode Crypto key submodule is not supported.
      boolean KeyMCryptoKeyVerifyFunctionEnabled [0..1]: multiplicity set at pre-compile, set at pre-compile, default-value=false  # Enables (TRUE) or disables (FALSE) the verify function of the key manager. If set to true, the KeyM_Verify() function can be called. Crypto key submodule is not supported.
      boolean KeyMDevErrorDetect: multiplicity set at pre-compile, set at pre-compile, default-value=true  # Switches the development error detection and notification on or off. | - true: detection and notification is enabled. - false: detection and notification is disabled.
      integer KeyMKeyCertNameMaxLength: 1..255, multiplicity set at pre-compile, set at pre-compile, default-value=1  # Maximum length in bytes of certificate or key names used for the service interface.
      float KeyMMainFunctionPeriod: 0..1.7976931348623157E+308, multiplicity set at pre-compile, set at pre-compile, default-value=0.01  # Specifies the period of main function KeyM_MainFunction in seconds.
      boolean KeyMServiceCertificateFunctionEnabled [0..1]: multiplicity set at pre-compile, set at pre-compile, default-value=false  # Enables (TRUE) or disables (FALSE) the certificate service function of the key manager. If set to true, the KeyM_ServiceCertificate() function has to be called accordingly.
      boolean KeyMVersionInfoApi: multiplicity set at pre-compile, origin=Vector Informatik, set at pre-compile, default-value=false  # Pre-processor switch to enable and disable availability of the API KeyM_GetVersionInfo(). True: API KeyM_GetVersionInfo() is available False: API KeyM_GetVersionInfo() is not available.
      string KeyMNvWriteBlockFctName: multiplicity set at pre-compile, origin=Vector Informatik, set at pre-compile, default-value=NvM_WriteBlock, min-length=1  # This function is called by the KeyM to write a Nv Block.
      string KeyMCustomIncludeFiles [0..*]: multiplicity set at pre-compile, origin=Vector Informatik, set at pre-compile, min-length=3  # Include custom header files.
      integer KeyMParseMaxNestingLevel: 7..100, multiplicity set at pre-compile, origin=Vector Informatik, set at pre-compile, default-value=20  # Defines the maximum nesting depth of ASN.1 structures within configured certificates. Warning: A high maximum nesting depth leads to increased stack usage.
      boolean KeyMCertificateSigningRequestEnabled: multiplicity set at pre-compile, origin=Vector Informatik, set at pre-compile, default-value=false  # Enables (TRUE) or disables (FALSE) both services (KEYM_SERVICE_CERT_REQUEST_CSR and KEYM_SERVICE_CERT_UPDATE_SIGNED_CSR) related to a certificate signing request within the key manager.
      string KeyMRemotePreconfigDestination [0..1]: multiplicity set at pre-compile, origin=Vector Informatik, set at pre-compile, default-value=$(GenDataFolder)/KeyMPreconfig/KeyM_bswmd_Pre.arxml, min-length=3  # When this parameter is instantiated, the KeyM on remote side will generate a Pre-Config file for the application side which can be used to synchronize the configurations between remote and application side. With this parameter, the target folder and filename of the generated Pre-Config file can be influenced. The Pre-Config file contains the certificate configurations for the application side. Specify the path to the file e.g.: - C:\Vector\KeyM\KeyM_bswmd_Pre.arxml - $(DpaProjectFolder)\Config\KeyMPreConfig\KeyM_bswmd_Pre.arxml The DaVinci Configurator variables can be used as placeholder to form the path. Attention: Target folder should exist, only the last folder can be created during generation! In the application configuration of the other SIP containing the KeyM, add the folder with the generated Pre-Config to the Additional Definitions using the Project Settings Dialogue.
      boolean KeyMSafeBswChecks: multiplicity set at pre-compile, origin=Vector Informatik, set at pre-compile, default-value=false  # Selects if safety checks are used. These checks improve robustness by e.g. checking invalid parameters before a function is executed. This attribute has to be enabled for safety projects where this component is mapped to an ASIL partition.
      enumeration KeyMRemoteHandlingCompatibility: {KEYM_VERSION_4_3_0, KEYM_VERSION_3_2_0}, multiplicity set at pre-compile, origin=Vector Informatik, set at pre-compile, default-value=KEYM_VERSION_4_3_0  # This parameter defines the version of KeyM running on the Remote. Please select the greatest value that is still <= the version that is running on the Remote. The value of this parameter is only relevant if Remote Handling is enabled and used.
      boolean KeyMCertificateExtensionValidationEnabled: multiplicity set at pre-compile, origin=Vector Informatik, set at pre-compile, default-value=true  # Enables (TRUE) or disables (FALSE) dedicated verification of standard extensions and functions for the retrieval of certificate extension data. The following extensions are supported: - Basic Constraints - Key Usage If set to true, the following API functions are provided: - KeyM_GetCertBasicConstraints() - KeyM_GetCertKeyUsage()
      integer KeyMOCSPResponseValidityPeriod [0..1]: 0..4294967295, multiplicity set at pre-compile, origin=Vector Informatik, set at pre-compile, default-value=1209600  # Defines the time in seconds, starting from the thisUpdate time, during which an OCSP response is considered valid. In case a nextUpdate time is present and smaller than (thisUpdate time + OCSP Response Validity Period), the nextUpdate time will be considered as validity threshold. Caution: The OCSP Response Validity Period must be configured longer than the time interval between two OCSP responses sent by the Server. Otherwise, a valid OCSP response could be rejected.
      reference KeyMCsmRemoteInfoJobRef [0..1]: multiplicity set at pre-compile, origin=Vector Informatik, set at pre-compile, requires-symbolic-name-value=true, destination=CsmJob  # Reference to a CSM job that is used to transfer a remote service request. This parameter is required for the KeyM on the application side if certificate service requests shall be processed remotely.
      reference KeyMCsmRemoteInfoKeyRef [0..1]: multiplicity set at pre-compile, origin=Vector Informatik, set at pre-compile, requires-symbolic-name-value=true, destination=CsmKey  # Reference to a CSM key that is used to transfer a remote service request. This parameter is required for the KeyM on the application side if certificate service requests shall be processed remotely.
      container KeyMOCSPFormat [0..1]: multiplicity set at pre-compile  # This container contains configuration of OCSP revocation state handling.
        integer KeyMOCSPMaxLengthOfDistinguishedName: 1..65535, multiplicity set at pre-compile, origin=Vector Informatik, set at pre-compile, default-value=1000  # Specifies the maximum length in bytes of the certificate's distinguished name.
        integer KeyMOCSPMaxLengthOfCertIdHash: 1..65535, multiplicity set at pre-compile, origin=Vector Informatik, set at pre-compile, default-value=64  # Specifies the maximum length in bytes of the hash in a CertId field of a BasicOCSPResponse (RFC6090).
    container KeyMCertificateGroup [0..65535]: multiplicity set at pre-compile  # This container contains configuration of certificate groups.
      integer KeyMCertificateRemoteGroupId [0..1]: 0..255, multiplicity set at pre-compile, origin=Vector Informatik, set at pre-compile, default-value=0  # Identifier of the certificate group on remote side. The parameter value is set by the generated preconfiguration based on the remote configuration.
      integer KeyMCertificateGroupId: 0..255, multiplicity set at pre-compile, origin=Vector Informatik, set at pre-compile, symbolic-name-value=true, default-value=0  # Identifier of the certificate group.
      function name KeyMCertificateGroupVerifyCallbackNotificationFunc [0..1]: multiplicity set at pre-compile, origin=Vector Informatik, set at pre-compile, default-value=Appl_KeyMCertificateGroupVerifyCallbackNotification, min-length=1  # This parameter provides the function name for the callback <KeyM_CertificateGroupVerifyCallbackNotification>. It indicates if a dynamic group verification operation was finished and provides its overall status. If this parameter is omitted, no callback will be provided.
      reference KeyMCertificateGroupCertRef [1..65535]: multiplicity set at pre-compile, origin=Vector Informatik, set at pre-compile, destination=KeyMCertificate  # References certificates that are used for determining a dynamic issuer and dynamic certificate slot mapping. Dynamic certificate slot mapping requires equal configuration of the certificate elements across all certificates. This can be achieved by configuring certain certificate elements as optional.
      reference KeyMCertificateGroupIssuerRef [0..65535]: multiplicity set at pre-compile, origin=Vector Informatik, set at pre-compile, destination=KeyMCertificate  # References cerificates that are used additionally for determinig a dynamic issuer.
    container KeyMCRE [0..1]: multiplicity set at pre-compile  # This container contains configuration of generic certificate revocation entries based on issuer common name and certificate serial number.
      integer KeyMCREMaxNumberOfEntries: 1..65535, multiplicity set at pre-compile, origin=Vector Informatik, set at pre-compile, default-value=1  # Specifies the maximum number of generic certificate revocation entries.
      integer KeyMCREMaxLengthOfIssuerName: 1..65535, multiplicity set at pre-compile, origin=Vector Informatik, set at pre-compile, default-value=64  # Specifies the maximum length in bytes of the common name of the revoked certificate's issuer.
      integer KeyMCREMaxLengthOfSerialNumber: 1..65535, multiplicity set at pre-compile, origin=Vector Informatik, set at pre-compile, default-value=32  # Specifies the maximum length in bytes of the revoked certificate's serial number.
      container KeyMCRENvmBlock [0..1]: multiplicity set at pre-compile  # Configuration of usage of Nvm to store certificate revocation information.
        enumeration KeyMCRENvBlockProcessing: {IMMEDIATE, DEFERRED}, multiplicity set at pre-compile, origin=Vector Informatik, set at pre-compile, default-value=IMMEDIATE  # Set the block processing type. DEFERRED: write block will not be triggered by the KeyM. The block needs to be written manually and configured to be written on shutdown. Use this setting to prevent inconsistencies when updating certificate revocation entries. IMMEDIATE: write block will be triggered by the KeyM when a certificate revocation entry is set.
        reference KeyMCRENvmBlockDescriptorRef: scope=ECU, multiplicity set at pre-compile, origin=Vector Informatik, set at pre-compile, requires-symbolic-name-value=true, destination=NvMBlockDescriptor  # Reference to the Nvm block description in the Nvm module configuration.
    container KeyMPublishedInformation [0..1]: multiplicity set at pre-compile  # This container contains configuration of remote service handling. The container is instantiated only on application side by the generated preconfiguration based on the remote configuration. The underlying boolean parameters determine whether service requests shall be transferred to the remote side.
      boolean KeyMRemoteOCSPEnabled: multiplicity set at pre-compile, origin=Vector Informatik, set at pre-compile, default-value=false  # Enables (TRUE) or disables (FALSE) remote handling of OCSP service requests.
      boolean KeyMRemoteCREEnabled: multiplicity set at pre-compile, origin=Vector Informatik, set at pre-compile, default-value=false  # Enables (TRUE) or disables (FALSE) remote handling of CRE service requests.
    container KeyMCertificateSlot [0..65535]: multiplicity set at pre-compile  # This container contains configuration of generic certificate slots to enable RAM sharing. Configured certificates can share a dedicated RAM certificate slot for certificate data and certificate status. This has the advantage that a series of certificate variants with different signature algorithms can be supported by only allocating one RAM certificate slot. To achieve this, each certificate slot needs to be instantiated in KeyMCertificateSlot and can be referenced by the corresponding certificates in KeyMCertificateSlotRef. This feature is only supported for certificates with storage type RAM (KEYM_STORAGE_IN_RAM). Furthermore, certificates with configured init values, can't be used for slot sharing. If a CA certificate shares a RAM slot with another certificate and the CA certificate is preempted from the RAM slot, all of its directly and indirectly issued certificates will remain in their current respective certificate statuses (e.g. KEYM_CERTIFICATE_VALID). If a verification is not explicitly triggered on these certificates, they will remain in their certificate status until ECU restart and will, for example, not react to a revocation of an upper certificate. If a verification is triggered on one of these certificates and the CA certificate is still preempted from the RAM slot, the verification will fail and the orphaned certificate's status will reflect this.
      integer KeyMCertificateSlotId: 0..65535, multiplicity set at pre-compile, origin=Vector Informatik, set at pre-compile, default-value=0  # Identifier of the certificate slot.
      integer KeyMCertificateSlotMaxLength: 1..65535, multiplicity set at pre-compile, origin=Vector Informatik, set at pre-compile, default-value=1200  # Specifies the maximum length in bytes of the certificate slot.
  bsw implementation KeyM_Impl: programming-language=C, sw-version=4.11.01, used-code-generator=DaVinci Configurator, vendor-id=30, ar-release-version=4.07.00, behavior=Behavior, preconfigured-configuration=KeyM_Pre, recommended-configuration=KeyM_Rec, vendor-specific-module-def=KeyM
  module config KeyM_Pre: definition=KeyM
    KeyMGeneral: KeyMCertificateManagerEnabled=1
  module config KeyM_Rec: definition=KeyM
    KeyMGeneral: KeyMServiceCertificateFunctionEnabled=1
  module config KeyM_Rec_Class1: definition=KeyM
    KeyMCertificate
      3 x KeyMCertificateElement:
        CertificateVersionNumber: KeyMCertificateElementObjectType=2, KeyMCertificateElementOfStructure=CertificateVersionNumber, KeyMCertificateElementOptional=1
        CertificateSerialNumber: KeyMCertificateElementObjectType=2, KeyMCertificateElementOfStructure=CertificateSerialNumber
        CertificateSignatureAlgorithmID: KeyMCertificateElementObjectType=6, KeyMCertificateElementOfStructure=CertificateSignatureAlgorithmID
