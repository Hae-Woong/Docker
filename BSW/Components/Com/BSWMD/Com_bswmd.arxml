AUTOSAR XML (schema 4-0-3)
# COPYRIGHT
# Copyright (c) 2021 by Vector Informatik GmbH. All rights reserved.
# This software is copyright protected and proprietary to Vector Informatik GmbH.
# Vector Informatik GmbH grants to you only those rights as set out in the license conditions.
package /MICROSAR
  module definition Com [0..1]: category=VENDOR_SPECIFIC_MODULE_DEFINITION, refined-module-def=Com, variants pre-compile/post-build-loadable/post-build-selectable  # The Com provides a signal-based communication interface to the upper layer (in an AUTOSAR system this is the Rte) which the Com couples with the PduR by packing and unpacking signals to and from pdus. The Com also allows for signal and pdu based routing. #Communication #AUTOSAR
    container ComConfig  # This container contains the configuration parameters and sub containers of the AUTOSAR COM module.
      integer ComConfigurationId: 0..4294967295, set at post-build in variant post-build-loadable+post-build-selectable / pre-compile in variant pre-compile, default-value=0  # This ID is returned by a call to Com_GetConfigurationId.
      integer ComDataMemSize [0..0]: 0..18446744073709551615, set at post-build in variant post-build-loadable+post-build-selectable / pre-compile in variant pre-compile, origin=Vector Informatik  # Size of internal Com data in units of bytes (static memory allocation) - memory required by post-build configuration must be smaller than this constant. This parameter is needed only in case of post-build loadable implementation using static memory allocation. Note: This parameter is not used by the generator.
      integer ComMaxIPduCnt [0..0]: 0..18446744073709551615, set at post-build in variant post-build-loadable+post-build-selectable / pre-compile in variant pre-compile, origin=Vector Informatik  # Maximum number of IPdus. This paramterer is needed only in case of post-build loadable implementtation using static memory allocation. Note: This parameter is not used by the generator.
      integer ComRxDeferredEventCacheSize [0..1]: 0..65535, set at post-build in variant post-build-loadable+post-build-selectable / pre-compile in variant pre-compile, origin=Vector Informatik  # This parameter defines the size of the deferred event cache.
      integer ComRxDeferredNotificationCacheSize: 0..65535, set at pre-compile, origin=Vector Informatik, default-value=1  # This parameter defines the max. number of ComSignal or ComSignalGroup notifications or invalid notifications, which will be cached during unpacking of all received deferred ComIPdus with closed Rx ISR lock. If the number of (invalid) notifications exceeds the configured cache size, the Rx ISR lock will temporarily be opened and all cached (invalid) notifications will be called.
      integer ComRxImmediateNotificationCacheSize: 0..65535, set at pre-compile, origin=Vector Informatik, default-value=1  # This parameter defines the max. number of ComSignal or ComSignalGroup notifications or invalid notifications, which will be cached during unpacking of a received immediate ComIPdu with closed Rx ISR lock. If the number of (invalid) notifications exceeds the configured cache size, the Rx ISR lock will temporarily be opened and all cached (invalid) notifications will be called.
      container ComGwMapping [0..*]: post-build-changeable=true  # Each GwMapping represents one signal routing relation handled by COM. A signal routing relation has one source signal and can have multiple destination signals. COM is able to route signals and group signals.
        choice container ComGwDestination [1..*]: post-build-changeable=true  # Definition of the source signal or group signal of a signal routing relation.
          container ComGwSignal [0..1]  # This choice container allows referring signals and group signals that have been configured explicitly in the COM configuration.
            choice reference ComGwSignalRef: set at post-build in variant post-build-loadable+post-build-selectable / pre-compile in variant pre-compile, destination=[ComGroupSignal, ComSignal]  # Reference to the destination (Tx) signal or group signal of the routing relation.
          container ComGwDestinationDescription [0..1]  # Description of a gateway destination. This container allows defining a gateway destination without the configuration of a complete COM signal. This allows adding / changing gateway relations post build without the configuration of new signals.
            integer ComBitPosition: 0..65535, set at post-build in variant post-build-loadable+post-build-selectable / pre-compile in variant pre-compile, default-value=0  # Starting position within the I-PDU. This parameter refers to the position in the I-PDU and not in the shadow buffer. If the endianness conversion is configured to Opaque the parameter ComBitPosition shall define the bit0 of the first byte like in little endian byte order
            enumeration ComSignalEndianness: {BIG_ENDIAN, LITTLE_ENDIAN, OPAQUE}, set at post-build in variant post-build-loadable+post-build-selectable / pre-compile in variant pre-compile, default-value=LITTLE_ENDIAN  # Defines the endianness of the signal's network representation.
            string ComSignalInitValue [0..0]: set at post-build in variant post-build-loadable+post-build-selectable / pre-compile in variant pre-compile, default-value=0  # Initial value for this signal. The default value is 0. Note: This container is not used. | In case the ComSignalType is UINT8, UINT16, UINT32, UINT64, SINT8, SINT16, SINT32, SINT64 the string shall be interpreted as defined in the chapter Integer Type in the AUTOSAR EcuC specification. In case the SignalType is BOOLEAN the string shall be interpreted as defined in the chapter Boolean Type in the AUTOSAR EcuC specification. In case the SignalType is UINT8_N the string shall be interpreted as a decimal representation of the characters separated by blanks, e.g. "97 98 100" means a string "abd", where the char "a" is in byte 0(lowest address), "b" is in byte 1, and "d" is in byte 2 and (highest address).
            enumeration ComTransferProperty: {PENDING, TRIGGERED, TRIGGERED_ON_CHANGE, TRIGGERED_ON_CHANGE_WITHOUT_REPETITION, TRIGGERED_WITHOUT_REPETITION}, set at post-build in variant post-build-loadable+post-build-selectable / pre-compile in variant pre-compile, default-value=PENDING  # Defines if a write access to this signal can trigger the transmission of the corresponding I-PDU. If the I-PDU is triggered, depends also on the transmission mode of the corresponding I-PDU.
            integer ComUpdateBitPosition [0..1]: 0..65535, set at post-build in variant post-build-loadable+post-build-selectable / pre-compile in variant pre-compile, default-value=0  # Bit position of update-bit inside I-PDU. | If this attribute is omitted then there is no update-bit. This setting must be consistently on sender and on receiver side. Range: 0..63 for CAN and LIN 0..2031 for FlexRay
            reference ComGwIPduRef: set at post-build in variant post-build-loadable+post-build-selectable / pre-compile in variant pre-compile, destination=ComIPdu  # Reference to an I-PDU of a Signal Gateway source or destination description.
            container ComFilter [0..0]  # This container contains the configuration parameters of the AUTOSAR COM module's Filters. Note: This container is not used. | Note: On sender side the container is used to specify the transmission mode conditions.
              enumeration ComFilterAlgorithm: {ALWAYS, MASKED_NEW_DIFFERS_MASKED_OLD, MASKED_NEW_DIFFERS_X, MASKED_NEW_EQUALS_X, NEVER, NEW_IS_OUTSIDE, NEW_IS_WITHIN}, set at post-build in variant post-build-loadable+post-build-selectable / pre-compile in variant pre-compile, default-value=ALWAYS  # The supported filter algorithms for signals/group signals are: - Always: This filter always evaluates to TRUE - Never: This filter always evaluates to FALSE - MaskedNewDiffersMaskedOld: ((new & mask) != (old & mask)) - MaskedNewEqualsX: ((new & mask) == x) - MaskedNewDiffersX: ((new & mask) != x) - NewIsOutside: ((new < min) || (max < new)) - NewIsWithin: ((min <= new) && (new <= max))
              integer ComFilterMask [0..1]: 0..18446744073709551615, set at post-build in variant post-build-loadable+post-build-selectable / pre-compile in variant pre-compile, default-value=18446744073709551615  # The specified mask is used for the filters: - MaskedNewDiffersMaskedOld: ((new & mask) != (old & mask)) - MaskedNewEqualsX: ((new & mask) == x) - MaskedNewDiffersX: ((new & mask) != x)
              integer ComFilterMax [0..1]: -2147483648..4294967295, set at post-build in variant post-build-loadable+post-build-selectable / pre-compile in variant pre-compile, default-value=0  # The specified max value is used for the filters: - NewIsOutside: ((new < min) || (max < new)) - NewIsWithin: ((min <= new) && (new <= max))
              integer ComFilterMin [0..1]: -2147483648..4294967295, set at post-build in variant post-build-loadable+post-build-selectable / pre-compile in variant pre-compile, default-value=0  # The specified min value is used for the filters: - NewIsOutside: ((new < min) || (max < new)) - NewIsWithin: ((min <= new) && (new <= max))
              integer ComFilterOffset [0..1]: 0..4294967294, set at post-build in variant post-build-loadable+post-build-selectable / pre-compile in variant pre-compile, default-value=0  # The name of this attribute corresponds to the parameter name in the [17] specification of Reception Filtering. Note: This parameter is not used by the generator. | Range = 0..(ComFilterPeriod-1)
              integer ComFilterPeriod [0..1]: 2..4294967295, set at post-build in variant post-build-loadable+post-build-selectable / pre-compile in variant pre-compile, default-value=2  # This parameter defines the period of the ComFilterAlgorithm ONE_EVERY_N. Note: This parameter is not used by the generator.
              integer ComFilterX [0..1]: -2147483648..4294967295, set at post-build in variant post-build-loadable+post-build-selectable / pre-compile in variant pre-compile, default-value=0  # The specified value X is used for the filters: - MaskedNewEqualsX: ((new & mask) == x) - MaskedNewDiffersX: ((new & mask) != x)
        choice container ComGwSource  # This choice container allows the definition of the gateway source signal by reference to an already configured COM signal / group signal.
          container ComGwSignal [0..1]  # This choice container allows referring signals and group signals that have been configured explicitly in the COM configuration.
            choice reference ComGwSignalRef: set at post-build in variant post-build-loadable+post-build-selectable / pre-compile in variant pre-compile, destination=[ComGroupSignal, ComSignal]  # Reference to the source (Rx) signal or group signal of the routing relation.
          container ComGwSourceDescription [0..1]  # Description of a gateway source. This container allows defining a gateway source without the configuration of a complete COM signal. This allows adding / changing gateway relations post build without the configuration of new signals.
            integer ComBitPosition: 0..65535, set at post-build in variant post-build-loadable+post-build-selectable / pre-compile in variant pre-compile, default-value=0  # Starting position within the I-PDU. This parameter refers to the position in the I-PDU and not in the shadow buffer. If the endianness conversion is configured to Opaque the parameter ComBitPosition shall define the bit0 of the first byte like in little endian byte order
            integer ComBitSize [0..1]: 0..64, set at post-build in variant post-build-loadable+post-build-selectable / pre-compile in variant pre-compile, default-value=0  # Size in bits, for non-array signal types. | For ComSignalType UINT8_N and UINT8_DYN this size shall be configured by ComSignalLength.
            enumeration ComSignalEndianness: {BIG_ENDIAN, LITTLE_ENDIAN, OPAQUE}, set at post-build in variant post-build-loadable+post-build-selectable / pre-compile in variant pre-compile, default-value=LITTLE_ENDIAN  # Defines the endianness of the signal's network representation.
            integer ComSignalLength [0..1]: 0..4095, set at pre-compile, default-value=0  # For ComSignalType UINT8_N this parameter specifies the length n in bytes. For ComSignalType UINT8_DYN it specifies the maximum length in bytes. For all other types this parameter shall be ignored. | For ComSignalType UINT8_N this parameter specifies the length n in bytes. For ComSignalType UINT8_DYN it specifies the maximum length in bytes. For all other types this parameter shall be ignored. Range: 0..8 for normal CAN/ LIN I-PDUs, 0..254 for normal FlexRay I-PDUs, and 0..4095 for I-PDUs with ComIPduType TP.
            enumeration ComSignalType: {BOOLEAN, SINT16, SINT32, SINT64, UINT16, UINT32, UINT64, UINT8, UINT8_N, SINT8}, set at pre-compile, default-value=BOOLEAN  # The AUTOSAR type of the signal. Whether or not the signal is signed or unsigned can be found by examining the value of this attribute. Note: This parameter is only evaluated for distinguishing between array based signal types (UINT8_N) and non array based signal types. | This type could also be used to reserved appropriate storage in AUTOSAR COM.
            integer ComUpdateBitPosition [0..1]: 0..65535, set at post-build in variant post-build-loadable+post-build-selectable / pre-compile in variant pre-compile, default-value=0  # Bit position of update-bit inside I-PDU. | If this attribute is omitted then there is no update-bit. This setting must be consistently on sender and on receiver side. Range: 0..63 for CAN and LIN 0..2031 for FlexRay
            reference ComGwIPduRef: set at post-build in variant post-build-loadable+post-build-selectable / pre-compile in variant pre-compile, destination=ComIPdu  # Reference to an I-PDU of a Signal Gateway source or destination description.
      container ComIPdu [0..*]: post-build-changeable=true  # I-PDU configuration of COM.
        function name ComIPduCallout [0..1]: set at pre-compile in variant post-build-loadable+pre-compile / post-build in variant post-build-selectable, min-length=1  # This parameter defines the existence and the name of the I-PDUs callout function. For Rx I-PDUs the callout function is called in the context of Com_RxIndication(). For Tx I-PDUs the callout function is called before the transmission is triggered by COM. If the parameter is undefined no callout function will be called. The API prototype is generated to Com_Cbk.h and has to be implemented by the application.
        enumeration ComIPduDirection: {RECEIVE, SEND}, set at pre-compile  # The direction defines if this I-PDU and the contributing signals and signal groups are sent or received.
        integer ComIPduHandleId: 0..65535, set at pre-compile, symbolic-name-value=true, default-value=0  # The numerical value used as the ID of this I-PDU. The ComIPduHandleId is required by the API calls to receive Rx I-PDUs from the PduR. For Tx-I-PDUs this handle Id is used by the PduR to confirm the transmission of the ComIPdu and for the APIs Com_TriggerTransmit() and Com_TriggerIPDUSend()
        enumeration ComIPduSignalProcessing: {DEFERRED, IMMEDIATE}, set at post-build in variant post-build-loadable+post-build-selectable / pre-compile in variant pre-compile, default-value=DEFERRED  # This option determines the call context and the point of time when the signal notification function is called. - IMMEDIATE: The notification function is called within Com_TxConfirmation() or Com_RxIndication(). Depending on the lower layer interface, this might be in interrupt context. - DEFERRED: The notification function is called on task level during the next call cycle of Com_MainFunctionRx() or Com_MainFunctionTx(). Please note that the signal data of a received I-PDU is not updated until the next call to Com_MainfunctionRx().
        function name ComIPduTriggerTransmitCallout [0..1]: set at pre-compile in variant post-build-loadable+pre-compile / post-build in variant post-build-selectable, min-length=1  # This parameter defines the existence and the name of a trigger callout function for the corresponding I-PDU. The function is called in the context of Com_TriggerTransmit() before the data are copied to the lower layer. The prototype is generated to Com_Cbk.h and has to be implemented by the application.
        enumeration ComIPduType: {NORMAL, TP}, set at post-build in variant post-build-loadable+post-build-selectable / pre-compile in variant pre-compile, default-value=NORMAL  # Defines the lower layer type that is used to transmit/received the I-PDU. Defines if this I-PDU is a normal I-PDU that can be sent unfragmented or if this is a large I-PDU that shall be sent via the Transport Protocol of the underlying bus. NORMAL: indicates that the I-PDU is sent/received unfragmented. TP: indicates that the I-PDU is send/received fragmented by a Transport Protocol.
        boolean ComIPduCancellationSupport: set at pre-compile, default-value=false  # Defines for I-PDUs with ComIPduType TP: If the underlying TP-module supports RX and TX cancellation of ongoing requests.
        reference ComIPduGroupRef [0..*]: set at post-build in variant post-build-loadable+post-build-selectable / pre-compile in variant pre-compile, destination=ComIPduGroup  # Reference to the I-PDU groups this I-PDU belongs to. I-PDU groups are used to enable and disable the transmision of I-PDUs.
        reference ComIPduSignalGroupRef [0..*]: set at post-build in variant post-build-loadable+post-build-selectable / pre-compile in variant pre-compile, destination=ComSignalGroup  # References to all signal groups contained in this I-PDU
        reference ComIPduSignalRef [0..*]: set at post-build in variant post-build-loadable+post-build-selectable / pre-compile in variant pre-compile, destination=ComSignal  # References to all signals contained in this I-PDU.
        reference ComPduIdRef: set at post-build in variant post-build-loadable / pre-compile in variant post-build-selectable+pre-compile, destination=Pdu  # Reference to the "global" PDU structure to allow harmonization of handle IDs in the COM-Stack.
        choice reference ComIPduMainFunctionRef [0..1]: set at post-build in variant post-build-loadable+post-build-selectable / pre-compile in variant pre-compile, origin=Vector Informatik, destination=[ComMainFunctionRx, ComMainFunctionTx]  # Reference to the Com_MainFunctionRx/Com_MainFunctionTx this I-PDU belongs to. Mandatory if multiple mainfuctions of the relevant type exists. See technical reference for details.
        reference ComEcucPartitionRef [0..1]: set at pre-compile, origin=Vector Informatik, destination=EcucPartition  # This parameter must never be changed manually. It is calculated automatically by the Com validation. The EcucPartition this Pdu is assigned to. To change this value, assign the referred global Pdu (/EcucPduCollection/Pdu) to a (different) EcucPartition. This value is copied from 'Pdu/EcucPduDefaultPartitionRef' or 'Pdu/EcucPduDedicatedPartition/EcucPduDedicatedPartitionRef'.
        container ComTxIPdu [0..1]  # Additional transmission related configuration parameters.
          float ComMinimumDelayTime: 0..3600, set at post-build in variant post-build-loadable+post-build-selectable / pre-compile in variant pre-compile, default-value=0  # Defines the Minimum Delay Time (MDT) between successive transmissions of this I-PDU. The MDT is independent of the possible different transmission modes. There is only one minimum delay time parameter for one I-PDU. The minimum delay timer is not reset by changing the transmission mode. Hence, it is not allowed to violate the minimum delay time by transmission mode changes. It is not possible to monitor the minimum delay time for I-PDUs that are requested using the Com_TriggerTransmit API. Note: The actual Minimum Delay Time is incremented by one ComTxTimeBase to ensure the minimum delay in case of late receiving Tx confirmations.
          float ComGwRoutingTimeout [0..1]: 0..3600, set at pre-compile, origin=Vector Informatik, default-value=0.05  # Maximum Time between two routing events before a timeout occurs.
          enumeration ComTxIPduClearUpdateBit [0..1]: {Confirmation, Transmit, TriggerTransmit}, set at post-build in variant post-build-loadable+post-build-selectable / pre-compile in variant pre-compile, default-value=Transmit  # Defines when the update bits shall be cleared. Transmit: clear update bit in PduR_ComTransmit() context TriggerTransmit: clear update bit in Com_TriggerTransmit() context Confirmation: The update-bits are cleared when the transmission of the I-PDU was confirmed.
          integer ComTxIPduUnusedAreasDefault: 0..255, set at pre-compile, default-value=0  # Byte pattern that is used to fill in unused bits within an I-PDU. The byte-pattern will be repeated throughout the I-PDU before any initial values or update-bits are applied.
          string ComMetaDataDefault [0..1]: set at pre-compile, origin=Vector Informatik  # The AUTOSAR COM module uses default MetaData when not triggered by Com_TriggerIPDUSendWithMetaData. the string is interpreted as a decimal representation of the characters separated by blanks, e.g. "97 98 100" means a string "abd", where the char "a" is in byte 0 (lowest address), "b" is in byte 1, and "d" is in byte 2 (highest address).
          container ComTxModeFalse  # Defines the I-PDU transmit behavior if the transmission mode state of the I-PDU is evaluated to false.
            container ComTxMode  # This container contains the configuration parameters of the AUTOSAR COM module's transmission modes.
              enumeration ComTxModeMode: {DIRECT, MIXED, NONE, PERIODIC}, set at post-build in variant post-build-loadable+post-build-selectable / pre-compile in variant pre-compile, default-value=NONE  # The transmission mode determines the Tx properties of the IPDU: - DIRECT: The message is transmitted in the next Com_MainFunctionTx() call after a trigger event occurred. - PERIODIC: The IPDU is transmitted with the specified cycle time (ComTxModeTimePeriod). - MIXED: Combines the transmission modes of CYCLIC and DIRECT. - NONE: COM does not transmit the I-PDU. The transmission must be triggered by the lower layer through Com_TriggerTransmit(). All transmission modes, except NONE, maintain the Minimum Delay Time (ComTxIPduMinimumDelayTime) and delay a transmission if required. | The transmission mode None shall not have any further sub-attributes in the ComTxMode object.
              integer ComTxModeNumberOfRepetitions [0..1]: 0..255, set at post-build in variant post-build-loadable+post-build-selectable / pre-compile in variant pre-compile, default-value=0  # Defines how often the I-PDU shall be transmitted after a single transmission trigger event. For the transmission mode DIRECT and the event driven part of transmission mode MIXED. If the parameter is configured to '0' the transmission is requested once by a trigger-event.
              float ComTxModeRepetitionPeriod [0..1]: 0..3600, set at post-build in variant post-build-loadable+post-build-selectable / pre-compile in variant pre-compile, default-value=0  # Defines the repetition period of the repeated transmissions in case ComTxModeNumberOfRepetitions is configured to a value greater 0 and the ComTxModeMode is configured to DIRECT or MIXED. In case of the mixed transmission mode only the event driven part is affected.
              float ComTxModeTimeOffset [0..1]: 0..3600, set at post-build in variant post-build-loadable+post-build-selectable / pre-compile in variant pre-compile, default-value=0  # Defines the period between the start of the I-PDU by Com_IpduGroupControl and the first transmission request to the lower layer if ComTxModeMode is configured to PERIODIC or MIXED. In case of the mixed transmission mode only the periodic part is affected.
              float ComTxModeTimePeriod [0..1]: 0..3600, set at post-build in variant post-build-loadable+post-build-selectable / pre-compile in variant pre-compile, default-value=0  # Defines the cycle time of periodic transmission requests in case ComTxModeMode is configured to PERIODIC or MIXED. In case of the mixed transmission mode only the periodic part is affected.
          container ComTxModeTrue  # Defines the I-PDU transmit behavior if the transmission mode state of the I-PDU is evaluated to true.
            container ComTxMode  # This container contains the configuration parameters of the AUTOSAR COM module's transmission modes.
              enumeration ComTxModeMode: {DIRECT, MIXED, NONE, PERIODIC}, set at post-build in variant post-build-loadable+post-build-selectable / pre-compile in variant pre-compile, default-value=NONE  # The transmission mode determines the Tx properties of the I-PDU: - DIRECT: The message is transmitted in the next Com_MainFunctionTx() call after a trigger event occurred. - PERIODIC: The I-PDU is transmitted with the specified cycle time (ComTxModeTimePeriod). - MIXED: Combines the transmission modes of CYCLIC and DIRECT. - NONE: COM does not transmit the I-PDUs. The transmission must be triggered by the lower layer through Com_TriggerTransmit(). All transmission modes, except NONE, maintain the Minimum Delay Time (ComTxIPduMinimumDelayTime) and delay a transmission if required. | The transmission mode None shall not have any further sub-attributes in the ComTxMode object.
              integer ComTxModeNumberOfRepetitions [0..1]: 0..255, set at post-build in variant post-build-loadable+post-build-selectable / pre-compile in variant pre-compile, default-value=0  # Defines how often the I-PDU shall be transmitted after a single transmission trigger event. For the transmission mode DIRECT and the event driven part of transmission mode MIXED. If the parameter is configured to '0' the transmission is requested once by a trigger event.
              float ComTxModeRepetitionPeriod [0..1]: 0..3600, set at post-build in variant post-build-loadable+post-build-selectable / pre-compile in variant pre-compile, default-value=0  # Defines the repetition period of the repeated transmissions in case ComTxModeNumberOfRepetitions is configured to a value greater 0 and the ComTxModeMode is configured to DIRECT or MIXED. In case of the mixed transmission mode only the event driven part is affected.
              float ComTxModeTimeOffset [0..1]: 0..3600, set at post-build in variant post-build-loadable+post-build-selectable / pre-compile in variant pre-compile, default-value=0  # Defines the period between the start of the I-PDU by Com_IpduGroupControl and the first transmission request to the lower layer if ComTxModeMode is configured to PERIODIC or MIXED. In case of the mixed transmission mode only the periodic part is affected.
              float ComTxModeTimePeriod [0..1]: 0..3600, set at post-build in variant post-build-loadable+post-build-selectable / pre-compile in variant pre-compile, default-value=0  # Defines the cycle time of periodic transmission requests in case ComTxModeMode is configured to PERIODIC or MIXED. In case of the mixed transmission mode only the periodic part is affected.
        container ComIPduCounter [0..0]  # This optional container contains the configuration parameters of PDU Counter. Note: This container is not used by the generator.
          function name ComIPduCounterErrorNotification [0..1]: set at pre-compile  # Name of Com_CbkCounterErr callback function to be called. If this | parameter is omitted no I-PDU counter mismatch notification shall take place.
          integer ComIPduCounterSize: 1..8, set at pre-compile, default-value=1  # Size of PDU Counter expressed in bits
          integer ComIPduCounterStartPosition: 0..2031, set at pre-compile, default-value=0  # Position of PDU counter expressed in bits from start position of data content | of I-PDU (SDU). Note that PDU counter is not allowed to cross a byte border. The parameter ComIPduCounterStartPosition shall define the bit0 of the first byte like in little endian byte order.
          integer ComIPduCounterThreshold [0..1]: 0..255, set at pre-compile, default-value=0  # Threshold value of I-PDU counter algorithm, see COM590.
        container ComIPduReplication [0..0]  # This optional container contains the information needed for each I-PDU replicated. Note: This container is not used by the generator.
          integer ComIPduReplicationQuorum: 1..3, set at pre-compile, default-value=1  # The number of identical I-PDUs needed for successful voting.
          reference ComIPduReplicaRef [1..2]: set at pre-compile, destination=Pdu  # Reference to replicas PduR PDUs of this IPDU.
      container ComIPduGroup [0..*]: post-build-changeable=true  # Defines one I-PDU group that is used to enable and disable the reception and transmission of a COM I-PDU. Typically there is for each communication channel at least one I-PDU group for Rx I-PDUs and one I-PDU group for Tx I-PDUs.
        integer ComIPduGroupHandleId: 0..65535, set at pre-compile, symbolic-name-value=true, default-value=0  # The numerical value used as the ID of this I-PDU Group . | The ComIPduGroupHandleId is required by the API calls to start and stop I-PDU Groups. Range: 0 .. (ComSupportedIPduGroups-1)
        reference ComIPduGroupGroupRef [0..1]: set at post-build in variant post-build-loadable+post-build-selectable / pre-compile in variant pre-compile, destination=ComIPduGroup  # References to an I-PDU group that includes this I-PDU group. If the referred I-PDU group is enabled or disabled this will have the same effect on this I-PDU group.
      container ComSignal [0..*]: post-build-changeable=true  # Defines one Signal transmitted or received by COM.
        integer ComBitPosition: 0..65535, set at post-build in variant post-build-loadable+post-build-selectable / pre-compile in variant pre-compile, default-value=0  # Start position of the signal within the I-PDU. The interpretation of the bit position depends on the signal endianness: BIG_ENDIAN: bit position refers to the MSB of the signal. LITTLE_ENDIAN: bit position refers to the LSB of the signal. OPAQUE: bit position refers to bit 0 of the first byte similar to the little endian byte order.
        integer ComBitSize [0..1]: 0..64, set at post-build in variant post-build-loadable+post-build-selectable / pre-compile in variant pre-compile, default-value=8  # Size in bits, for non-array signal types. | For ComSignalType UINT8_N and UINT8_DYN this size shall be configured by ComSignalLength.
        enumeration ComDataInvalidAction [0..1]: {NOTIFY, REPLACE}, set at pre-compile in variant post-build-loadable+pre-compile / post-build in variant post-build-selectable, default-value=NOTIFY  # This parameter defines the action performed upon reception of an invalid signal. NOTIFY: The configured invalid notification is called and further signal processing (like signal indication) is abandoned. In this case the invalid value is not stored to preserve the last valid received value. REPLACE: The last received value is replaced by the initial value. After the replacement the normal signal processing takes place. | Relating to signal groups the action in case if one of the included signals is an invalid signal. If Replace is used the ComSignalInitValue will be used for the replacement.
        function name ComErrorNotification [0..1]: set at pre-compile in variant post-build-loadable+pre-compile / post-build in variant post-build-selectable, min-length=1  # Defines the name and existence of the error notification function that is called in case of transmit errors The notification is called for not confirmed send requests, if the corresponding I-PDU group is getting stopped or the COM module is de-initialized. The error notification function is not available for receive signals. Notification functions that shall not be handled by the RTE must use a function name without the pre-fix 'Rte_'. The prototype will then be generated to the file 'Appl_Cbk.h' and has to be implemented by called module. | If this parameter is omitted no error notification shall take place.
        float ComFirstTimeout [0..1]: 0..3600, set at post-build in variant post-build-loadable+post-build-selectable / pre-compile in variant pre-compile, default-value=0  # Timeout time that is used for reception deadline monitoring immediately after start (or restart) of the deadline monitoring service. If the parameter is undefined or configured to 0, the signal reception is not monitored from the BSW initialization until the I-PDU is received for the first time. After the first reception ComTimeout will be used o monitor signal reception. For signals without a configured update-bit, an I-PDU based deadline monitoring is used. The first timeout time is evaluated as smallest first timeout time of all signals and signal groups without configured update-bit of the I-PDU
        integer ComHandleId [0..1]: 0..65535, set at pre-compile, symbolic-name-value=true, default-value=0  # The numerical value used as the ID. | For signals it is required by the API calls Com_UpdateShadowSignal, Com_ReceiveShadowSignal and Com_InvalidateShadowSignal. For signals groups it is required by the Com_SendSignalGroup and Com_ReceiveSignalGroup calls.
        function name ComInvalidNotification [0..1]: set at pre-compile in variant post-build-loadable+pre-compile / post-build in variant post-build-selectable, min-length=1  # Defines the name and existence of callback function that is called if the signal has been identified to be invalid. The notification is called if the invalid action is configured to 'NOTIFY' and an invalid value is received. The call context depends on the configured signal processing of the corresponding I-PDU. Notification functions that shall not be handled by the RTE must use a function name without the pre-fix 'Rte_'. The prototype will then be generated to the file 'Appl_Cbk.h' and has to be implemented by called module.
        function name ComNotification [0..1]: set at pre-compile in variant post-build-loadable+pre-compile / post-build in variant post-build-selectable, min-length=1  # Defines the name and existence of a callback function. The notification is called for Tx signals, if the transmission of the signal is confirmed, for Rx signals, if the signal is received. The call context depends on the configured signal processing of the corresponding I-PDU. Notification functions that shall not be handled by the RTE must use a function name without the pre-fix 'Rte_'. The prototype will then be generated to the file 'Appl_Cbk.h' and has to be implemented by called module. | On receiver side: Name of Com_CbkRxAck callback function to be called. If this parameter is omitted no notification shall take place.
        enumeration ComRxDataTimeoutAction [0..1]: {NONE, REPLACE}, set at pre-compile in variant post-build-loadable+pre-compile / post-build in variant post-build-selectable, default-value=NONE  # If this parameter is configured to 'REPLACE', the initial value is set for this signal if a timeout occurred. If this parameter is configured to 'NONE' or undefined, the last received value is maintained.
        string ComSignalDataInvalidValue [0..1]: set at pre-compile, default-value=0  # Defines the invalid value of the signal. The invalid value is a dedicated value that is transmitted in case the application cannot provide a valid value. The reception of an invalid signal value can trigger special invalid handling on receiver side. The interpretation of the configured value depends on ComSignalType setting: - UINT8, UINT16, UINT32, UINT64, SINT8, SINT16, SINT32, SINT64, FLOAT32, FLOAT64 the string is interpreted as integer type ( ..., -2, -1, 0, 1, 2,...). - BOOLEAN the string is interpreted as boolean type. Possible values are "0", "1", "true", "false". - UINT8_N the string is interpreted as a decimal representation of the characters separated by blanks, e.g. "97 98 100" means a string "abd", where the char "a" is in byte 0 (lowest address), "b" is in byte 1, and "d" is in byte 2 (highest address). | In case the ComSignalType is UINT8, UINT16, UINT32, UINT64, SINT8, SINT16, SINT32, SINT64 the string shall be interpreted as defined in the chapter Integer Type in the AUTOSAR EcuC specification. In case the ComSignalType is BOOLEAN the string shall be interpreted as defined in the chapter Boolean Type in the AUTOSAR EcuC specification. In case the ComSignal is a UINT8_N, uint8_DYN the string shall be interpreted as a decimal representation of the characters separated by blanks, e.g. "97 98 100" means a string "abd", where the char "a" is in byte 0(lowest address), "b" is in byte 1, and "d" is in byte 2 and (highest address).
        enumeration ComSignalEndianness: {BIG_ENDIAN, LITTLE_ENDIAN, OPAQUE}, set at post-build in variant post-build-loadable+post-build-selectable / pre-compile in variant pre-compile, default-value=LITTLE_ENDIAN  # Defines the endianness of the signal's network representation. OPAQUE indicates that no byte order conversion is performed (e.g. for byte arrays).
        string ComSignalInitValue: set at post-build in variant post-build-loadable+post-build-selectable / pre-compile in variant pre-compile, default-value=0  # Defines the Initial value of the signal. The value is set during initialization of the module and if the corresponding I-PDU group is getting started with parameter 'initialize' set to 'true'. The interpretation of the configured value depends on ComSignalType setting: - UINT8, UINT16, UINT32, UINT64, SINT8, SINT16, SINT32, SINT64, FLOAT32, FLOAT64 the string is interpreted as integer type ( ..., -2, -1, 0, 1, 2,...). - BOOLEAN the string is interpreted as boolean type. Possible values are "0", "1", "true", "false". - UINT8_N the string is interpreted as a decimal representation of the characters separated by blanks, e.g. "97 98 100" means a string "abd", where the char "a" is in byte 0 (lowest address), "b" is in byte 1, and "d" is in byte 2 (highest address). | In case the ComSignalType is UINT8, UINT16, UINT32, UINT64, SINT8, SINT16, SINT32, SINT64 the string shall be interpreted as defined in the chapter Integer Type in the AUTOSAR EcuC specification. In case the ComSignalType is BOOLEAN the string shall be interpreted as defined in the chapter Boolean Type in the AUTOSAR EcuC specification. In case the ComSignal is a UINT8_N, uint8_DYN the string shall be interpreted as a decimal representation of the characters separated by blanks, e.g. "97 98 100" means a string "abd", where the char "a" is in byte 0(lowest address), "b" is in byte 1, and "d" is in byte 2 and (highest address).
        integer ComSignalLength [0..1]: 0..4095, set at pre-compile, default-value=0  # Indicates the signal length in bytes for signals with data type UINT8_N. | For ComSignalType UINT8_N this parameter specifies the length n in bytes. For ComSignalType UINT8_DYN it specifies the maximum length in bytes. For all other types this parameter shall be ignored. Range: 0..8 for normal CAN/ LIN I-PDUs, 0..254 for normal FlexRay I-PDUs, and 0..4095 for I-PDUs with ComIPduType TP.
        enumeration ComSignalType: {BOOLEAN, SINT16, SINT32, SINT64, SINT8, UINT16, UINT32, UINT64, UINT8, UINT8_DYN, UINT8_N, FLOAT32, FLOAT64}, set at pre-compile, default-value=UINT8  # Specifies the data type that is used by the application to receive or transmit the signal through the COM APIs. | This type could also be used to reserved appropriate storage in AUTOSAR COM.
        float ComTimeout [0..1]: 0..3600, set at post-build in variant post-build-loadable+post-build-selectable / pre-compile in variant pre-compile, default-value=0  # Timeout time that is used for deadline monitoring. If the value is configured to '0' or undefined, the signal is not monitored. For signals without a configured update-bit, an I-PDU based deadline monitoring is used. The timeout time is evaluated as smallest timeout time of all signals and signal groups without configured update-bit of the I-PDU.
        function name ComTimeoutNotification [0..1]: set at pre-compile in variant post-build-loadable+pre-compile / post-build in variant post-build-selectable, min-length=1  # Defines the name and existence of the callback function that is called, if a timeout for the signal is detected. Notification functions that shall not be handled by the RTE must use a function name without the pre-fix 'Rte_'. The prototype will then be generated to the file 'Appl_Cbk.h' and has to be implemented by called module. | On receiver side: Name of Com_CbkRxTOut callback function to be called.
        enumeration ComTransferProperty [0..1]: {PENDING, TRIGGERED, TRIGGERED_ON_CHANGE, TRIGGERED_ON_CHANGE_WITHOUT_REPETITION, TRIGGERED_WITHOUT_REPETITION}, set at post-build in variant post-build-loadable+post-build-selectable / pre-compile in variant pre-compile, default-value=PENDING  # The transfer behavior for the transmission mode DIRECT or MIXED when writing to the signal can either be - TRIGGERED: the transmission of the message is triggered if the signal is written regardless of the signal value - TRIGGERED_WITHOUT_REPETITION: the transmission of the message is triggered just once without a repetition - TRIGGERED_ON_CHANGE: the transmission of the message is triggered if the signal is written and the signal value has changed - TRIGGERED_ON_CHANGE_WITHOUT_REPETITION: the transmission of the message is triggered just once without a repetition - PENDING: writing to the signal does not cause direct transmission.
        integer ComUpdateBitPosition [0..1]: 0..65535, set at post-build in variant post-build-loadable+post-build-selectable / pre-compile in variant pre-compile, default-value=0  # Bit position of the update-bit inside the I-PDU. | If this attribute is omitted then there is no update-bit. This setting must be consistently on sender and on receiver side. Range: 0..63 for CAN and LIN 0..2031 for FlexRay
        string ComRxDataTimeoutSubstitutionValue [0..1]: set at post-build in variant post-build-loadable+post-build-selectable / pre-compile in variant pre-compile, origin=Vector Informatik, default-value=0  # If this parameter and the ComRxDataTimeoutAction is configured to 'REPLACE', the signal value will be set to the value of this parameter, if a timeout occurred. The interpretation of the configured value depends on ComSignalType setting: - UINT8, UINT16, UINT32, UINT64, SINT8, SINT16, SINT32, SINT64, FLOAT32, FLOAT64 the string is interpreted as integer type ( ..., -2, -1, 0, 1, 2,...). - BOOLEAN the string is interpreted as boolean type. Possible values are "0", "1", "true", "false". - UINT8_N the string is interpreted as a decimal representation of the characters separated by blanks, e.g. "97 98 100" means a string "abd", where the char "a" is in byte 0 (lowest address), "b" is in byte 1, and "d" is in byte 2 (highest address).
        enumeration ComSignalAccess: {ACCESS_NOT_NEEDED, ACCESS_UNCLEAR, ACCESS_NEEDED_BY_SWC_OR_COM, ACCESS_NEEDED_BY_OTHER}, set at pre-compile, origin=Vector Informatik, default-value=ACCESS_UNCLEAR  # The parameter ComSignalAccess gives the Com generator the information whether a Signal access is needed or not. All Signals with ComSignalAccess != ACCESS_NOT_NEEDED can be accessed. All Signals with ComSignalAccess == ACCESS_NOT_NEEDED cannot be accessed. ACCESS_NOT_NEEDED The Signal will never be accessed. ACCESS_UNCLEAR It is unclear if the Signal will be accessed. ACCESS_NEEDED_BY_SWC_OR_COM It is clear that the Signal access is needed, e.g. by COM. This state is set by a validator ACCESS_NEEDED_BY_OTHER The Signal access is declared as to be needed. This state is set by the user.
        foreign reference ComSystemTemplateSystemSignalRef [0..1]: set at post-build in variant post-build-loadable+post-build-selectable / pre-compile in variant pre-compile, destination-type=I-SIGNAL-TO-I-PDU-MAPPING  # Reference to the ISignalToIPduMapping that contains a reference to the ISignal (System Template) which this ComSignal (or ComGroupSignal) represents.
        container ComFilter [0..1]  # Defines the filter that is applied on transmit signals. The filter result of each signal is used to determine the TxMode that shall be used for transmitting the I-PDU. For receive signal the filter is used to determine whether the reception event is forwarded to the application or not. Signal only have a filter if the ComFilter container exists. | Note: On sender side the container is used to specify the transmission mode conditions.
          enumeration ComFilterAlgorithm: {ALWAYS, MASKED_NEW_DIFFERS_MASKED_OLD, MASKED_NEW_DIFFERS_X, MASKED_NEW_EQUALS_X, NEVER, NEW_IS_OUTSIDE, NEW_IS_WITHIN}, set at post-build in variant post-build-loadable+post-build-selectable / pre-compile in variant pre-compile, default-value=NEVER  # The supported filter algorithms for signals are: - Always: This filter always evaluates to TRUE - Never: This filter always evaluates to FALSE - MaskedNewDiffersMaskedOld: ((new & mask) != (old & mask)) - MaskedNewEqualsX: ((new & mask) == x) - MaskedNewDiffersX: ((new & mask) != x) - NewIsOutside: ((new < min) || (max < new)) - NewIsWithin: ((min <= new) && (new <= max))
          integer ComFilterMask [0..1]: 0..18446744073709551615, set at post-build in variant post-build-loadable+post-build-selectable / pre-compile in variant pre-compile, default-value=18446744073709551615  # The specified mask is used for the filters: - MaskedNewDiffersMaskedOld: ((new & mask) != (old & mask)) - MaskedNewEqualsX: ((new & mask) == x) - MaskedNewDiffersX: ((new & mask) != x)
          integer ComFilterMax [0..1]: -2147483648..4294967295, set at post-build in variant post-build-loadable+post-build-selectable / pre-compile in variant pre-compile, default-value=0  # The specified max value is used for the filters: - NewIsOutside: ((new < min) || (max < new)) - NewIsWithin: ((min <= new) && (new <= max))
          integer ComFilterMin [0..1]: -2147483648..4294967295, set at post-build in variant post-build-loadable+post-build-selectable / pre-compile in variant pre-compile, default-value=0  # The specified min value is used for the filters: - NewIsOutside: ((new < min) || (max < new)) - NewIsWithin: ((min <= new) && (new <= max))
          integer ComFilterX [0..1]: -2147483648..4294967295, set at post-build in variant post-build-loadable+post-build-selectable / pre-compile in variant pre-compile, default-value=0  # The specified value X is used for the filters: - MaskedNewEqualsX: ((new & mask) == x) - MaskedNewDiffersX: ((new & mask) != x)
          integer ComFilterOffset [0..0]: 0..4294967294, set at post-build in variant post-build-loadable+post-build-selectable / pre-compile in variant pre-compile, default-value=0  # The name of this attribute corresponds to the parameter name in the [17] specification of Reception Filtering. Note: This parameter is not used by the generator. | Range = 0..(ComFilterPeriod-1)
          integer ComFilterPeriod [0..0]: 2..4294967295, set at post-build in variant post-build-loadable+post-build-selectable / pre-compile in variant pre-compile, default-value=2  # This parameter defines the period of the ComFilterAlgorithm ONE_EVERY_N. Note: This parameter is not used by the generator.
      container ComSignalGroup [0..*]: post-build-changeable=true  # Defines a signal group. Signal groups are used to transmit or receive its included group signals consistently.
        enumeration ComDataInvalidAction [0..1]: {NOTIFY, REPLACE}, set at pre-compile, default-value=NOTIFY  # This parameter defines the action performed if at least one of the included signals is an invalid signal. NOTIFY: The configured invalid notification is called and further signal processing (like signal indication) is abandoned. In this case the invalid value is not stored to preserve the last valid received value. REPLACE: The last received values of all group signals are replaced by the initial values. After the replacement the normal signal processing takes place. | Relating to signal groups the action in case if one of the included signals is an invalid signal. If Replace is used the ComSignalInitValue will be used for the replacement.
        boolean ComSignalGroupArrayAccess [0..1]: set at pre-compile, origin=Vector Informatik, default-value=false  # Defines whether the uint8-array based access shall be used for this ComSignalGroup.
        function name ComErrorNotification [0..1]: set at pre-compile in variant post-build-loadable+pre-compile / post-build in variant post-build-selectable, min-length=1  # Defines the name and existence of the error notification function that is called in case of transmit errors The notification is called for not confirmed send requests, if the corresponding I-PDU group is getting stopped or the COM module is de-initialized. The error notification function is not available for receive signal groups. Notification functions that shall not be handled by the RTE must use a function name without the pre-fix 'Rte_'. The prototype will then be generated to the file 'Appl_Cbk.h' and has to be implemented by called module. | If this parameter is omitted no error notification shall take place.
        float ComFirstTimeout [0..1]: 0..3600, set at post-build in variant post-build-loadable+post-build-selectable / pre-compile in variant pre-compile, default-value=0  # Timeout time that is used for reception deadline monitoring immediately after start (or restart) of the deadline monitoring service. If the parameter is undefined or configured to 0, the signal group reception is not monitored from the BSW initialization until the I-PDU is received for the first time. After the first reception ComTimeout will be used o monitor signal group reception. For signal groups without a configured update-bit, an I-PDU based deadline monitoring is used. The first timeout time is evaluated as smallest first timeout time of all signals and signal groups without configured update-bit of the I-PDU.
        integer ComHandleId [0..1]: 0..65535, set at pre-compile, symbolic-name-value=true, default-value=0  # The numerical value used as the ID. | For signals it is required by the API calls Com_UpdateShadowSignal, Com_ReceiveShadowSignal and Com_InvalidateShadowSignal. For signal groups it is required by the Com_SendSignalGroup and Com_ReceiveSignalGroup calls.
        function name ComInvalidNotification [0..1]: set at pre-compile in variant post-build-loadable+pre-compile / post-build in variant post-build-selectable, min-length=1  # Defines the name and existence of callback function that is called if the signal has been identified to be invalid. The notification is called if the invalid action is configured to 'NOTIFY' and an invalid value is received. The call context depends on the configured signal processing of the corresponding I-PDU. Notification functions that shall not be handled by the RTE must use a function name without the pre-fix 'Rte_'. The prototype will then be generated to the file 'Appl_Cbk.h' and has to be implemented by called module.
        function name ComNotification [0..1]: set at pre-compile in variant post-build-loadable+pre-compile / post-build in variant post-build-selectable, min-length=1  # Defines the name and existence of a callback function. The notification is called for Tx signal groups, if the transmission of the signal group is confirmed, for Rx signal groups, if the signal group is received. The call context depends on the configured signal processing of the corresponding I-PDU. Notification functions that shall not be handled by the RTE must use a function name without the pre-fix 'Rte_'. The prototype will then be generated to the file 'Appl_Cbk.h' and has to be implemented by called module. | On receiver side: Name of Com_CbkRxAck callback function to be called. If this parameter is omitted no notification shall take place.
        enumeration ComRxDataTimeoutAction [0..1]: {NONE, REPLACE}, set at pre-compile, default-value=NONE  # If this parameter is configured to 'REPLACE', the initial values of all group signals are set if a timeout occurred. If this parameter is configured to 'NONE' or undefined, the last received values are maintained.
        float ComTimeout [0..1]: 0..3600, set at post-build in variant post-build-loadable+post-build-selectable / pre-compile in variant pre-compile, default-value=0  # Timeout time that is used for deadline monitoring. If the value is configured to '0' or undefined, the signal group is not monitored. For signal groups without a configured update-bit, an I-PDU based deadline monitoring is used. The timeout time is evaluated as smallest timeout time of all signals and signal groups without configured update-bit of the I-PDU.
        function name ComTimeoutNotification [0..1]: set at pre-compile in variant post-build-loadable+pre-compile / post-build in variant post-build-selectable, min-length=1  # Defines the name and existence of the callback function that is called, if a timeout for the signal group is detected. Notification functions that shall not be handled by the RTE must use a function name without the pre-fix 'Rte_'. The prototype will then be generated to the file 'Appl_Cbk.h' and has to be implemented by called module. | On receiver side: Name of Com_CbkRxTOut callback function to be called.
        enumeration ComTransferProperty [0..1]: {PENDING, TRIGGERED, TRIGGERED_ON_CHANGE, TRIGGERED_ON_CHANGE_WITHOUT_REPETITION, TRIGGERED_WITHOUT_REPETITION}, set at post-build in variant post-build-loadable+post-build-selectable / pre-compile in variant pre-compile, default-value=PENDING  # The transfer behavior for the transmission mode DIRECT or MIXED when writing to the signal group can either be - TRIGGERED: the transmission of the message is triggered if at least one group signal of signal group is written regardless of the group signal value - TRIGGERED_WITHOUT_REPETITION: the transmission of the message is triggered just once without a repetition - TRIGGERED_ON_CHANGE: the transmission of the message is triggered if at least one group signal of signal group is written and the group signal value has changed - TRIGGERED_ON_CHANGE_WITHOUT_REPETITION: the transmission of the message is triggered just once without a repetition - PENDING: writing to the signal group does not cause direct transmission. Note: If at least one group signal of the signal group has a defined transfer property not equal to PENDING, the transfer property of the signal group will be ignored and the trigger will be evaluated per group signal.
        integer ComUpdateBitPosition [0..1]: 0..65535, set at post-build in variant post-build-loadable+post-build-selectable / pre-compile in variant pre-compile, default-value=0  # Bit position of the update-bit inside the I-PDU. | If this attribute is omitted then there is no update-bit. This setting must be consistently on sender and on receiver side. Range: 0..63 for CAN and LIN 0..2031 for FlexRay
        enumeration ComSignalGroupAccess: {ACCESS_NOT_NEEDED, ACCESS_UNCLEAR, ACCESS_NEEDED_BY_SWC_OR_COM, ACCESS_NEEDED_BY_OTHER}, set at pre-compile, origin=Vector Informatik, default-value=ACCESS_UNCLEAR  # The parameter ComSignalGroupAccess gives the Com generator the information whether a SignalGroup access is needed or not. All Signals with ComSignalGroupAccess != ACCESS_NOT_NEEDED can be accessed. All Signals with ComSignalGroupAccess == ACCESS_NOT_NEEDED cannot be accessed. ACCESS_NOT_NEEDED The SignalGroup will never be accessed. ACCESS_UNCLEAR It is unclear if the SignalGroup will be accessed. ACCESS_NEEDED_BY_SWC_OR_COM It is clear that the SignalGroup access is needed, e.g. by COM. This state is set by a validator ACCESS_NEEDED_BY_OTHER The SignalGroup access is declared as to be needed. This state is set by the user.
        foreign reference ComSystemTemplateSignalGroupRef [0..1]: set at post-build in variant post-build-loadable+post-build-selectable / pre-compile in variant pre-compile, destination-type=I-SIGNAL-TO-I-PDU-MAPPING  # Reference to the ISignalToIPduMapping that contains a reference to the ISignalGroup (SystemTemplate) which this ComSignalGroup represents.
        container ComGroupSignal [1..*]: post-build-changeable=true  # Specifies a group signal that is included within the signal group.
          integer ComBitPosition: 0..65535, set at post-build in variant post-build-loadable+post-build-selectable / pre-compile in variant pre-compile, default-value=0  # Starting position within the I-PDU (not in the shadow buffer). The interpretation of the bit position depends on the signal endianness: BIG_ENDIAN: bit position refers to the MSB. LITTLE_ENDIAN: bit position refers to the LSB. OPAQUE: bit position refers to bit0 of the first byte like in little endian byte order.
          integer ComBitSize [0..1]: 0..64, set at post-build in variant post-build-loadable+post-build-selectable / pre-compile in variant pre-compile, default-value=8  # Size in bits, for non-array signal types. | For ComSignalType UINT8_N and UINT8_DYN this size shall be configured by ComSignalLength.
          integer ComHandleId [0..1]: 0..65535, set at pre-compile, symbolic-name-value=true, default-value=0  # The numerical value used as the ID. | For signals it is required by the API calls Com_UpdateShadowSignal, Com_ReceiveShadowSignal and Com_InvalidateShadowSignal. For signals groups it is required by the Com_SendSignalGroup and Com_ReceiveSignalGroup calls.
          string ComSignalDataInvalidValue [0..1]: set at pre-compile, default-value=0  # Defines the invalid value of the group signal. The invalid value is a dedicated value that is transmitted in case the application cannot provide a valid value. The reception of an invalid signal value can trigger special invalid handling on receiver side. The interpretation of the configured value depends on ComSignalType setting: - UINT8, UINT16, UINT32, UINT64, SINT8, SINT16, SINT32, SINT64, FLOAT32, FLOAT64 the string is interpreted as integer type ( ..., -2, -1, 0, 1, 2,...). - BOOLEAN the string is interpreted as boolean type. Possible values are "0", "1", "true", "false". - UINT8_N the string is interpreted as a decimal representation of the characters separated by blanks, e.g. "97 98 100" means a string "abd", where the char "a" is in byte 0 (lowest address), "b" is in byte 1, and "d" is in byte 2 (highest address). | In case the ComSignalType is UINT8, UINT16, UINT32, UINT64, SINT8, SINT16, SINT32, SINT64 the string shall be interpreted as defined in the chapter Integer Type in the AUTOSAR EcuC specification. In case the ComSignalType is BOOLEAN the string shall be interpreted as defined in the chapter Boolean Type in the AUTOSAR EcuC specification. In case the ComSignal is a UINT8_N, uint8_DYN the string shall be interpreted as a decimal representation of the characters separated by blanks, e.g. "97 98 100" means a string "abd", where the char "a" is in byte 0(lowest address), "b" is in byte 1, and "d" is in byte 2 and (highest address).
          enumeration ComSignalEndianness: {BIG_ENDIAN, LITTLE_ENDIAN, OPAQUE}, set at post-build in variant post-build-loadable+post-build-selectable / pre-compile in variant pre-compile, default-value=LITTLE_ENDIAN  # Defines the endianness of the group signal's network representation. OPAQUE indicates that no byte order conversion is performed (e.g. for byte arrays).
          string ComSignalInitValue: set at post-build in variant post-build-loadable+post-build-selectable / pre-compile in variant pre-compile, default-value=0  # Initial value for this signal. The value is set during initialization of the module and if the corresponding I-PDU group is getting started with parameter 'initialize' set to 'true'. Note: The interpretation of the configured string depends on ComSignalType: - UINT8, UINT16, UINT32, UINT64, SINT8, SINT16, SINT32, SINT64, FLOAT32, FLOAT64 the string is interpreted as integer type ( ..., -2, -1, 0, 1, 2,...). - BOOLEAN the string is interpreted as boolean type. It can be one of "0", "1", "true", "false". - UINT8_N the string is interpreted as a decimal representation of the characters separated by blanks, e.g. "97 98 100" means a string "abd", where the char "a" is in byte 0 (lowest address), "b" is in byte 1, and "d" is in byte 2 (highest address). | In case the ComSignalType is UINT8, UINT16, UINT32, UINT64, SINT8, SINT16, SINT32, SINT64 the string shall be interpreted as defined in the chapter Integer Type in the AUTOSAR EcuC specification. In case the ComSignalType is BOOLEAN the string shall be interpreted as defined in the chapter Boolean Type in the AUTOSAR EcuC specification. In case the ComSignal is a UINT8_N, uint8_DYN the string shall be interpreted as a decimal representation of the characters separated by blanks, e.g. "97 98 100" means a string "abd", where the char "a" is in byte 0(lowest address), "b" is in byte 1, and "d" is in byte 2 and (highest address).
          integer ComSignalLength [0..1]: 0..4095, set at pre-compile, default-value=0  # For ComSignalType UINT8_N this parameter specifies the length n in bytes. For ComSignalType UINT8_DYN it specifies the maximum length in bytes. For all other types this parameter shall be ignored. | For ComSignalType UINT8_N this parameter specifies the length n in bytes. For ComSignalType UINT8_DYN it specifies the maximum length in bytes. For all other types this parameter shall be ignored. Range: 0..8 for normal CAN/ LIN I-PDUs, 0..254 for normal FlexRay I-PDUs, and 0..4095 for I-PDUs with ComIPduType TP.
          enumeration ComSignalType: {BOOLEAN, SINT64, SINT16, SINT32, SINT8, UINT16, UINT32, UINT64, UINT8, UINT8_DYN, UINT8_N, FLOAT32, FLOAT64}, set at pre-compile, default-value=UINT8  # Specifies the data type that is used by the application to receive or transmit the signal through the COM APIs. | This type could also be used to reserved appropriate storage in AUTOSAR COM.
          enumeration ComTransferProperty [0..1]: {PENDING, TRIGGERED_ON_CHANGE, TRIGGERED, TRIGGERED_ON_CHANGE_WITHOUT_REPETITION, TRIGGERED_WITHOUT_REPETITION}, set at post-build in variant post-build-loadable+post-build-selectable / pre-compile in variant pre-compile, default-value=PENDING  # The transfer behavior for the transmission mode DIRECT or MIXED when writing to the group signal can either be - TRIGGERED: the transmission of the message is triggered if the group signal is written regardless of the group signal value - TRIGGERED_WITHOUT_REPETITION: the transmission of the message is triggered just once without a repetition - TRIGGERED_ON_CHANGE: the transmission of the message is triggered if the group signal is written and the group signal value has changed - TRIGGERED_ON_CHANGE_WITHOUT_REPETITION: the transmission of the message is triggered just once without a repetition - PENDING: writing to the group signal does not cause direct transmission. Note: If all the transfer properties of the group signals of a signal group equals PENDING, the transfer property of the signal group will be evaluated for the group signals.
          string ComRxDataTimeoutSubstitutionValue [0..1]: set at post-build in variant post-build-loadable+post-build-selectable / pre-compile in variant pre-compile, origin=Vector Informatik, default-value=0  # If this parameter and the ComRxDataTimeoutAction is configured to 'REPLACE', the signal value will be set to the value of this parameter, if a timeout occurred. The interpretation of the configured value depends on ComSignalType setting: - UINT8, UINT16, UINT32, UINT64, SINT8, SINT16, SINT32, SINT64, FLOAT32, FLOAT64 the string is interpreted as integer type ( ..., -2, -1, 0, 1, 2,...). - BOOLEAN the string is interpreted as boolean type. Possible values are "0", "1", "true", "false". - UINT8_N the string is interpreted as a decimal representation of the characters separated by blanks, e.g. "97 98 100" means a string "abd", where the char "a" is in byte 0 (lowest address), "b" is in byte 1, and "d" is in byte 2 (highest address).
          enumeration ComSignalAccess: {ACCESS_NOT_NEEDED, ACCESS_UNCLEAR, ACCESS_NEEDED_BY_SWC_OR_COM, ACCESS_NEEDED_BY_OTHER}, set at pre-compile, origin=Vector Informatik, default-value=ACCESS_UNCLEAR  # The parameter ComSignalAccess gives the Com generator the information whether a GroupSignal access is needed or not. All GroupSignals with ComSignalAccess != ACCESS_NOT_NEEDED can be accessed. All GroupSignals with ComSignalAccess == ACCESS_NOT_NEEDED cannot be accessed. ACCESS_NOT_NEEDED The GroupSignal will never be accessed. ACCESS_UNCLEAR It is unclear if the GroupSignal will be accessed. ACCESS_NEEDED_BY_SWC_OR_COM It is clear that the GroupSignal access is needed, e.g. by COM. This state is set by a validator ACCESS_NEEDED_BY_OTHER The GroupSignal access is declared as to be needed. This state is set by the user.
          foreign reference ComSystemTemplateSystemSignalRef [0..1]: set at post-build in variant post-build-loadable+post-build-selectable / pre-compile in variant pre-compile, destination-type=I-SIGNAL-TO-I-PDU-MAPPING  # Reference to the ISignalToIPduMapping that contains a reference to the ISignal (System Template) which this ComSignal (or ComGroupSignal) represents.
          container ComFilter [0..1]  # Defines the filter that is applied on transmit signals. The filter result of each signal is used to determine the TxMode that shall be used for transmitting the I-PDU. For receive signal the filter is used to determine whether the reception event is forwarded to the application or not. Signal only have a filter if the ComFilter container exists. | Note: On sender side the container is used to specify the transmission mode conditions.
            enumeration ComFilterAlgorithm: {ALWAYS, MASKED_NEW_DIFFERS_MASKED_OLD, MASKED_NEW_DIFFERS_X, MASKED_NEW_EQUALS_X, NEVER, NEW_IS_OUTSIDE, NEW_IS_WITHIN}, set at post-build in variant post-build-loadable+post-build-selectable / pre-compile in variant pre-compile, default-value=NEVER  # The supported filter algorithms for group signals are: - Always: This filter always evaluates to TRUE - Never: This filter always evaluates to FALSE - MaskedNewDiffersMaskedOld: ((new & mask) != (old & mask)) - MaskedNewEqualsX: ((new & mask) == x) - MaskedNewDiffersX: ((new & mask) != x) - NewIsOutside: ((new < min) || (max < new)) - NewIsWithin: ((min <= new) && (new <= max))
            integer ComFilterMask [0..1]: 0..18446744073709551615, set at post-build in variant post-build-loadable+post-build-selectable / pre-compile in variant pre-compile, default-value=18446744073709551615  # Only valid on sender side: The supported filter algorithms for Tx signals are: - None: The signal has no filter (Multiplicity of ComFilter) - Always: This filter always evaluates to TRUE - Never: This filter always evaluates to FALSE - MaskedNewDiffersMaskedOld: ((new & mask) != (old & mask)) - MaskedNewEqualsX: ((new & mask) == x) - MaskedNewDiffersX: ((new & mask) != x) - NewIsOutside: ((new < min) || (max < new)) - NewIsWithin: ((min <= new) && (new <= max))
            integer ComFilterMax [0..1]: -2147483648..4294967295, set at post-build in variant post-build-loadable+post-build-selectable / pre-compile in variant pre-compile, default-value=0  # The specified max value is used for the filters: - NewIsOutside: ((new < min) || (max < new)) - NewIsWithin: ((min <= new) && (new <= max))
            integer ComFilterMin [0..1]: -2147483648..4294967295, set at post-build in variant post-build-loadable+post-build-selectable / pre-compile in variant pre-compile, default-value=0  # The specified min value is used for the filters: - NewIsOutside: ((new < min) || (max < new)) - NewIsWithin: ((min <= new) && (new <= max))
            integer ComFilterX [0..1]: -2147483648..4294967295, set at post-build in variant post-build-loadable+post-build-selectable / pre-compile in variant pre-compile, default-value=0  # The specified value X is used for the filters: - MaskedNewEqualsX: ((new & mask) == x) - MaskedNewDiffersX: ((new & mask) != x)
            integer ComFilterOffset [0..0]: 0..4294967294, set at post-build in variant post-build-loadable+post-build-selectable / pre-compile in variant pre-compile, default-value=0  # The name of this attribute corresponds to the parameter name in the [17] specification of Reception Filtering. Note: This parameter is not used by the generator. | Range = 0..(ComFilterPeriod-1)
            integer ComFilterPeriod [0..0]: 2..4294967295, set at post-build in variant post-build-loadable+post-build-selectable / pre-compile in variant pre-compile, default-value=2  # This parameter defines the period of the ComFilterAlgorithm ONE_EVERY_N. Note: This parameter is not used by the generator.
      container ComMainFunctionRx [0..*]  # Each element of this container defines one instance of Com_MainFunctionRx.
        float ComMainRxTimeBase: 0..3600, set at pre-compile, origin=Vector Informatik, default-value=0.01  # The period between successive calls to according instance of Com_MainFunctionRx in seconds. This parameter is used by the COM generator to transform the values of the reception related timing configuration parameters of the COM module to internal counter values.
        integer ComMainFunctionRxHandleId: 0..65535, set at pre-compile, origin=Vector Informatik, symbolic-name-value=true, default-value=0  # The numerical value used as the ID of this MainFunctionRx.
        reference ComMainRxPartitionRef [0..1]: set at pre-compile, origin=Vector Informatik, destination=EcucPartition  # Reference to EcucPartition, where the according Com_MainFunctionRx instance is assigned to.
      container ComMainFunctionTx [0..*]  # Each element of this container defines one instance of Com_MainFunctionTx.
        float ComMainTxTimeBase: 0..3600, set at pre-compile, origin=Vector Informatik, default-value=0.01  # The period between successive calls to according instance of Com_MainFunctionTx in seconds. This parameter is used by the COM generator to transform the values of the transmission related timing configuration parameters of the COM module to internal counter values.
        integer ComMainFunctionTxHandleId: 0..65535, set at pre-compile, origin=Vector Informatik, symbolic-name-value=true, default-value=0  # The numerical value used as the ID of this MainFunctionTx.
        reference ComMainTxPartitionRef [0..1]: set at pre-compile, origin=Vector Informatik, destination=EcucPartition  # Reference to EcucPartition, where the according Com_MainFunctionTx instance is assigned to.
      container ComMainFunctionRouteSignals [0..*]  # Each element of this container defines one instance of Com_MainFunctionRouteSignals.
        float ComMainRouteSignalsTimeBase: 0..3600, set at pre-compile, origin=Vector Informatik, default-value=0.01  # The period between successive calls to according instance of Com_MainFunctionRouteSignals in seconds. This parameter is used by the COM generator to transform the values of the reception related timing configuration parameters of the COM module to internal counter values.
        integer ComMainFunctionRouteSignalsHandleId: 0..65535, set at pre-compile, origin=Vector Informatik, symbolic-name-value=true, default-value=0  # The numerical value used as the ID of this ComMainFunctionRouteSignals.
        reference ComMainRouteSignalsPartitionRef [0..1]: set at pre-compile, origin=Vector Informatik, destination=EcucPartition  # Reference to EcucPartition, where the according Com_MainFunction instance is assigned to.
      choice container ComCrossPartitionRoutingQueue [0..*]: post-build-changeable=true  # Common configuration container for all supported queue variants of the Com
        container ComSignalGatewayQueue [0..1]  # Cross-partition queue is used to perform the routing between different partitions. Each container consists of two unidirectional cross-partition queues from partition A to partition B and vice versa. It is possible to specify the queue size for each direction independently.
          integer ComCrossPartitionQueueSizeAtoB: 0..4294967295, set at post-build in variant post-build-loadable+post-build-selectable / pre-compile in variant pre-compile, origin=Vector Informatik  # Size of the cross-partition queue for communication from partition A to partition B.
          integer ComCrossPartitionQueueSizeBtoA: 0..4294967295, set at post-build in variant post-build-loadable+post-build-selectable / pre-compile in variant pre-compile, origin=Vector Informatik  # Size of the cross-partition queue for communication from partition B to partition A.
          reference ComEcucPartitionARef: set at pre-compile, origin=Vector Informatik, destination=EcucPartition  # Reference to EcuC Partition A.
          reference ComEcucPartitionBRef: set at pre-compile, origin=Vector Informatik, destination=EcucPartition  # Reference to EcuC Partition B.
        container ComDescriptionRoutingQueue [0..1]  # Cross-partition queue is used to perform the routing between different partitions. Each container consists of two unidirectional cross-partition queues from partition A to partition B and vice versa. It is possible to specify the queue size for each direction independently.
          integer ComCrossPartitionQueueSizeAtoB: 0..4294967295, set at post-build in variant post-build-loadable+post-build-selectable / pre-compile in variant pre-compile, origin=Vector Informatik  # Size of the cross-partition queue for communication from partition A to partition B.
          integer ComCrossPartitionQueueSizeBtoA: 0..4294967295, set at post-build in variant post-build-loadable+post-build-selectable / pre-compile in variant pre-compile, origin=Vector Informatik  # Size of the cross-partition queue for communication from partition B to partition A.
          reference ComEcucPartitionARef: set at pre-compile, origin=Vector Informatik, destination=EcucPartition  # Reference to EcuC Partition A.
          reference ComEcucPartitionBRef: set at pre-compile, origin=Vector Informatik, destination=EcucPartition  # Reference to EcuC Partition B.
    container ComGeneral  # Contains the general configuration parameters of the module.
      boolean ComConfigurationUseDet: set at pre-compile, default-value=true  # If 'Development Error Detection' is enabled, all development errors are reported to the Development Error Tracer (DET). The errors are described in the technical reference. Note: In general, the development error detection is recommended during pre-test phase. It is not recommended to enable the development error detection in production code due to increased runtime and ROM needs. | If this parameter is configured COM_DEV_ERROR_DETECT shall be set to ON as output of the configuration tool. (as input for the source code), see COM028.
      boolean ComSafeBswChecks: set at pre-compile, origin=Vector Informatik, default-value=false  # Selects if safety checks are used. These checks improve robustness as e.g. invalid parameters are checked before function is executed. This attribute has to be enabled for safety projects where this component is mapped to an ASIL partition.
      boolean ComEnableMDTForCyclicTransmission [0..1]: set at pre-compile, default-value=true  # Enables globally for the whole COM module the minimum delay time monitoring for cyclic and repeated transmissions (ComTxModeMode=PERIODIC or ComTxModeMode=MIXED for the cyclic transmissions, ComTxModeNumberOfRepetitions > 0 for repeated transmissions).
      boolean ComEnableSignalGroupArrayApi: set at pre-compile, origin=Vector Informatik, default-value=false  # Activate/Deactivate the signal group array access APIs (Com_SendSignalGroupArray, Com_ReceiveSignalGroupArray). | true: signal group array access APIs activated false: signal group array access APIs deactivated
      boolean ComRetryFailedTransmitRequests: set at pre-compile, default-value=false  # If the feature is activated, the COM repeats transmission requests of a Tx I-PDU to the underlying layer if E_NOT_OK is returned. If the feature is deactivated, the COM will ignore all errors from the underlying communication layer as recommended by AUTOSAR.
      integer ComSupportedIPduGroups: 0..65535, set at pre-compile, default-value=0  # Note: This parameter is not used by the generator.
      boolean ComVersionInfoApi: set at pre-compile, default-value=false  # Note: This parameter is not used by the generator.
      string ComUserConfigFile [0..1]: set at pre-compile, origin=Vector Informatik  # Reference to an external user configuration file that will be included during generation. The content of the user configuration file will be added at the end of the generated module configuration file and allows altering or extending the generated code. Caution: User configuration files can cause the software module to malfunction and must only be used with great care!
      boolean ComMetaDataSupport: set at pre-compile, origin=Vector Informatik, default-value=false  # Note: This parameter is not used by the generator.
      string ComUserCbkHeaderFile [0..*]: set at pre-compile, origin=Vector Informatik, max-length=32, min-length=1  # Defines the header files for callback functions which shall be included by the COM module.
      boolean ComDescriptionGateway: set at pre-compile, origin=Vector Informatik, default-value=false  # Activate/Deactivate the ComGwSourceDescription and ComGwDestinationDescription based Gateway.
      boolean ComStrictRepetitionPeriod: set at pre-compile, origin=Vector Informatik, default-value=false  # Defines how the ComTxModeRepetitionPeriod is affected by the ComMinimumDelayTime. If the feature is activated, the time between two transmits equals ComTxModeRepetitionPeriod (Autosar 4.0.3). If the feature is deactivated, the time between two transmits can be shorter than ComTxModeRepetitionPeriod if the first transmit is delayed by the ComMinimumDelayTime (Autosar 4.1.3).
      boolean ComMixedModePeriodicSuppression: set at pre-compile, origin=Vector Informatik, default-value=false  # Mixed transmission mode PDUs with repetitions: the periodic part is suppressed.
      enumeration ComSignalGateway: {NONE, MINIMALSIGNALPROCESSING, COMPLETESIGNALPROCESSING}, set at pre-compile, origin=Vector Informatik, default-value=NONE  # Define if SignalGateway shall be used and what kind of signal routing shall be used. NONE: No Signal Gateway shall be used. MINIMALSIGNALPROCESSING: Endianness conversion, sign extension, check of update bits, I-PDU callout, reset reception deadline monitoring for I-PDU based monitoring is performed, before any signal is routed to its destination (ASR Version 4.3). COMPLETESIGNALPROCESSING: Signal invalidation, reception filtering and replace action of signal-based deadline monitoring are performed in addition to the MINIMALSIGNALPROCESSING steps, before any signal is routed to its destination (ASR Version 4.2). The resulting value after the complete signal processing is routed to the destination.
      boolean ComMultiPartition: set at pre-compile, origin=Vector Informatik, default-value=false  # Enabled, if multi-partition capabilities are used.
    container ComGeneration  # Contains the generation configuration parameters of the module Com.
      enumeration ComOutOfBoundsWriteProtectionStrategy: set at pre-compile, origin=Vector Informatik, default-value=NONE  # This parameter is used to configure a strategy to protect the code to write out of bounds. NONE: no protection strategy is generated in the data access. INDEX_SATURATION: arrays are blown up and the data access index is saturated by an appropriate mask. The advantage is the speed of the data access, but own data elements at other indexes of the same variable can be overridden. This debugging feature must not be used in production code! INDEX_CHECKING: the data access index is validated by a runtime check. The advantage is that values are never written to incorrect indexes of the data access. This debugging feature must not be used in production code!
        NONE  # none
        INDEX_SATURATION  # index saturation
        INDEX_CHECKING  # index checking
      boolean ComOutOfBoundsWriteSanitizer: set at pre-compile, origin=Vector Informatik, default-value=false  # This parameter activates/deactivates the generation of runtime checks which call a DET error notification function to find easily out of bounds write problems. This debugging feature must not be used in production code! FALSE: no checks are generated in the data access. TRUE: the data access is enriched with DET checks to validate indexes.
      boolean ComOutOfBoundsReadSanitizer: set at pre-compile, origin=Vector Informatik, default-value=false  # This parameter activates/deactivates the generation of runtime checks which call a DET error notification function to find easily out of bounds read problems. This debugging feature must not be used in production code! FALSE: no checks are generated in the data access. TRUE: the data access is enriched with DET checks to validate indexes.
      boolean ComReduceConstantData2Define: set at pre-compile, origin=Vector Informatik, default-value=true  # Reduce Constant Data To a Define | This parameter activates/deactivates the capability to generate CONFIG-CLASS PRE-COMPILE ROM arrays as constant define. FALSE: ROM arrays are generated as data even if all values are identical. TRUE: ROM arrays are generated as constant define if all values are identical.
      enumeration ComBoolDataInArrayOfStructStrategy: set at pre-compile, origin=Vector Informatik, default-value=BITFIELD  # This parameter is used to tailor the usage of boolean data in structures in all CONFIG-CLASSES. The difference between BITFIELD and BITMASKING depends on your compiler options and memory mapping. BOOLEAN: The datatype of boolean data is native boolean. Code: the code size is small. RAM: no change expected. ROM: the ROM size is large. Runtime: the runtime is fast. BITFIELD: The bitfield type is used and the compiler extracts the boolean data from structures. Code: the code size is larger than using BOOLEAN. RAM: no change expected. ROM: the ROM size is smaller than using BOOLEAN. Runtime: the runtime is larger than using BOOLEAN. BITMASKING: Generated Masks are used to extract the boolean data from structures. Code: the code size is larger than using BOOLEAN. RAM: no change expected. ROM: the ROM size is smaller than using BOOLEAN. Runtime: the runtime is larger than using BOOLEAN.
        BOOLEAN  # boolean
        BITFIELD  # bitfield
        BITMASKING  # bitmasking
      boolean ComDeduplicateIndirectedData: set at pre-compile, origin=Vector Informatik, default-value=true  # This parameter activates/deactivates the capability to compress 0:N relational ROM data in all CONFIG-CLASSES without increasing the runtime. This option can be used in lib builds and in postbuild configurations. TRUE: 0:N relational ROM data is compressed without decreasing the runtime. Code: no change expected. RAM: no change expected. ROM: the ROM size is minimized. Runtime: no change expected. FALSE: 0:N relational ROM data is not compressed.
      enumeration ComDataDeduplicationStrategy: set at pre-compile, origin=Vector Informatik, default-value=WITH_CAST  # This parameter is used to deduplicate CONFIG-CLASS PRE-COMPILE ROM data. NONE: The generated data is not deduplicated. WITHOUT_CAST: The data is deduplicated without using casts. Code: no change expected. RAM: no change expected. ROM: the ROM size can be minimized. Runtime: no change expected. WITH_CAST: The data is deduplicated using casts. Code: no change expected. RAM: no change expected. ROM: the ROM size can be minimized more than in DEDUPLICATE_CONST_DATA_WITHOUT_CAST. Runtime: no change expected.
        NONE  # none
        WITHOUT_CAST  # without cast
        WITH_CAST  # with cast
      integer ComReduceBoolDataByNegationThreshold: 0..9223372036854775807, set at pre-compile, origin=Vector Informatik, default-value=2  # This parameter activates/deactivates the capability to compress boolean CONFIG-CLASS PRE-COMPILE ROM data by using the negation operator. 0: The optimization is deactivated. >0: If the number of deduplicateable elements is greater than this threshold the data optimization can be performed. Code: the code size is increased due to the usage of the negation operator in the data access. RAM: no change expected. ROM: the ROM size is minimized. Runtime: the runtime is increased due to the usage of the negation operator in the data access.
      integer ComReduceBoolDataByNumericalComparisonThreshold: 0..9223372036854775807, set at pre-compile, origin=Vector Informatik, default-value=2  # This parameter activates/deactivates the capability to compress boolean CONFIG-CLASS PRE-COMPILE ROM data by using numerical comparison with other ROM data. 0: The optimization is deactivated. >0: If the number of deduplicateable elements is greater than this threshold the data optimization can be performed. Code: the code size is increased due to the usage of the operation in the data access. RAM: no change expected. ROM: the ROM size is minimized. Runtime: the runtime is increased due to the usage of the operation in the data access.
      integer ComReduceBoolDataByNumericalRelationThreshold: 0..9223372036854775807, set at pre-compile, origin=Vector Informatik, default-value=2  # This parameter activates/deactivates the capability to compress boolean CONFIG-CLASS PRE-COMPILE ROM data by using relational comparison with other ROM data. 0: The optimization is deactivated. >0: If the number of deduplicateable elements is greater than this threshold the data optimization can be performed. Code: the code size is increased due to the usage of the operation in the data access. RAM: no change expected. ROM: the ROM size is minimized. Runtime: the runtime is increased due to the usage of the operation in the data access.
      enumeration ComReduceBoolDataByNumericalOperandStrategy: set at pre-compile, origin=Vector Informatik, default-value=WITH_ANY_VALUE  # This parameter is used to taylor the CONFIG-CLASS PRE-COMPILE ROM data deduplication mechaisms. A comparison with 0 is very efficient, but a numerical comparison with a value not 0 can be used to increase the ROM data compression rate. NONE: ROM data deduplications are switched off. Code: the code size is small. RAM: no change expected. ROM: the ROM size is large. Runtime: the runtime is fast. WITH_ZERO: ROM data deduplications can be applied with the value 0. Code: the code size is larger than using NONE RAM: no change expected. ROM: the ROM size is smaller than using NONE. Runtime: the runtime is larger than using NONE. WITH_ANY_VALUE: ROM data deduplications can be applied with any numerical value. Code: the code size is larger than using NONE RAM: no change expected. ROM: the ROM size is smaller than using DEDUPLICATE_DATA_WITH_ZERO. Runtime: the runtime is larger than using NONE.
        NONE  # none
        WITH_ZERO  # with 0
        WITH_ANY_VALUE  # with any value
      integer ComReduceNumericalDataByOffsetThreshold: 0..9223372036854775807, set at pre-compile, origin=Vector Informatik, default-value=2  # This parameter activates/deactivates the capability to compress numerical CONFIG-CLASS PRE-COMPILE ROM data by using a constant offset. 0: The optimization is not performed. >0: This is the threshold to activate the data optimization. Code: the code size is increased due to the usage of the constant offset operation in the data access. RAM: no change expected. ROM: the ROM size is minimized. Runtime: the runtime is increased due to the usage of the constant offset operation in the data access.
      integer ComReduceNumericalDataByArraySubtractionThreshold: 0..9223372036854775807, set at pre-compile, origin=Vector Informatik, default-value=2  # This parameter activates/deactivates the capability to compress numerical CONFIG-CLASS PRE-COMPILE ROM data by using a sutraction with other ROM data. 0: The optimization is not performed. >0: This is the threshold to activate the data optimization. Code: the code size is increased due to the usage of the operation in the data access. RAM: no change expected. ROM: the ROM size is minimized. Runtime: the runtime is increased due to the usage of the operation in the data access.
      boolean ComReduceDataByStreaming: set at pre-compile, origin=Vector Informatik, default-value=false  # This parameter activates/deactivates the capability to pack generated CONFIG-CLASS PRE-COMPILE ROM data into a data type dependent stream. TRUE: generated const data is packed into a data type dependent stream. Code: no change expected. RAM: no change expected. ROM: configuration dependent smaller than with FALSE. Runtime: no change expected. FALSE: generated const data is not packed into a data type dependent stream.
      boolean ComShortSymbols: set at pre-compile, origin=Vector Informatik, default-value=false  # This parameter activates/deactivates the capability to generate shortened symbol names. FALSE: symbol names are generated in a human readable style based on the MIP, tags and variant names. TRUE: symbol names are generated based on the MIP and a CRC32.
      boolean ComInterfacesForDeactivatedData: set at pre-compile, origin=Vector Informatik, default-value=false  # This parameter activates/deactivates the capability to generate bsw data interfaces for deactivated data elements. This is an advantage for the BSW developer to reduce the time to market with a development environment using auto completition and to investigate potential interfaces. FALSE: data interfaces are not generated if the data elementis deactivated. TRUE: data interfaces are generated as e.g. emty macros.
      boolean ComReferringKeysInComments: set at pre-compile, origin=Vector Informatik, default-value=false  # This parameter activates/deactivates the capability to generate referring keys in comments. This is an advantage for the developer to investigate indirections, but this feature reduces the overall readability of the generated data. FALSE: referring keys are not generated in comments. TRUE: referring keys are generated in comments.
      integer ComNumberOfElementsCommentThreshold: 0..9223372036854775807, set at pre-compile, origin=Vector Informatik, default-value=1000  # This parameter defines the maximum number of elements up to which comments for iterable var data are printed. These comments contain the referable keys corresponding to the index. 0: No Comments are printed. >0: Comments are printed for var data, if the contained number of elements is less than the specified threshold.
    container ComOptimization  # Contains parameters that can change the module runtime.
      integer ComTxProcessingISRLockThreshold: 0..65534, set at post-build in variant post-build-loadable+post-build-selectable / pre-compile in variant pre-compile, origin=Vector Informatik, default-value=1  # This parameter defines the maximum number of Tx PDUs which are processed for transmission under Tx ISR Locks.
      integer ComRxProcessingISRLockThreshold: 0..65534, set at post-build in variant post-build-loadable+post-build-selectable / pre-compile in variant pre-compile, origin=Vector Informatik, default-value=1  # This parameter defines the maximum number of Rx PDUs which are deferred processed under Rx ISR Locks.
      integer ComGatewayProcessingISRLockThreshold: 0..65534, set at post-build in variant post-build-loadable+post-build-selectable / pre-compile in variant pre-compile, origin=Vector Informatik, default-value=1  # This parameter defines the maximum number of Tx PDUs which are deferred processed under Gateway ISR Locks.
      integer ComGatewayDescriptionProcessingISRLockThreshold: 0..65534, set at post-build in variant post-build-loadable+post-build-selectable / pre-compile in variant pre-compile, origin=Vector Informatik, default-value=1  # This parameter defines the maximum number of deferred gateway descriptions, which are processed in under Gateway Description ISR Locks.
      integer ComIPduGroupISRLockThreshold: 0..65534, set at post-build in variant post-build-loadable+post-build-selectable / pre-compile in variant pre-compile, origin=Vector Informatik, default-value=1  # This parameter defines the maximum number of IPdus, which are started or stopped under IPduGroup ISR Locks.
  bsw implementation Com_Impl: programming-language=C, sw-version=25.02.00, used-code-generator=DaVinci Configurator, vendor-id=30, ar-release-version=4.00.03, behavior=ComBehavior, preconfigured-configuration=Com_Pre, recommended-configuration=Com_Rec, vendor-specific-module-def=Com
  module config Com_Pre: definition=Com
  module config Com_Rec: definition=Com
