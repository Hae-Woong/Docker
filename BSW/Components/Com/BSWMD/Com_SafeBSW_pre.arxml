AUTOSAR XML (schema 4-0-3)
package /MICROSAR
  module config Com_Rec: definition=Com
    ComGeneral: ComSafeBswChecks=1
