AUTOSAR XML (schema 4-3-1)
package /MICROSAR
  module config StbM_Rec: definition=StbM
    StbMGeneral: StbMSafeBswChecks=1
