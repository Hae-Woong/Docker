AUTOSAR XML (schema 4-3-1)
package /MICROSAR
  module definition StbM [0..1]: category=VENDOR_SPECIFIC_MODULE_DEFINITION, post-build-variant-support=true, refined-module-def=StbM, variants pre-compile  # The Synchronized Time-Base Manager provides synchronized time bases to its customers, i.e., time bases, which are synchronized with time bases on other nodes of a distributed system. #TimeSync #AUTOSAR #ServiceComponent
    container StbMGeneral: multiplicity set at pre-compile  # This container holds the general parameters of the Synchronized Time-base Manager
      string StbMCustomerHeaderInclude [0..1]: multiplicity set at pre-compile, set at pre-compile  # Defines the header file, which has the declaration of the callback function prototype for the notification customer of the reference Time Base.
      boolean StbMDevErrorDetect: multiplicity set at pre-compile, set at pre-compile, default-value=true  # Switches the development error detection and notification on or off. | * true: detection and notification is enabled. * false: detection and notification is disabled.
      boolean StbMGetCurrentTimeExtendedAvailable [0..1]: multiplicity set at pre-compile, set at pre-compile, default-value=false  # This allows to define whether an additional variant of the API GetCurrentTime with a 64 bit argument is provided.
      float StbMMainFunctionPeriod: 0..1, multiplicity set at pre-compile, set at pre-compile, default-value=0.01  # Schedule period of the main function StbM_MainFunction.
      boolean StbMTimeRecordingSupport: multiplicity set at pre-compile, set at pre-compile, default-value=false  # Enables/Disables the usage of the recording functionality for Synchronized and Offset timebases for Global Time precision measurement purpose.
      boolean StbMVersionInfoApi: multiplicity set at pre-compile, set at pre-compile, default-value=false  # Activate/Deactivate the version information API (StbM_GetVersionInfo). True: version information API activated False: version information API deactivated.
      boolean StbMSafeBswChecks: multiplicity set at pre-compile, origin=Vector Informatik, set at pre-compile, default-value=false  # Selects if safety checks are used. These checks improve robustness as e.g. invalid parameters are checked before function is executed. This attribute has to be enabled for safety projects where this component is mapped to an ASIL partition.
      boolean StbMFloat64Support [0..1]: multiplicity set at pre-compile, origin=Vector Informatik, set at pre-compile, default-value=true  # Selects if the time correction feature shall use 64 bit floating point for time correction calculation instead of 64 bit signed integer. If this parameter is unchecked, no floating point arithmetic is used within the StbM.
      symbolic name reference StbMGptTimerRef [0..1]: multiplicity set at pre-compile, set at pre-compile, requires-symbolic-name-value=true, destination=GptChannelConfiguration  # This represents an optional sub-container in case any Time Notification Customer is configured. | The designated GPT timer has to be configured to have a tick duration of one micro second.
      symbolic name reference StbMEcucPartitionRef [0..1]: multiplicity set at pre-compile, origin=Vector Informatik, set at pre-compile, requires-symbolic-name-value=true, destination=EcucPartition  # Reference to EcucPartition, where StbM module is assigned to. Note: This parameter is not used. For Multi-Partition use cases configure the used partitions via parameter StbMOsApplicationRef at the Time Base.
    container StbMSynchronizedTimeBase [1..65536]: multiplicity set at pre-compile  # Synchronized time.base collects the information about a specific time-base provider within the system.
      boolean StbMAllowMasterRateCorrection [0..1]: multiplicity set at pre-compile, set at pre-compile, default-value=false  # This attribute describes whether the rate correction value of a Time Base can be set by StbM_SetRateCorrection(): | * false: the rate correction value can not be set by StbM_SetRateCorrection() * true: the rate correction value can be set by StbM_SetRateCorrection() Note: This parameter is only relevant for Global Time Masters.
      boolean StbMAllowSystemWideGlobalTimeMaster [0..1]: multiplicity set at pre-compile, set at pre-compile  # For postbuild variant of the StbM this parameter has to be set to true for a Global Time Master that may act as a system-wide source of time. Otherwise no corresponding service ports/interfaces is provided. | The Global Time Master functionality behind the service ports/interfaces has to be enabled/disabled separately via parameter StbMIsSystemWideGlobalTimeMaster. Note: This parameter is only relevant for Global Time Masters.
      integer StbMClearTimeleapCount [0..1]: 1..65535, multiplicity set at pre-compile, set at pre-compile, default-value=1  # This attribute describes the required number of updates to the Time Base where the time difference to the previous value has to remain below StbMTimeLeapPastThreshold/StbMTimeLeapFutureThreshold until the TIMELEAP_PAST/TIMELEAP_FUTURE bit within timeBaseStatus of the Time Base is cleared. Note: This parameter is only relevant for Time Slaves.
      boolean StbMIsSystemWideGlobalTimeMaster: multiplicity set at pre-compile, post-build-variant-value=true, set at pre-compile, default-value=false  # This parameter shall be set to true for a Global Time Master that acts as a system-wide source of time information with respect to Global Time. | It is possible that several Global Time Masters exist that have set this parameter set to true because the Global Time Masters exist once per Global Time Domain and one ECU may own several Global Time Domains on different buses it is connected to. Note: This parameter is only relevant for Global Time Masters.
      integer StbMMasterRateDeviationMax [0..1]: 0..32000, multiplicity set at pre-compile, set at pre-compile, default-value=0  # This attribute describes the maximum allowed absolute value of the rate deviation value to be set by StbM_SetRateCorrection(). Note: This parameter is only relevant for Global Time Masters.
      function name StbMStatusNotificationCallback [0..1]: multiplicity set at pre-compile, set at pre-compile  # Name of the customer specific status notification callback function, which shall be called, if a non-masked status event occurs.
      integer StbMStatusNotificationMask [0..1]: 0..4294967295, multiplicity set at pre-compile, set at pre-compile, default-value=0  # The parameter defines the initial value for NotificationMask mask, which defines the events for which the event notification callback function shall be called.
      enumeration StbMStoreTimebaseNonVolatile [0..1]: {NO_STORAGE, STORAGE_AT_SHUTDOWN}, multiplicity set at pre-compile, set at pre-compile, default-value=NO_STORAGE  # This allows for specifying that the Time Base shall be stored in the NvRam.
      integer StbMSynchronizedTimeBaseIdentifier: 0..65535, multiplicity set at pre-compile, set at pre-compile, symbolic-name-value=true  # Identification of a Synchronized TimeBase via a unique identifier. | Range: * 0 .. 15: Synchronized Time Bases * 16 .. 31: Offset Time Bases * 32 .. 127: Pure Local Time Bases or Synchronized Time Bases (depends on reference from TimeSync Module) * 128 .. 65535: Reserved
      float StbMSyncLossTimeout [0..1]: 0..4294967, multiplicity set at pre-compile, set at pre-compile, default-value=1  # This attribute describes the timeout for the situation that the time synchronization gets lost in the scope of the time domain. Note: This parameter is only relevant for Time Slaves.
      float StbMTimeLeapFutureThreshold [0..1]: 0..2, multiplicity set at pre-compile, set at pre-compile, default-value=1  # This represents the maximum allowed positive difference between the current Local Time Base value and a newly received Global Time Base value. A threshold of 0 deactivates the Time Leap check. Note: This parameter is only relevant for Time Slaves.
      float StbMTimeLeapPastThreshold [0..1]: 0..2, multiplicity set at pre-compile, set at pre-compile, default-value=1  # This represents the maximum allowed negative difference between the current Local Time Base value and a newly received Global Time Base value. A threshold of 0 deactivates the Time Leap check. Note: This parameter is only relevant for Time Slaves.
      reference StbMOffsetTimeBase [0..1]: multiplicity set at pre-compile, set at pre-compile, destination=StbMSynchronizedTimeBase  # This is the reference to the Synchronized Time-Base this Offset Time-Base is based on. This reference makes the containing StbMSynchronizedTimeBase an Offset Time-Base.
      reference StbMSourceTimeBase [0..1]: multiplicity set at pre-compile, origin=Vector Informatik, set at pre-compile, destination=StbMSynchronizedTimeBase  # This is a reference to a Time Base, which the current Time Base is cloned from. This makes the referenced Time Base the source Time Base for cloning and the current Time the destination Time Base for cloning.
      reference StbMOsApplicationRef [0..*]: multiplicity set at pre-compile, origin=Vector Informatik, set at pre-compile, destination=OsApplication  # This reference defines the list of partitions the TimeBase is used in.
      container StbMLocalTimeClock [0..1]: multiplicity set at pre-compile  # References the hardware reference clock of this Synchronized Time Base.
        integer StbMClockFrequency: 0..4294967295, multiplicity set at pre-compile, set at pre-compile  # Represents the frequency of the HW reference clock used by the StbM.
        integer StbMClockPrescaler: 0..4294967295, multiplicity set at pre-compile, set at pre-compile  # Represents the prescaler to calculate the resulting frequency of the HW reference clock used by the StbM.
        choice reference StbMLocalTimeHardware: multiplicity set at pre-compile, set at pre-compile, destination=[EthTSynGlobalTimeDomain, GptChannelConfiguration, OsCounter]  # Reference to the local time hardware.
      container StbMNotificationCustomer [0..*]: multiplicity set at pre-compile  # This container holds the configuration of a notification customer, which is notified is informed about the occurance of a Time-base related event.
        integer StbMNotificationCustomerId: 0..65535, multiplicity set at pre-compile, set at pre-compile, symbolic-name-value=true, default-value=0  # Identification of a event notification customer.
        function name StbMTimeNotificationCallback [0..1]: multiplicity set at pre-compile, set at pre-compile  # Name of the customer specific notification callback function, which shall be called, if the time previously set by the customer is reached.
        float StbMTimerStartThreshold: 0..2, multiplicity set at pre-compile, set at pre-compile, default-value=0.01  # This interval defines, when a GPT Timer shall be started for Time Notification Customers for which the corresponding Customer Timer is running.
      container StbMTimeCorrection [0..1]: multiplicity set at pre-compile  # Collects the information relevant for the rate- and offset correction of a Time Base. Note: This container is only relevant for Time Slaves.
        float StbMOffsetCorrectionAdaptionInterval [0..1]: 0..4, multiplicity set at pre-compile, set at pre-compile, default-value=1  # Defines the interval during which the adaptive rate correction cancels out the rate- and time deviation.
        float StbMOffsetCorrectionJumpThreshold [0..1]: 0..4, multiplicity set at pre-compile, set at pre-compile, default-value=1  # Threshold for the correction method. Deviations below this value will be corrected by a linear reduction over a defined timespan. Values equal- and greater than this value will be corrected by immediately setting the correct time- and rate in form of a jump.
        float StbMRateCorrectionMeasurementDuration [0..1]: 0..60, multiplicity set at pre-compile, set at pre-compile, default-value=1  # Definition of the time span which is used to calculate the rate deviation.
        integer StbMRateCorrectionsPerMeasurementDuration [0..1]: 1..65535, multiplicity set at pre-compile, set at pre-compile, default-value=1  # Number of simultaneous rate measurements to determine the current rate deviation.
      container StbMTimeRecording [0..1]: multiplicity set at pre-compile  # Collects the information relevant for configuration of the precision measurement of a Time Base. Note: This container is only relevant for Time Slaves.
        function name StbMOffsetTimeRecordBlockCallback [0..1]: multiplicity set at pre-compile, set at pre-compile  # Name of the customer specific callback function, which shall be called, if a measurement data for a Offset Time Base is available.
        integer StbMOffsetTimeRecordTableBlockCount: 0..65535, multiplicity set at pre-compile, set at pre-compile  # Represents the number of Blocks used for queueing time measurement events for the Offset Time Base Record Table.
        function name StbMSyncTimeRecordBlockCallback [0..1]: multiplicity set at pre-compile, set at pre-compile  # Name of the customer specific callback function, which shall be called, if a measurement data for a Synchronized Time Base is available.
        integer StbMSyncTimeRecordTableBlockCount: 0..65535, multiplicity set at pre-compile, set at pre-compile  # Represents the number of Blocks used for queueing time measurement events for the Synchronized Time Base Record Table.
      container StbMTimeValidation [0..1]: multiplicity set at pre-compile  # Container with TimeValidation configuration for a TimeBase.
        integer StbMTimingRecordTableBlockCount: 1..65535, multiplicity set at pre-compile, origin=Vector Informatik, set at pre-compile  # Size of Timing Record Table used for storing TimeValidation timing data.
    container StbMTriggeredCustomer [0..65536]: multiplicity set at pre-compile  # The triggered customer is directly triggered by the Synchronized Time-base Manager by getting synchronized with the current (global) definition of time and passage of time.
      integer StbMTriggeredCustomerPeriod: 1..4294967295, multiplicity set at pre-compile, set at pre-compile, default-value=10000  # The triggering period of the triggered customer, called by the StbM_MainFunction. | The period is documented in microseconds.
      float StbMOSScheduleTableCounterTickDuration: 1E-09..1E-06, multiplicity set at pre-compile, origin=Vector Informatik, set at pre-compile  # Tick duration of the OS counter, which drives the synchronized OS ScheduleTable, in seconds.
      reference StbMOSScheduleTableRef: multiplicity set at pre-compile, set at pre-compile, destination=OsScheduleTable  # Mandatory reference to synchronized OS ScheduleTable, which will be explicitly synchronized by the StbM.
      reference StbMSynchronizedTimeBaseRef: multiplicity set at pre-compile, set at pre-compile, destination=StbMSynchronizedTimeBase  # Mandatory reference to the required synchronized time-base.
  bsw implementation StbM_Impl: programming-language=C, sw-version=9.06.00, used-code-generator=DaVinci Configurator, vendor-id=30, ar-release-version=4.07.00, behavior=StbMBehavior, preconfigured-configuration=StbM_Pre, recommended-configuration=StbM_Rec, vendor-specific-module-def=StbM
  module config StbM_Pre: definition=StbM
  module config StbM_Rec: definition=StbM
