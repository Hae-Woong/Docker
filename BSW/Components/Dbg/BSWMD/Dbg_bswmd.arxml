AUTOSAR XML (schema 4-1-1)
package /MICROSAR
  module definition Dbg [0..1]: category=VENDOR_SPECIFIC_MODULE_DEFINITION, refined-module-def=Dbg, variants pre-compile/link-time  # MICROSAR AMD (AUTOSAR Monitoring and Debugging). Provides access to BSW internal states for debugging purposes via Xcp protocol. #AMD #Xcp #CANoe #CANape #Monitoring #Debugging #AUTOSAR
    container DbgBuffering [0..0]  # This container holds the parameters to manage the storage of debugging data in RAM.
      integer DbgBufferSize: 0..65535, set at pre-compile, default-value=0  # Size in bytes of the RAM for the ring buffer. A size of 0 means that no buffer exists. All data records are directly transferred.
      enumeration DbgBufferStrategy: {OverwriteOldestEntries, StopStorage}, set at pre-compile, default-value=StopStorage  # Strategy of buffer operations when it is full: overwrite oldest entries or stop the storage.
      enumeration DbgBufferTransmission: {StartAfterInitialization, StartOnHostRequest}, set at pre-compile, default-value=StartOnHostRequest  # Automatic or requested transmission of the buffer.
    container DbgCommunication [0..0]  # This container holds all configuration parameters for communication.
      container DbgRxPdu  # This container holds configuration parameters for the receive-pdu.
        integer DbgRxPduId: 0..65535, set at published-information in variant pre-compile / pre-compile in variant link-time, symbolic-name-value=true, default-value=0  # Handle Id to be used by the PduR to indicate the reception of the DbgRxPdu to the Dbg module. The actual value of this parameter is fixed to 0 since there is only one RxPdu for the Dbg module. | The existence of this parameter is essential for the PduR generation tool to actually find a symbolicNameValue for the RxPdu.
        reference DbgReceiveIPduRef: set at pre-compile, destination=Pdu  # Reference to the receive I-PDU.
      container DbgTxPdu  # This container holds configuration parameters for the transmit-pdu.
        integer DbgTxConfirmationPduId: 0..65535, set at published-information in variant pre-compile / pre-compile in variant link-time, symbolic-name-value=true, default-value=0  # Handle Id to be used by the PduR to confirm the transmission of the DbgTxPdu to the Dbg module. The actual value of this parameter is fixed to 0 since there is only one TxPdu for the Dbg module. | The existence of this parameter is essential for the PduR generation tool to actually find a symbolicNameValue for the TxPdu.
        reference DbgSendIPduRef: set at pre-compile, destination=Pdu  # Reference to the send I-PDU.
    container DbgGeneral  # This container holds the general parameters of the debugging module.
      boolean DbgDevErrorDetect: set at pre-compile, default-value=true  # Enables/Disables development error detection.
      string DbgHeaderFileInclusion [0..*]: set at pre-compile  # Name of the header file(s) to be included by the Dbg module.
      boolean DbgVersionInfoApi: set at pre-compile, default-value=false  # Activate/Deactivate the version information API (Dbg_GetVersionInfo). True: version information API activated False: version information API deactivated.
      string DbgUserConfigFile [0..1]: set at pre-compile, origin=Vector Informatik  # A configuration file is generated by Cfg5. If you want to overwrite settings in the generated configuration file, you can specify a path to a user defined configuration file. Note: The user defined configuration file will be included at the end of the generated file. Therefore definitions in the user defined configuration file can overwrite definitions in the generated configuration file. The contents of the user defined configuration file is copied to the end of <Bsw>_Cfg.h.
      float DbgSamplingFunctionPeriod [0..1]: 0..10, configuration-class-affection=affection-kind=NO-AFFECT, set at pre-compile, origin=Vector Informatik, default-value=0.005  # The execution cycle of the Dbg_PeriodicSamplingFunction in seconds. The Dbg component does not require this information but the BSW scheduler, which invokes the sampling function, needs it in order to plan its tasks.
      boolean DbgSafeBswChecks: set at pre-compile, origin=Vector Informatik, default-value=false  # Selects if safety checks are used. These checks improve robustness as e.g. invalid parameters are checked before function is executed. This attribute has to be enabled for safety projects where this component is mapped to an ASIL partition.
    container DbgMultipleConfigurationContainer  # This container includes the configuration parameters and sub containers of the AUTOSAR Dbg module. This container is a MultipleConfigurationContainer, i.e. this container and its sub-containers exist once per configuration set.
      integer DbgMaxDynamicDID [0..1]: 0..200, set at pre-compile, default-value=0  # Maximum number of dynamic DIDs. This value is only needed to reserve memory for dynamic DIDs added by the host at runtime. If this parameter is not supplied it is automatically set to the configured number of static DIDs. | The sum of MaxStaticDID and MaxDynamicDID must not exceed 200. Dynamic DIDs are MaxStaticDID based and consecutive.
      integer DbgMaxStaticDID [0..1]: 0..200, set at pre-compile, default-value=0  # Maximum number of static DIDs. This value is only needed to reserve memory for static DIDs added at post-build time. If this parameter is not supplied it is automatically set to the configured number of static DIDs. Static DIDs are zero based and consecutive.
      container DbgPredefinedDID [0..0]  # This container holds all configuration parameters for predefined DIDs. For predefined DIDs, only certain values can be changed.
        boolean DbgPredefinedDIDActivation: set at pre-compile, default-value=false  # Activation or not of the DID for debugging. | true: DIDOn. false: DIDOff.
        boolean DbgPredefinedDIDBuffering: set at pre-compile, default-value=false  # Buffer the data or transmit directly. | true: BufferingOn. false: BufferingOff.
        enumeration DbgPredefinedDIDName: {Dbg_PostTaskHook, Dbg_PreTaskHook, Dbg_TraceDetCall, Dbg_TraceFunctionEntry, Dbg_TraceFunctionExit, Dbg_TraceRTECall, Dbg_TraceRTEComCallback, Dbg_TraceRTEComSignalIv, Dbg_TraceRTEComSignalRx, Dbg_TraceRTEComSignalTx, Dbg_TraceRTEVfbSignalReceive, Dbg_TraceRTEVfbSignalSend, Dbg_TraceRunnableStart, Dbg_TraceRunnableTermination, Dbg_TraceTimestamps}, set at pre-compile, default-value=Dbg_PreTaskHook  # List of possible names for predefined DIDs.
        boolean DbgPredefinedDIDTimeStampActivation: set at pre-compile, default-value=false  # Using or not of time stamp. | true: TimeStampOn. false: TimeStampOff.
        choice container DbgPredefinedDIDAddInfo [0..*]  # Additional information in case the Predefined DID needs further configuration parameters.
          container DbgAddInfoComSignal [0..1]  # Additional information for DIDs with the DbgPredefinedDIDName set to: | - Dbg_TraceRTEComSignalTx - Dbg_TraceRTEComSignalRx - Dbg_TraceRTEComSignalIv - Dbg_TraceRTEComCallback The actual SignalId used in the debugging trace APIs is taken from the ComHandleId availabe at the ComSignal configuration of the Com module.
            string DbgComSignalName [0..1]: set at pre-compile, default-value=Dummy, max-length=128, min-length=0  # Optional name of the traced signal. If present it shall be used in the display of the debugging tool.
            foreign reference DbgBswModuleEntryRef: set at pre-compile, destination-type=BSW-MODULE-ENTRY  # Foreign reference to the BSWModuleEntry describing the trace function implementation.
            symbolic name reference DbgComSignalRef: set at pre-compile, destination=ComSignal  # Reference to the ComSignal which shall be traced.
          container DbgAddInfoRteCall [0..1]  # Additional information for DIDs with the DbgPredefinedDIDName set to: | - Dbg_TraceRTECall
            integer DbgCallComponentId: 0..65535, set at pre-compile, default-value=0  # Id used to identify the SW-Component Type.
            integer DbgCallInstanceId: 0..255, set at pre-compile, default-value=0  # Id used to identify the SW-Component Instance.
            integer DbgCallPortId: 0..65535, set at pre-compile, default-value=0  # Id used to identify the Port.
            integer DbgCallServiceId: 0..255, set at pre-compile, default-value=0  # Id used to identify the OperationProtoype.
            foreign reference DbgBswModuleEntryRef: set at pre-compile, destination-type=BSW-MODULE-ENTRY  # Foreign reference to the BSWModuleEntry describing the trace function implementation.
            instance reference DbgServiceInstanceRef: set at pre-compile, destination-context=SW-COMPONENT-PROTOTYPE PORT-PROTOTYPE, destination-type=CLIENT-SERVER-OPERATION  # Reference to the actual OperationPrototype which shall be traced.
          container DbgAddInfoRunnable [0..1]  # Additional information for DIDs with the DbgPredefinedDIDName set to: | - Dbg_TraceRunnableStart - Dbg_TraceRunnableTermination
            integer DbgRunnableComponentId: 0..65535, set at pre-compile, default-value=0  # Id used to identify the SW-Component Type.
            integer DbgRunnableId: 0..255, set at pre-compile, default-value=0  # Id used to identify the RunnableEntity.
            integer DbgRunnableInstanceId: 0..255, set at pre-compile, default-value=0  # Id used to identify the SW-Component Instance.
            foreign reference DbgBswModuleEntryRef: set at pre-compile, destination-type=BSW-MODULE-ENTRY  # Foreign reference to the BSWModuleEntry describing the trace function implementation.
            foreign reference DbgRunnableEntityRef: set at pre-compile, destination-type=RUNNABLE-ENTITY  # Reference to the actual RunnableEntity which shall be traced.
            foreign reference DbgSoftwareComponentInstanceRef: set at pre-compile, destination-type=SW-COMPONENT-PROTOTYPE  # Reference to the SW-ComponentProtoype which shall be traced.
          container DbgAddInfoVfbSignal [0..1]  # Additional information for DIDs with the DbgPredefinedDIDName set to: | - Dbg_TraceRTEVfbSignalSend - Dbg_TraceRTEVfbSignalReceive
            integer DbgVfbComponentId: 0..65535, set at pre-compile, default-value=0  # Id used to identify the SW-Component Type.
            integer DbgVfbDataElementId: 0..255, set at pre-compile, default-value=0  # Id used to identify the DataElementPrototype.
            integer DbgVfbInstanceId: 0..255, set at pre-compile, default-value=0  # Id used to identify the SW-Component Instance.
            integer DbgVfbPortId: 0..65535, set at pre-compile, default-value=0  # Id used to identify the Port.
            foreign reference DbgBswModuleEntryRef: set at pre-compile, destination-type=BSW-MODULE-ENTRY  # Foreign reference to the BSWModuleEntry describing the trace function implementation.
            instance reference DbgDataElementInstanceRef: set at pre-compile, destination-context=SW-COMPONENT-PROTOTYPE PORT-PROTOTYPE, destination-type=VARIABLE-DATA-PROTOTYPE  # Reference to the actual DataElementPrototype which shall be traced.
      container DbgStaticDID [0..200]  # This container holds all configuration parameters for static DIDs. For predefined DIDs, only certain values can be changed.
        integer DbgAutomaticCollectionFrequency: 0..65535, set at pre-compile, default-value=0  # Cycle time of collection in DataCollectionTicks. A value of "0" indicates that the collection takes place only on request.
        boolean DbgStaticDIDActivation: set at pre-compile, default-value=false  # Activation or not of the DID for debugging. | true: DIDOn. false: DIDOff.
        boolean DbgStaticDIDBuffering: set at pre-compile, default-value=false  # Buffer the data or transmit directly. | true: BufferingOn. false: BufferingOff.
        string DbgStaticDIDNameRef: set at pre-compile  # Name of the DID, translated by the configuration/generation tool into consecutive DID numbers starting from 0.
        boolean DbgStaticTimeStampActivation: set at pre-compile, default-value=false  # Using or not of time stamp. | true: TimeStampOn. false: TimeStampOff.
        choice container DbgStaticDIDData [1..65535]  # Choice how the DID is to be configured.
          container DbgAddressSizePair [0..1]  # This container describes address/size pairs. It is used for static DIDs and dynamic DIDs.
            integer DbgASAbsoluteAddress [0..0]: 0..4294967295, set at pre-compile, default-value=0  # Absolute address of memory location to be debugged. | max = (2**32)-1
            linker symbol DbgASNameRef: set at pre-compile, default-value=MyVarName  # Symbolic name of the variable, translated by the configuration/generation tool into the address and size of the variable.
            integer DbgASSize: 0..255, set at pre-compile, default-value=1  # Absolute size in Bytes of memory location to be debugged.
          container DbgDebugData [0..0]  # Reference to staticMemory used for Debug Data.
            foreign reference DbgDebugDataRef: set at pre-compile, destination-type=VARIABLE-DATA-PROTOTYPE  # Reference to staticMemory used for Debug Data.
          container DbgLocalDebugData [0..1]  # Reference to a localDebugData.
            string DbgFunctionCall: set at pre-compile, origin=Vector Informatik, default-value=MyFuncName(AndValidParameter)  # This parameter specifies the complete function call including all parameters. The parameters are specified during configuration time, and cannot be changed during run time. If the function signature contains "[VarName]" the Dbg generator sets the DbgLocalDebugData value by reference via the function call. Any return values passed by the callout will be ignored. If the function signature does not contain "[VarName]" the Dbg generator uses the functions return value to set DbgLocalDebugData.
            foreign reference DbgLocalDebugDataRef: set at pre-compile, destination-type=IMPLEMENTATION-DATA-TYPE  # Reference to a localDebugData.
    container DbgPeriodicDataCollection [0..0]  # This container holds the parameters to manage the time base of the debugging module.
      integer DbgDataCollectionTick: 0..4294967295, set at pre-compile, default-value=0  # Number of OS counter ticks to be used as data collection tick. The OS alarm used for periodic collection of DIDs is set with this value.
      reference DbgAlarmReference: set at pre-compile, destination=OsAlarm  # Reference to the OS alarm used for periodic collection of DIDs.
    container DbgTimestampConfiguration [0..0]  # This container holds the parameters to manage the time stamps of the debugging module.
      enumeration DbgGlobalTimestampActivation: {TimestampOff, TimestampOn}, set at pre-compile, default-value=TimestampOff  # Initial value for timestamp collection.
      enumeration DbgTimeStampSize: {TimeStampSize_16Bit, TimeStampSize_32Bit}, set at pre-compile, default-value=TimeStampSize_16Bit  # Memory size used for the time stamps of all DIDs.
      symbolic name reference DbgGptChannel: set at pre-compile, destination=GptChannelConfiguration  # Reference to the hardware free running timer of the GPT module for time stamps (if no HWFRT is applied, calls to add timestamps are ignored)
  bsw implementation Dbg_Impl: programming-language=C, sw-version=2.00.00, used-code-generator=cMSR, vendor-id=30, ar-release-version=4.00.03, behavior=DbgBehavior, preconfigured-configuration=Dbg_Pre, recommended-configuration=Dbg_Rec, vendor-specific-module-def=Dbg
  module config Dbg_Pre: definition=Dbg
  module config Dbg_Rec: definition=Dbg
