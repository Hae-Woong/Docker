AUTOSAR XML (schema 4-2-1)
package /MICROSAR
  module config EthTSyn_Rec: definition=EthTSyn
    EthTSynGeneral: EthTSynSafeBswChecks=1
