AUTOSAR XML (schema 00046)
# COPYRIGHT
# Copyright (c) 2024 by Vector Informatik GmbH. All rights reserved.
# This software is copyright protected and proprietary to Vector Informatik GmbH.
# Vector Informatik GmbH grants to you only those rights as set out in the license conditions.
package /MICROSAR
  module definition EthTSyn [0..1]: category=VENDOR_SPECIFIC_MODULE_DEFINITION, post-build-variant-support=true, refined-module-def=EthTSyn, variants pre-compile  # The Ethernet Time Synchronization module implements a protocol for time synchronization over Ethernet. It is developed according to AUTOSAR specification which is based on IEEE802.1As ((g)PTP) with some modifications. #Ethernet #TimeSync #AVB #AUTOSAR
    container EthTSynGeneral: multiplicity set at pre-compile  # This container holds the general parameters of the Ethernet-specific Synchronized Time-base Manager
      string EthTSynDestPhyAddr: multiplicity set at pre-compile, set at pre-compile, default-value=01:80:C2:00:00:0E  # Destination Physical Address (MAC-Address). Destination Physical Hardware Address (MAC-Address) of EthTSyn-gPTP Frmaes. Input format has to match xx:xx:xx:xx:xx:xx, where x stands for a hex value between 0 and F. | Destination Physical Hardware Address (MAC-Address) of EthTSyn-gPTP Frames. Input format has to match xx:xx:xx:xx:xx:xx, where x stands for a hex value between 0 and F.
      boolean EthTSynDevErrorDetect: multiplicity set at pre-compile, set at pre-compile, default-value=true  # Switches the development error detection and notification on or off. | * true: detection and notification is enabled. * false: detection and notification is disabled.
      float EthTSynGlobalTimeRxToUplinkSwitchResidenceTime [0..1]: 0..4, multiplicity set at pre-compile, set at pre-compile, default-value=0  # This parameter is specifying the default value used for the residence time of the Ethernet Switch [Ingress to Uplink]. This value is used by the EthTSyn if the calculation of the residence time failed. | This value is used by the EthTSyn if the calculation of the residence time failed. Unit: seconds
      float EthTSynGlobalTimeUplinkToTxSwitchResidenceTime [0..1]: 0..4, multiplicity set at pre-compile, set at pre-compile, default-value=0  # This parameter is specifying the default value used for the residence time of the Ethernet Switch [Uplink to Egress]. This value is used by the EthTSyn if the calculation of the residence time failed. | This value is used by the EthTSyn if the calculation of the residence time failed. Unit: seconds
      boolean EthTSynHardwareTimestampSupport: multiplicity set at pre-compile, set at pre-compile, default-value=false  # Activate/Deactivate the hardware time stamping functionality of the Ethernet hardware. | True: Timestamp is retrieved from the Ethernet hardware False: Timestamp is retrieved from the StbM
      float EthTSynMainFunctionPeriod: 0..65535, multiplicity set at pre-compile, set at pre-compile, default-value=0.005  # Schedule period of the main function EthTSyn_MainFunction. Note: Only integral milliseconds are supported | Unit: seconds.
      boolean EthTSynMasterSlaveConflictDetection: multiplicity set at pre-compile, set at pre-compile, default-value=false  # Enables master / slave conflict detection and notification. | * true: detection and notification is enabled. * false: detection and notification is disabled.
      boolean EthTSynMessageCompliance: multiplicity set at pre-compile, set at pre-compile, default-value=false  # * true: IEEE 802.1AS compliant message format will be used. * false: IEEE 802.1AS message format with AUTOSAR extension will be used. | * false: IEEE 802.1AS message format with AUTOSAR extension will be used.
      integer EthTSynSwitchMgmtRxMessageBufferCount [0..1]: 1..255, multiplicity set at pre-compile, set at pre-compile, default-value=10  # This parameter is used to determine the amount of Rx message buffers available in the EthTSyn when EthTSyn is used in a Bridge configuration.
      boolean EthTSynVersionInfoApi: multiplicity set at pre-compile, set at pre-compile, default-value=false  # Activate/Deactivate the version information API (EthTSyn_GetVersionInfo). True: version information API activated False: version information API deactivated.
      string EthTSynUserConfigFile [0..1]: multiplicity set at pre-compile, origin=Vector Informatik, set at pre-compile  # Reference to an external user configuration file that will be included during generation. The content of the user configuration file will be added at the end of the generated module configuration file and allows altering or extending the generated code. Caution: User configuration files can cause the software module to malfunction and must only be used with great care!
      string EthTSynPublicCddHeaderFile [0..*]: multiplicity set at pre-compile, origin=Vector Informatik, set at pre-compile  # Defines header files for call-back functions (e.g. Sync / FollowUp sent) which shall be included in case of CDDs. Range of characters is 1.. 32.
      integer EthTSynSwitchMgmtRxMessageBufferPayloadSize [0..1]: 42..1500, multiplicity set at pre-compile, origin=Vector Informatik, set at pre-compile, default-value=42  # This parameter is specifying the size of the payload portion for each Bridge message buffer in Bytes. This size has to be configured such that every expected EthTSyn-Frame can be stored here. Please note that the Common Ptp Header (34 Byte) is excluded from this size here.
      boolean EthTSynEnableSwitchMgmt: multiplicity set at pre-compile, origin=Vector Informatik, set at pre-compile, default-value=false  # This parameter is used to determine if the Switch management functionality of the EthTSyn is enabled or disabled.
      boolean EthTSynSafeBswChecks: multiplicity set at pre-compile, origin=Vector Informatik, set at pre-compile, default-value=false  # Selects if safety checks are used. These checks improve robustness as e.g. invalid parameters are checked before function is executed. This attribute has to be enabled for safety projects where this component is mapped to an ASIL partition.
      float EthTSynSwitchMgmtMainFunctionPeriod [0..1]: 0..65535, multiplicity set at pre-compile, origin=Vector Informatik, set at pre-compile, default-value=0.001  # Schedule period of the main function EthTSyn_SwtMgmt_MainFunction. Note: Only integral milliseconds are supported | Unit: seconds.
      integer EthTSynSwitchMgmtTxMgmtObjQueueSize [0..1]: 1..255, multiplicity set at pre-compile, origin=Vector Informatik, set at pre-compile, default-value=10  # This parameter is used to determine the size of the Tx mamagement object queue in the EthTSyn when EthTSyn is used in a Bridge configuration.
      enumeration EthTSynSwitchMgmtBridgeMode [0..1]: {TRANSPARENT_CLOCK, BOUNDARY_CLOCK, ASYMMETRIC_TRANSPARENT_CLOCK}, multiplicity set at pre-compile, origin=Vector Informatik, set at pre-compile, default-value=TRANSPARENT_CLOCK  # Selection of the bridge operation mode
      boolean EthTSynSwitchMgmtSwitchAndHostAsOneTimeAwareSystem [0..1]: multiplicity set at pre-compile, origin=Vector Informatik, set at pre-compile, default-value=false  # Selection whether the Ethernet Switch and the host controller are considered as one time-aware system. When switch and host are considered as one time-aware system, it is expected that both the switch and the Ethernet controller of the host use the same clock source (are both clocks are synchronized, which is out of scope for the EthTSyn).
      integer EthTSynAsymTransparentClockEgrTsBufSize [0..1]: 1..255, multiplicity set at pre-compile, origin=Vector Informatik, set at pre-compile, default-value=10  # Amount of egress timestamps which can be per received frame.
      boolean EthTSynEnablePortParameterStatistics: multiplicity set at pre-compile, origin=Vector Informatik, set at pre-compile, default-value=false  # This parameter is used to determine if the port parameter statistics functionality of the EthTSyn is enabled or disabled.
      reference EthTSynEthIfFrameType: multiplicity set at pre-compile, set at pre-compile, destination=EthIfFrameOwnerConfig  # The chosen frame owner determines which frames (in respect to ethertype) are received.
    container EthTSynGlobalTimeDomain [1..*]: multiplicity set at pre-compile  # This represents the existence of a global time domain on Ethernet. The EthTSyn module can administrate several global time domains at the same time that in itself form a hierarchy of domains and sub-domains. | If the EthTSyn exists it is assumed that at least one global time domain exists.
      integer EthTSynGlobalTimeDomainId: 0..255, multiplicity set at pre-compile, set at pre-compile, default-value=0  # The global time domain ID. Note: This value is automatically derived from the StbMSynchronizedTimeBase referenced by EthTSynSynchronizedTimeBaseRef.
      boolean EthTSynSwitchMgmtKeepSourcePortIdentity [0..1]: multiplicity set at pre-compile, origin=Vector Informatik, set at pre-compile, default-value=false  # This parameter is only used in a bridge configuration. When this parameter is enabled, the source port identity of forwarded Sync/FollowUp messages is not modified.
      float EthTSynSwitchMgmtGlobalTimeSyncTimeout [0..1]: 0..4, multiplicity set at pre-compile, origin=Vector Informatik, set at pre-compile, default-value=0  # This parameter is only used in a Bridge configuration. It specifies the time, the bridge is waiting for the reception of a new Sync message on its slave port before a Grand Master timeout is assumed and the Bridge begins to generate its own Sync and FollowUp messages. Note: A value of 0 disable this timeout observation. In case this timeout observation is disabled, the grandmaster capable bridge will not start generating its own Sync and FollowUp messages in case no more Sync/FollowUp messages are received on the bridges slave port.
      boolean EthTSynIsOffsetTimeDomain: multiplicity set at pre-compile, origin=Vector Informatik, set at pre-compile, default-value=false  # Information only (computed automatically). This parameter is set to 'TRUE' if the EthTSynSynchronizedTimeBaseRef of this time domain point to an offset time base.
      boolean EthTSynEnableTimeValidation: multiplicity set at pre-compile, origin=Vector Informatik, set at pre-compile, default-value=false  # Enables/disables time recording for time validation for a specific Time Domain. Note: Value is set according to parameter StbMEnableTimeValidation of the referenced Time Base in the StbM
      integer EthTSynSwitchMgmtNumMsgForwardRetries [0..1]: 0..255, multiplicity set at pre-compile, origin=Vector Informatik, set at pre-compile, default-value=3  # This parameter is only used in a bridge configuration. It defines the amount of retries done for forwarded Sync and FollowUp messages. Note: Some hints regarding the value and meaning of the retry counter are described in the Technical Reference of the EthTSyn module.
      string EthTSynGlobalTimeDomainDestPhyAddr [0..1]: multiplicity set at pre-compile, origin=Vector Informatik, set at pre-compile, default-value=xx:xx:xx:xx:xx:xx, max-length=17, min-length=17  # This parameter can be used to override the Destination Physical Hardware Address (MAC-Address) of EthTSyn-gPTP Frames (configured via EthTSynGeneral/EthTSynDestPhyAddr) for the EthTSynGlobalTimeDomain. Input format has to match xx:xx:xx:xx:xx:xx, where x stands for a hex value between 0 and F. When this parameter exists, this value will be used as destination MAC for frames transmitted in this time domain. In case of a multicast MAC-Address, the physical address filter of the HW will be updated to be able to receive frames with this destination address as well. Note: In case of a Unicast address, no update of the physical address filter will be done. If frames need to be received directed to this unicast address, the user has to ensure that reception is possible (e.g. by enabling the promiscuous mode of the HW).
      symbolic name reference EthTSynSynchronizedTimeBaseRef: multiplicity set at pre-compile, set at pre-compile, requires-symbolic-name-value=true, destination=StbMSynchronizedTimeBase  # Mandatory reference to the required synchronized time-base. Note: Only Microsar StbM is supported.
      container EthTSynGlobalTimeFollowUpDataIDList [0..1]: multiplicity set at pre-compile  # The DataIDList for Follow_Up message ensures the identification of data elements due to CRC calculation process.
        container EthTSynGlobalTimeFollowUpDataIDListElement [16..16]: multiplicity set at pre-compile  # Element of the DataIDList for Follow_Up message ensures the identification of data elements due to CRC calculation process.
          integer EthTSynGlobalTimeFollowUpDataIDListIndex: 0..15, multiplicity set at pre-compile, set at pre-compile, default-value=0  # Index of the DataIDList for Follow_Up message ensures the identification of data elements due to CRC calculation process.
          integer EthTSynGlobalTimeFollowUpDataIDListValue: 0..255, multiplicity set at pre-compile, set at pre-compile, default-value=0  # Value of the DataIDList for Follow_Up message ensures the identification of data elements due to CRC calculation process.
      container EthTSynPortConfig [1..*]: multiplicity set at pre-compile  # Configuration of the EthTSyn-Ports within the TimeDomain.
        integer EthTSynFramePrio [0..1]: 0..7, multiplicity set at pre-compile, set at pre-compile, default-value=0  # This optional parameter, if present, indicates the priority of outgoing EthTSyn messages, if sent via VLAN (used for the 3-bit PCP field of the VLAN tag). If this optional parameter is not present, frames are sent without a priority and VLAN field.
        float EthTSynGlobalTimeDebounceTime: 0..4, multiplicity set at pre-compile, set at pre-compile, default-value=0  # This represents the configuration of a TX debounce time for messages transmitted by the EthTSyn on the same physical/HW port.
        integer EthTSynPortNumber: 0..65534, multiplicity set at pre-compile, origin=Vector Informatik, set at pre-compile, default-value=0  # Determines the Port Number
        integer EthTSynPortIndex [0..1]: 0..254, multiplicity set at pre-compile, origin=Vector Informatik, set at pre-compile, symbolic-name-value=true, default-value=0  # Index of the PortConfig within the context of the EthTSyn. This index is only used if EthTSynEnablePortParameterStatistics is enabled and only for PortConfigs which collect port paramter statistices. See TechRef for more details about which PortConfigs are relevant for this feature. This Index is calculated automatically and provided as symbolic name value.
        symbolic name reference EthTSynGlobalTimeEthIfRef: multiplicity set at pre-compile, set at pre-compile, requires-symbolic-name-value=true, destination=EthIfController  # This represents the reference to the Ethernet interface taken to fetch the global time information.
        symbolic name reference EthTSynSwitchManagementEthSwitchPortRef [0..1]: multiplicity set at pre-compile, set at pre-compile, requires-symbolic-name-value=true, destination=EthSwtPort  # In an AVB-Bridge config, this reference is used to assign the EthTSyn-Port to an Ethernet Switch-Port.
        container EthTSynPdelayConfig [0..1]: multiplicity set at pre-compile  # Configuration of cyclic propagation delay measurement.
          boolean EthTSynGlobalTimePdelayRespEnable: multiplicity set at pre-compile, set at pre-compile, default-value=true  # This parameter allows disabling Pdelay_Resp / Pdelay_Resp_Follow_Up transmission, if no Pdelay_Req messages are expected. | FALSE: No Pdelay requests expected. Pdelay_Resp / Pdelay_Resp_Follow_Up transmission is disabled. TRUE: Pdelay requests expected. Pdelay_Resp / Pdelay_Resp_Follow_Up transmission is enabled.
          float EthTSynGlobalTimePropagationDelay: 0..4, multiplicity set at pre-compile, set at pre-compile, default-value=0  # If cyclic propagation delay measurement is enabled, this parameter represents the default value of the propagation delay until the first actually measured propagation delay is available. If cyclic propagation delay measurement is disabled, this parameter represents the static value of the propagation delay. | If cyclic propagation delay measurement is disabled, this parameter replaces a measured propagation delay by a fixed value. Unit: seconds
          float EthTSynGlobalTimeTxPdelayReqPeriod: 0..65535, multiplicity set at pre-compile, set at pre-compile, default-value=1  # This represents configuration of the TX period for Pdelay_Req messages. A value of 0 disables the cyclic Pdelay measurement. | A value of 0 disables the cyclic Pdelay measurement. Unit: seconds
          float EthTSynPdelayRespAndRespFollowUpTimeout: 0..4, multiplicity set at pre-compile, set at pre-compile, default-value=0  # Timeout value for Pdelay_Resp and Pdelay_Resp_Follow_Up after a Pdelay_Req has been transmitted resp. a Pdelay_Resp has been received. A value of 0 deactivates this timeout ovservation. | A value of 0 deactivates this timeout observation. Unit: seconds
          integer EthTSynPdelayAverageWeight [0..1]: 1..255, multiplicity set at pre-compile, origin=Vector Informatik, set at pre-compile, default-value=30  # To determine the Pdelay, a weighted average calculation can be used instead of always take the last measured value. This parameter represents the weight factor (w) for PathDelay calculation: NewPathDelay = ( ( (w - 1) * OldPathDelay) + CurrentPathDelay) / w
          integer EthTSynPdelayReqAllowedLostResponses [0..1]: 0..255, multiplicity set at pre-compile, origin=Vector Informatik, set at pre-compile, default-value=3  # Determines the number of allowed lost responses of a PDelay_Request. If this count is exceeded, the AsCapable Flag of the Port is set to false.
          float EthTSynPdelayLatencyThreshold [0..1]: 0..4, multiplicity set at pre-compile, set at pre-compile, default-value=1E-05  # Threshold for calculated Pdelay. If a measured Pdelay exceeds EthTSynPdelayLatencyThreshold, this value is discarded. Unit: seconds Note: Lost response counter is incremented in case of discarded Pdelay.
          boolean EthTSynUseStaticPdelay: multiplicity set at pre-compile, origin=Vector Informatik, set at pre-compile, default-value=false  # When this parameter is set to TRUE, the configured Pdelay value (EthTSynGlobalTimePropagationDelay) is always used as Pdelay. The optional Pdelay measurement does not affect this value.
          boolean EthTSynAlwaysAsCapable: multiplicity set at pre-compile, origin=Vector Informatik, set at pre-compile, default-value=true  # Always AsCapable | This parameter sets AsCapable to true without checking for a gPTP-capable counterpart via Pdelay-Mechanism. The AsCapable flag will not be influenced by the Pdelay-Mechanism at all. According to IEEE 802.1AS this parameter must be false at start-up and is set automatically to true if a gPTP-capable device at the other end of the link is detected.
          boolean EthTSynPdelayRespUseGlobalTime: multiplicity set at pre-compile, origin=Vector Informatik, set at pre-compile, default-value=false  # This parameter is used to determine if a Pdelay Responder shall use the global or the virtual local time within Pdelay_Resp and Pdelay_Resp_Fup messages. Note: Can only be enabled when: - EthTSynGeneral/EthTSynMessageCompliance is enabled - EthTSynGeneral/EthTSynEnableSwitchMgmt is disabled
        choice container EthTSynPortRole: multiplicity set at pre-compile  # Specifying the Role of the EthTSyn-Port (Master or Slave).
          container EthTSynGlobalTimeMaster [0..1]: multiplicity set at pre-compile  # Configuration of the global time master. Each global time domain is required to have exactly one global time master. This master may or may not exist on the configured ECU.
            float EthTSynCyclicMsgResumeTime: 0..1.7976931348623157E+308, multiplicity set at pre-compile, set at pre-compile, default-value=0  # Defines the time where the 1st regular cycle time based message transmission takes place, after an immediate transmission before.
            enumeration EthTSynGlobalTimeTxCrcSecured: {CRC_NOT_SUPPORTED, CRC_SUPPORTED}, multiplicity set at pre-compile, set at pre-compile, default-value=CRC_NOT_SUPPORTED  # This represents the configuration of whether or not CRC is supported.
            float EthTSynGlobalTimeTxPeriod: 0..1.7976931348623157E+308, multiplicity set at pre-compile, set at pre-compile, default-value=0.125  # This represents configuration of the TX period for Sync/FollowUp messages. Notes: - A value of '0' disables the cyclic Sync message transmission (requires EthTSynImmediateTimeSync == TRUE). This parameter does not have any effect (hence, the above mentioned restriction does not apply as well) when all of the following conditions are true: - /MICROSAR/EthTSyn/EthTSynGeneral/EthTSynSwitchMgmtBridgeMode is set to ASYMMETRIC_TRANSPARENT_CLOCK or TRANSPARENT_CLOCK - /MICROSAR/EthTSyn/EthTSynGlobalTimeDomain also contains a slave port (/MICROSAR/EthTSyn/EthTSynGlobalTimeDomain/EthTSynPortConfig/EthTSynPortRole/EthTSynGlobalTimeSlave)
            boolean EthTSynImmediateTimeSync: multiplicity set at pre-compile, set at pre-compile, default-value=false  # Enables/Disables the cyclic polling of StbM_GetTimeBaseUpdateCounter() within EthTSyn_MainFunction() and therefore the optional transmission of immediate time sync messages. Note: This parameter does not have any effect when all of the following conditions are true: - /MICROSAR/EthTSyn/EthTSynGeneral/EthTSynSwitchMgmtBridgeMode is set to ASYMMETRIC_TRANSPARENT_CLOCK or TRANSPARENT_CLOCK - /MICROSAR/EthTSyn/EthTSynGlobalTimeDomain also contains a slave port (/MICROSAR/EthTSyn/EthTSynGlobalTimeDomain/EthTSynPortConfig/EthTSynPortRole/EthTSynGlobalTimeSlave)
            function name EthTSynSyncSentCallBackFunction [0..1]: multiplicity set at pre-compile, origin=Vector Informatik, set at pre-compile, min-length=1  # This function is called after a SYNC message has successfully been transmitted. Call-back function has following signature: void EthTSyn_SyncSentCallback(EthTSyn_IntPortIdxType PortIdx, const uint8* TxBufPtr );
            function name EthTSynFollowUpSentCallBackFunction [0..1]: multiplicity set at pre-compile, origin=Vector Informatik, set at pre-compile, min-length=1  # This function is called after a FOLLOW_UP message has successfully been transmitted. Call-back function has following signature: void EthTSyn_FollowUpSentCallback(EthTSyn_IntPortIdxType PortIdx, const uint8* TxBufPtr);
            float EthTSynTxAnnouncePeriod: 0..1.7976931348623157E+308, multiplicity set at pre-compile, origin=Vector Informatik, set at pre-compile, default-value=0.125  # This represents configuration of the TX period for optional Announce messages. Note: A value of '0' disables the cyclic Announce message transmission.
            boolean EthTSynTxSubTLVOFS: multiplicity set at pre-compile, origin=Vector Informatik, set at pre-compile, default-value=false  # Tx Sub TLV OFS | Definition of whether (true) or not (false) a Sub-TLV:OFS Secured or Sub-TLV:OFS Not Secured shall be sent in the AUTOSAR TLV of a Follow_Up message. Note: Parameter as defined in AUTOSAR 22-11
            boolean EthTSynTxSubTLVStatus: multiplicity set at pre-compile, origin=Vector Informatik, set at pre-compile, default-value=false  # Definition of whether (true) or not (false) a Sub-TLV:Status Secured or Sub-TLV:Status Not Secured shall be sent in the AUTOSAR TLV of a Follow_Up message. Note: Parameter as defined in AUTOSAR 22-11
            boolean EthTSynTxSubTLVTime: multiplicity set at pre-compile, origin=Vector Informatik, set at pre-compile, default-value=false  # Definition of whether (true) or not (false) a Sub-TLV:Time Secured shall be sent in the AUTOSAR TLV of a Follow_Up message. Note: Parameter as defined in AUTOSAR 22-11
            boolean EthTSynTxSubTLVUserData: multiplicity set at pre-compile, origin=Vector Informatik, set at pre-compile, default-value=false  # Definition of whether (true) or not (false) a Sub-TLV:UserData Secured or Sub-TLV:User Data Not Secured shall be sent in the AUTOSAR TLV of a Follow_Up message. Note: Parameter as defined in AUTOSAR 22-11
            container EthTSynCrcTimeFlagsTxSecured [0..1]: multiplicity set at pre-compile  # This container collects definitions which parts of the Follow_Up message elements shall be used for CRC calculation.
              boolean EthTSynCrcCorrectionField: multiplicity set at pre-compile, set at pre-compile, default-value=false  # correctionField from the Follow_Up Message Header shall be included in CRC calculation.
              boolean EthTSynCrcDomainNumber: multiplicity set at pre-compile, set at pre-compile, default-value=false  # domainNumber from the Follow_Up Message Header shall be included in CRC calculation.
              boolean EthTSynCrcMessageLength: multiplicity set at pre-compile, set at pre-compile, default-value=false  # messageLength from the Follow_Up Message Header shall be included in CRC calculation.
              boolean EthTSynCrcPreciseOriginTimestamp: multiplicity set at pre-compile, set at pre-compile, default-value=true  # preciseOriginTimestamp from the Follow_Up Message Field shall be included in CRC calculation.
              boolean EthTSynCrcSequenceId: multiplicity set at pre-compile, set at pre-compile, default-value=false  # sequenceId from the Follow_Up Message Header shall be included in CRC calculation.
              boolean EthTSynCrcSourcePortIdentity: multiplicity set at pre-compile, set at pre-compile, default-value=false  # sourcePortIdentity from the Follow_Up Message Header shall be included in CRC calculation.
          container EthTSynGlobalTimeSlave [0..1]: multiplicity set at pre-compile  # Configuration of a time slave. Each global time domain is required to have at least one time slave. The configured ECU may or may not represent a time slave.
            float EthTSynGlobalTimeFollowUpTimeout: 0..4, multiplicity set at pre-compile, set at pre-compile, default-value=0.125  # Timeout value of the Follow_Up message (of the subsequent Sync message). A value of 0 deactivates this timeout observation. | A value of 0 deactivates this timeout observation. Unit: seconds
            enumeration EthTSynRxCrcValidated: {CRC_IGNORED, CRC_NOT_VALIDATED, CRC_OPTIONAL, CRC_VALIDATED}, multiplicity set at pre-compile, set at pre-compile, default-value=CRC_IGNORED  # Definition of whether or not validation of the CRC is supported. CRC_IGNORED - EthTSyn accepts all FollowUp messages. Possibly included CRCs in any ArSubTlv will be ignored. CRC_NOT_VALIDATED - EthTSyn only accepts FollowUp messages where no CRC is included in optional ArSubTlvs (i.e. SubTlv Types: 0x51, 0x61 and 0x34). CRC_OPTIONAL - EthTSyn accepts all FollowUp messages. If an ArSubTlv inlcudes a CRC, the CRC is validated. CRC_VALIDATED - EthTSyn only accepts FollowUp messages where CRC is included in optional ArSubTlvs (i.e. SubTlv Types: 0x28, 0x50, 0x60 and 0x44). The Crc is validated.
            integer EthTSynAnnounceMaxStepRemoved [0..1]: 1..254, multiplicity set at pre-compile, origin=Vector Informatik, set at pre-compile, default-value=7  # This represents the maximum number of network hops between the Grandmaster and this slave. Note: Only used when EthTSynEnableAnnounce==true
            float EthTSynAnnounceTimeout [0..1]: 0..65535, multiplicity set at pre-compile, origin=Vector Informatik, set at pre-compile, default-value=0.1  # Determines the maximum delay time in ms between incoming Announce messages sent by the master. Note: Only used when EthTSynEnableAnnounce==true
            boolean EthTSynEnableAnnounce: multiplicity set at pre-compile, origin=Vector Informatik, set at pre-compile, default-value=false  # When this option is enabled, the slave has to receive an valid annouce message before synchronization is possible. The slave stores the ClockIdentity of the GrandMaster (received via announce message) and validates Sync/FollowUp messages using this clock identity.
            boolean EthTSynEnableSourcePortIdentityCheck: multiplicity set at pre-compile, origin=Vector Informatik, set at pre-compile, default-value=false  # This parameter speciefies whether the SourcePortIdentity of received Sync/FollowUp messages should be verified or not. Note: When enabled, the valid source port identity for Sync/FollowUp messages has to be configured using the container EthTSynSourcePortIdentityCheckConfig.
            integer EthTSynFollowUpCorrectionFieldThreshold [0..1]: 0..281474976710655, multiplicity set at pre-compile, origin=Vector Informatik, set at pre-compile, default-value=281474976710655  # This represents a threshold in nanoseconds for the correction field of a FollowUp message received by the slave. The FollowUp message is discarded if this threshold is exceeded.
            boolean EthTSynRxSubTLVOFS: multiplicity set at pre-compile, origin=Vector Informatik, set at pre-compile, default-value=false  # Rx Sub TLV OFS | Definition of whether or not a Sub-TLV:OFS Secured or Sub-TLV:OFS Not Secured shall be present and shall be evaluated when processing a received Follow_Up message. Note: Parameter as defined in AUTOSAR 22-11
            boolean EthTSynRxSubTLVStatus: multiplicity set at pre-compile, origin=Vector Informatik, set at pre-compile, default-value=false  # Definition of whether or not a Sub-TLV:Status Secured or Sub-TLV:Status Not Secured shall be present and shall be evaluated when processing a received Follow_Up message. Note: Parameter as defined in AUTOSAR 22-11
            boolean EthTSynRxSubTLVTime: multiplicity set at pre-compile, origin=Vector Informatik, set at pre-compile, default-value=false  # Definition of whether or not a Sub-TLV:Time Secured shall be present and shall be evaluated when processing a received Follow_Up message. Note: Parameter as defined in AUTOSAR 22-11
            boolean EthTSynRxSubTLVUserData: multiplicity set at pre-compile, origin=Vector Informatik, set at pre-compile, default-value=false  # Definition of whether or not a Sub-TLV:UserData Secured or Sub-TLV:UserData Not Secured shall be present and shall be evaluated when processing a received Follow_Up message. Note: Parameter as defined in AUTOSAR 22-11
            container EthTSynCrcFlagsRxValidated [0..1]: multiplicity set at pre-compile  # This container collects definitions which parts of the Follow_Up message elements shall be included in CRC validation.
              boolean EthTSynCrcCorrectionField: multiplicity set at pre-compile, set at pre-compile, default-value=false  # correctionField from the Follow_Up Message Header shall be included in CRC calculation.
              boolean EthTSynCrcDomainNumber: multiplicity set at pre-compile, set at pre-compile, default-value=false  # domainNumber from the Follow_Up Message Header shall be included in CRC calculation.
              boolean EthTSynCrcMessageLength: multiplicity set at pre-compile, set at pre-compile, default-value=false  # messageLength from the Follow_Up Message Header shall be included in CRC calculation.
              boolean EthTSynCrcPreciseOriginTimestamp: multiplicity set at pre-compile, set at pre-compile, default-value=true  # preciseOriginTimestamp from the Follow_Up Message Field shall be included in CRC calculation.
              boolean EthTSynCrcSequenceId: multiplicity set at pre-compile, set at pre-compile, default-value=false  # sequenceId from the Follow_Up Message Header shall be included in CRC calculation.
              boolean EthTSynCrcSourcePortIdentity: multiplicity set at pre-compile, set at pre-compile, default-value=false  # sourcePortIdentity from the Follow_Up Message Header shall be included in CRC calculation.
            container EthTSynSourcePortIdentityCheckConfig [0..1]: multiplicity set at pre-compile  # Configuration of the Master Source Port Identity used to verifiy the Source Port Identity of Sync/FollowUp received by the slave if Source Port Identity Check is enabled. Note: Only used when EthTSynEnableSourcePortIdentityCheck==true
              string EthTSynMasterPhysicalAddress: multiplicity set at pre-compile, origin=Vector Informatik, set at pre-compile, max-length=17, min-length=17  # The Physical Hardware Address (MAC-Address) of Time Master. Input format has to match xx::xx::xx::xx::xx::xx, where x stands for a hex value between 0 and F.
    container EthTSynSwitchTimeSyncConfig [0..255]: multiplicity set at pre-compile  # Configuration of all parameters required for the time synchronization of the Ethernet Switch. Note: Only Ethernet switches configured here will be synchronized.
      float EthTSynSwitchTimeSyncSyncPrecisionLimit: 0..4, multiplicity set at pre-compile, origin=Vector Informatik, set at pre-compile, default-value=1E-05  # This parameter is used to determine the max allowed offset of the Switch time to the global time. If this limit is exceeded, the SyncState changes to UNSYNC. Note: The Offset is measured with each synchronization event.
      integer EthTSynSwitchTimeSyncMaxOutOfSyncCount: 1..255, multiplicity set at pre-compile, origin=Vector Informatik, set at pre-compile, default-value=3  # This parameter inidcates how often in a row the measured Switch offset can exceed the configured SwitchSyncPrecisionLimit befor the Sync state is changed to UNSYNC.
      function name EthTSynSwitchTimeSyncSyncStateChangeCallback [0..1]: multiplicity set at pre-compile, origin=Vector Informatik, set at pre-compile  # Callout to inform about a change of the sync state of the Switch. Call-back function has following signature: void SyncStateChgCbk(uint8 EthTSynSwitchIdx, EthTSyn_SyncStateType SyncState)
      integer EthTSynSwitchTimeSyncIndex: 0..254, multiplicity set at pre-compile, origin=Vector Informatik, set at pre-compile, symbolic-name-value=true, default-value=0  # Index of the Switch (cascade)/SwitchTimeSyncConfig within the context of the EthTSyn. This Index is calculated automatically and provided as symbolic name value.
      boolean EthTSynSwitchTimeSyncApplyRateRatioToSlaveSwitches [0..1]: multiplicity set at pre-compile, origin=Vector Informatik, set at pre-compile, default-value=true  # With this parameter it can be decided if a correction of the RateRatio has to be applied to the slave switches seperatly or not: TRUE: RateRatio is applied to all slave switches seperatly FALSE: RateRatio is only applied to the master switch Notes: - This parameter is only relevant when at least one slave switch is configured - When ./EthTSynSwitchTimeSyncMechanism/EthTSynRateRegulator/EthTSynUseOffsetCorrectionForInitialCorrection is enabled, the initial offset correction is always applied to all slave switches - Setting of this parameter depends on the Hardware setup (e.g. it might be set to FALSE when the master switch is providing the clock for the slave switches)
      float EthTSynSwitchTimeSyncSyncEventTimeout: 0..4, multiplicity set at pre-compile, origin=Vector Informatik, set at pre-compile, default-value=1  # Timeout for sync event. When no sync event occurres (or required timestamps of the sync event are not available) within this timeout, the sync state will be changed to ETHTSYN_UNCERTAIN. Note: A value of 0 disables the timeout observation.
      reference EthTSynSwitchTimeSyncTimeDomainRef: multiplicity set at pre-compile, origin=Vector Informatik, set at pre-compile, destination=EthTSynGlobalTimeDomain  # Reference to the time domain, the switch (cascade) shall be synchronized to.
      symbolic name reference EthTSynSwitchTimeSyncEthIfMasterSwitchRef: multiplicity set at pre-compile, origin=Vector Informatik, set at pre-compile, requires-symbolic-name-value=true, destination=EthIfSwitch  # Reference to the Switch in the context of the Ethernet Interface which shall be synchronized. Note: Depending on the configuration, the Switch is either synchronized to an external Time Master or to the Host CPU (if the Host is acting as Time Master).
      symbolic name reference EthTSynSwitchTimeSyncEthIfSlaveSwitchRef [0..*]: multiplicity set at pre-compile, origin=Vector Informatik, set at pre-compile, requires-symbolic-name-value=true, destination=EthIfSwitch  # With this reference 0..n Slave-Switches can be synchronized. In this case the Switch configured in [/MICROSAR/EthTSyn/EthTSynSwitchMgmtSwitchTimeSyncConfig/EthTSynEthIfMasterSwitchRef] is used as Master-Switch. The Offset and RateRatio is only calculated for the Master-Switch and the same values are forwareded to all configured Slave-Switches via EthIf_SetSwitchCorrectionTime().
      choice container EthTSynSwitchTimeSyncMechanism: multiplicity set at pre-compile  # Defining the mechanism which schould be used for the time synchronization of the switch. RateRegulator: - Offset correction (time leap) is only performed when the Sync-State was never reached yet (optional) - Adoption of the RateRatio (frequency) is done in such way, that absolute time offsets are corrected without time leaps Note: Currently only RateRegulator is supported.
        container EthTSynRateRegulator [0..1]: multiplicity set at pre-compile  # Configuration of the RateRegulator time synchronization method: - Offset correction (time leap) is only performed when the Sync-State was never reached yet (optional) - Adoption of the RateRatio (frequency) is done in such way, that absolute time offsets are corrected without time leaps
          boolean EthTSynUseOffsetCorrectionForInitialCorrection: multiplicity set at pre-compile, origin=Vector Informatik, set at pre-compile, default-value=true  # Decide if offset correction should be used before reaching the Sync-State for the first time. This might be useful to compensate big time offset at startup.
          float EthTSynRateRatioMax: 1..2, multiplicity set at pre-compile, origin=Vector Informatik, set at pre-compile, default-value=1.1  # Defining the max allowed value of the RateRatio. If the RateRatio calculated by the regulator exceeds this threshold, it is set to this value. Note: This value onyl defines the boundary for the relative RateRatio (i.e. the RateRatio computed with one synchronitation event)
          float EthTSynRateRatioMin: 0.5..1, multiplicity set at pre-compile, origin=Vector Informatik, set at pre-compile, default-value=0.9  # Defining the max allowed value of the RateRatio. If the RateRatio calculated by the regulator falls below this threshold, it is set to this value. Note: This value onyl defines the boundary for the relative RateRatio (i.e. the RateRatio computed with one synchronitation event)
          integer EthTSynNumberOfParallelRateMeasurements: 1..255, multiplicity set at pre-compile, origin=Vector Informatik, set at pre-compile, default-value=3  # Decide how many rate measurements are running parallel. A higher value increases the duration of each rate measurement. This decreases the effect of errors due to fluctuations of the sync cycle duration. A lower value on the other hand, increases performance.
          integer EthTSynNumberOfSyncCyclesForOffsetCorrection: 1..255, multiplicity set at pre-compile, origin=Vector Informatik, set at pre-compile, default-value=3  # Decide how many sync cycles it should take for the rate regulator to correct an offset. High values might increase the duration until the system is synchronized but stabilize the regulating mechanism.
          float EthTSynOffsetJumpCorrectionThreshold [0..1]: 1E-09..4, multiplicity set at pre-compile, origin=Vector Informatik, set at pre-compile, default-value=0.001  # If the offset exceeds this value, offset jump correction is used instead of rate regulator. This can be useful for large offsets because the rate regulator might need too long to synchronize in this case.
  bsw implementation EthTSyn_Impl: programming-language=C, sw-version=17.00.00, used-code-generator=DaVinci Configurator, vendor-id=30, ar-release-version=4.04.00, behavior=EthTSynBehavior, preconfigured-configuration=EthTSyn_Pre, recommended-configuration=EthTSyn_Rec, vendor-specific-module-def=EthTSyn
  module config EthTSyn_Pre: definition=EthTSyn
  module config EthTSyn_Rec: definition=EthTSyn
