AUTOSAR XML (schema 4-0-3)
# COPYRIGHT
# Copyright (c) 2021 by Vector Informatik GmbH. All rights reserved.
# This software is copyright protected and proprietary to Vector Informatik GmbH.
# Vector Informatik GmbH grants to you only those rights as set out in the license conditions.
package /MICROSAR/CddDrm
  module definition Cdd [0..1]: category=VENDOR_SPECIFIC_MODULE_DEFINITION, api-service-prefix=CddDrm, refined-module-def=Cdd, variants pre-compile  # Diagnostic Request Manager (DRM), is used by customer applications for sending diagnostic requests and handling responses to/from diagnostic servers either on the same ECU or ECUs on the communication bus. #Diagnostics #UDS #Vector
    container CddComStackContribution  # Contribution of COM Stack modules.
      container CddPduRUpperLayerContribution [0..1]  # PduR Upper Layer Contribution | Parameters that are necessary for the configuration of a Complex Driver that serves as the UpperLayer of the Pdu Router module.
        container CddPduRUpperLayerRxPdu [1..*]  # PduR Upper Layer Rx Pdu | Rx PDU that is received by the Complex Driver and forwarded to the PduR.
          integer CddPduRUpperLayerHandleId: 0..65535, set at pre-compile, symbolic-name-value=true, default-value=0  # PduR Upper Layer Handle Id | ECU wide unique, symbolic handle for the Pdu.
          reference CddPduRUpperLayerPduRef: set at pre-compile, destination=Pdu  # PduR Upper Layer Pdu Ref | Reference to the "global" Pdu structure to allow harmonization of handle IDs in the COM-Stack.
        container CddPduRUpperLayerTxPdu [1..*]  # PduR Upper Layer Tx Pdu | Tx PDU that is received by the Complex Driver from the PduR.
          integer CddPduRUpperLayerHandleId: 0..65535, set at pre-compile, symbolic-name-value=true, default-value=0  # PduR Upper Layer Handle Id | ECU wide unique, symbolic handle for the Pdu.
          reference CddPduRUpperLayerPduRef: set at pre-compile, destination=Pdu  # PduR Upper Layer Pdu Ref | Reference to the "global" Pdu structure to allow harmonization of handle IDs in the COM-Stack.
      container CddPduRLowerLayerContribution [0..1]  # Parameters that are necessary for the configuration of a Complex Driver that serves as the LowerLayer of the Pdu Router module.
        container CddPduRLowerLayerRxPdu [1..*]  # PduR Lower Layer Rx Pdu | Rx PDU that is received by the Complex Driver and forwarded to the PduR.
          integer CddPduRLowerLayerHandleId: 0..65535, set at pre-compile, symbolic-name-value=true, default-value=0  # PduR Lower Layer Handle Id | ECU wide unique, symbolic handle for the Pdu.
          reference CddPduRLowerLayerPduRef: set at pre-compile, destination=Pdu  # PduR Lower Layer Pdu Ref | Reference to the "global" Pdu structure to allow harmonization of handle IDs in the COM-Stack.
        container CddPduRLowerLayerTxPdu [1..*]  # PduR Lower Layer Tx Pdu | Tx PDU that is received by the Complex Driver from the PduR.
          integer CddPduRLowerLayerHandleId: 0..65535, set at pre-compile, symbolic-name-value=true, default-value=0  # PduR Lower Layer Handle Id | ECU wide unique, symbolic handle for the Pdu.
          reference CddPduRLowerLayerPduRef: set at pre-compile, destination=Pdu  # PduR Lower Layer Pdu Ref | Reference to the "global" Pdu structure to allow harmonization of handle IDs in the COM-Stack.
    container CddGeneral  # This container contains the general configuration (parameters) of the Drm.
      integer CddNumberOfChannels: 1..253, set at pre-compile, origin=Vector Informatik, default-value=1  # This value specifies the limit of active connections at the same time. Note: If ECU Detection is enabled, the minimum value of this parameter is 2.
      float CddTaskTime: 0.001..10, set at pre-compile, origin=Vector Informatik, default-value=0.01  # MainTimer Function Period | This value specifies the cyclic call of the main function.
      boolean CddDevErrorDetect: set at pre-compile, origin=Vector Informatik, default-value=true  # Development Error Detect | Activate/Deactivate the Development Error Detection and Notification. If this option is enabled, integration errors are reported to the DET module (e.g. calling APIs with invalid arguments that would cause a malfunction of the Drm module). In a production system this option can be disabled as all code should be tested to correctly use the Drm API.
      boolean CddVersionInfoApi: set at pre-compile, origin=Vector Informatik, default-value=false  # This switch turns the API to get the component version ON or OFF. true: Version API ON false: Version API OFF
      boolean CddCancelApi: set at pre-compile, origin=Vector Informatik, default-value=false  # If enabled the Drm supports the API CddDrm_CancelRequest() to cancel an ongoing request processing.
      float CddRequestDelayTime [0..1]: 0.01..2.55, set at pre-compile, origin=Vector Informatik, default-value=0.2  # This value specifies the delay time before the next request is sent. The timer is reloaded with this value when all request data was successful copied to the PduR. Restrictions: If connection separation time is configured this parameter cannot be activated too.
      boolean CddUseNvm [0..1]: set at pre-compile, origin=Vector Informatik, default-value=true  # If enabled the Drm stores data in non-volatile memory, e.g. ECU detection.
      boolean CddEcuDetectionSupport: set at pre-compile, origin=Vector Informatik, default-value=false  # This parameter switches the ECU Detection on or off. Note: If this switch is set to true, the UseNvm parameter and EcuDetection container is mandatory and must be configured.
      string CddHeaderFileInclusion [1..*]: set at pre-compile, origin=Vector Informatik  # Name of the header file(s) to be included by the Drm module containing the used C-callback declarations. The different callout configurations allow to specify a C-Callback. Therefore you need to add a header file here with the appropriate declaration of the function.
      string CddUserConfigFile [0..1]: set at pre-compile, origin=Vector Informatik, default-value=CddDrm_UserConfig.ucf  # Reference to an external text file that will be included during generation to CddDrm_Cfg.h. The content of the user configuration file will be added at the end of the generated module configuration file and allows altering or extending the generated code. Caution: User configuration files can cause the software module to malfunction and must only be used with great care!
      boolean CddUseFirewallUserDefinedServices: set at pre-compile, origin=Vector Informatik, default-value=false  # This parameter enables a callback so the application can verify if the user defined service is allowed or not. Note: If user defined services enabled in firewall, the callback is mandatory.
      integer CddCompiledConfigId [0..1]: 0..65535, set at pre-compile, origin=Vector Informatik, default-value=0  # Change this value to force the Drm to clear all NV data on next initialization (startup). This is useful if the flash eeprom emulation is not cleared during flashing of a new software version. If this value is missing the Drm will clear its NV data, if the component major or minor version will change.
      integer CddFunctionalRespBufferNum [0..1]: 1..255, set at pre-compile, origin=Vector Informatik, default-value=1  # Defines the number of buffers which are used to store functional response data.
      integer CddInternalBufferSize [0..1]: 1..255, set at pre-compile, origin=Vector Informatik, default-value=8  # Specifies the Drm internal buffer size (in Bytes) used for internal ECU communication. The buffer is only placed on the stack.
      boolean CddForwardRCRRPToApplication: set at pre-compile, origin=Vector Informatik, default-value=false  # This parameter switches forwarding of RCRRPs to the application on or off. Note: If this switch is set to true, received RCRRPs are forwarded to the application in the same way as NRCs.
      boolean CddSafeBswChecks: set at pre-compile, origin=Vector Informatik, default-value=false  # SafeBSW Checks | Selects if safety checks are used. These checks improve robustness as e.g. invalid parameters are checked before function is executed. This attribute has to be enabled for safety projects where this component is mapped to an ASIL partition.
      integer CddFunctionalRespBufferSize [0..1]: 1..255, set at pre-compile, origin=Vector Informatik, default-value=8  # Defines the size(byte) of each buffer which is used to store functional response data.
      float CddP3FunctionalDelayTimer [0..1]: 0.01..2.55, set at pre-compile, origin=Vector Informatik, default-value=0.2  # This value specifies the delay time between functional connection requests. The timer is reloaded with this value when all request data was successful copied to the PduR, during TxConfirmation. Restrictions: If RequestDelayTime is configured, the functional connection request delay time can not be activated too.
      container CddDedicatedApiServiceSupport  # Dedicated Diagnostic Service APIs
        boolean CddSupportSvcApi_10: set at pre-compile, origin=Vector Informatik, default-value=true  # Support Service 0x10 | DiagnosticSessionControl true: Service enabled false: Service disabled
        boolean CddSupportSvcApi_11: set at pre-compile, origin=Vector Informatik, default-value=true  # Support Service 0x11 | ECU Reset true: Service enabled false: Service disabled
        boolean CddSupportSvcApi_22: set at pre-compile, origin=Vector Informatik, default-value=true  # Support Service 0x22 | ReadDataByIdentifier true: Service enabled false: Service disabled
        boolean CddSupportSvcApi_27: set at pre-compile, origin=Vector Informatik, default-value=true  # Support Service 0x27 | SecurityAccess true: Service enabled false: Service disabled
        boolean CddSupportSvcApi_28: set at pre-compile, origin=Vector Informatik, default-value=true  # Support Service 0x28 | CommunicationControl true: Service enabled false: Service disabled
        boolean CddSupportSvcApi_3E: set at pre-compile, origin=Vector Informatik, default-value=true  # Support Service 0x3E | TesterPresent true: Service enabled false: Service disabled
        boolean CddSupportSvcApi_85: set at pre-compile, origin=Vector Informatik, default-value=true  # Support Service 0x85 | ControlDTCSetting true: Service enabled false: Service disabled
        boolean CddSupportSvcApi_1904: set at pre-compile, origin=Vector Informatik, default-value=true  # Support Service 0x1904 | ReadDTCInformation sub-function: 0x04 true: Service enabled false: Service disabled
        boolean CddSupportSvcApi_31: set at pre-compile, origin=Vector Informatik, default-value=true  # Support Service 0x31 | RoutineControl true: Service enabled false: Service disabled
        boolean CddSupportSvcApi_34: set at pre-compile, origin=Vector Informatik, default-value=true  # Support Service 0x34 | RequestDownload true: Service enabled false: Service disabled
        boolean CddSupportSvcApi_36: set at pre-compile, origin=Vector Informatik, default-value=true  # Support Service 0x36 | TransferData true: Service enabled false: Service disabled
        boolean CddSupportSvcApi_37: set at pre-compile, origin=Vector Informatik, default-value=true  # Support Service 0x37 | RequestTransferExit true: Service enabled false: Service disabled
        boolean CddSupportSvcApi_1902: set at pre-compile, origin=Vector Informatik, default-value=true  # Support Service 0x1902 | ReadDTCInformation sub-function: 0x02 true: Service enabled false: Service disabled
      container CddNvRamBlockId [0..1]  # NvRam BlockId | This container represents a non-volatile memory block used by the Drm. If no permanent storage is required, no block needs to be configured.
        enumeration CddNvRamBlockIdType: {DRM_NVBLOCK_ECU_DETECTION}, set at pre-compile, origin=Vector Informatik, default-value=DRM_NVBLOCK_ECU_DETECTION  # NvRam BlockId Type | Usage kind of this NvBlock. This parameter is used to identify which block data needs to be stored.
        symbolic name reference CddNvRamBlockIdRef: set at pre-compile, origin=Vector Informatik, destination=NvMBlockDescriptor  # NvRam BlockId Ref | This reference contains the link to a non-volatile memory block.
      container CddCallback  # This container contain all callbacks that can be configured in the Drm.
        function name CddResponseNotification: set at pre-compile, origin=Vector Informatik, default-value=Drm_ResponseNotification  # Specifies the function name in the application which is called when the request processing has finished. E.g. a response was received or a timeout has occured.
        function name CddTxConfirmation [0..1]: set at pre-compile, origin=Vector Informatik  # Specifies the function name in the application which is called when all request data was transferred to the PduR. Note: Callback is only called, if request is triggered by application.
        function name CddEcuDetectionFinished [0..1]: set at pre-compile, origin=Vector Informatik  # This callback will be triggered from Drm after ECU Detection is finished. Note: Do not configure this callback, if ECU Detection is disabled.
        function name CddFirewallUserCallback [0..1]: set at pre-compile, origin=Vector Informatik  # Specifies a callback to the application, to verify if user defined service is allowed or not.
      container CddEcuDetection [0..1]  # This container contains all parameters related to the ECU detection.
        integer CddDetectionRequest [1..7]: 0..255, set at pre-compile, origin=Vector Informatik, requires-index=true  # This value specifies the request bytes, which will be used to detect ECUs.
        integer CddDetectionBufferSize: 3..255, set at pre-compile, origin=Vector Informatik, default-value=7  # Response Buffer Size | Specifies the Drm internal response buffer, that is only used for ECU Detection. Note: If the buffer is not large enough to receive the response data, the respective ECU is set to not detected.
    container CddConfig  # This container contains communication related configuration (parameters).
      container CddConnection [1..254]  # This container contains the connection specific configuration (parameters) of the Drm. For the physical connection type, the connection represents a diagnosable ECU in the vehicle network. In case of the functional connection type, the connection represents a set of diagnosable ECUs in the vehicle network.
        float CddP2: 0.001..65.535, set at pre-compile, origin=Vector Informatik, default-value=0.1  # P2 Time | This value specifies the default P2 Time.
        float CddP2Extended: 0.001..655.35, set at pre-compile, origin=Vector Informatik, default-value=10  # P2 Extended Time | This value specifies the extended P2 time.
        integer CddMaxRCRRP [0..1]: 1..255, set at pre-compile, origin=Vector Informatik, default-value=10  # Max. allowed RCRRP | This value specifies the maximum number of allowed RCRRP messages. If this value is missing, the CddDrm will not differentiate between RCRRP messages and other negative responses.
        float CddSeparationTime [0..1]: 0.01..2.55, set at pre-compile, origin=Vector Informatik, default-value=0.2  # This value specifies the delay time between a diagnostic response and the next possible request for this connection. The timer is reloaded with this value when the allocated channel for this connection was closed. The channel can be closed for the following reasons: - Tx error between Drm and PduR - Rx error between Drm and PduR - Response timeout - External tester detected - Cancel API(s) has been called - RCRRP limit reached Restrictions: If RequestDelayTime is configured, the connection separation time cannot be activated too.
        reference CddFirewallListRef [0..1]: set at pre-compile, origin=Vector Informatik, destination=CddFirewallLists  # This value references the firewall list.
        choice container CddConnectionType  # Physical or functional connection type.
          container CddPhysical [0..1]  # The physical request and response Pdu for the ECU.
            boolean CddPhysicalDynamicConnection [0..1]: set at pre-compile, origin=Vector Informatik, default-value=false  # Dynamic Connection | Configure the physical connection as a dynamic connection. MetaDataLength must be set for all referenced Pdu:s, same length must be used for all Pdu:s. Response Pdu has to be configured but is not bound to the dynamic connection.
            reference CddPhysicalResponseRef: set at pre-compile, origin=Vector Informatik, destination=CddPduRUpperLayerRxPdu  # Response Pdu that is received by the Drm from the PduR.
            reference CddPhysicalRequestRef: set at pre-compile, origin=Vector Informatik, destination=CddPduRUpperLayerTxPdu  # Physical request Pdu that is forwarded to the PduR.
          container CddFunctional [0..1]  # The functional request Pdu for the ECU.
            reference CddFunctionalRequestRef: set at pre-compile, origin=Vector Informatik, destination=CddPduRUpperLayerTxPdu  # Functional request Pdu that is forwarded to the PduR.
      container CddFirewallLists [0..65535]  # This container contains the firewall configuration (parameters) of the Drm.
        enumeration CddFirewallServiceIds [1..*]: set at pre-compile, origin=Vector Informatik  # Diagnostic services configured in this blacklist will be rejected for service processing.
          Service_0x10  # Diagnostic Session Control
          Service_0x11  # ECU Reset
          Service_0x14  # Clear Diagnostic Information
          Service_0x19  # Read DTC Information
          Service_0x22  # Read Data By Identifier
          Service_0x23  # Read Memory By Address
          Service_0x24  # Read Scaling Data By Identifier
          Service_0x27  # Security Access
          Service_0x28  # Communication Control
          Service_0x2A  # Read Data By Periodic Identifier
          Service_0x2C  # Dynamically Define Data Identifier
          Service_0x2E  # Write Data By Identifier
          Service_0x2F  # Input Output Control By Identifier
          Service_0x31  # Routine Control
          Service_0x34  # Request Download
          Service_0x35  # Request Upload
          Service_0x36  # Transfer Data
          Service_0x37  # Request Transfer Exit
          Service_0x38  # Request File Transfer
          Service_0x3D  # Write Memory By Address
          Service_0x3E  # Tester Present
          Service_0x83  # Access Timing Parameter
          Service_0x84  # Secured Transmission
          Service_0x85  # Control DTC Settings
          Service_0x86  # Response on Event
          Service_0x87  # Link control
      container CddInternalEcuRouting [0..254]  # This container contains the routings for diagnostic request to the internal Dcm.
        container CddRouting  # This container contains the pdu references needed for a internal diagnostic request.
          reference CddRequestTxPduRef: set at pre-compile, origin=Vector Informatik, destination=CddPduRLowerLayerTxPdu  # Pdu reference for the TxPdu of the diagnostic request for internal communication.
          reference CddRequestRxPduRef: set at pre-compile, origin=Vector Informatik, destination=CddPduRLowerLayerRxPdu  # Pdu reference for the RxPdu of the diagnostic request for internal communication.
          reference CddResponseTxPduRef: set at pre-compile, origin=Vector Informatik, destination=CddPduRLowerLayerTxPdu  # Pdu reference for the TxPdu of the diagnostic response for internal communication.
          reference CddResponseRxPduRef: set at pre-compile, origin=Vector Informatik, destination=CddPduRLowerLayerRxPdu  # Pdu reference for the RxPdu of the diagnostic response for internal communication.
  module config Cdd_Pre: definition=Cdd
  module config Cdd_Rec: definition=Cdd
  bsw implementation Cdd_Impl: programming-language=C, sw-version=7.00.01, used-code-generator=DaVinci Configurator, vendor-id=30, ar-release-version=4.01.02, behavior=CddDrmBehavior, preconfigured-configuration=Cdd_Pre, recommended-configuration=Cdd_Rec, vendor-specific-module-def=Cdd
    required-artifacts:
      dependency on artifact CddDrm_MemMap: category=MEMMAP, artifact-descriptor={short-label=CddDrm_MemMap.h, category=SWHDR}
    resource consumption ResourceConsumption
      13 x memory section, all with prefix=CddDrm_Prefix:
        CDDDRM_CODE: sw-addrmethod=CODE, symbol=CODE
        CDDDRM_CONST_8BIT: alignment=8, sw-addrmethod=CONST_8, symbol=CONST_8BIT
        CDDDRM_CONST_16BIT: alignment=16, sw-addrmethod=CONST_16, symbol=CONST_16BIT
        CDDDRM_CONST_32BIT: alignment=32, sw-addrmethod=CONST_32, symbol=CONST_32BIT
        CDDDRM_CONST_UNSPECIFIED: alignment=UNSPECIFIED, sw-addrmethod=CONST_UNSPECIFIED, symbol=CONST_UNSPECIFIED
        CDDDRM_VAR_PBCFG: sw-addrmethod=VAR_PBCFG, symbol=VAR_PBCFG
        CDDDRM_VAR_NOINIT_8BIT: alignment=8, sw-addrmethod=VAR_NO_INIT_8, symbol=VAR_NOINIT_8BIT
        CDDDRM_VAR_NOINIT_16BIT: alignment=16, sw-addrmethod=VAR_NO_INIT_16, symbol=VAR_NOINIT_16BIT
        CDDDRM_VAR_NOINIT_UNSPECIFIED: alignment=UNSPECIFIED, sw-addrmethod=VAR_NO_INIT_UNSPECIFIED, symbol=VAR_NOINIT_UNSPECIFIED
        CDDDRM_VAR_INIT_8BIT: alignment=8, sw-addrmethod=VAR_INIT_8, symbol=VAR_INIT_8BIT
        CDDDRM_VAR_ZERO_INIT_8BIT: alignment=8, sw-addrmethod=VAR_CLEARED_8, symbol=VAR_ZERO_INIT_8BIT
        CDDDRM_VAR_ZERO_INIT_UNSPECIFIED: alignment=UNSPECIFIED, sw-addrmethod=VAR_CLEARED_UNSPECIFIED, symbol=VAR_ZERO_INIT_UNSPECIFIED
        CDDDRM_VAR_SAVED_ZONE0_UNSPECIFIED: alignment=UNSPECIFIED, sw-addrmethod=VAR_FAST_NO_INIT_UNSPECIFIED, symbol=VAR_SAVED_ZONE0_UNSPECIFIED
      section name prefix CddDrm_Prefix: symbol=CDDDRM
