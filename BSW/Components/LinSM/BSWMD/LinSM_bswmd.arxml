AUTOSAR XML (schema 4-0-3)
# COPYRIGHT
# Copyright (c) 2022 by Vector Informatik GmbH. All rights reserved.
# This software is copyright protected and proprietary to Vector Informatik GmbH.
# Vector Informatik GmbH grants to you only those rights as set out in the license conditions.
package /MICROSAR
  module definition LinSM [0..1]: category=VENDOR_SPECIFIC_MODULE_DEFINITION, refined-module-def=LinSM, variants pre-compile/post-build-selectable/post-build-loadable  # Configuration of the LinSM (Lin State Manager) module.
    container LinSMConfigSet  # This container describes one configuration set of LinSM.
      integer LinSMModeRequestRepetitionMax [0..1]: 0..255, set at post-build in variant post-build-loadable+post-build-selectable / pre-compile in variant pre-compile, origin=Vector Informatik, default-value=0  # Specifies the maximal amount of Full Communication mode request repetitions without a respective mode indication from the LinIf module until the LinSM module tries to go back to no communication. If this parameter is not configured or is 0, no wake-up repetition will be performed.
      container LinSMChannel [0..*]  # This container describes one LIN channel the LinSM is connected to.
        float LinSMConfirmationTimeout: 0..65.535, set at pre-compile in variant post-build-loadable+pre-compile / post-build in variant post-build-selectable, default-value=1  # Timeout for the goto sleep, wake-up and change schedule requests to LinIf. If a request is not confirmed by LinIf within the timeout, the LinSM reports a DET error. The timeout must be longer than a goto-sleep command on the bus (i.e. it is bit rate dependent). Set the value to 0 to disable the confirmation timeout handling. Note: The value should be a multiple of LinSMMainProcessingPeriod.
        boolean LinSMSleepSupport: set at pre-compile in variant post-build-loadable+pre-compile / post-build in variant post-build-selectable, default-value=false  # Some LIN clusters do not need a go to sleep command, they just shut down. This parameter controls the behavior of the sleep process: Enabled: The LinSM requests the LinIf to transmit the go to sleep command before changing to the no communication state LINSM_NO_COM. Disabled: The LinSM changes its state directly without requesting the LinIf to wake-up or shut down. The state change is executed immediately and the new state is notified to ComM and BswM.
        boolean LinSMTransceiverPassiveMode [0..1]: set at pre-compile in variant post-build-loadable+pre-compile / post-build in variant post-build-selectable, default-value=false  # The LinSM switches the transceiver state according to the communication state by using the LinIf. The transceiver handling can be disabled by deleting this parameter. If this parameter is true, the transceiver will be set to STANDBY mode when state LINSM_NO_COM is entered. Otherwise the transceiver will be set to SLEEP mode. The transceiver will be set to NORMAL mode, when LINSM_FULL_COM is entered.
        boolean LinSMTransceiverHandling: set at pre-compile in variant post-build-loadable+pre-compile / post-build in variant post-build-selectable, origin=Vector Informatik, default-value=false  # En-/ disable the handling of the transceiver driver state of this channel. If enabled, the LinSM switches the transceiver state via the LinIf according to the communication state: - No Communication: The transceiver is set into standby or sleep mode (depending on LinSMTransceiverPassiveMode) - Full Communication: The transceiver is set into normal mode
        enumeration LinSMNodeType: set at pre-compile in variant post-build-loadable+pre-compile / post-build in variant post-build-selectable, origin=Vector Informatik, default-value=MASTER  # Specifies the LIN node type (Master or Slave) of this channel.
          MASTER  # Master node
          SLAVE  # Slave node
        float LinSMSilenceAfterWakeupTimeout [0..1]: 0..1.7976931348623157E+308, set at pre-compile in variant post-build-loadable+pre-compile / post-build in variant post-build-selectable, origin=Vector Informatik, default-value=1  # Timeout in seconds after a failed wakeup sequence until a new wakeup process is started.
        symbolic name reference LinSMComMNetworkHandleRef: set at post-build in variant post-build-selectable / pre-compile in variant pre-compile+post-build-loadable, destination=ComMChannel  # ComM Network Handle Reference | Unique handle to identify one certain LIN network. Reference to one of the network handles configured in the ComM.
        container LinSMSchedule [0..*]: post-build-changeable=true  # The schedule references to a schedule that is located in the LinIf configuration.
          integer LinSMScheduleIndex: 0..255, set at pre-compile, symbolic-name-value=true, default-value=0  # This index parameter can be used by the BswM as a SymbolicNameReference target. The LinSM just forwards the request from the BswM to LinIf. Note that the value of the LinSMScheduleIndex shall be the same as the value from the LinIf.
          symbolic name reference LinSMScheduleIndexRef: set at pre-compile, destination=LinIfScheduleTable  # Reference to a schedule table in the LinIf configuration
    container LinSMGeneral  # This container contains general parameters of LIN State Manager module.
      boolean LinSMDevErrorDetect: set at pre-compile, default-value=true  # This parameter switches the Development Error Detection and Notification ON or OFF. true: Development error detection is enabled. false: Development error detection is disabled. Note: In general, the development error detection is recommended during pre-test phase. It is not recommended to enable the development error detection in production code due to increased runtime and ROM needs.
      float LinSMMainProcessingPeriod: 0.001..0.255, set at pre-compile, default-value=0.01  # Fixed call period of the LinSM_MainFunction.
      boolean LinSMVersionInfoApi: set at pre-compile, default-value=false  # This parameter enables/disables the function LinSM_GetVersionInfo() to get major, minor and patch version information.
      string LinSMUserConfigFile [0..1]: set at pre-compile, origin=Vector Informatik  # Reference to an external user configuration file that will be included during generation. The content of the user configuration file will be added at the end of the generated module configuration file and allows altering or extending the generated code. Caution: User configuration files can cause the software module to malfunction and must only be used with great care!
      boolean LinSMSafeBswChecks: set at pre-compile, origin=Vector Informatik, default-value=false  # Selects if safety checks are used. These checks improve robustness as e.g. invalid parameters are checked before function is executed. This attribute has to be enabled for safety projects where this component is mapped to an ASIL partition.
      container LinSMGeneration  # Contains the generation configuration parameters of the module LinSM.
        boolean LinSMOutOfBoundsWriteSanitizer: set at pre-compile, origin=Vector Informatik, default-value=false  # This parameter activates/deactivates the generation of runtime checks which call a DET error notification function to find easily out of bounds write problems. FALSE: no checks are generated in the data access. TRUE: the data access is enriched with DET checks to validate indexes.
        boolean LinSMOutOfBoundsReadSanitizer: set at pre-compile, origin=Vector Informatik, default-value=false  # This parameter activates/deactivates the generation of runtime checks which call a DET error notification function to find easily out of bounds read problems. FALSE: no checks are generated in the data access. TRUE: the data access is enriched with DET checks to validate indexes.
        boolean LinSMShortSymbols: set at pre-compile, origin=Vector Informatik, default-value=false  # This parameter activates/deactivates the capability to generate shortened symbol names. FALSE: symbol names are generated in a human readable style based on the MIP, tags and variant names. TRUE: symbol names are generated based on the MIP and a CRC32.
  bsw implementation LinSM_Impl: programming-language=C, sw-version=7.00.03, used-code-generator=DaVinci Configurator, vendor-id=30, ar-release-version=4.00.03, behavior=LinSMBehavior, preconfigured-configuration=LinSM_Pre, recommended-configuration=LinSM_Rec, vendor-specific-module-def=LinSM
  module config LinSM_Pre: definition=LinSM
  module config LinSM_Rec: definition=LinSM
