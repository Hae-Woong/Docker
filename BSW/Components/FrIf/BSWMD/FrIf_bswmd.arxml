AUTOSAR XML (schema 4-0-3)
package /MICROSAR
  module definition FrIf [0..1]: category=VENDOR_SPECIFIC_MODULE_DEFINITION, refined-module-def=FrIf, variants pre-compile/link-time/post-build-loadable/post-build-selectable  # FlexRay Interface. Provides a PDU based API that can be used asynchronously to the FlexRay global time by upper software layer modules. The FlexRay Interface assembles PDUs of the upper software layers into FlexRay frames and vice versa. #FR #FlexRay #AUTOSAR
    container FrIfConfig  # Configuration of the FlexRay Interface. This container is a MultipleConfigurationContainer, i.e. this container and its sub-containers exist once per configuration set.
      integer FrIfMaxPduCnt [0..1]: 0..18446744073709551615, set at pre-compile in variant pre-compile / link in variant link-time+post-build-loadable+post-build-selectable  # Maximum number of Pdus. This parameter is needed only in case of post-build loadable implementation using static memory allocation. NOTE: This parameter is ignored currently.
      container FrIfCluster [1..*]: post-build-changeable=true  # This container specifies a FrIf Cluster and all related data which is required to enable communication of the Cluster. A Cluster may consist of more than one Controller.
        integer FrIfClstIdx: 0..63, set at pre-compile in variant pre-compile / link in variant link-time+post-build-loadable+post-build-selectable, symbolic-name-value=true, default-value=0  # This parameter provides a zero-based consecutive index of the FlexRay Clusters. Upper layer BSW modules and the FrIf itself use this index to identify a FlexRay Cluster. NOTE: A maximum of two FlexRay Clusters is currently supported.
        boolean FrIfDetectNITError: set at pre-compile in variant pre-compile / link in variant link-time / post-build in variant post-build-loadable+post-build-selectable, default-value=false  # Indicates whether NIT error status of each cluster shall be detected or not.
        enumeration FrIfGChannels: {FR_CHANNEL_A, FR_CHANNEL_AB, FR_CHANNEL_B}, set at pre-compile in variant pre-compile / link in variant link-time / post-build in variant post-build-loadable+post-build-selectable  # The channels that are used by the cluster. | Implementation Type: Fr_ChannelType
        integer FrIfGColdStartAttempts: 2..31, set at pre-compile in variant pre-compile / link in variant link-time / post-build in variant post-build-loadable+post-build-selectable  # Maximum number of times a node in the cluster is permitted to attempt to start the cluster by initiating schedule synchronization
        integer FrIfGCycleCountMax: 7..63, set at pre-compile in variant pre-compile / link in variant link-time / post-build in variant post-build-loadable+post-build-selectable, default-value=63  # Maximum cycle counter value in a given cluster. | Remark: Set to 63 for FlexRay Protocol 2.1 Rev. A compliance.
        integer FrIfGListenNoise: 2..16, set at pre-compile in variant pre-compile / link in variant link-time / post-build in variant post-build-loadable+post-build-selectable  # Upper limit for the start up listen timeout and wake up listen timeout in the presence of noise. It is used as a multiplier of the node | parameter pdListenTimeout.
        integer FrIfGMacroPerCycle: 8..16000, set at pre-compile in variant pre-compile / link in variant link-time / post-build in variant post-build-loadable+post-build-selectable  # Number of macroticks in a communication cycle. | Note: Lower limit 10 for FlexRay Protocol 2.1 Rev. A compliance
        integer FrIfGMaxWithoutClockCorrectFatal: 1..15, set at pre-compile in variant pre-compile / link in variant link-time / post-build in variant post-build-loadable+post-build-selectable  # Threshold used for testing the vClockCorrectionFailed counter. Defines the number of consecutive even/odd Cycle pairs with missing clock correction terms that will cause the protocol to transition from the POC:normal active or POC:normal passive state into the POC:halt state. [Even/odd cycle pairs].
        integer FrIfGMaxWithoutClockCorrectPassive: 1..15, set at pre-compile in variant pre-compile / link in variant link-time / post-build in variant post-build-loadable+post-build-selectable  # Threshold used for testing the vClockCorrectionFailed counter. Defines the number of consecutive even/odd Cycle pairs with missing clock correction terms that will cause the protocol to transition from the POC:normal active state to the POC:normal passive state. [Even/Odd cycle pairs]
        integer FrIfGNetworkManagementVectorLength: 0..12, set at pre-compile in variant pre-compile / link in variant link-time / post-build in variant post-build-loadable+post-build-selectable  # Length of the Network Management vector in a cluster [bytes]
        integer FrIfGNumberOfMinislots: 0..7988, set at pre-compile in variant pre-compile / link in variant link-time / post-build in variant post-build-loadable+post-build-selectable  # Number of minislots in the dynamic segment | Remark: Upper limit 7986 for FlexRay Protocol 2.1 Rev. A compliance
        integer FrIfGNumberOfStaticSlots: 2..1023, set at pre-compile in variant pre-compile / link in variant link-time / post-build in variant post-build-loadable+post-build-selectable  # Number of static slots in the static segment
        integer FrIfGPayloadLengthStatic: 0..127, set at pre-compile in variant pre-compile / link in variant link-time / post-build in variant post-build-loadable+post-build-selectable  # Payload length of a static frame [16 bit words]
        integer FrIfGSyncFrameIDCountMax: 2..15, set at pre-compile in variant pre-compile / link in variant link-time / post-build in variant post-build-loadable+post-build-selectable, default-value=15  # Maximum number of distinct syncframe identifiers present in a given cluster. This parameter maps to FlexRay Protocol 2.1 Rev. A parameter gSyncNodeMax.
        integer FrIfGdActionPointOffset: 1..63, set at pre-compile in variant pre-compile / link in variant link-time / post-build in variant post-build-loadable+post-build-selectable  # Number of macroticks the action point is offset from the beginning of a static slot.
        enumeration FrIfGdBit: {T100NS, T200NS, T400NS}, set at pre-compile in variant pre-compile / link in variant link-time / post-build in variant post-build-loadable+post-build-selectable  # Nominal bit time in seconds
        integer FrIfGdCasRxLowMax: 28..254, set at pre-compile in variant pre-compile / link in variant link-time / post-build in variant post-build-loadable+post-build-selectable  # Upper limit of the CAS acceptance windows [gdBit] | Remark: Range 67 to 99 for FlexRay Protocol 2.1 Rev. A compliance
        float FrIfGdCycle: 2.4E-5..0.016, set at pre-compile in variant pre-compile / link in variant link-time / post-build in variant post-build-loadable+post-build-selectable  # Length of the cycle, expressed in [s] | Remark: Lower limit 0.000024 for FlexRay Protocol 3.0 compliance.
        integer FrIfGdDynamicSlotIdlePhase: 0..2, set at pre-compile in variant pre-compile / link in variant link-time / post-build in variant post-build-loadable+post-build-selectable  # Duration of the idle phase within a dynamic slot [Minislots].
        integer FrIfGdIgnoreAfterTx: 0..15, set at pre-compile in variant pre-compile / link in variant link-time / post-build in variant post-build-loadable+post-build-selectable, default-value=0  # Duration for which the bitstrobing is paused after transmission [gdBit]. | Remark: Set to 0 for FlexRay Protocol 2.1 Rev. A compliance.
        float FrIfGdMacrotick: 1E-6..6E-6, set at pre-compile in variant pre-compile / link in variant link-time / post-build in variant post-build-loadable+post-build-selectable  # Duration of the cluster wide nominal macrotick, expressed in s
        integer FrIfGdMiniSlotActionPointOffset: 1..31, set at pre-compile in variant pre-compile / link in variant link-time / post-build in variant post-build-loadable+post-build-selectable  # Number of Macroticks the Minislot action point is offset from the beginning of a Minislot [Macroticks].
        integer FrIfGdMinislot: 2..63, set at pre-compile in variant pre-compile / link in variant link-time / post-build in variant post-build-loadable+post-build-selectable  # Duration of a minislot [Macroticks]
        integer FrIfGdNit: 2..15978, set at pre-compile in variant pre-compile / link in variant link-time / post-build in variant post-build-loadable+post-build-selectable  # Duration of the Network Idle Time [Macroticks] | Remark: Upper limit 805 for FlexRay Protocol 2.1 Rev. A compliance.
        enumeration FrIfGdSampleClockPeriod: {T12_5NS, T25NS, T50NS}, set at pre-compile in variant pre-compile / link in variant link-time / post-build in variant post-build-loadable+post-build-selectable  # Sample clock period
        integer FrIfGdStaticSlot: 3..664, set at pre-compile in variant pre-compile / link in variant link-time / post-build in variant post-build-loadable+post-build-selectable  # Duration of a static slot [Macroticks]. | Remark: Range 4-661 for FlexRay Protocol 2.1 Rev. A compliance.
        integer FrIfGdSymbolWindow: 0..162, set at pre-compile in variant pre-compile / link in variant link-time / post-build in variant post-build-loadable+post-build-selectable  # Duration of the symbol window [Macroticks]. | Remark: Range 0-142 for FlexRay Protocol 2.1 Rev. A compliance.
        integer FrIfGdSymbolWindowActionPointOffset [0..1]: 1..63, set at pre-compile in variant pre-compile / link in variant link-time / post-build in variant post-build-loadable+post-build-selectable  # Number of macroticks the action point offset is from the beginning of the symbol window [Macroticks]. | Remark: Set to GdActionPointOffset for FlexRay Protocol 2.1 Rev. A compliance.
        integer FrIfGdTSSTransmitter: 1..15, set at pre-compile in variant pre-compile / link in variant link-time / post-build in variant post-build-loadable+post-build-selectable  # Number of bits in the Transmission Start Sequence [gdBits]. | Remark: Lower limit 3 for FlexRay Protocol 2.1 Rev. A compliance.
        integer FrIfGdWakeupRxIdle: 8..59, set at pre-compile in variant pre-compile / link in variant link-time / post-build in variant post-build-loadable+post-build-selectable  # Number of bits used by the node to test the duration of the 'idle' or HIGH phase of a received wakeup [gdBit]. Remarks: This parameter maps to FlexRay Protocol 2.1 Rev. A parameter gdWakeupSymbolRxIdle. Lower limit 14 for FlexRay Protocol 2.1 Rev. A compliance.
        integer FrIfGdWakeupRxLow: 8..59, set at pre-compile in variant pre-compile / link in variant link-time / post-build in variant post-build-loadable+post-build-selectable  # Number of bits used by the node to test the duration of the LOW phase of a received wakeup [gdBit]. | Remarks: This parameter maps to FlexRay Protocol 2.1 Rev. A parameter gdWakeupSymbolRxLow. Lower limit 11 for FlexRay Protocol 2.1 Rev. A compliance.
        integer FrIfGdWakeupRxWindow: 76..485, set at pre-compile in variant pre-compile / link in variant link-time / post-build in variant post-build-loadable+post-build-selectable  # The size of the window used to detect wakeups [gdBit]. | Remarks: This parameter maps to FlexRay Protocol 2.1 Rev. A parameter gdWakeupSymbolRxWindow. Upper limit 301 for FlexRay Protocol 2.1 Rev. A compliance.
        integer FrIfGdWakeupTxActive: 15..60, set at pre-compile in variant pre-compile / link in variant link-time / post-build in variant post-build-loadable+post-build-selectable  # Number of bits used by the node to transmit the LOW phase of awakeup symbol and the HIGH and LOW phases of a WUDOP [gdBit]. | Remarks: This parameter maps to FlexRay Protocol 2.1 Rev. A parameter gdWakeupSymbolTxLow.
        integer FrIfGdWakeupTxIdle: 45..180, set at pre-compile in variant pre-compile / link in variant link-time / post-build in variant post-build-loadable+post-build-selectable  # Number of bits used by the node to transmit the 'idle' part of a | wakeup symbol [gdBit]. Remarks: This parameter maps to FlexRay Protocol 2.1 Rev. A parameter gdWakeupSymbolTxIdle.
        float FrIfMainFunctionPeriod [0..1]: 0.., set at pre-compile in variant pre-compile / link in variant link-time / post-build in variant post-build-loadable+post-build-selectable  # The execution cycle of the FrIf_MainFunction_<cluster>() in seconds. The FrIf does not require this information but the BSW scheduler, which invokes the cluster main functions, needs it in order to plan its tasks. If this parameter is not defined the Vector BSW scheduler uses the FrIfGdCycle time as period for the cluster main functions.
        integer FrIfMaxIsrDelay [0..1]: 0..10240000, set at pre-compile in variant pre-compile / link in variant link-time / post-build in variant post-build-loadable+post-build-selectable, origin=Vector Informatik  # The maximum delay in macroticks the FrIf_JoblistExec_<cluster>() function is processed after the absolute timer interrupt was triggered.
        integer FrIfSafetyMargin [0..1]: 0..10240000, set at pre-compile in variant pre-compile / link in variant link-time / post-build in variant post-build-loadable+post-build-selectable  # Additional timespan in macroticks which takes jitter into account to be able to set the JobListPointer to the next possible job which can be executed in case the FlexRay Job List Execution Function has be resynchronized. NOTE: if this parameter is not defined the FrIf assumes a safety margin of (FrIfGMacroPerCycle / 100).
        container FrIfClusterDemEventParameterRefs [0..1]  # Container for the references to DemEventParameter elements which shall be invoked using the API Dem_ReportErrorStatus API in case the corresponding error occurs. The EventId is taken from the referenced DemEventParameter's DemEventId value. The standardized errors are provided in the container and can be extended by vendor specific error references.
          symbolic name reference FRIF_E_ACS_CH_A [0..1]: set at pre-compile, destination=DemEventParameter  # Reference to the DemEventParameter which shall be issued when an error in ACS on channel A was detected. If the reference is not configured the error shall not be reported (neither to DET nor to DEM).
          symbolic name reference FRIF_E_ACS_CH_B [0..1]: set at pre-compile, destination=DemEventParameter  # Reference to the DemEventParameter which shall be issued when an error in ACS on channel B was detected. If the reference is not configured the error shall not be reported (neither to DET nor to DEM).
          symbolic name reference FRIF_E_NIT_CH_A [0..1]: set at pre-compile, destination=DemEventParameter  # Reference to the DemEventParameter which shall be issued when an error in NIT on channel A was detected. If the reference is not configured the error shall not be reported (neither to DET nor to DEM).
          symbolic name reference FRIF_E_NIT_CH_B [0..1]: set at pre-compile, destination=DemEventParameter  # Reference to the DemEventParameter which shall be issued when an error in NIT on channel B was detected. If the reference is not configured the error shall not be reported (neither to DET nor to DEM).
          symbolic name reference FRIF_E_SW_CH_A [0..1]: set at pre-compile, destination=DemEventParameter  # Reference to the DemEventParameter which shall be issued when an error in SW on channel A was detected. If the reference is not configured the error shall not be reported (neither to DET nor to DEM).
          symbolic name reference FRIF_E_SW_CH_B [0..1]: set at pre-compile, destination=DemEventParameter  # Reference to the DemEventParameter which shall be issued when an error in SW on channel B was detected. If the reference is not configured the error shall not be reported (neither to DET nor to DEM).
        container FrIfController: post-build-changeable=true  # This container contains the configuration of FlexRay CC.
          integer FrIfCtrlIdx: 0..31, set at pre-compile in variant pre-compile / link in variant link-time+post-build-loadable+post-build-selectable, symbolic-name-value=true, default-value=0  # This parameter provides a zero-based consecutive index of the FlexRay Communication Controllers. Upper layer BSW modules and the FrIf itself use this index to identify a FlexRay CC. NOTE: Currently only one FlexRay Communication Controller per FlexRay Cluster is supported.
          symbolic name reference FrIfFrCtrlRef: set at pre-compile in variant pre-compile / link in variant link-time+post-build-loadable / post-build in variant post-build-selectable, destination=FrController  # Reference to a Controller, which is handled by a specific Driver. This reference is unique for the ECU.
          container FrIfFrameTriggering [1..*]: post-build-changeable=true  # A Frame triggering contains the communication parameters of the FlexRay Frame as well as a reference to the Frame Construction Plan.
            boolean FrIfAllowDynamicLSduLength: set at pre-compile in variant pre-compile / link in variant link-time / post-build in variant post-build-loadable+post-build-selectable, default-value=false  # Allows L-PDU length reduction ('FrIfLSduLength' defines max. length) and indicates that the related CC buffer has to be reconfigured for the actual length and Header-CRC before transmission of the L-PDU.
            boolean FrIfAlwaysTransmit: set at pre-compile in variant pre-compile / link in variant link-time / post-build in variant post-build-loadable+post-build-selectable, default-value=false  # Defines wether the driver's API function Fr_TransmitTxLPdu() shall always be called for this L-PDU. If this option is disabled, either a null frame (in the static segment) or no frame (in the dynamic segment) will be transmit, when none of the PDUs of the frame need to be transmitted. If this option is enabled, a frame will always be transmitted, even when none of the PDUs of the frame need to be transmitted. The frame will be filled with zeros. RESTRICTIONS: This option can only be set, if the 'FrIfImmediate' option of all PDUs of the frame is set to 'false'
            integer FrIfBaseCycle: 0..63, set at pre-compile in variant pre-compile / link in variant link-time / post-build in variant post-build-loadable+post-build-selectable  # This parameter contains the FlexRay Base Cycle used to transmit this FlexRay Frame.
            enumeration FrIfChannel: {FRIF_CHANNEL_A, FRIF_CHANNEL_AB, FRIF_CHANNEL_B}, set at pre-compile in variant pre-compile / link in variant link-time / post-build in variant post-build-loadable+post-build-selectable  # This parameter contains the FlexRay Channel used to transmit this FlexRay Frame.
            integer FrIfCycleRepetition: 1..64, set at pre-compile in variant pre-compile / link in variant link-time / post-build in variant post-build-loadable+post-build-selectable  # This parameter contains the FlexRay Cycle Repetition used to transmit this FlexRay Frame.. | possible Values: 1,2,4,8,16,32,64
            integer FrIfLSduLength: 0..254, set at pre-compile in variant pre-compile / link in variant link-time / post-build in variant post-build-loadable+post-build-selectable  # The payload length of the Frame is given here. This parameter is required for validation if configured PDUs and update information fits into the Frame at configuration time [bytes].
            integer FrIfMessageId [0..1]: 0..65535, set at link in variant link-time / post-build in variant post-build-loadable / pre-compile in variant pre-compile+post-build-selectable  # The first two bytes of the payload segment of the FlexRay frame format for frames transmitted in the dynamic segment can be used as receiver filterable data called the message ID. NOTE: This parameter is ignored currently. | dynamic segment can be used as receiver filterable data called the message ID.
            boolean FrIfPayloadPreamble: set at pre-compile in variant pre-compile / link in variant link-time / post-build in variant post-build-loadable+post-build-selectable, default-value=false  # Switching the Payload Preamble bit.
            integer FrIfSlotId: 1..2047, set at pre-compile in variant pre-compile / link in variant link-time / post-build in variant post-build-loadable+post-build-selectable  # This parameter contains the FlexRay Slot ID used to transmit this FlexRay Frame.
            enumeration FrIfTransmitMode [0..1]: {SingleShot, Continuous}, set at pre-compile in variant pre-compile / link in variant link-time / post-build in variant post-build-loadable+post-build-selectable, origin=Vector Informatik, default-value=SingleShot  # Transmit mode of the Frame triggering. SingleShot: Frame triggering is sent once per transmit request. Continuous: Frame is sent out cyclically beginning with the first transmit request. Note: this parameter is only relevant for Tx frames.
            reference FrIfFrameStructureRef: set at pre-compile in variant pre-compile / link in variant link-time+post-build-loadable / post-build in variant post-build-selectable, destination=FrIfFrameStructure  # Reference to the Construction Plan of the FlexRay Frame.
            reference FrIfRedundantFrameTriggeringRef [0..1]: set at pre-compile in variant pre-compile / link in variant link-time / post-build in variant post-build-loadable+post-build-selectable, origin=Vector Informatik, destination=FrIfFrameTriggering  # Reference to the redundant Frame triggering. NOTE: If a Frame triggering is configured to be redundant to another Frame triggering, of both Frame triggerings the FlexRay Interface will only confirm and indicate the PDUs of the Frame triggering with the largest FrIfSlotId to the upper layer components. I.e. if FrameTrigA (SlotId 10) and FrameTrigB (SlotId 15) are redundant to each other, only the PDUs of FrameTrigB will be processed by the FrIf. RESTRICTIONS: This parameter can only be configured if the 'FrIfDualChannelRedundancySupport' is enabled. Only FrIfFrameTriggerings with the same FrIfBaseCycle and FrIfCycleRepetition and the same Frame layout can be selected as redundant Frame triggering.
            container FrIfFrameTriggeringDemEventParameterRefs [0..0]  # Container for the references to DemEventParameter elements which shall be invoked using the API Dem_ReportErrorStatus API in case the corresponding error occurs. The EventId is taken from the referenced DemEventParameter's DemEventId value. The standardized errors are provided in the container and can be extended by vendor specific error references. NOTE: This feature is currently not supported by the Fr module.
              symbolic name reference FrIfDemFTSlotStatusRef [0..1]: set at pre-compile, destination=DemEventParameter  # Reference to DEM event Id that is reported when FlexRay driver module detects slot errors. If this parameter is not configured, no event reporting happens.
          container FrIfLPdu [1..*]: post-build-changeable=true  # Reference to a L-PDU index
            integer FrIfLPduIdx: 0..4095, set at pre-compile in variant pre-compile+post-build-loadable+post-build-selectable / link in variant link-time, symbolic-name-value=true, default-value=0  # This parameter identifies the L-PDU in the interaction between FlexRay Interface and FlexRay Driver.
            boolean FrIfReconfigurable: set at pre-compile in variant pre-compile / link in variant link-time / post-build in variant post-build-loadable+post-build-selectable, default-value=false  # This parameter specifies that this LPdu is reconfigurable using FrIf_ReconfigLPdu. This means that this LPdu can be assigned to a different FrameTriggering at runtime. However, this reconfiguration is limited by hardware constraints. The direction of the LPdu cannot be reconfigured. RESTRICTION: This option can only be set to 'true', if the 'FrIfReconfigLPduSupport' is set to 'true'.
            reference FrIfVBTriggeringRef: set at pre-compile in variant pre-compile / link in variant link-time+post-build-loadable / post-build in variant post-build-selectable, destination=FrIfFrameTriggering  # Reference to the assigned Frame triggering.
          container FrIfTransceiver [0..2]: post-build-changeable=true  # Up to two FlexRay Transceivers may connect a Controller to a Cluster. This container realizes a Controller-Transceiver assignment.
            enumeration FrIfClusterChannel: {FRIF_CHANNEL_A, FRIF_CHANNEL_B}, set at pre-compile in variant pre-compile / link in variant link-time / post-build in variant post-build-loadable+post-build-selectable  # This parameter identifies to which one of the two Channels (A, B, A and B) of the Cluster the Transceiver is connected. FrIfClusterChannel shall map to Fr_ChannelType: FRIF_CHANNEL_A == FR_CHANNEL_A FRIF_CHANNEL_B == FR_CHANNEL_B FR_CHANNEL_AB shall not be used.
            symbolic name reference FrIfFrTrcvChannelRef: set at pre-compile in variant pre-compile / link in variant link-time+post-build-loadable / post-build in variant post-build-selectable, destination=FrTrcvChannel  # Reference to a Transceiver Driver Channel. This reference is unique for the ECU.
        container FrIfJobList  # This container specifies a list of all FlexRay Jobs of the Cluster to be performed by FrIf_JobListExec_<ClstIdx>().
          symbolic name reference FrIfAbsTimerRef [0..1]: set at pre-compile in variant pre-compile / link in variant link-time / post-build in variant post-build-loadable+post-build-selectable, destination=FrAbsoluteTimer  # Reference to the absolute timer to be used to trigger the interrupt whose ISR contains the FrIf_JobListExec_<ClstIdx>() function.
          container FrIfJob [1..*]: post-build-changeable=true  # A job may contain more than one operation that are executed at a specific point in time.
            integer FrIfCycle: 0..63, set at pre-compile in variant pre-compile / link in variant link-time / post-build in variant post-build-loadable+post-build-selectable, default-value=0  # The FlexRay Cycle in which the communication operation will execute this job
            integer FrIfMacrotick: 0..10240000, set at pre-compile in variant pre-compile / link in variant link-time / post-build in variant post-build-loadable+post-build-selectable  # Macrotick offset in the Cycle [Macrotick]
            integer FrIfStartSlot: 0..10035, set at link in variant pre-compile+link-time / post-build in variant post-build-loadable+post-build-selectable, origin=Vector Informatik  # The first FlexRay slot id of the slot range for which data is transferred to the FlexRay Driver by the job. RESTRICTIONS: The configured slot-range (specified by the 'FrIfStartSlot' and 'FrIfEndSlot' parameters) shall not overlap with the specified 'FrIfMacrotick' value of the corresponding FrIfJob because, as result of the concurrent access of the FrIf and the communication controller to the message buffer, the same information can be read twice (new data was not received) or to loose information of a message.
            integer FrIfEndSlot: 0..10035, set at link in variant pre-compile+link-time / post-build in variant post-build-loadable+post-build-selectable, origin=Vector Informatik  # The EndSlot of the processed FlexRay cycle segment of this FrIf job. RESTRICTIONS: The configured slot-range (specified by the 'FrIfStartSlot' and 'FrIfEndSlot' parameters) shall not overlap with the specified 'FrIfMacrotick' value of the corresponding FrIfJob because, as result of the concurrent access of the FrIf and the communication controller to the message buffer, the same information can be read twice (new data was not received) or to loose information of a message.
            integer FrIfMaxIsrDelay: 0..16000, set at link in variant pre-compile+link-time / post-build in variant post-build-loadable+post-build-selectable  # The maximum permissable delay in [Macrotick] for the start of the job execution. If the job start is delayed more than this value, the job execution is considered out of sync. This will result in a production error.
            boolean FrIfDelayedTxConfirmation [0..1]: set at link in variant pre-compile+link-time / post-build in variant post-build-loadable+post-build-selectable, origin=Vector Informatik, default-value=false  # The 'DelayedTxConfirmation' flag specifies whether the Tx Job is confirmed at the latest possible time or whether the PDU is confirmed as soon as possible. true: If this option is enabled, the confirmation will be given to the upperlayer shortly before the next point of transmission of the PDU. For example, if the Com Tx IPDU callout is used to calculate signal values, this option can be helpful to minimize the signal age. false: By default (DelayedTxConfirmation is disabled) the FlexRay Interface confirms a Tx PDU in the same cycle of the transmission. RESTRICTIONS: This option can only be customized if there is no FrNm PDU assigned to a FrameTriggering of this FrIfJob and no PDU is assigned to different FrameTriggerings.
            boolean FrIfIsRxJob: set at link in variant pre-compile+link-time / post-build in variant post-build-loadable+post-build-selectable, origin=Vector Informatik, default-value=false  # The 'FrIfIsRxJob' flag specifies whether this FrIfJob handles the reception or transmission of FlexRay frames. RESTRICTIONS: - This option cannot be set if there is at least one FrIfCommunicationOperation assigned to the FrIfJob with FrIfCommunicationAction 'RECEIVE_AND_INDICATE'. - This option cannot be reset if there is at least one FrIfCommunicationOperation assigned to the FrIfJob with FrIfCommunicationAction 'DECOUPLED_TRANSMISSION'.
            integer FrIfJobId: 0..255, set at link in variant pre-compile+link-time / post-build in variant post-build-loadable+post-build-selectable, origin=Vector Informatik  # The FrIf job identifier. The identifier has to be zero based and consecutive for each direction.
            reference FrIfTxConfJobRef [0..1]: set at pre-compile in variant pre-compile / link in variant link-time / post-build in variant post-build-loadable+post-build-selectable, origin=Vector Informatik, destination=FrIfJob  # This parameter defines which FrIfJob executes the Tx Confirmations for this Tx Job. RESTRICTIONS: This option can only be set if the FrIfIsRxJob option is disabled for this FrIfJob.
            container FrIfCommunicationOperation [0..*]: post-build-changeable=true  # A separate operation which is part of a FlexRay Job and defines what type of action is executed.
              enumeration FrIfCommunicationAction: {DECOUPLED_TRANSMISSION, FREE_OP_A, FREE_OP_B, PREPARE_LPDU, RECEIVE_AND_INDICATE, RECEIVE_AND_STORE, RX_INDICATION, TX_CONFIRMATION}, set at pre-compile in variant pre-compile / link in variant link-time / post-build in variant post-build-loadable+post-build-selectable  # The action to be performed in the FlexRay Operation
              integer FrIfCommunicationOperationIdx: 0..65535, set at pre-compile in variant pre-compile / link in variant link-time / post-build in variant post-build-loadable+post-build-selectable, default-value=0  # For each FlexRay Communication Job, this index spans a range of zero-based consecutive values and thus defines the order of the FlexRay Communication Operation in the respective FlexRay Communication Job.
              integer FrIfRxComOpMaxLoop: 1..512, set at pre-compile in variant pre-compile / link in variant link-time / post-build in variant post-build-loadable+post-build-selectable, default-value=512  # Defines the maximum number of loops for the receive RECEIVE_AND_INDICATE (Use case: emptying a FIFO). NOTE: This parameter is ignored currently.
              boolean FrIfManualAssignedLPdu: set at pre-compile in variant pre-compile / link in variant link-time / post-build in variant post-build-loadable+post-build-selectable, origin=Vector Informatik, default-value=false  # Specifies whether this LPdu was assigned manually by the user to the FrIfJob or not. true: LPdu was manually assigned false: LPdu was assigned via slot range definition NOTE: This AUTOSAR parameter is not used for the code generation of the FrIf.
              reference FrIfLPduIdxRef: set at link in variant link-time / post-build in variant post-build-loadable+post-build-selectable / pre-compile in variant pre-compile, destination=FrIfLPdu  # Reference to a L-PDu index
      container FrIfFrameStructure [1..*]: post-build-changeable=true  # The Frame structure specifies a Construction Plan how a Frame is assembled with PDUs and their respective Update-Bits.
        enumeration FrIfByteOrder: {BIG_ENDIAN, LITTLE_ENDIAN}, set at pre-compile in variant pre-compile / link in variant link-time / post-build in variant post-build-loadable+post-build-selectable, default-value=BIG_ENDIAN  # This parameter defines the ByteOrder of all Pdus that are mapped into the Frame. NOTE: This parameter is ignored currently. | The absolute position of a Pdu in the Frame is determined by the definition of the ByteOrder parameter: If BIG_ENDIAN is specified, the FrIfPduOffset indicates the position of the most significant bit in the Frame. If LITTLE_ENDIAN is specified, the FrIfPduOffset indicates the position of the least significant bit in the Frame.
        container FrIfPdusInFrame [1..*]: post-build-changeable=true  # This container holds all the information about a PDU in a FlexRay Frame.
          integer FrIfPduOffset: 0..253, set at pre-compile in variant pre-compile / link in variant link-time / post-build in variant post-build-loadable+post-build-selectable  # The value specifies the offset of the PDU within the Frame [bytes].
          integer FrIfPduUpdateBitOffset [0..1]: 0..2031, set at pre-compile in variant pre-compile / link in variant link-time / post-build in variant post-build-loadable+post-build-selectable  # This value specifies where the PDU's Update-Bit is stored in the Frame (bit location of PDU's Update-Bit in the FlexRay Frame).
          integer FrIfMappedPduId: 0..65535, set at link in variant pre-compile+link-time / post-build in variant post-build-loadable+post-build-selectable, origin=Vector Informatik, default-value=0  # Internal Mapped Pdu Id used by the FrIf to sort FrIf_FrameLayoutElements.
          reference FrIfPduRef: set at pre-compile in variant pre-compile / link in variant link-time / post-build in variant post-build-loadable+post-build-selectable, destination=FrIfPdu  # This is the reference to the local definition of a PDU.
      container FrIfPdu [1..*]: post-build-changeable=true  # Contains PDU information. A PDU may be either a transmission PDU or a reception PDU.
        choice container FrIfPduDirection: post-build-changeable=true  # A PDU is either transmit or receive
          container FrIfRxPdu [0..1]: post-build-changeable=true  # Receive PDU
            function name FrIfRxIndicationName [0..1]: set at pre-compile in variant pre-compile / link in variant link-time+post-build-loadable / post-build in variant post-build-selectable, default-value=Appl_RxIndication  # This parameter defines the name of the <User_RxIndication>. This parameter depends on the parameter FRIF_USERRXINDICATION_UL. If FRIF_USERRXINDICATION_UL equals FR_TP, FR_NM, FR_AR_TP, FR_TSYN, PDUR or XCP, the name of the <User_RxIndication> is fixed. If FRIF_USERRXINDICATION_UL equals CDD, the name of the <User_RxIndication> is selectable.
            enumeration FrIfUserRxIndicationUL: {PDUR, FR_NM, FR_TP, XCP, NONE, FR_TSYN, FR_AR_TP, CDD}, set at pre-compile in variant pre-compile / link in variant link-time / post-build in variant post-build-loadable+post-build-selectable  # This parameter defines the upper layer (UL) module to which the indication of the successfully received FRIFRXPDU has to be routed via <User_RxIndication>. This <User_RxIndication> has to be invoked when the indication of the configured FRIFRXPDU will be received by a Rx indication event from the FR Driver module. If no upper layer (UL) module is configured, no <User_RxIndication> has to be called in case of a Rx indication event of the FRIFRXPDU from the FR Driver module. NOTE: Rx indications won't take place for this PDU if this parameter is set to NONE.
            integer FrIfRxPduId: 0..65535, set at link in variant pre-compile+link-time / post-build in variant post-build-loadable+post-build-selectable, origin=Vector Informatik, default-value=0  # Handle Id used by the FrIf for the reception of the FrIfRxPdu.
            reference FrIfRxPduRef: set at pre-compile in variant pre-compile / link in variant link-time+post-build-loadable / post-build in variant post-build-selectable, destination=Pdu  # Reference to the external PDU definition.
          container FrIfTxPdu [0..1]: post-build-changeable=true  # This container specifies transmission PDUs.
            boolean FrIfConfirm: set at pre-compile in variant pre-compile / link in variant link-time / post-build in variant post-build-loadable+post-build-selectable, default-value=true  # Defines whether the transmission of a PDU should be checked and confirmed to the PDU owning BSW module.
            integer FrIfCounterLimit: 1..255, set at pre-compile in variant pre-compile / link in variant link-time / post-build in variant post-build-loadable+post-build-selectable, default-value=1  # This value states the maximum number of indication of ready PDU data to the FrIf (i.e. maximum number of invocations of FrIf_Transmit) without an intermediate transmission of the PDU. RESTRICTIONS: For values other than 1, Tx confimations (FrIf/FrIfConfig/FrIfPdu/FrIfPduDirection/FrIfTxPdu/FrIfConfirm) must be enabled for the PDU.
            boolean FrIfImmediate: set at pre-compile in variant pre-compile / link in variant link-time / post-build in variant post-build-loadable+post-build-selectable, default-value=false  # Defines whether the PDU is transmitted immediate or decoupled. RESTRICTIONS: The FrIfImmediate option can only be set to 'true' if the PDU is the only one in the corresponding frame, the 'FrIfAlwaystransmit' option of the frame is 'false' and if the 'FrIfNoneMode' option is set to 'false' for the PDU.
            boolean FrIfNoneMode: set at pre-compile in variant pre-compile / link in variant link-time / post-build in variant post-build-loadable+post-build-selectable, default-value=false  # Using the "None-Mode" which means that there is no API FrIf_Transmit call of the upper layer for this PDU. If FrIfNoneMode is set, the PDU will ALWAYS be sent according to the timing defined in the FlexRay schedule. RESTRICTIONS: The FrIfNoneMode option can only be set to 'true' if the 'FrIfImmediate' option is set to 'false' for the PDU.
            function name FrIfTxConfirmationName [0..1]: set at pre-compile in variant pre-compile / link in variant link-time+post-build-loadable / post-build in variant post-build-selectable, default-value=Appl_TxConfirmation  # This parameter defines the name of the <User_TxConfirmation>. This parameter depends on the parameter FrIfUserTxUL. If FrIfUserTxUL equals FR_TP, FR_NM, FR_AR_TP, FR_TSYN, PDUR or XCP, the name of the <User_TxConfirmation> is fixed. If FrIfUserTxUL equals CDD, the name of the <User_TxConfirmation> is selectable.
            integer FrIfTxPduId: 0..65535, set at link, symbolic-name-value=true, default-value=0  # The global PDU identifier, which has to be used by the upper layer BSW module. The identifier has to be zero based and consecutive.
            function name FrIfUserTriggerTransmitName [0..1]: set at pre-compile in variant pre-compile / link in variant link-time+post-build-loadable / post-build in variant post-build-selectable, default-value=Appl_TriggerTransmit  # This parameter defines the name of the <User_TriggerTransmit>. This parameter depends on the parameter FrIfUserTxUL. If FrIfUserTxUL equals FR_TP, FR_NM, FR_AR_TP, FR_TSYN, PDUR or XCP, the name of the <User_TriggerTransmit> is fixed. If FrIfUserTxUL equals CDD, the name of the <User_TriggerTransmit> is selectable.
            enumeration FrIfUserTxUL: {PDUR, FR_NM, FR_TP, XCP, NONE, FR_TSYN, FR_AR_TP, CDD}, set at pre-compile in variant pre-compile / link in variant link-time / post-build in variant post-build-loadable+post-build-selectable  # This parameter defines the upper layer (UL) module to which the trigger of the to be transmitted FRIFTXPDUID (via the <User_TriggerTransmit>) or the confirmation of the successfully transmitted FRIFTXPDUID has to be routed (via the <User_TxConfirmation>). NOTE: The FlexRay interface expects no transmission requests for PDUs with this parameter set to NONE. Decoupled transmission of the PDU won't take place and no Tx confirmations will be given.
            reference FrIfTxPduRef: set at pre-compile in variant pre-compile / link in variant link-time+post-build-loadable / post-build in variant post-build-selectable, destination=Pdu  # Reference to the external PDU definition.
    container FrIfGeneral  # This container contains the general configuration parameters of the FlexRay Interface.
      integer FrIfAbsTimerIdx: 0..15, set at pre-compile, default-value=1  # Maximum number of supported absolut timers. If this parameter is set to 0 the FrIf does not provide the following API services: - FrIf_SetAbsoluteTimer() - FrIf_CancelAbsoluteTimer() - FrIf_AckAbsoluteTimerIRQ() - FrIf_EnableAbsoluteTimerIRQ() - FrIf_DisableAbsoluteTimerIRQ() - FrIf_GetAbsoluteTimerIRQStatus() Setting this parameter to 0 can be used for code optimization since the absolute timer functions are not used by other AUTOSAR BSW components. If your application has no need for these APIs you can disable these functions.
      boolean FrIfAllSlotsSupport: set at pre-compile, default-value=false  # Configuration parameter to enable/disable FrIf support to enable/disable of switching from key-slot / single-slot mode to all slot mode. Enabling this feature makes sense only if the Fr/FrMultipleConfiguration/FrController/FrPKeySlotOnlyEnabled parameter is set to true.
      boolean FrIfCancelTransmitSupport: set at pre-compile, default-value=false  # Configuration parameter to enable/disable FrIf support to request the cancellation of the I-PDU transmission to FrDrv.
      boolean FrIfDevErrorDetect: set at pre-compile, default-value=true  # Switches the Development Error Detection and Notification on or off | true: Development Error Detection and Notification on false: Development Error Detection and Notification off
      boolean FrIfDisableLPduSupport: set at pre-compile, default-value=false  # Configuration parameter to enable/disable FrIf support to disables the hardware resource of a LPdu for transmission/reception. Enabling this feature makes sense only if at least one LPdu has the parameter FrIf/FrIfConfig/FrIfCluster/FrIfController/FrIfLPdu/FrIfReconfigurable set to true.
      boolean FrIfDisableTransceiverBranchSupport: set at pre-compile, default-value=false  # Configuration parameter to enable/disable FrIf support to disable branches of an active star. NOTE: This feature is currently not supported. If a FrIf/FrIfConfig/FrIfCluster/FrIfController/FrIfTransceiver container is present, the function FrIf_DisableTransceiverBranchis always available.
      boolean FrIfEnableTransceiverBranchSupport: set at pre-compile, default-value=false  # Configuration parameter to enable/disable FrIf support to enable branches of an active star. NOTE: This feature is currently not supported. If a FrIf/FrIfConfig/FrIfCluster/FrIfController/FrIfTransceiver container is present, the function FrIf_EnableTransceiverBranch is always available.
      boolean FrIfGetClockCorrectionSupport: set at pre-compile, default-value=false  # Configuration parameter to enable/disable FrIf support to enable/disable of polling the FlexRay Driver to getting CC clock correction values.
      boolean FrIfGetGetChannelStatusSupport: set at pre-compile, default-value=false  # Configuration parameter to enable/disable FrIf support to enable/disable of polling the FlexRay Driver to getting error information about the FlexRay communications bus.
      boolean FrIfGetNmVectorSupport: set at pre-compile, default-value=false  # Configuration parameter to enable/disable FrIf support to request the FlexRay hardware NMVector.
      boolean FrIfGetNumOfStartupFramesSupport: set at pre-compile, default-value=false  # Configuration parameter to enable/disable FrIf support to enable/disable of polling the FlexRay Driver for the actual number of received startup frames on the bus.
      boolean FrIfGetSyncFrameListSupport: set at pre-compile, default-value=false  # Configuration parameter to enable/disable FrIf support to enable/disable of polling the FlexRay Driver to getting a list of actual received sync frames.
      boolean FrIfGetTransceiverErrorSupport: set at pre-compile, default-value=false  # Configuration parameter to enable/disable FrIf support to get the FlexRay Transceiver errors by calling the FlexRay Transceiver module. Enabling this feature makes sense only if at last one FrIf/FrIfConfig/FrIfCluster/FrIfController/FrIfTransceiver is configured.
      boolean FrIfGetWakeupRxStatusSupport: set at pre-compile, default-value=false  # Configuration parameter to enable/disable FrIf support to get the wakeup received information from the FlexRay controller.
      integer FrIfNumClstSupported: 1..15, set at pre-compile, default-value=1  # Maximum number of FlexRay Clusters that the FlexRay Interface supports. NOTE: A maximum of two FlexRay Clusters is currently supported.
      integer FrIfNumCtrlSupported: 1..15, set at pre-compile, default-value=1  # Maximum number of FlexRay CCs that the FlexRay Interface supports. NOTE: Currently only one FlexRay Communication Controller per FlexRay Cluster is supported.
      string FrIfPublicCddHeaderFile [0..*]: set at pre-compile, default-value=Appl_Cbk.h  # Defines header files for callback functions which shall be included in case of CDDs. Range of characters is 1.. 32. A FrIfPublicCddHeaderFile should be present only if at least one FrIfRxPdu or FrIfTxPdu has a CDD as upper layer.
      boolean FrIfReadCCConfigApi: set at pre-compile, default-value=false  # Configuration parameter to enable/disable the optional FrIf_ReadCCConfig API. This parameter also enables the CC readback support feature of the Fr module.
      boolean FrIfReconfigLPduSupport: set at pre-compile, default-value=false  # Configuration parameter to enable/disable FrIf support to enable/disable the reconfiguration of a given LPdu according to the parameters (FrameId, Channel, CycleRepetition, CycleOffset, PayloadLength, HeaderCRC) at runtime.
      integer FrIfUnusedBitValue: 0..1, set at pre-compile, default-value=0  # Set unused bits to a defined value.
      boolean FrIfVersionInfoApi: set at pre-compile, default-value=false  # Enables/disables the existence of the FrIf_GetVersionInfo() API service | true: FrIf_GetVersionInfo() API service exists false: FrIf_GetVersionInfo() API service does not exist
      integer FrIfFrameBufferLength: 2..254, set at link in variant pre-compile+link-time / post-build in variant post-build-loadable+post-build-selectable, origin=Vector Informatik, default-value=254  # Post-build configurations for the FrIf can have different maximum frame lengths. Set the maximum frame length [Bytes] of all post-build configurations. RESTRICTIONS: This parameter must be greater or equal to the maximum /FrIfConfig/FrIfCluster/FrIfController/FrIfFrameTriggering/FrIfLSduLength of all post-build configurations.
      boolean FrIfJobConcatenationEnable: set at pre-compile, origin=Vector Informatik, default-value=false  # If Job Concatenation Enable is enabled, the FrIf_JobListExec_<ClstIdx> function will concatenate an Rx and an Tx FrIf job if both jobs have the same configured Macrotick parameter. This option can be used to reduce the interrupt load caused by the FrIf.
      boolean FrIfAbortCommunicationDisable: set at pre-compile, origin=Vector Informatik, default-value=false  # Enables/disables the usage of the FrIf_AbortCommunication() routine. This switch can be used for code optimization since the FrIf_AbortCommunication() routine is not used by other AUTOSAR BSW components. true: FrIf_AbortCommunication() routine is disabled false: FrIf_AbortCommunication() routine is enabled RESTRICTIONS: This option should only be enabled if your application has no need for the FrIf_AbortCommunication() API.
      boolean FrIfCounterLimitDisable: set at pre-compile, origin=Vector Informatik, default-value=false  # This value states whether PDUs can have a 'FrIfCounterLimit' greater '1' or not. This switch can be used for code optimization. true: only one indication of ready PDU data to the FrIf without an immediate transmission false: up to 255 indications of ready PDU data to the FrIf depending on the FrIfCounterLimit configuration of the corresponding PDU. RESTRICTIONS: This option can only be enabled if your application uses only PDUs that have a 'FrIfCounterLimit' of '1'.
      string FrIfRxVotingFunction [0..1]: set at pre-compile, origin=Vector Informatik, default-value=Appl_RxVotingFct  # This parameter defines the name of the <FrIf_RxVotingFunction>. The FlexRay Interface calls this voting function in order to select one PDU instance that shall be indicated to the upper layer. RESTRICTIONS: This option can only be customized in Cfg5 if the 'FrIfDualChannelRedundancySupport' option is enabled.
      string FrIfRxVotingFunctionHeaderFile [0..1]: set at pre-compile, origin=Vector Informatik, default-value=Appl_Cbk.h  # Defines header file for the Rx Voting Function which shall be included for redundant reception on a FlexRay dual channel cluster. RESTRICTIONS: This option can only be customized in Cfg5 if the 'FrIfDualChannelRedundancySupport' option is enabled.
      boolean FrIfPduDirtyByteUsage: set at pre-compile, origin=Vector Informatik, default-value=false  # If PduDirtyByte Usage is enabled the execution times of the FrIf Tx tasks are minimized by replacing the PduDirty bit arrays for the decoupled transmission with dedicated bytes for each PDU. The usage of PduDirtyBytes has the advantage that the critical sections for the read-modify-write bit access of the Tx tasks are no more nessesary and the codesize of the FrIf component is reduced. The disadvantage is the increase memory requirements of the FrIf.
      enumeration FrIfSchedulingAlgorithm: set at pre-compile in variant pre-compile / link in variant link-time / post-build in variant post-build-loadable+post-build-selectable, origin=Vector Informatik, default-value=Default  # Select which scheduling algorithm shall be applied to the FrIf module. - Default: The default scheduling algorithm divides the FlexRay cycle into n segments of the same size, where n is the number of Tx or Rx tasks. Depending on the start slot and end slot of these segments the start time of the corresponding task and the maximum delay is automatically calculated. Note that the dynamic segment is never divided. - UserConfigured: the scheduling algorithm is set to UserConfigured if the user changes one of the automatically calculated task parameters. In this case the FrIf will not calculate any FrIfJob or FrIfJob settings, even if not FrIfJobs are present. - DynamicNmAsStatic: Frames containing Nm PDUs located at the beginning of the dynamic segment will be treated as if they were located at the end of the static segment. As a consequence, the Rx indication of these PDUs will take place soon after they're received, instead of at the end of the dynamic segment.
        Default  # Default_Algorithm
        UserDefined  # UserDefined_Algorithm
        DynamicNmAsStatic  # DynamicNmAsStatic_Algorithm
      boolean FrIfSetWakeupChannelDisable: set at pre-compile, origin=Vector Informatik, default-value=false  # Enables/disables the usage of the FrIf_SetWakeupChannel() routine. This switch can be used for code optimization since the FrIf_SetWakeupChannel() routine is not used by other AUTOSAR BSW components. true: FrIf_SetWakeupChannel() routine is disabled false: FrIf_SetWakeupChannel() routine is enabled RESTRICTIONS: This option should only be enabled if your application has no need for the FrIf_SetWakeupChannel() API.
      boolean FrIfSingleChannelAPI: set at pre-compile, origin=Vector Informatik, default-value=false  # According to the FlexRay Interface software specification (SWS FlexRay Interface) some FlexRay Inferface services contain a controller or cluster handle. If only one FlexRay Controller Driver instance is used these handles are not necessary, except for development error detection. Therefore, if only one FlexRay Controller Driver instance is used, the handles can be removed by a macro for code size optimization. These macros still expect channel handles, which remain unused. RESTRICTIONS: This option can only be customized in single controller pre-compile configurations.
      enumeration FrIfTxVirtualBufferIndexType: {uint8, uint16}, set at pre-compile, origin=Vector Informatik, default-value=uint8  # If a large number of TX virtual buffers are used, this must be set to uint16. Note that a frame with a complex timing can result into multiple virtual buffer indexes.
      enumeration FrIfRxVirtualBufferIndexType: {uint8, uint16}, set at pre-compile, origin=Vector Informatik, default-value=uint8  # If a large number of RX virtual buffers are used, this must be set to uint16. Note that a frame with a complex timing can result into multiple virtual buffer indexes.
      string FrIfUserConfigFile [0..1]: set at pre-compile, origin=Vector Informatik  # A configuration file is generated by Cfg5. If you want to overwrite settings in the generated configuration file, you can specify a path to a user defined configuration file. NOTE: The user defined configuration file will be included at the end of the generated file. Therefore definitions in the user defined configuration file can overwrite definitions in the generated configuration file. The contents of the user defined configuration file is copied to the end of <Bsw>_Cfg.h.
      boolean FrIfWrapperAPIsAsMacro: set at pre-compile, origin=Vector Informatik, default-value=false  # Enables/disables the macro implementation for all FrIf functions that wrap functions of the Fr or the FrTrcv component. This option can be used to reduce the codesize of the FrIf. true: Macro implementation is used for the FrIf wrapper functions false: Macro implementation is not used for the FrIf wrapper functions RESTRICTIONS: This option can only be customized in pre-compile configurations where the 'DevErrorDetect' option of the FrIf set to 'false'.
      boolean FrIfUniformUpdateBytePos: set at pre-compile, origin=Vector Informatik, default-value=false  # Specify whether the PDUs FrIfPduUpdateBitOffset of the same FrIfFrameStructure are always at the same byte position for each of the corresponding frame triggerings. This switch can be used for code optimization. RESTRICTIONS: This option can only be customized in pre-compile configurations if the update byte position of PDUs is equal for each frame triggering of the corresponding FrIfFrameStructure.
      boolean FrIfGlobalUniformUpdateBytePos: set at pre-compile, origin=Vector Informatik, default-value=false  # Specify whether the update bits of all frames of the FrIfCluster are always at the same byte position. This switch can be used for additional code optimization. RESTRICTIONS: This option can only be customized in pre-compile configurations if the update byte position of all frames is always the same and the 'FrIfUniformUpdateBytePos' option is set to 'true'.
      boolean FrIfFreeOpCallbackSupport: set at pre-compile, origin=Vector Informatik, default-value=false  # Specify whether the a free operation callback can be configured for FrIfJobs or not. NOTE: This feature is currently not supported.
      boolean FrIfJobsUseFreeOpCallback: set at pre-compile, origin=Vector Informatik, default-value=false  # Enables/disables the usage of the FREE_OP communication operation actions in the FrIfJobs. true: All RxJobs call the Fr_FreeOpA() API before executing the RECEIVE_AND_INDICATE and TX_CONFIRMATION communication operation actions. false: All TxJobs call the Fr_FreeOpB() API after executing the DECOUPLED_TRANSMISSION and TX_CONFIRMATION communication operation actions. NOTE: This feature is currently not supported. RESTRICTIONS: This parameter can only be configured and is only considered during code generation if the 'FrIfFreeOpCallbackSupport' parameter is set to 'true'.
      boolean FrIfDualChannelRedundancySupport: set at pre-compile, origin=Vector Informatik, default-value=false  # Configuration parameter to enable/disable FrIf support for redundant transmission and reception on a FlexRay dual channel cluster according to Bugzilla 42025. RESTRICTION: This feature should be enabled only if the parameter FrIf/FrIfConfig/FrIfCluster/FrIfController/FrIfFrameTriggering/FrIfRedundantFrameTriggeringRef exists in at least one FrIfFrameTriggering.
      boolean FrIfEnablePrepareLpdu: set at pre-compile, origin=Vector Informatik, default-value=false  # The FrIfEnablePrepareLpdu flag enables the FlexRay Driver to use a more efficient message buffer assignment. RESTRICTIONS: This option can only be customized in pre-compile configurations by setting the 'FrPrepareLPduAPIEnable' option of the Fr component.
      boolean FrIfDelayedTxConfirmationSupport: set at pre-compile, origin=Vector Informatik, default-value=false  # Enables/disables the usage of a delayed TxConfirmation for all FrameTriggerings of a Tx FrIfJob. If this feature is enabled the 'Delayed Tx Confirmation' option of a Tx FrIfJob can be set.
      boolean FrIf3rdPartyDriverSupport: set at pre-compile, origin=Vector Informatik, default-value=false  # If 3rd Party Driver support is enabled FlexRay Interface calls the Fr_ReceiveRxLPdu() and Fr_TransmitTxLPdu() API services with the LPduIdx (according to AUTOSAR). If a Vector FlexRay Driver is used, the FlexRay Interface calls these API services with separate handles for Rx and Tx due to optimization. NOTE: the FlexRay Interface does not support the configuration of Fr_PrepareLPdu() communication operations even if this feature is enabled.
      boolean FrIfSuppressProtectedRangeCheck: set at pre-compile, origin=Vector Informatik, default-value=false  # Enables/disables the protected range check. If the protected range check is enabled, FrIfJobs are not allowed to lie within their own slot range.
      boolean FrIfRuntimeMeasurementSupport: set at pre-compile, origin=Vector Informatik, default-value=false  # This parameter defines if AMD Runtime Measurement (RTM) is enabled for this module.
      string FrIfFreeOpsHeader [0..1]: set at pre-compile  # Defines header file for configurable FREE_OP_A / FREE_OP_B functions. NOTE: This feature is currently not supported.
      string FrIfFreeOpAApiName [0..1]: set at pre-compile, default-value=Fr_FreeOpA  # API name that is called when FREE_OP_A is selected as communication operation. See also chapter 8.8.3 Configurable Interfaces. NOTE: This feature is currently not supported.
      string FrIfFreeOpBApiName [0..1]: set at pre-compile, default-value=Fr_FreeOpB  # API name that is called when FREE_OP_B is selected as communication operation. See also chapter 8.8.3 Configurable Interfaces. NOTE: This feature is currently not supported.
      boolean FrIfSafeBswChecks: set at pre-compile, origin=Vector Informatik, default-value=false  # Selects if safety checks are used. These checks improve robustness as e.g. invalid parameters are checked before function is executed. This attribute has to be enabled for safety projects where this component is mapped to an ASIL partition.
      boolean FrIfGetTxConflictStatusSupport: set at pre-compile, origin=Vector Informatik, default-value=false  # Configuration parameter to enable/disable FrIf support to enable/disable of polling the FlexRay Driver to get TxClonflict status information for the given LPdu. true: FrIf_GetTxConflictStatus() API service exists false: FrIf_GetTxConflictStatus() API service does not exist RESTRICTIONS: This option cannot be customized directly in FrIf. Please set the 'Enable Tx Conflict Status' option of the Fr component to enable this option.
  bsw implementation FrIf_Impl: programming-language=C, sw-version=5.05.00, used-code-generator=cMSR, vendor-id=30, ar-release-version=4.00.03, behavior=FrIfBehavior, preconfigured-configuration=FrIf_Pre, recommended-configuration=FrIf_Rec, vendor-specific-module-def=FrIf
  module config FrIf_Pre: definition=FrIf
  module config FrIf_Rec: definition=FrIf
