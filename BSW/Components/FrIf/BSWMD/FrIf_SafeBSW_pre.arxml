AUTOSAR XML (schema 4-0-3)
package /MICROSAR
  module config FrIf_Rec: definition=FrIf
    FrIfGeneral: FrIfSafeBswChecks=1
