AUTOSAR XML (schema 00048)
# COPYRIGHT
# Copyright (c) 2021 by Vector Informatik GmbH. All rights reserved.
# This software is copyright protected and proprietary to Vector Informatik GmbH.
# Vector Informatik GmbH grants to you only those rights as set out in the license conditions.
package /MICROSAR
  bsw implementation FrIf_Impl
    resource consumption ResourceConsumption
      10 x memory section:
        FRIF_CODE: sw-addrmethod=CODE, symbol=CODE
        FRIF_APPL_CODE: sw-addrmethod=CALLOUT_CODE, symbol=CALLOUT_CODE
        FRIF_PBCFG: sw-addrmethod=CONST_PBCFG, symbol=PBCFG
        FRIF_PBCFG_ROOT: sw-addrmethod=PBCFG_GLOBALROOT, symbol=PBCFG_GLOBALROOT
        FRIF_CONST_32BIT: alignment=32, sw-addrmethod=CONST_32, symbol=CONST_32
        FRIF_CONST_UNSPECIFIED: alignment=UNSPECIFIED, sw-addrmethod=CONST_UNSPECIFIED, symbol=CONST_UNSPECIFIED
        FRIF_VAR_NOINIT_UNSPECIFIED: alignment=UNSPECIFIED, sw-addrmethod=VAR_NO_INIT_UNSPECIFIED, symbol=VAR_NOINIT_UNSPECIFIED
        FRIF_VAR_INIT_UNSPECIFIED: alignment=UNSPECIFIED, sw-addrmethod=VAR_INIT_UNSPECIFIED, symbol=VAR_INIT_UNSPECIFIED
        FRIF_ZERO_INIT_UNSPECIFIED: alignment=UNSPECIFIED, sw-addrmethod=VAR_CLEARED_UNSPECIFIED, symbol=VAR_CLEARED_UNSPECIFIED
        FRIF_VAR_PBCFG: sw-addrmethod=VAR_PBCFG, symbol=VAR_PBCFG
